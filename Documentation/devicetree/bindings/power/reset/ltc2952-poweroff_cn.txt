## Documentation/devicetree/bindings/power/rockchip,power-controller_cn.yaml
```yaml
# SPDX-许可证标识符: GPL-2.0
%YAML 1.2
---
$id: http://devicetree.org/schemas/power/rockchip,power-controller.yaml#
$schema: http://devicetree.org/meta-schemas/core.yaml#

标题: Rockchip 电源域

维护者:
  - 张庆 <zhangqing@rock-chips.com>
  - Heiko Stuebner <heiko@sntech.de>

描述: |
  Rockchip 处理器包括对多个电源域的支持，这些电源域可以根据不同的应用场景由软件进行上电/下电操作以节省电力。
  在 power-controller 节点内包含的电源域是通用电源域提供者，详细信息记录在
  文档/devicetree/bindings/power/power-domain.yaml 中。
属于某个电源域的 IP 核应该包含一个名为 "power-domains" 的属性，该属性是指向表示该域的电源域节点的句柄。
属性:
  $nodename:
    常量: power-controller

  compatible:
    枚举:
      - rockchip,px30-power-controller
      - rockchip,rk3036-power-controller
      - rockchip,rk3066-power-controller
      - rockchip,rk3128-power-controller
      - rockchip,rk3188-power-controller
      - rockchip,rk3228-power-controller
      - rockchip,rk3288-power-controller
      - rockchip,rk3328-power-controller
      - rockchip,rk3366-power-controller
      - rockchip,rk3368-power-controller
      - rockchip,rk3399-power-controller
      - rockchip,rk3568-power-controller
      - rockchip,rk3588-power-controller
      - rockchip,rv1126-power-controller

  "#power-domain-cells":
    常量: 1

  "#address-cells":
    常量: 1

  "#size-cells":
    常量: 0

必需:
  - compatible
  - "#power-domain-cells"

其他属性: false

模式属性:
  "^power-domain@[0-9a-f]+$":

    $引用: "#/$defs/pd-node"

    未评估属性: false

    属性:
      "#address-cells":
        常量: 1

      "#size-cells":
        常量: 0

    模式属性:
      "^power-domain@[0-9a-f]+$":

        $引用: "#/$defs/pd-node"

        未评估属性: false

        属性:
          "#address-cells":
            常量: 1

          "#size-cells":
            常量: 0

        模式属性:
          "^power-domain@[0-9a-f]+$":

            $引用: "#/$defs/pd-node"

            未评估属性: false

            属性:
              "#power-domain-cells":
                常量: 0

$defs:
  pd-node:
    类型: 对象
    描述: |
      表示 power 控制器节点内的电源域
属性:
      reg:
        最大项目数: 1
        描述: |
          电源域索引。有效值定义在
          "include/dt-bindings/power/px30-power.h"
          "include/dt-bindings/power/rk3036-power.h"
          "include/dt-bindings/power/rk3066-power.h"
          "include/dt-bindings/power/rk3128-power.h"
          "include/dt-bindings/power/rk3188-power.h"
          "include/dt-bindings/power/rk3228-power.h"
          "include/dt-bindings/power/rk3288-power.h"
          "include/dt-bindings/power/rk3328-power.h"
          "include/dt-bindings/power/rk3366-power.h"
          "include/dt-bindings/power/rk3368-power.h"
          "include/dt-bindings/power/rk3399-power.h"
          "include/dt-bindings/power/rk3568-power.h"
          "include/dt-bindings/power/rk3588-power.h"
          "include/dt-bindings/power/rockchip,rv1126-power.h"

      clocks:
        最小项目数: 1
        最大项目数: 30
        描述: |
          需要在电源域状态切换时启用的一组时钟句柄
pm_qos:
        $引用: /schemas/types.yaml#/definitions/phandle-array
        项目:
          最大项目数: 1
        描述: |
          需要在电源域状态切换时保存和恢复的一组 QoS 块句柄
"#power-domain-cells":
        枚举: [0, 1]
        描述:
          对于代表单个 PM 域的节点必须为 0，对于提供多个 PM 域的节点必须为 1
必需:
      - reg
      - "#power-domain-cells"

示例:
  - |
    #include <dt-bindings/clock/rk3399-cru.h>
    #include <dt-bindings/power/rk3399-power.h>

    soc {
        #address-cells = <2>;
        #size-cells = <2>;

        qos_hdcp: qos@ffa90000 {
            compatible = "rockchip,rk3399-qos", "syscon";
            reg = <0x0 0xffa90000 0x0 0x20>;
        };

        qos_iep: qos@ffa98000 {
            compatible = "rockchip,rk3399-qos", "syscon";
            reg = <0x0 0xffa98000 0x0 0x20>;
        };

        qos_rga_r: qos@ffab0000 {
            compatible = "rockchip,rk3399-qos", "syscon";
            reg = <0x0 0xffab0000 0x0 0x20>;
        };

        qos_rga_w: qos@ffab0080 {
            compatible = "rockchip,rk3399-qos", "syscon";
            reg = <0x0 0xffab0080 0x0 0x20>;
        };

        qos_video_m0: qos@ffab8000 {
            compatible = "rockchip,rk3399-qos", "syscon";
            reg = <0x0 0xffab8000 0x0 0x20>;
        };

        qos_video_m1_r: qos@ffac0000 {
            compatible = "rockchip,rk3399-qos", "syscon";
            reg = <0x0 0xffac0000 0x0 0x20>;
        };

        qos_video_m1_w: qos@ffac0080 {
            compatible = "rockchip,rk3399-qos", "syscon";
            reg = <0x0 0xffac0080 0x0 0x20>;
        };

        power-management@ff310000 {
            compatible = "rockchip,rk3399-pmu", "syscon", "simple-mfd";
            reg = <0x0 0xff310000 0x0 0x1000>;

            power-controller {
                compatible = "rockchip,rk3399-power-controller";
                #power-domain-cells = <1>;
                #address-cells = <1>;
                #size-cells = <0>;

                /* 这些电源域按 VD_CENTER 分组 */
                power-domain@RK3399_PD_IEP {
                    reg = <RK3399_PD_IEP>;
                    clocks = <&cru ACLK_IEP>,
                             <&cru HCLK_IEP>;
                    pm_qos = <&qos_iep>;
                    #power-domain-cells = <0>;
                };
                power-domain@RK3399_PD_RGA {
                    reg = <RK3399_PD_RGA>;
                    clocks = <&cru ACLK_RGA>,
                             <&cru HCLK_RGA>;
                    pm_qos = <&qos_rga_r>,
                             <&qos_rga_w>;
                    #power-domain-cells = <0>;
                };
                power-domain@RK3399_PD_VCODEC {
                    reg = <RK3399_PD_VCODEC>;
                    clocks = <&cru ACLK_VCODEC>,
                             <&cru HCLK_VCODEC>;
                    pm_qos = <&qos_video_m0>;
                    #power-domain-cells = <0>;
                };
                power-domain@RK3399_PD_VDU {
                    reg = <RK3399_PD_VDU>;
                    clocks = <&cru ACLK_VDU>,
                             <&cru HCLK_VDU>;
                    pm_qos = <&qos_video_m1_r>,
                             <&qos_video_m1_w>;
                    #power-domain-cells = <0>;
                };
                power-domain@RK3399_PD_VIO {
                    reg = <RK3399_PD_VIO>;
                    #power-domain-cells = <1>;
                    #address-cells = <1>;
                    #size-cells = <0>;

                    power-domain@RK3399_PD_HDCP {
                        reg = <RK3399_PD_HDCP>;
                        clocks = <&cru ACLK_HDCP>,
                                 <&cru HCLK_HDCP>,
                                 <&cru PCLK_HDCP>;
                        pm_qos = <&qos_hdcp>;
                        #power-domain-cells = <0>;
                    };
                };
            };
        };
    };
```

## Documentation/devicetree/bindings/power/rockchip-io-domain_cn.yaml
```yaml
# SPDX-许可证标识符: GPL-2.0
%YAML 1.2
---
$id: http://devicetree.org/schemas/power/rockchip-io-domain.yaml#
$schema: http://devicetree.org/meta-schemas/core.yaml#

标题: Rockchip SRAM 用于 IO 电压域

维护者:
  - Heiko Stuebner <heiko@sntech.de>

描述: |
  在某些 Rockchip 系统级芯片 (SoC) 上，IO 域的电压是可变的，但需要与稳压器和 SoC 使用特殊寄存器保持同步。
一个具体的例子使用 rk3288：
    如果连接到像 SDMMC0_VDD 这样的引脚上的稳压器为 3.3V，则 GRF_IO_VSEL 的第 7 位需要为 0。如果连接到该引脚的稳压器为 1.8V，则 GRF_IO_VSEL 的第 7 位需要为 1。
换句话说，此驱动程序仅处理保持 SoC 中通用寄存器文件 (GRF) 中的位与连接到引脚的实际电压值同步。
请注意，此驱动程序明确不包括以下内容：
    任何关于应将稳压器设置为何种电压的逻辑；
    任何关于稳压器（或内部 SoC 模块）是否应该有电或不应该有电的逻辑。

  如果有其他软件具有决定稳压器的智能，它将与此驱动程序协同工作。当该其他软件调整稳压器电压时，此驱动程序会处理告知 SoC 这一变化。一个很好的例子是 vqmmc 对于 SD。在这种情况下，dw_mmc 驱动程序仅仅被告知了一个稳压器。它在正确的时间在 3.3V 和 1.8V 之间改变稳压器。此驱动程序注意到这种变化并确保 SoC 了解这一变化。
您使用标准稳压器绑定来指定供电，方法是在相关稳压器中包含一个 phandle。所有指定的供电都必须能够报告其电压。对于未指定的任何供电的 IO 电压域将不会被触碰。
属性:
  compatible:
    枚举:
      - rockchip,px30-io-voltage-domain
      - rockchip,px30-pmu-io-voltage-domain
      - rockchip,rk3188-io-voltage-domain
      - rockchip,rk3228-io-voltage-domain
      - rockchip,rk3288-io-voltage-domain
      - rockchip,rk3328-io-voltage-domain
      - rockchip,rk3368-io-voltage-domain
      - rockchip,rk3368-pmu-io-voltage-domain
      - rockchip,rk3399-io-voltage-domain
      - rockchip,rk3399-pmu-io-voltage-domain
      - rockchip,rk3568-pmu-io-voltage-domain
      - rockchip,rv1108-io-voltage-domain
      - rockchip,rv1108-pmu-io-voltage-domain
      - rockchip,rv1126-pmu-io-voltage-domain

必需:
  - compatible

未评估的属性: false

allOf:
  - $ref: "#/$defs/px30"
  - $ref: "#/$defs/px30-pmu"
  - $ref: "#/$defs/rk3188"
  - $ref: "#/$defs/rk3228"
  - $ref: "#/$defs/rk3288"
  - $ref: "#/$defs/rk3328"
  - $ref: "#/$defs/rk3368"
  - $ref: "#/$defs/rk3368-pmu"
  - $ref: "#/$defs/rk3399"
  - $ref: "#/$defs/rk3399-pmu"
  - $ref: "#/$defs/rk3568-pmu"
  - $ref: "#/$defs/rv1108"
  - $ref: "#/$defs/rv1108-pmu"
  - $ref: "#/$defs/rv1126-pmu"

$defs:
  px30:
    if:
      属性:
        compatible:
          包含:
            常量: rockchip,px30-io-voltage-domain

    then:
      属性:
        vccio1-supply:
          描述: 连接到 VCCIO1 的供电
        vccio2-supply:
          描述: 连接到 VCCIO2 的供电
        vccio3-supply:
          描述: 连接到 VCCIO3 的供电
        vccio4-supply:
          描述: 连接到 VCCIO4 的供电
        vccio5-supply:
          描述: 连接到 VCCIO5 的供电
下面是您提供的内容翻译成中文：

`vccio6-supply`:
  描述: 连接到 VCCIO6 的供电

`vccio-oscgpi-supply`:
  描述: 连接到 VCCIO_OSCGPI 的供电

`px30-pmu`:
  如果:
    属性:
      兼容性:
        包含:
          常量: rockchip,px30-pmu-io-voltage-domain

  那么:
    属性:
      `pmuio1-supply`:
        描述: 连接到 PMUIO1 的供电

`pmuio2-supply`:
  描述: 连接到 PMUIO2 的供电

`rk3188`:
  如果:
    属性:
      兼容性:
        包含:
          常量: rockchip,rk3188-io-voltage-domain

  那么:
    属性:
      `ap0-supply`:
        描述: 连接到 AP0_VCC 的供电

`ap1-supply`:
  描述: 连接到 AP1_VCC 的供电

`cif-supply`:
  描述: 连接到 CIF_VCC 的供电

`flash-supply`:
  描述: 连接到 FLASH_VCC 的供电

`lcdc0-supply`:
  描述: 连接到 LCD0_VCC 的供电

`lcdc1-supply`:
  描述: 连接到 LCD1_VCC 的供电
下面是给定内容的中文翻译：

`vccio0-supply`:
   描述: 连接到 VCCIO0 的电源供应

`vccio1-supply`:
   描述: 连接到 VCCIO1 的电源供应。同时也标记为 VCCIO2
`rk3228`:
   如果:
     属性:
       compatible:
         包含:
           常量: rockchip,rk3228-io-voltage-domain

   那么:
     属性:
       `vccio1-supply`:
         描述: 连接到 VCCIO1 的电源供应
`vccio2-supply`:
   描述: 连接到 VCCIO2 的电源供应
`vccio3-supply`:
   描述: 连接到 VCCIO3 的电源供应
`vccio4-supply`:
   描述: 连接到 VCCIO4 的电源供应
`rk3288`:
   如果:
     属性:
       compatible:
         包含:
           常量: rockchip,rk3288-io-voltage-domain

   那么:
     属性:
       `audio-supply`:
         描述: 连接到 APIO4_VDD 的电源供应
`bb-supply`:
   描述: 连接到 APIO5_VDD 的电源供应
`dvp-supply`:
   描述: 连接到 DVPIO_VDD 的电源供应
`flash0-supply`:
   描述: 连接到 FLASH0_VDD 的电源供应。通常用于 eMMC
以下是您提供的内容翻译成中文：

`flash1-supply`：
   描述：连接到 `FLASH1_VDD` 的供电。也被称为 `SDIO1`。

`gpio30-supply`：
   描述：连接到 `APIO1_VDD` 的供电。

`gpio1830-supply`：
   描述：连接到 `APIO2_VDD` 的供电。

`lcdc-supply`：
   描述：连接到 `LCDC_VDD` 的供电。

`sdcard-supply`：
   描述：连接到 `SDMMC0_VDD` 的供电。

`wifi-supply`：
   描述：连接到 `APIO3_VDD` 的供电。也被称为 `SDIO0`。

对于 `rk3328` 部分：

如果：
  属性：
    `compatible`：
      包含：
        常量：`rockchip,rk3328-io-voltage-domain`

那么：
  属性：
    `vccio1-supply`：
      描述：连接到 `VCCIO1` 的供电。
    
    `vccio2-supply`：
      描述：连接到 `VCCIO2` 的供电。
      
    `vccio3-supply`：
      描述：连接到 `VCCIO3` 的供电。
      
    `vccio4-supply`：
      描述：连接到 `VCCIO4` 的供电。
以下是提供的描述翻译为中文：

`vccio5-supply`:
   描述: 连接到 VCCIO5 的供电

`vccio6-supply`:
   描述: 连接到 VCCIO6 的供电

`pmuio-supply`:
   描述: 连接到 VCCIO_PMU 的供电

对于 `rk3368`:
   如果:
     属性:
       `compatible`:
         包含:
           常量: `rockchip,rk3368-io-voltage-domain`

   那么:
     属性:
       `audio-supply`:
         描述: 连接到 APIO3_VDD 的供电
       
       `dvp-supply`:
         描述: 连接到 DVPIO_VDD 的供电

       `flash0-supply`:
         描述: 连接到 FLASH0_VDD 的供电。通常用于 eMMC

       `gpio30-supply`:
         描述: 连接到 APIO1_VDD 的供电

       `gpio1830-supply`:
         描述: 连接到 APIO4_VDD 的供电

       `sdcard-supply`:
         描述: 连接到 SDMMC0_VDD 的供电

       `wifi-supply`:
         描述: 连接到 APIO2_VDD 的供电。也称为 SDIO0
以下是给定内容的中文翻译：

### rk3368-pmu:
**如果：**
- 属性：
  - 兼容性：
    - 包含：
      - 常量: `rockchip,rk3368-pmu-io-voltage-domain`

**那么：**
- 属性：
  - `pmu-supply`:
    - 描述: 连接到PMUIO_VDD的供电
  - `vop-supply`:
    - 描述: 连接到LCDC_VDD的供电

### rk3399:
**如果：**
- 属性：
  - 兼容性：
    - 包含：
      - 常量: `rockchip,rk3399-io-voltage-domain`

**那么：**
- 属性：
  - `audio-supply`:
    - 描述: 连接到APIO5_VDD的供电
  - `bt656-supply`:
    - 描述: 连接到APIO2_VDD的供电
  - `gpio1830-supply`:
    - 描述: 连接到APIO4_VDD的供电
  - `sdmmc-supply`:
    - 描述: 连接到SDMMC0_VDD的供电

### rk3399-pmu:
**如果：**
- 属性：
  - 兼容性：
    - 包含：
      - 常量: `rockchip,rk3399-pmu-io-voltage-domain`

**那么：**
- 属性：
  - `pmu1830-supply`:
    - 描述: 连接到PMUIO2_VDD的供电

### rk3568-pmu:
**如果：**
- 属性：
  - 兼容性：
    - 包含：
      - 常量: `rockchip,rk3568-pmu-io-voltage-domain`

**那么：**
- 属性：
  - `pmuio1-supply`:
    - 描述: 连接到PMUIO1的供电
  - `pmuio2-supply`:
    - 描述: 连接到PMUIO2的供电
  - `vccio1-supply`:
    - 描述: 连接到VCCIO1的供电
这段描述可以翻译为如下中文：

`vccio2-supply:`  
  描述: 连接到 VCCIO2 的供电  

`vccio3-supply:`  
  描述: 连接到 VCCIO3 的供电  

`vccio4-supply:`  
  描述: 连接到 VCCIO4 的供电  

`vccio5-supply:`  
  描述: 连接到 VCCIO5 的供电  

`vccio6-supply:`  
  描述: 连接到 VCCIO6 的供电  

`vccio7-supply:`  
  描述: 连接到 VCCIO7 的供电  

对于 RV1108:  
  如果:  
    属性:  
      兼容性:  
        包含:  
          常量: rockchip,rv1108-io-voltage-domain  

  那么:  
    属性:  
      `vccio1-supply:`  
        描述: 连接到 APIO1_VDD 的供电  
      `vccio2-supply:`  
        描述: 连接到 APIO2_VDD 的供电  
      `vccio3-supply:`  
        描述: 连接到 APIO3_VDD 的供电  
      `vccio5-supply:`  
        描述: 连接到 APIO5_VDD 的供电  

注意：在原文中，`vccio4-supply` 和 `vccio6-supply` 在 RV1108 的部分没有被提及，因此这部分翻译中也没有包括这两个供电的描述。如果需要对这些内容进行补充，请提供更多的上下文信息。
下面是您提供的内容翻译成中文的版本：

`vccio6-supply`:
    描述: 连接到`APIO6_VDD`的电源供应

`rv1108-pmu`:
    如果:
      属性:
        compatible:
          包含:
            常量: `rockchip,rv1108-pmu-io-voltage-domain`

    那么:
      属性:
        `pmu-supply`:
          描述: 连接到`PMUIO_VDD`的电源供应

`rv1126-pmu`:
    如果:
      属性:
        compatible:
          包含:
            常量: `rockchip,rv1126-pmu-io-voltage-domain`

    那么:
      属性:
        `vccio1-supply`:
          描述: 连接到`VCCIO1`的电源供应
          
`vccio2-supply`:
    描述: 连接到`VCCIO2`的电源供应

`vccio3-supply`:
    描述: 连接到`VCCIO3`的电源供应

`vccio4-supply`:
    描述: 连接到`VCCIO4`的电源供应

`vccio5-supply`:
    描述: 连接到`VCCIO5`的电源供应

`vccio6-supply`:
    描述: 连接到`VCCIO6`的电源供应

`vccio7-supply`:
    描述: 连接到`VCCIO7`的电源供应

`pmuio0-supply`:
    描述: 连接到`PMUIO0`的电源供应
这段文本描述了一个设备树片段，用于配置一个特定的硬件平台（在这个例子中是基于 Rockchip RK3288 的系统）中的 I/O 电压域。下面是该文本的中文翻译：

`pmuio1-supply`:
  描述: 连接到 PMUIO1 的电源供应
示例:
  - |
    io-domains {
      兼容性 = "rockchip,rk3288-io-voltage-domain";
      音频电源 = <&vcc18_codec>;
      BB 电源 = <&vcc33_io>;
      DVP 电源 = <&vcc_18>;
      闪存0电源 = <&vcc18_flashio>;
      GPIO1830 电源 = <&vcc33_io>;
      GPIO30 电源 = <&vcc33_pmuio>;
      LCD 控制器电源 = <&vcc33_lcd>;
      SD 卡电源 = <&vccio_sd>;
      Wi-Fi 电源 = <&vcc18_wl>;
    };

这里每个 `supply` 都代表一个特定的电源供应，为不同的硬件组件提供所需的电压。例如，`音频电源` 是指为音频部分供电的电源，而 `BB 电源` 则可能为基带或某些 I/O 接口供电等。这些电源配置对于确保硬件正常工作非常重要。
```

## Documentation/devicetree/bindings/power/starfive,jh7110-pmu_cn.yaml
~~~~yaml
```yaml
# SPDX-许可证标识符: (GPL-2.0-only 或 BSD-2-Clause)
%YAML 1.2
---
$id: http://devicetree.org/schemas/power/starfive,jh7110-pmu.yaml#
$schema: http://devicetree.org/meta-schemas/core.yaml#

title: StarFive JH7110 电源管理单元

maintainers:
  - Walker Chen <walker.chen@starfivetech.com>

description: |
  StarFive JH7110 系统芯片支持多个电源域，可以根据不同的应用场景通过软件控制其开/关以节省电能。

properties:
  compatible:
    enum:
      - starfive,jh7110-pmu

  reg:
    maxItems: 1

  interrupts:
    maxItems: 1

  "#power-domain-cells":
    const: 1

required:
  - compatible
  - reg
  - interrupts
  - "#power-domain-cells"

additionalProperties: false

examples:
  - |
    pwrc: power-controller@17030000 {
        compatible = "starfive,jh7110-pmu";
        reg = <0x17030000 0x10000>;
        interrupts = <111>;
        #power-domain-cells = <1>;
    };
```

以上是将给定的 YAML 文档翻译成了中文版本。请注意，某些专业术语和缩写词（如“SPDX-许可证标识符”、“$schema”等）保持了英文形式，因为这些术语在中文环境中通常也使用英文表达。
~~~~
