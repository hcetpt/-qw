## Documentation/devicetree/bindings/power/reset/ltc2952-poweroff_cn.txt
```
LTC2952 PowerPath 控制器的绑定

此芯片用于外部触发系统关闭。一旦触发信号被发送，需要重置芯片的看门狗以优雅地关闭系统。
完整的电源关闭可以通过 kill 信号触发。
必需属性：

- compatible: 必须包含："lltc,ltc2952"
- watchdog-gpios: 芯片看门狗线所连接的GPIO的句柄和GPIO指定符
- kill-gpios: 芯片kill线所连接的GPIO的句柄和GPIO指定符

可选属性：
- trigger-gpios: 芯片触发线所连接的GPIO的句柄和GPIO指定符。如果未设置此属性，则忽略触发功能，并且在接收到明确的kill信号之前保持芯片处于活动状态
- trigger-delay-ms: 在执行关机过程前，在触发线被激活后等待的毫秒数。默认值为2500ms

示例：

ltc2952 {
	compatible = "lltc,ltc2952";

	trigger-gpios = <&gpio0 1 GPIO_ACTIVE_LOW>;
	trigger-delay-ms = <2000>;
	watchdog-gpios = <&gpio1 2 GPIO_ACTIVE_HIGH>;
	kill-gpios = <&gpio0 2 GPIO_ACTIVE_LOW>;
};
```

## Documentation/devicetree/bindings/power/reset/mt6323-poweroff_cn.txt
```
针对MediaTek电源管理集成电路 (PMIC) 上的电源控制器的设备树绑定

在PMIC上找到的电源控制器负责通过BBPU电路对外部的远程MediaTek系统级芯片 (SoC) 进行上电或断电操作。
必需的属性：
- compatible: 应该是以下选项之一
       "mediatek,mt6323-pwrc": 适用于MT6323 PMIC

示例：

       pmic {
               compatible = "mediatek,mt6323";

               ..
power-controller {
                       compatible = "mediatek,mt6323-pwrc";
               };
       }
```

## Documentation/devicetree/bindings/power/reset/nvmem-reboot-mode_cn.yaml
```yaml
# SPDX-许可证标识符: (GPL-2.0-only 或 BSD-2-Clause)
%YAML 1.2
---
$id: http://devicetree.org/schemas/power/reset/nvmem-reboot-mode.yaml#
$schema: http://devicetree.org/meta-schemas/core.yaml#

title: 通用 NVMEM 重启模式

maintainers:
  - Bartosz Golaszewski <bartosz.golaszewski@linaro.org>

description:
  该驱动程序从重启模式驱动程序获取重启模式的魔法值，并将其存储在名为 "reboot-mode" 的 NVMEM 单元中。然后，引导加载程序可以读取它，并根据该值采取不同的行动。

properties:
  compatible:
    const: nvmem-reboot-mode

  nvmem-cells:
    description:
      指向存储表示重启模式的供应商特定魔法值的 nvmem-cells 节点的 phandle
maxItems: 1

  nvmem-cell-names:
    items:
      - const: reboot-mode

allOf:
  - $ref: reboot-mode.yaml#

required:
  - compatible
  - nvmem-cells
  - nvmem-cell-names

unevaluatedProperties: false

examples:
  - |
    reboot-mode {
        compatible = "nvmem-reboot-mode";
        nvmem-cells = <&reboot_reason>;
        nvmem-cell-names = "reboot-mode";
        mode-recovery = <0x01>;
        mode-bootloader = <0x02>;
    };
```

## Documentation/devicetree/bindings/power/reset/ocelot-reset_cn.txt
~~~~
Microsemi Ocelot 重置控制器

DEVCPU_GCB:CHIP_REGS 中有一个名为 SOFT_RST 的寄存器，可以用来重置 SoC 核心。
这些重置寄存器同时存在于 MSCC vcoreiii MIPS 和 microchip Sparx5 armv8 SoC 中。
所需属性：

- compatible: "mscc,ocelot-chip-reset", "mscc,luton-chip-reset",
  "mscc,jaguar2-chip-reset" 或 "microchip,sparx5-chip-reset"

示例：
```plaintext
reset@1070008 {
	compatible = "mscc,ocelot-chip-reset";
	reg = <0x1070008 0x4>;
};
```
这段示例代码定义了一个位于地址 `0x1070008` 处的重置控制器，并且指定了其兼容性为 "mscc,ocelot-chip-reset"。
~~~~

## Documentation/devicetree/bindings/power/reset/qcom,pon_cn.yaml
```yaml
# SPDX-文件许可人: (GPL-2.0 或 BSD-2-Clause)
%YAML 1.2
---
$id: http://devicetree.org/schemas/power/reset/qcom,pon.yaml#
$schema: http://devicetree.org/meta-schemas/core.yaml#

标题: 高通 PON 设备

维护者:
  - Vinod Koul <vkoul@kernel.org>

描述: |
  对于高通 PM8xxx 的电源开启设备是一个支持 pwrkey
  和 resin 以及 Android 重启模式的多功功能设备 (MFD)
  此设备树节点有 pwrkey 和 resin 作为子节点
属性:
  compatible:
    枚举:
      - qcom,pm8916-pon
      - qcom,pm8941-pon
      - qcom,pms405-pon
      - qcom,pm8998-pon
      - qcom,pmk8350-pon

  reg:
    描述: |
      指定 PON (开机) 周边设备的 SPMI 基地址。对于
      拥有将 PON 周边设备 (GEN3) 分为 PON_HLOS 和 PON_PBS
      (例如 PMK8350) 的电源管理 IC，此属性可以包含
      两个 PON_HLOS 和 PON_PBS 周边设备的地址。在这种情况下，
      必须指定 PON_PBS 地址以便在某些电源管理 IC 上实现软件防抖动。
最小项数: 1
    最大项数: 2

  reg-names:
    最小项数: 1
    最大项数: 2

  pwrkey:
    类型: 对象
    $ref: /schemas/input/qcom,pm8941-pwrkey.yaml#

  resin:
    类型: 对象
    $ref: /schemas/input/qcom,pm8941-pwrkey.yaml#

  watchdog:
    类型: 对象
    $ref: /schemas/watchdog/qcom,pm8916-wdt.yaml

必需:
  - compatible
  - reg

未评估属性: false

allOf:
  - 如果:
      属性:
        compatible:
          包含:
            枚举:
              - qcom,pm8916-pon
              - qcom,pms405-pon
              - qcom,pm8998-pon
    然后:
      allOf:
        - $ref: reboot-mode.yaml#

      属性:
        reg:
          最大项数: 1
        reg-names:
          项:
            - 常量: pon

    # 特殊情况适用于 pm8941，它不存储重置模式
  - 如果:
      属性:
        compatible:
          包含:
            常量: qcom,pm8941-pon
    然后:
      属性:
        reg:
          最大项数: 1
        reg-names:
          项:
            - 常量: pon

  - 如果:
      属性:
        compatible:
          包含:
            常量: qcom,pmk8350-pon
    然后:
      属性:
        reg:
          最小项数: 1
          最大项数: 2
        reg-names:
          最小项数: 1
          项:
            - 常量: hlos
            - 常量: pbs

示例:
  - |
   #include <dt-bindings/interrupt-controller/irq.h>
   #include <dt-bindings/input/linux-event-codes.h>
   #include <dt-bindings/spmi/spmi.h>

   spmi@c440000 {
     reg = <0x0c440000 0x1100>;
     #address-cells = <2>;
     #size-cells = <0>;

     pmic@0 {
       reg = <0x0 SPMI_USID>;
       #address-cells = <1>;
       #size-cells = <0>;

       pon@800 {
         compatible = "qcom,pm8998-pon";
         reg = <0x800>;

         pwrkey {
            compatible = "qcom,pm8941-pwrkey";
            interrupts = <0x0 0x8 0 IRQ_TYPE_EDGE_BOTH>;
            debounce = <15625>;
            bias-pull-up;
            linux,code = <KEY_POWER>;
         };

         resin {
            compatible = "qcom,pm8941-resin";
            interrupts = <0x0 0x8 1 IRQ_TYPE_EDGE_BOTH>;
            debounce = <15625>;
            bias-pull-up;
            linux,code = <KEY_VOLUMEDOWN>;
         };
       };
     };
   };
..
```

## Documentation/devicetree/bindings/power/reset/qcom,pshold_cn.yaml
```yaml
# SPDX-许可证标识符: GPL-2.0-only 或 BSD-2-Clause
%YAML 1.2
---
$id: http://devicetree.org/schemas/power/reset/qcom,pshold.yaml#
$schema: http://devicetree.org/meta-schemas/core.yaml#

标题: 高通 SoC 重启和关机

维护者:
  - Bjorn Andersson <bjorn.andersson@linaro.org>

描述:
  一个电源供应保持 (ps-hold) 位被设置以供电给高通芯片组。
清除该位允许我们进行重启/关机。重启与关机之间的区别由特定的电源管理 IC 设置决定。
属性:
  compatible:
    常量: qcom,pshold

  reg:
    最大项数: 1

必需:
  - compatible
  - reg

额外属性: false

示例:
  - |
    reset-controller@fc4ab000 {
        compatible = "qcom,pshold";
        reg = <0xfc4ab000 0x4>;
    };
```

## Documentation/devicetree/bindings/power/reset/qnap-poweroff_cn.txt
```
* QNAP 关机

QNAP NAS 设备有一个微控制器来控制主电源供应。这个微控制器连接到了 Kirkwood 和 Orion5x 系统芯片（SoC）上的 UART1。发送字符 'A'，以 19200 波特率进行通信，会指示微控制器关闭电源。
群晖（Synology）NAS 设备使用了类似的方案，但采用了不同的波特率，即 9600，以及不同的字符，即 '1'。
必需的属性：
- compatible（兼容性）: 应该是 "qnap,power-off" 或者 "synology,power-off"

- reg（寄存器）: UART1 寄存器集的地址和长度
- clocks（时钟）: tclk 时钟
```

## Documentation/devicetree/bindings/power/reset/reboot-mode_cn.yaml
~~~~yaml
下面是给定内容的中文翻译：

```yaml
# SPDX-文件许可人: (GPL-2.0-only 或 BSD-2-Clause)
%YAML 1.2
---
$id: http://devicetree.org/schemas/power/reset/reboot-mode.yaml#
$schema: http://devicetree.org/meta-schemas/core.yaml#

title: 通用重启模式核心映射

maintainers:
  - Andy Yan <andy.yan@rock-chips.com>

description: |
  本驱动程序获取重启模式参数，并调用写接口将魔法值存储在特定寄存器或RAM中。
  然后，引导加载程序可以读取该值，并根据所存储的参数采取不同的行动。
所有模式属性都是供应商特定的，它指示引导加载程序在系统重启时应执行的操作，
并且应该命名为 mode-xxx = <magic>（xxx 是模式名称，magic 应是一个非零值）。
例如，在 Android 平台上常见的模式包括：
    - normal: 正常重启模式，通过命令 "reboot" 重启系统
- recovery: Android 恢复模式，这是一种用于格式化设备或更新新镜像的模式
- bootloader: Android 快速启动模式，这是一种用于重新刷新基于 Android 的设备上的分区的模式
- loader: 引导加载模式，这是一种用于在 Rockchip 平台上下载镜像的模式，
           通常在开发中使用
properties:
  mode-normal:
    $ref: /schemas/types.yaml#/definitions/uint32
    description:
      如果没有提供命令，则在重启时设置的默认值
patternProperties:
  "^mode-.*$":
    $ref: /schemas/types.yaml#/definitions/uint32

additionalProperties: true

examples:
  - |
    reboot-mode {
      mode-normal = <0>;
      mode-recovery = <1>;
      mode-bootloader = <2>;
      mode-loader = <3>;
    };
```
```
~~~~

## Documentation/devicetree/bindings/power/reset/regulator-poweroff_cn.yaml
```yaml
# SPDX-许可证标识符: (GPL-2.0-only 或 BSD-2-Clause)
%YAML 1.2
---
$id: http://devicetree.org/schemas/power/reset/regulator-poweroff.yaml#
$schema: http://devicetree.org/meta-schemas/core.yaml#

title: 强制禁用电源调节器以关闭电源
maintainers:
  - Michael Klein <michael@fossekall.de>

description: |
  当调用电源关闭处理器时，通过调用 regulator_force_disable() 来禁用一个电源调节器。
  如果在 3000 毫秒的延迟后电源仍然开启且 CPU 仍在运行，则会发出警告。

properties:
  compatible:
    const: regulator-poweroff

  cpu-supply:
    description:
      在电源下降时要禁用的调节器

required:
  - compatible
  - cpu-supply

additionalProperties: false

examples:
  - |
    regulator-poweroff {
        compatible = "regulator-poweroff";
        cpu-supply = <&reg_vcc1v2>;
    };
```

## Documentation/devicetree/bindings/power/reset/st-reset_cn.txt
~~~~
针对ST（意法半导体）SW复位功能的设备树绑定。

所需属性：
- compatible（兼容性）：应为 "stih407-restart"
- st,syscfg：应为 syscfg 节点的句柄
示例节点：
``` 
restart {
	compatible = "st,stih407-restart";
	st,syscfg = <&syscfg_sbc_reg>;
};
```
这段描述了在设备树中如何定义与意法半导体（ST）特定硬件相关的软件复位功能。通过这种方式，操作系统或固件可以正确识别并利用这些硬件特性来执行复位操作。
~~~~

## Documentation/devicetree/bindings/power/reset/syscon-poweroff_cn.yaml
```yaml
# SPDX-许可证标识符: GPL-2.0
%YAML 1.2
---
$id: http://devicetree.org/schemas/power/reset/syscon-poweroff.yaml#
$schema: http://devicetree.org/meta-schemas/core.yaml#

标题: 通用 SYSCON 映射寄存器关机驱动程序

维护者:
  - Sebastian Reichel <sre@kernel.org>

描述: |+
  这是一个使用 syscon 映射关机寄存器的通用关机驱动程序。
  通常通过向由 syscon 引用所指向的寄存器映射加上偏移量定义的关机寄存器写入值来执行关机操作，
  其中值和掩码由关机节点定义。
  默认情况下为小端模式，仅支持 32 位访问。
  SYSCON 寄存器映射通常从父 dt 节点获取。因此，
  SYSCON 关机节点应该作为 "syscon" 或 "simple-mfd" 节点的子节点表示。
属性:
  compatible:
    常量: syscon-poweroff

  mask:
    $ref: /schemas/types.yaml#/definitions/uint32
    描述: 更新由掩码（32 位）定义的寄存器位
  offset:
    $ref: /schemas/types.yaml#/definitions/uint32
    描述: 在寄存器映射中关机寄存器的偏移量（以字节为单位）
  regmap:
    $ref: /schemas/types.yaml#/definitions/phandle
    已弃用: true
    描述:
      寄存器映射节点的 phandle。此属性已弃用，取而代之的是使 syscon-poweroff 节点成为系统控制器节点的子节点
  value:
    $ref: /schemas/types.yaml#/definitions/uint32
    描述: 写入到关机寄存器的关机值（32 位访问）

必需:
  - compatible
  - offset

其他属性: false

allOf:
  - 如果:
      不:
        必需:
          - mask
    然后:
      必需:
        - value

示例:
  - |
    poweroff {
        compatible = "syscon-poweroff";
        offset = <0x0>;
        mask = <0x7a>;
    };
```

## Documentation/devicetree/bindings/power/reset/syscon-reboot-mode_cn.yaml
```yaml
# SPDX-许可证标识符: GPL-2.0-only
%YAML 1.2
---
$id: http://devicetree.org/schemas/power/reset/syscon-reboot-mode.yaml#
$schema: http://devicetree.org/meta-schemas/core.yaml#

标题: 通用 SYSCON 重启模式驱动程序

维护者:
  - Sebastian Reichel <sre@kernel.org>

描述: |
  此驱动程序从重启模式驱动程序获取重启模式的魔法值，
  并将其存储在映射到SYSCON的寄存器中。然后，引导加载程序
  可以读取它，并根据存储的魔法值采取不同的行动。
  映射到SYSCON的寄存器通过父dt节点加上偏移量来获取。
  因此，SYSCON重启模式节点应该表示为“syscon”、“simple-mfd”节点的子节点。

属性:
  compatible:
    常量: syscon-reboot-mode

  mask:
    $ref: /schemas/types.yaml#/definitions/uint32
    描述: 仅更新由掩码(32位)定义的寄存器位

  offset:
    $ref: /schemas/types.yaml#/definitions/uint32
    描述: 模式寄存器在寄存器映射中的偏移量（以字节为单位）

allOf:
  - $ref: reboot-mode.yaml#

未评估的属性: false

必需:
  - compatible
  - offset

示例:
  - |
    #include <dt-bindings/soc/rockchip,boot-mode.h>

    reboot-mode {
      compatible = "syscon-reboot-mode";
      offset = <0x40>;
      mode-normal = <BOOT_NORMAL>;
      mode-recovery = <BOOT_RECOVERY>;
      mode-bootloader = <BOOT_FASTBOOT>;
      mode-loader = <BOOT_BL_DOWNLOAD>;
    };
```

## Documentation/devicetree/bindings/power/reset/syscon-reboot_cn.yaml
```yaml
# SPDX-许可证标识符: GPL-2.0
%YAML 1.2
---
$id: http://devicetree.org/schemas/power/reset/syscon-reboot.yaml#
$schema: http://devicetree.org/meta-schemas/core.yaml#

标题: 通用 SYSCON 映射寄存器复位驱动程序

维护者:
  - Sebastian Reichel <sre@kernel.org>

描述: |+
  这是一个使用 SYSCON 映射复位寄存器的通用复位驱动程序。
  复位通常通过向由 SYSCON 寄存器映射基址加上偏移量定义的复位寄存器写入来执行，值和掩码在重启节点中定义。
  默认情况下为小端模式，仅支持 32 位访问。SYSCON 寄存器映射通常从父 dt 节点获取。因此，SYSCON 重启节点应作为“syscon”、“simple-mfd”节点的子节点表示。尽管指向系统控制器节点的 regmap 属性也得到支持。

属性:
  compatible:
    常量: syscon-reboot

  mask:
    $ref: /schemas/types.yaml#/definitions/uint32
    描述: 更新由掩码（32 位）定义的寄存器位
  offset:
    $ref: /schemas/types.yaml#/definitions/uint32
    描述: 在寄存器映射中用于重启寄存器的偏移量（以字节为单位）
  regmap:
    $ref: /schemas/types.yaml#/definitions/phandle
    已废弃: true
    描述: |
      指向寄存器映射节点的 phandle。此属性已被废弃，取而代之的是将 syscon-reboot 节点作为系统控制器节点的子节点
  value:
    $ref: /schemas/types.yaml#/definitions/uint32
    描述: 写入到重启寄存器的复位值（32 位访问）
  priority:
    默认: 192

必需:
  - compatible
  - offset

额外属性: false

allOf:
  - $ref: restart-handler.yaml#
  - if:
      not:
        必需:
          - mask
    then:
      必需:
        - value

示例:
  - |
    reboot {
        compatible = "syscon-reboot";
        regmap = <&regmapnode>;
        offset = <0x0>;
        mask = <0x1>;
    };
```

## Documentation/devicetree/bindings/power/reset/xlnx,zynqmp-power_cn.yaml
```yaml
# SPDX-许可证标识符: (GPL-2.0-only 或 BSD-2-Clause)
%YAML 1.2
---
$id: http://devicetree.org/schemas/power/reset/xlnx,zynqmp-power.yaml#
$schema: http://devicetree.org/meta-schemas/core.yaml#

标题: Xilinx Zynq MPSoC 电源管理

维护者:
  - Michal Simek <michal.simek@amd.com>

描述: |
  zynqmp-power 节点描述了电源管理配置。
  它将控制远程挂起/关机接口。

属性:
  compatible:
    常量: xlnx,zynqmp-power

  interrupts:
    最大项数: 1

  mboxes:
    描述: |
      标准属性用于指定邮箱。mboxes 属性的每个值应包含指向邮箱控制器设备节点的 phandle 和一个参数指定符，
      这个指定符将是用于通信的预期子邮箱节点的 phandle。有关通用邮箱控制器和客户端驱动程序绑定的更多详细信息，请参阅
      文档/devicetree/bindings/mailbox/mailbox.txt。有关通常用于与本系统控制器通信的控制器的更多信息，请参阅
      文档/devicetree/bindings/mailbox/xlnx,zynqmp-ipi-mailbox.txt。
    项:
      - 描述: 发送通道
      - 描述: 接收通道

  mbox-names:
    描述:
      在 'mboxes' 属性中看到的通道名称
    项:
      - 常量: tx
      - 常量: rx

必需:
  - compatible
  - interrupts

额外属性: false

示例:
  - |+

    // 使用中断方法的示例：

    firmware {
      zynqmp-firmware {
        power-management {
          compatible = "xlnx,zynqmp-power";
          interrupts = <0 35 4>;
        };
      };
    };

  - |+

    // 使用 IPI 邮箱方法的示例：

    firmware {
      zynqmp-firmware {
        power-management {
          compatible = "xlnx,zynqmp-power";
          interrupt-parent = <&gic>;
          interrupts = <0 35 4>;
          mboxes = <&ipi_mailbox_pmu1 0>,
                   <&ipi_mailbox_pmu1 1>;
          mbox-names = "tx", "rx";
        };
      };
    };
```
