## Documentation/devicetree/bindings/power/supply/active-semi,act8945a-charger_cn.yaml
~~~~yaml
```yaml
# SPDX-文件许可标识: GPL-2.0
%YAML 1.2
---
$id: http://devicetree.org/schemas/power/supply/active-semi,act8945a-charger.yaml#
$schema: http://devicetree.org/meta-schemas/core.yaml#

title: Active-semi ACT8945A 充电器功能

maintainers:
  - Sebastian Reichel <sre@kernel.org>

allOf:
  - $ref: power-supply.yaml#

properties:
  compatible:
    const: active-semi,act8945a-charger

  interrupts:
    maxItems: 1

  active-semi,chglev-gpios:
    maxItems: 1
    description: 充电电流等级 GPIO

  active-semi,lbo-gpios:
    maxItems: 1
    description: 低电池电压检测 GPIO

  active-semi,input-voltage-threshold-microvolt:
    description: |
      指定充电器的输入过压阈值，尽管名称中使用微伏（μV），实际指定的单位是毫伏（mV）
      默认为 6.6 V
    enum: [ 6600, 7000, 7500, 8000 ]

  active-semi,precondition-timeout:
    $ref: /schemas/types.yaml#/definitions/uint32
    description: |
      指定充电器的预处理安全定时器设置值（分钟）
      如果为 0，则表示禁用此定时器
      默认为 40 分钟
    enum: [ 0, 40, 60, 80 ]

  active-semi,total-timeout:
    $ref: /schemas/types.yaml#/definitions/uint32
    description: |
      指定充电器的总安全定时器设置值（小时）；
      如果为 0，则表示禁用此定时器；
      默认为 3 小时
    enum: [ 0, 3, 4, 5 ]

required:
  - compatible
  - interrupts
  - active-semi,chglev-gpios
  - active-semi,lbo-gpios

additionalProperties: false

examples:
  - |
    #include <dt-bindings/gpio/gpio.h>
    #include <dt-bindings/interrupt-controller/irq.h>
    pmic {
      charger {
        compatible = "active-semi,act8945a-charger";
        interrupt-parent = <&pioA>;
        interrupts = <45 IRQ_TYPE_LEVEL_LOW>;
        active-semi,chglev-gpios = <&pioA 12 GPIO_ACTIVE_HIGH>;
        active-semi,lbo-gpios = <&pioA 72 GPIO_ACTIVE_LOW>;
        active-semi,input-voltage-threshold-microvolt = <6600>;
        active-semi,precondition-timeout = <40>;
        active-semi,total-timeout = <3>;
      };
    };
```

这段 YAML 描述了 Active-semi ACT8945A 充电器在设备树中的配置。它定义了与充电器相关的属性和要求，并提供了一个示例来展示如何在设备树源代码中使用这些属性。
~~~~

## Documentation/devicetree/bindings/power/supply/adc-battery_cn.yaml
```yaml
# SPDX-License-Identifier: (GPL-2.0-only OR BSD-2-Clause)
%YAML 1.2
---
$id: http://devicetree.org/schemas/power/supply/adc-battery.yaml#
$schema: http://devicetree.org/meta-schemas/core.yaml#

title: ADC 电池

maintainers:
  - Sebastian Reichel <sre@kernel.org>

description:
  基本的电池容量计，仅通过 ADC 通道报告基本的电池数据，并可选地通过轮询 GPIO 线指示电池已充满
电压预期在电池端子间测量，这是必须的。可选的电流/功率通道预期监测从电池流出的电流/功率。最后，温度通道预期测量电池温度
allOf:
  - $ref: power-supply.yaml#

properties:
  compatible:
    const: adc-battery

  charged-gpios:
    description:
      表示电池已完全充电的 GPIO。该 GPIO 通常由软件不可控的充电 IC 提供
maxItems: 1

  io-channels:
    minItems: 1
    maxItems: 4

  io-channel-names:
    minItems: 1
    items:
      - const: voltage
      - enum: [ current, power, temperature ]
      - enum: [ power, temperature ]
      - const: temperature

  monitored-battery: true

required:
  - compatible
  - io-channels
  - io-channel-names
  - monitored-battery

unevaluatedProperties: false

examples:
  - |
    #include <dt-bindings/gpio/gpio.h>

    fuel-gauge {
        compatible = "adc-battery";
        charged-gpios = <&gpio 42 GPIO_ACTIVE_HIGH>;
        io-channels = <&adc 13>, <&adc 37>;
        io-channel-names = "voltage", "current";

        power-supplies = <&charger>;
        monitored-battery = <&battery>;
    };
```

## Documentation/devicetree/bindings/power/supply/battery_cn.yaml
~~~~yaml
# SPDX-许可证标识符: (GPL-2.0-only 或 BSD-2-Clause)
%YAML 1.2
---
$id: http://devicetree.org/schemas/power/supply/battery.yaml#
$schema: http://devicetree.org/meta-schemas/core.yaml#

标题: 电池特性

维护者:
  - Sebastian Reichel <sre@kernel.org>

描述: |
  设备树中的电池节点提供了静态的电池特性。
  在智能电池中，这些特性通常存储在燃料计量芯片上的非易失性内存中。
  应当在没有合适的非易失性内存或该内存未编程/不正确的情况下使用电池节点。
  上游设备树文件不应包含电池节点，除非所表示的电池不容易被系统中的另一种类型的电池替换。
  这可以防止由于更换了不同类型的电池而未相应更新设备树二进制文件时可能出现的不可预测甚至潜在有害的行为。
  电池属性尽可能地以与 `include/linux/power_supply.h` 中定义的 `enum power_supply_property` 对应的元素命名。

  电池必须通过 phandle 被充电器和/或燃料计量器引用。
  phandle 的属性应命名为 "monitored-battery"。
属性:
  compatible:
    常量: simple-battery

  device-chemistry:
    描述: 描述电池的化学技术。
    可选之一:
      - 常量: nickel-cadmium
      - 常量: nickel-metal-hydride
      - 常量: lithium-ion
        描述: 这是一个涵盖所有锂离子电池的通用类型，
          包括以下几种。如果可能，应使用下面更精确的兼容字符串，
          但有时具体使用的锂离子电池未知，这时可以使用这个宽泛的兼容类型。
      - 常量: lithium-ion-polymer
      - 常量: lithium-ion-iron-phosphate
      - 常量: lithium-ion-manganese-oxide

  over-voltage-threshold-microvolt:
    描述: 电池过电压限制。

  re-charge-voltage-microvolt:
    描述: 重新开始充电的电压限制。

  voltage-min-design-microvolt:
    描述: 电池耗尽时的电压。

  voltage-max-design-microvolt:
    描述: 电池完全充电时的电压。

  energy-full-design-microwatt-hours:
    描述: 电池设计能量。

  charge-full-design-microamp-hours:
    描述: 电池设计容量。

  trickle-charge-current-microamp:
    描述: 滴流充电阶段的电流。

  precharge-current-microamp:
    描述: 预充电阶段的电流。

  precharge-upper-limit-microvolt:
    描述: 更改为恒定充电的电压上限。

  charge-term-current-microamp:
    描述: 充电终止阶段的电流。

  constant-charge-current-max-microamp:
    描述: 最大恒定输入电流。

  constant-charge-voltage-max-microvolt:
    描述: 最大恒定输入电压。

  factory-internal-resistance-micro-ohms:
    描述: 电池出厂内部电阻。

  resistance-temp-table:
    $ref: /schemas/types.yaml#/definitions/uint32-matrix
    项:
      项:
        - 描述: 温度（摄氏度）
        - 描述: 电池内部电阻百分比
    描述: |
      提供温度（摄氏度）及其对应的电池内部电阻百分比的表格，用于根据当前温度查找电阻百分比，以获得不同温度下准确的电池内部电阻。

  ocv-capacity-celsius:
    描述: |
      包含每个电池容量查表的温度（摄氏度）的数组。

  operating-range-celsius:
    描述: 电池的操作温度范围。
    项:
      - 描述: 电池可以工作的最低温度
      - 描述: 电池可以工作的最高温度

  ambient-celsius:
    描述: 安全的环境温度范围。
    项:
      - 描述: 当环境温度低于此值时发出警报
      - 描述: 当环境温度高于此值时发出警报

  alert-celsius:
    描述: 安全的电池温度范围。
    项:
      - 描述: 当电池温度低于此值时发出警报
      - 描述: 当电池温度高于此值时发出警报

必需:
  - compatible

模式属性:
  '^ocv-capacity-table-[0-9]+$':
    $ref: /schemas/types.yaml#/definitions/uint32-matrix
    描述: |
      提供电池开路电压(OCV)及其对应的电池容量百分比的数组，用于根据当前 OCV 值查找电池容量。开路电压单位是微伏特。
```yaml
maxItems: 100
items:
  items:
    - description: 开路电压（OCV）, 单位微伏
    - description: 电池容量百分比
      maximum: 100

additionalProperties: false

examples:
  - |
    power {
      #address-cells = <1>;
      #size-cells = <0>;

      battery: battery {
        compatible = "simple-battery";
        over-voltage-threshold-microvolt = <4500000>;  # 过压阈值，单位微伏
        re-charge-voltage-microvolt = <250000>;        # 重充电电压，单位微伏
        voltage-min-design-microvolt = <3200000>;      # 最小设计电压，单位微伏
        voltage-max-design-microvolt = <4200000>;      # 最大设计电压，单位微伏
        energy-full-design-microwatt-hours = <5290000>;# 全满能量设计值，单位微瓦时
        charge-full-design-microamp-hours = <1430000>; # 全满电荷设计值，单位微安时
        precharge-current-microamp = <256000>;         # 预充电电流，单位微安
        precharge-upper-limit-microvolt = <2500000>;   # 预充电上限电压，单位微伏
        charge-term-current-microamp = <128000>;       # 收尾阶段充电电流，单位微安
        constant-charge-current-max-microamp = <900000>;# 恒定充电最大电流，单位微安
        constant-charge-voltage-max-microvolt = <4200000>;# 恒定充电最大电压，单位微伏
        factory-internal-resistance-micro-ohms = <250000>;# 出厂内部电阻，单位微欧姆
        ocv-capacity-celsius = <(-10) 0 10>;           # OCV-容量关系在不同摄氏度下的表
        /* -10摄氏度时的表格 */
        ocv-capacity-table-0 = <4185000 100>, <4113000 95>, <4066000 90>;
        /* 0摄氏度时的表格 */
        ocv-capacity-table-1 = <4200000 100>, <4185000 95>, <4113000 90>;
        /* 10摄氏度时的表格 */
        ocv-capacity-table-2 = <4250000 100>, <4200000 95>, <4185000 90>;
        resistance-temp-table = <20 100>, <10 90>, <0 80>, <(-10) 60>; # 内阻与温度的关系表
        operating-range-celsius = <(-30) 50>; # 工作温度范围，单位摄氏度
        ambient-celsius = <(-5) 50>;          # 环境温度范围，单位摄氏度
        alert-celsius = <0 40>;               # 警戒温度范围，单位摄氏度
      };

      charger@11 {
        reg = <0x11>;
        monitored-battery = <&battery>;
      };

      fuel-gauge@22 {
        reg = <0x22>;
        monitored-battery = <&battery>;
      };
    };
```

这段配置描述了一个电源系统的定义，其中包括一个电池、一个充电器和一个燃油计量装置。具体包括电池的各项参数，如过压阈值、充电电压、设计电压范围等，并且还定义了不同温度下开路电压与电池容量的关系。同时，还包括充电器和燃油计量装置的配置信息。
~~~~

## Documentation/devicetree/bindings/power/supply/bq2415x_cn.yaml
~~~~yaml
```yaml
# SPDX-许可证标识符: GPL-2.0
# 版权 (C) 2021 Sebastian Reichel
%YAML 1.2
---
$id: http://devicetree.org/schemas/power/supply/bq2415x.yaml#
$schema: http://devicetree.org/meta-schemas/core.yaml#

title: TI bq2415x 锂离子充电器

maintainers:
  - Sebastian Reichel <sre@kernel.org>

allOf:
  - $ref: power-supply.yaml#

properties:
  compatible:
    enum:
      - ti,bq24150
      - ti,bq24150a
      - ti,bq24151
      - ti,bq24151a
      - ti,bq24152
      - ti,bq24153
      - ti,bq24153a
      - ti,bq24155
      - ti,bq24156
      - ti,bq24156a
      - ti,bq24158

  reg:
    maxItems: 1

  ti,current-limit:
    $ref: /schemas/types.yaml#/definitions/uint32
    description: 充电器从电源可抽取的初始最大电流（单位：毫安）
  ti,weak-battery-voltage:
    $ref: /schemas/types.yaml#/definitions/uint32
    description: |
      电池电压较低阈值（单位：毫伏）
      当电池电压低于此值时，芯片将使用慢速预充
  ti,battery-regulation-voltage:
    $ref: /schemas/types.yaml#/definitions/uint32
    description: 最大充电电压（单位：毫伏）
  ti,charge-current:
    $ref: /schemas/types.yaml#/definitions/uint32
    description: 最大充电电流（单位：毫安）
  ti,termination-current:
    $ref: /schemas/types.yaml#/definitions/uint32
    description: |
      在恒压阶段，当充电电流下降到低于此值（单位：毫安）时，充电将终止
  ti,resistor-sense:
    $ref: /schemas/types.yaml#/definitions/uint32
    description: 检测电阻的值（单位：毫欧姆）
  ti,usb-charger-detection:
    $ref: /schemas/types.yaml#/definitions/phandle
    description: USB充电检测设备的phandle（自动模式下必需）

required:
  - compatible
  - reg
  - ti,current-limit
  - ti,weak-battery-voltage
  - ti,battery-regulation-voltage
  - ti,charge-current
  - ti,termination-current
  - ti,resistor-sense

additionalProperties: false

examples:
  - |
    i2c {
      #address-cells = <1>;
      #size-cells = <0>;

      charger@6b {
        compatible = "ti,bq24150a";
        reg = <0x6b>;

        ti,current-limit = <100>;
        ti,weak-battery-voltage = <3400>;
        ti,battery-regulation-voltage = <4200>;
        ti,charge-current = <650>;
        ti,termination-current = <100>;
        ti,resistor-sense = <68>;

        ti,usb-charger-detection = <&isp1704>;
      };
    };
```

这段 YAML 文件描述了 TI bq2415x 系列锂离子充电器在 Device Tree 中的配置。它包括了必要的属性和示例，以便正确配置 bq2415x 充电器。
~~~~

## Documentation/devicetree/bindings/power/supply/bq24190_cn.yaml
~~~~yaml
下面是给定内容的中文翻译：

```yaml
# SPDX-文件许可标识符: GPL-2.0
# 版权 (C) 2021 Sebastian Reichel
%YAML 1.2
---
$id: http://devicetree.org/schemas/power/supply/bq24190.yaml#
$schema: http://devicetree.org/meta-schemas/core.yaml#

标题: TI BQ2419x 锂离子电池充电器

维护者:
  - Sebastian Reichel <sre@kernel.org>

allOf:
  - $ref: power-supply.yaml#

属性:
  compatible:
    枚举:
      - ti,bq24190
      - ti,bq24192
      - ti,bq24192i
      - ti,bq24196
      - ti,bq24296

  reg:
    最大项数: 1

  interrupts:
    最大项数: 1

  usb-otg-vbus:
    $ref: /schemas/regulator/regulator.yaml#
    描述: |
      用于控制OTG端口上VBUS电压方向的稳压器，适用于USB主机模式或充电

  ti,system-minimum-microvolt:
    描述: |
      当电源连接且电池电压低于系统最小电压时，系统将被调节到高于此设置

omit-battery-class:
    类型: 布尔值
    描述: |
      如果设置了此属性，则操作系统不会尝试创建一个电池设备
monitored-battery:
    $ref: /schemas/types.yaml#/definitions/phandle
    描述: |
      具有"simple-battery"兼容性的节点的phandle
      此属性必须是battery.yaml中描述格式的节点的phandle，并要求具有以下属性：
      - precharge-current-microamp: 预充阶段的最大充电电流（通常为电池容量的20%）
- charge-term-current-microamp: 当电池电压高于再充电阈值且电流低于此设置时，充电周期终止（通常为电池容量的10%）

必需:
  - compatible
  - reg
  - interrupts

额外属性: false

示例:
  - |
    #include <dt-bindings/gpio/gpio.h>
    #include <dt-bindings/interrupt-controller/irq.h>

    bat: 电池 {
      compatible = "simple-battery";
      precharge-current-microamp = <256000>;
      charge-term-current-microamp = <128000>;
    };

    i2c {
      #address-cells = <1>;
      #size-cells = <0>;

      charger@6a {
        compatible = "ti,bq24190";
        reg = <0x6a>;
        interrupt-parent = <&gpiochip>;
        interrupts = <10 IRQ_TYPE_EDGE_FALLING>;
        monitored-battery = <&bat>;
        ti,system-minimum-microvolt = <3200000>;

        usb_otg_vbus: usb-otg-vbus { };
      };
    };
```

请注意，部分 YAML 格式的特殊字符和注释符号（如 `|` 和 `-`）在中文翻译中保留了原样。
~~~~

## Documentation/devicetree/bindings/power/supply/bq24257_cn.yaml
~~~~yaml
以下是提供的 YAML 文件的中文翻译：

```yaml
# SPDX-许可证标识符: GPL-2.0
# 版权 (C) 2021 Sebastian Reichel
%YAML 1.2
---
$id: http://devicetree.org/schemas/power/supply/bq24257.yaml#
$schema: http://devicetree.org/meta-schemas/core.yaml#

标题: Bq24250、bq24251 和 bq24257 锂离子充电器

维护者:
  - Sebastian Reichel <sre@kernel.org>

allOf:
  - $ref: power-supply.yaml#

属性:
  compatible:
    枚举:
      - ti,bq24250
      - ti,bq24251
      - ti,bq24257

  reg:
    最大项数: 1

  interrupts:
    最大项数: 1

  ti,battery-regulation-voltage:
    $ref: /schemas/types.yaml#/definitions/uint32
    描述: 最大充电电压（微伏）

  ti,charge-current:
    $ref: /schemas/types.yaml#/definitions/uint32
    描述: 最大充电电流（微安）

  ti,termination-current:
    $ref: /schemas/types.yaml#/definitions/uint32
    描述: |
      当恒压阶段的充电电流下降到此值（微安）以下时，将终止充电。

  pg-gpios:
    描述: |
      用于连接 bq2425x 设备 PG（电源良好）引脚的 GPIO。
      此引脚并非所有设备都有，但如果可能的话应该使用，因为这是获取充电器输入 PG 状态的推荐方法。如果没有指定此引脚，则会采用基于软件的方法来检测 PG。
    最大项数: 1

  ti,current-limit:
    $ref: /schemas/types.yaml#/definitions/uint32
    描述: |
      充电器输入的最大电流（微安）
      如果未指定此属性，则会自动设置输入限流电流，使用 USB D+/D- 信号来检测充电器类型。
      如果硬件不支持基于 D+/D- 的检测，则默认使用 500,000（=500毫安）。

  ti,ovp-voltage:
    $ref: /schemas/types.yaml#/definitions/uint32
    描述: |
      配置过压保护电压（微伏）
      如果未指定，则使用默认值 6,5000,000（=6.5伏）。

  ti,in-dpm-voltage:
    $ref: /schemas/types.yaml#/definitions/uint32
    描述: |
      配置动态功率路径管理的阈值输入电压（微伏）
      如果未指定，则使用默认值 4,360,000（=4.36伏）。

必需:
  - compatible
  - reg
  - interrupts
  - ti,battery-regulation-voltage
  - ti,charge-current
  - ti,termination-current

额外属性: false

示例:
  - |
    #include <dt-bindings/gpio/gpio.h>
    #include <dt-bindings/interrupt-controller/irq.h>
    i2c {
      #address-cells = <1>;
      #size-cells = <0>;

      charger@6a {
        compatible = "ti,bq24257";
        reg = <0x6a>;
        interrupt-parent = <&gpio1>;
        interrupts = <16 IRQ_TYPE_EDGE_BOTH>;

        pg-gpios = <&gpio1 28 GPIO_ACTIVE_HIGH>;

        ti,battery-regulation-voltage = <4200000>;
        ti,charge-current = <1000000>;
        ti,termination-current = <50000>;
      };
    };
  - |
    #include <dt-bindings/gpio/gpio.h>
    #include <dt-bindings/interrupt-controller/irq.h>
    i2c {
      #address-cells = <1>;
      #size-cells = <0>;

      charger@6a {
        compatible = "ti,bq24250";
        reg = <0x6a>;
        interrupt-parent = <&gpio1>;
        interrupts = <16 IRQ_TYPE_EDGE_BOTH>;

        ti,battery-regulation-voltage = <4200000>;
        ti,charge-current = <500000>;
        ti,termination-current = <50000>;
        ti,current-limit = <900000>;
        ti,ovp-voltage = <9500000>;
        ti,in-dpm-voltage = <4440000>;
      };
    };
```

请注意，由于 YAML 是一种数据格式，其关键字和结构通常不会翻译。因此，上面的翻译保留了原始 YAML 结构中的关键字和符号，并仅翻译了描述性文本。
~~~~
