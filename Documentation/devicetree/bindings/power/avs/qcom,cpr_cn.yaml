## Documentation/devicetree/bindings/power/reset/keystone-reset_cn.txt
~~~~
针对德州仪器Keystone重置的设备树绑定

此节点旨在允许在选定的看门狗进行软件重置的情况下对系统芯片(SoC)进行重置。
Keystone系统级芯片最多可以包含4个用于重置SoC的看门狗定时器。每个看门狗定时器事件输入都连接到重置多路复用器（Reset Mux）模块。重置多路复用器模块可以配置为触发或不触发重置，并且还可以配置为软重置或硬重置。
必需属性：

- compatible: `ti,keystone-reset`

- ti,syscon-pll: phandle/偏移量对。访问PLL控制器寄存器所使用的syscon的句柄以及用于重置控制寄存器的偏移量
- ti,syscon-dev: phandle/偏移量对。访问设备状态控制寄存器所使用的syscon的句柄，以及为了使用所有看门狗的多路复用器模块寄存器所需的偏移量

可选属性：

- ti,soft-reset: 布尔选项，表示是否使用软重置，默认情况下使用硬重置
- ti,wdt-list: 可以导致SoC重置的看门狗列表。该列表与看门狗驱动无关，仅需要启用由一个看门狗触发的与SoC相关的重置。格式为：`<0>, <2>`；它可以是任意顺序，从0开始到3结束，因为Keystone最多可以包含4个SoC重置看门狗，并且可以是任意顺序。

示例1：
设置Keystone重置，使得当发生软件重置或者WDT0被触发时，它会发出SoC的硬重置
pllctrl: pll-controller@2310000 {
	compatible = "ti,keystone-pllctrl", "syscon";
	reg = <0x02310000 0x200>;
};

devctrl: device-state-control@2620000 {
	compatible = "ti,keystone-devctrl", "syscon";
	reg = <0x02620000 0x1000>;
};

rstctrl: reset-controller {
	compatible = "ti,keystone-reset";
	ti,syscon-pll = <&pllctrl 0xe4>;
	ti,syscon-dev = <&devctrl 0x328>;
	ti,wdt-list = <0>;
};

示例2：
设置Keystone重置，使得当发生软件重置或者WDT0或WDT2被触发时，它会发出SoC的软重置
以下是提供的文本的中文翻译：

```rstctrl: reset-controller { 
	compatible = "ti,keystone-reset"; 
	ti,syscon-pll = <&pllctrl 0xe4>; 
	ti,syscon-dev = <&devctrl 0x328>; 
	ti,wdt-list = <0>, <2>; 
	ti,soft-reset; 
};
```

重置控制器配置如下：
```
rstctrl: 重置控制器 {
    compatible = "ti,keystone-reset"; 
    ti,syscon-pll = <&pllctrl 0xe4>; 
    ti,syscon-dev = <&devctrl 0x328>; 
    ti,wdt-list = <0>, <2>; 
    ti,soft-reset; 
};
```

这里的含义是定义了一个与 `ti,keystone-reset` 兼容的重置控制器，并且配置了相关的属性，例如 PLL 控制器、设备控制器以及看门狗定时器列表等。
~~~~
