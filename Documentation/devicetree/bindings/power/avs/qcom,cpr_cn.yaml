## Documentation/devicetree/bindings/power/avs/qcom,cpr_cn.yaml
```yaml
# SPDX-许可证标识符: (GPL-2.0-only 或 BSD-2-Clause)
%YAML 1.2
---
$id: http://devicetree.org/schemas/power/avs/qcom,cpr.yaml#
$schema: http://devicetree.org/meta-schemas/core.yaml#

标题: 高通核心功耗降低（CPR）

维护者:
  - Niklas Cassel <nks@flawful.org>

描述: |
  CPR（核心功耗降低）是一项技术，用于减少CPU或其他设备的核心功耗。每个设备的OPP（运行性能点）对应一个“工作点”，该工作点在特定频率下有一系列有效的电压值。当设备以特定频率运行时，CPR会监控温度等动态因素，并建议调整电压以节省功耗并满足硅特性要求。
属性:
  compatible:
    items:
      - 枚举:
          - qcom,qcs404-cpr
      - 常量: qcom,cpr

  reg:
    描述: RBCPR寄存器区域的基本地址和大小
最大项数: 1

  interrupts:
    最大项数: 1

  clocks:
    items:
      - 描述: 参考时钟
clock-names:
    items:
      - 常量: ref

  vdd-apc-supply:
    描述: APC调节器电源
'#power-domain-cells':
    常量: 0

  operating-points-v2:
    描述: |
      指向包含由CPR功耗域支持的性能状态的OPP表的phandle
acc-syscon:
    $ref: /schemas/types.yaml#/definitions/phandle
    描述: 用于写入ACC设置的syscon的phandle
nvmem-cells:
    items:
      - 描述: 工作点1的商偏移
      - 描述: 工作点2的商偏移
      - 描述: 工作点3的商偏移
      - 描述: 工作点1的初始电压
      - 描述: 工作点2的初始电压
      - 描述: 工作点3的初始电压
      - 描述: 工作点1的商
      - 描述: 工作点2的商
      - 描述: 工作点3的商
      - 描述: 工作点1的环形振荡器
      - 描述: 工作点2的环形振荡器
      - 描述: 工作点3的环形振荡器
      - 描述: 熔丝版本

  nvmem-cell-names:
    items:
      - 常量: cpr_quotient_offset1
      - 常量: cpr_quotient_offset2
      - 常量: cpr_quotient_offset3
      - 常量: cpr_init_voltage1
      - 常量: cpr_init_voltage2
      - 常量: cpr_init_voltage3
      - 常量: cpr_quotient1
      - 常量: cpr_quotient2
      - 常量: cpr_quotient3
      - 常量: cpr_ring_osc1
      - 常量: cpr_ring_osc2
      - 常量: cpr_ring_osc3
      - 常量: cpr_fuse_revision

必需:
  - compatible
  - reg
  - interrupts
  - clocks
  - clock-names
  - vdd-apc-supply
  - '#power-domain-cells'
  - operating-points-v2
  - nvmem-cells
  - nvmem-cell-names

额外属性: false

示例:
  - |
    #include <dt-bindings/interrupt-controller/arm-gic.h>

    cpr_opp_table: opp-table-cpr {
        compatible = "operating-points-v2-qcom-level";

        cpr_opp1: opp1 {
            opp-level = <1>;
            qcom,opp-fuse-level = <1>;
        };
        cpr_opp2: opp2 {
            opp-level = <2>;
            qcom,opp-fuse-level = <2>;
        };
        cpr_opp3: opp3 {
            opp-level = <3>;
            qcom,opp-fuse-level = <3>;
        };
    };

    power-controller@b018000 {
        compatible = "qcom,qcs404-cpr", "qcom,cpr";
        reg = <0x0b018000 0x1000>;
        interrupts = <0 15 IRQ_TYPE_EDGE_RISING>;
        clocks = <&xo_board>;
        clock-names = "ref";
        vdd-apc-supply = <&pms405_s3>;
        #power-domain-cells = <0>;
        operating-points-v2 = <&cpr_opp_table>;
        acc-syscon = <&tcsr>;

        nvmem-cells = <&cpr_efuse_quot_offset1>,
            <&cpr_efuse_quot_offset2>,
            <&cpr_efuse_quot_offset3>,
            <&cpr_efuse_init_voltage1>,
            <&cpr_efuse_init_voltage2>,
            <&cpr_efuse_init_voltage3>,
            <&cpr_efuse_quot1>,
            <&cpr_efuse_quot2>,
            <&cpr_efuse_quot3>,
            <&cpr_efuse_ring1>,
            <&cpr_efuse_ring2>,
            <&cpr_efuse_ring3>,
            <&cpr_efuse_revision>;
        nvmem-cell-names = "cpr_quotient_offset1",
            "cpr_quotient_offset2",
            "cpr_quotient_offset3",
            "cpr_init_voltage1",
            "cpr_init_voltage2",
            "cpr_init_voltage3",
            "cpr_quotient1",
            "cpr_quotient2",
            "cpr_quotient3",
            "cpr_ring_osc1",
            "cpr_ring_osc2",
            "cpr_ring_osc3",
            "cpr_fuse_revision";
    };
```

## Documentation/devicetree/bindings/power/brcm,bcm-pmb_cn.yaml
~~~~yaml
```yaml
# SPDX-许可证标识符: GPL-2.0-only 或 BSD-2-Clause
%YAML 1.2
---
$id: http://devicetree.org/schemas/power/brcm,bcm-pmb.yaml#
$schema: http://devicetree.org/meta-schemas/core.yaml#

title: Broadcom PMB (电源管理总线) 控制器

description: 本文件描述了 Broadcom 的 PMB 控制器。它支持为各种类型的连接设备（例如 PCIe、USB、SATA）供电。
maintainers:
  - Rafał Miłecki <rafal@milecki.pl>

properties:
  compatible:
    enum:
      - brcm,bcm4908-pmb
      - brcm,bcm63138-pmb

  reg:
    description: 一个或多个总线的寄存器空间
    maxItems: 1

  big-endian:
    $ref: /schemas/types.yaml#/definitions/flag
    description: 用于标记块在大端模式下工作的标志
"#power-domain-cells":
    description: 单元指定设备ID（参见 bcm-pmb.h）
    const: 1

required:
  - reg
  - "#power-domain-cells"

additionalProperties: false

examples:
  - |
    #include <dt-bindings/soc/bcm-pmb.h>

    pmb: power-controller@802800e0 {
        compatible = "brcm,bcm4908-pmb";
        reg = <0x802800e0 0x40>;
        #power-domain-cells = <1>;
    };

    foo {
        power-domains = <&pmb BCM_PMB_PCIE0>;
    };
```

请注意，`"#power-domain-cells"` 需要正确格式化，但 YAML 格式不允许在键名中使用 `#` 字符。因此，在实际的 YAML 文件中，您需要使用其他方法来表示这个键名，比如通过转义或者修改键名以符合 YAML 的规范。在此示例中，我保留了原始格式以保持与提供的代码示例的一致性。
~~~~

## Documentation/devicetree/bindings/power/brcm,bcm63xx-power_cn.yaml
~~~~yaml
```yaml
# SPDX-许可证标识符: (GPL-2.0-only 或 BSD-2-Clause)
%YAML 1.2
---
$id: http://devicetree.org/schemas/power/brcm,bcm63xx-power.yaml#
$schema: http://devicetree.org/meta-schemas/core.yaml#

title: BCM63xx 电源域驱动程序

maintainers:
  - Álvaro Fernández Rojas <noltari@gmail.com>

description: |
  BCM6318、BCM6328、BCM6362 和 BCM63268 系统级芯片包含一个电源域控制器，
  用于启用/禁用某些组件以节省电力。

properties:
  compatible:
    items:
      - enum:
          - brcm,bcm6318-power-controller
          - brcm,bcm6328-power-controller
          - brcm,bcm6362-power-controller
          - brcm,bcm63268-power-controller

  reg:
    maxItems: 1

  "#power-domain-cells":
    const: 1

required:
  - compatible
  - reg
  - "#power-domain-cells"

additionalProperties: false

examples:
  - |
    periph_pwr: power-controller@10001848 {
        compatible = "brcm,bcm6328-power-controller";
        reg = <0x10001848 0x4>;
        #power-domain-cells = <1>;
    };
```

这段 YAML 文件定义了针对 Broadcom BCM63xx 系列 SoC 的电源控制器的 Device Tree 组件规范。
~~~~

## Documentation/devicetree/bindings/power/fsl,imx-gpc_cn.yaml
```yaml
# SPDX-文件许可人: (GPL-2.0-only 或 BSD-2-Clause)
%YAML 1.2
---
$id: http://devicetree.org/schemas/power/fsl,imx-gpc.yaml#
$schema: http://devicetree.org/meta-schemas/core.yaml#

标题: Freescale i.MX 通用电源控制器

维护者:
  - Philipp Zabel <p.zabel@pengutronix.de>

描述: |
  i.MX6 通用电源控制 (GPC) 模块包含 DVFS 负载跟踪计数器和电源门控控制 (PGC)。
  电源域是作为通用电源域提供者，具体文档请参考
  文档/devicetree/bindings/power/power-domain.yaml。它们被描述为 GPC 的电源门控控制器 'pgc' 节点的子节点。
  属于某个电源域的 IP 核心应包含一个 'power-domains' 属性，该属性是一个指向设备所属电源域的 phandle。

属性:
  compatible:
    oneOf:
      - 枚举:
          - fsl,imx6q-gpc
      - items:
          - 枚举:
              - fsl,imx6qp-gpc
              - fsl,imx6sl-gpc
              - fsl,imx6sx-gpc
              - fsl,imx6ul-gpc
          - 常量: fsl,imx6q-gpc

  reg:
    maxItems: 1

  interrupts:
    maxItems: 1

  interrupt-controller: true
  '#interrupt-cells':
    常量: 3

  clocks:
    maxItems: 1

  clock-names:
    常量: ipg

  pgc:
    类型: 对象
    additionalProperties: false
    描述: 由这个控制器提供的电源域列表
属性:
      '#address-cells':
        常量: 1

      '#size-cells':
        常量: 0

    patternProperties:
      "power-domain@[0-9]$":
        类型: 对象
        additionalProperties: false

        属性:

          '#power-domain-cells':
            常量: 0

          reg:
            描述: |
              下列的 DOMAIN_INDEX 值对于 i.MX6Q 是有效的:
                ARM_DOMAIN     0
                PU_DOMAIN      1
              下列额外的 DOMAIN_INDEX 值对于 i.MX6SL 是有效的:
                DISPLAY_DOMAIN 2
              下列额外的 DOMAIN_INDEX 值对于 i.MX6SX 是有效的:
                PCI_DOMAIN     3
            maxItems: 1

          clocks:
            描述: |
              一系列时钟的 phandle，在域启动顺序中需要启用这些时钟以确保重置传播到此电源域内的设备
minItems: 1
            maxItems: 7

          power-supply: true

        必需:
          - '#power-domain-cells'
          - reg

    必需:
      - '#address-cells'
      - '#size-cells'

必需:
  - compatible
  - reg
  - interrupts
  - clocks
  - clock-names
  - pgc

additionalProperties: false

示例:
  - |
    #include <dt-bindings/clock/imx6qdl-clock.h>
    #include <dt-bindings/interrupt-controller/arm-gic.h>

    gpc@20dc000 {
        compatible = "fsl,imx6q-gpc";
        reg = <0x020dc000 0x4000>;
        interrupts = <0 89 IRQ_TYPE_LEVEL_HIGH>;
        clocks = <&clks IMX6QDL_CLK_IPG>;
        clock-names = "ipg";

        pgc {
            #address-cells = <1>;
            #size-cells = <0>;

            power-domain@0 {
                reg = <0>;
                #power-domain-cells = <0>;
            };

            pd_pu: power-domain@1 {
                reg = <1>;
                #power-domain-cells = <0>;
                power-supply = <&reg_pu>;
                clocks = <&clks IMX6QDL_CLK_GPU3D_CORE>,
                         <&clks IMX6QDL_CLK_GPU3D_SHADER>,
                         <&clks IMX6QDL_CLK_GPU2D_CORE>,
                         <&clks IMX6QDL_CLK_GPU2D_AXI>,
                         <&clks IMX6QDL_CLK_OPENVG_AXI>,
                         <&clks IMX6QDL_CLK_VPU_AXI>;
            };
        };
    };
```

## Documentation/devicetree/bindings/power/fsl,imx-gpcv2_cn.yaml
```yaml
# SPDX-文件许可人: (GPL-2.0-only 或 BSD-2-Clause)
%YAML 1.2
---
$id: http://devicetree.org/schemas/power/fsl,imx-gpcv2.yaml#
$schema: http://devicetree.org/meta-schemas/core.yaml#

标题: Freescale i.MX 通用电源控制器 V2

维护者:
  - Andrey Smirnov <andrew.smirnov@gmail.com>

描述: |
  i.MX7S/D 通用电源控制 (GPC) 块包含针对各种电源域的电源门控控制 (PGC)。
  在 GPC 节点内所包含的电源域是通用电源域提供者，其在
  文档/devicetree/bindings/power/power-domain.yaml 中有详细说明，这些电源域作为电源门控控制器 'pgc' 节点的子节点来描述。
  属于某个电源域的 IP 核应包含一个 'power-domains' 属性，该属性为表示该域的 PGC 节点的 phandle。
属性:
  compatible:
    枚举:
      - fsl,imx7d-gpc
      - fsl,imx8mn-gpc
      - fsl,imx8mq-gpc
      - fsl,imx8mm-gpc
      - fsl,imx8mp-gpc

  reg:
    maxItems: 1

  interrupts:
    maxItems: 1

  interrupt-controller: true
  '#interrupt-cells':
    常量: 3

  pgc:
    类型: 对象
    additionalProperties: false
    描述: 由该控制器提供的电源域列表
属性:
      '#address-cells':
        常量: 1

      '#size-cells':
        常量: 0

    patternProperties:
      "power-domain@[0-9a-f]+$":
        类型: 对象
        additionalProperties: false

        属性:

          '#power-domain-cells':
            常量: 0

          reg:
            描述: |
              电源域索引。有效值定义在
              include/dt-bindings/power/imx7-power.h 对于 fsl,imx7d-gpc 和
              include/dt-bindings/power/imx8m-power.h 对于 fsl,imx8mq-gpc
              include/dt-bindings/power/imx8mm-power.h 对于 fsl,imx8mm-gpc
              include/dt-bindings/power/imx8mp-power.h 对于 fsl,imx8mp-gpc
            maxItems: 1

          clocks:
            描述: |
              需要在域上电序列期间启用的时钟的 phandle 数量，以确保位于此电源域内的设备的复位传播
minItems: 1
            maxItems: 5

          power-supply: true

          power-domains:
            maxItems: 1

          resets:
            描述: |
              在域上电序列期间需要置位的复位的 phandle 数量。这些复位属于位于电源域内的设备，
              这些设备需要在整个上电序列中保持在复位状态。因此，在通用电源域绑定中没有手段来指定每个复位是什么。
minItems: 1
            maxItems: 4

        必须:
          - '#power-domain-cells'
          - reg

    必须:
      - '#address-cells'
      - '#size-cells'

必须:
  - compatible
  - reg
  - interrupts
  - pgc

additionalProperties: false

示例:
  - |
    #include <dt-bindings/interrupt-controller/arm-gic.h>

    gpc@303a0000 {
        compatible = "fsl,imx7d-gpc";
        reg = <0x303a0000 0x1000>;
        interrupts = <GIC_SPI 87 IRQ_TYPE_LEVEL_HIGH>;

        pgc {
            #address-cells = <1>;
            #size-cells = <0>;

            pgc_mipi_phy: power-domain@0 {
                #power-domain-cells = <0>;
                reg = <0>;
                power-supply = <&reg_1p0d>;
            };

            pgc_pcie_phy: power-domain@1 {
                #power-domain-cells = <0>;
                reg = <1>;
                power-supply = <&reg_1p0d>;
            };

            pgc_hsic_phy: power-domain@2 {
                #power-domain-cells = <0>;
                reg = <2>;
                power-supply = <&reg_1p2>;
            };
        };
    };
```

## Documentation/devicetree/bindings/power/fsl,scu-pd_cn.yaml
~~~~yaml
```yaml
# SPDX-许可证标识符: (GPL-2.0-only 或 BSD-2-Clause)
%YAML 1.2
---
$id: http://devicetree.org/schemas/power/fsl,scu-pd.yaml#
$schema: http://devicetree.org/meta-schemas/core.yaml#

title: i.MX SCU 客户端设备节点 - 基于 SCU 消息协议的电源域

maintainers:
  - Dong Aisheng <aisheng.dong@nxp.com>

description: i.MX SCU 客户端设备节点
  客户端节点作为相关 IMX-SCU 设备节点的子节点进行维护。
  基于 SCU 消息协议的电源域绑定。

allOf:
  - $ref: power-domain.yaml#

properties:
  compatible:
    items:
      - enum:
          - fsl,imx8dl-scu-pd
          - fsl,imx8qm-scu-pd
          - fsl,imx8qxp-scu-pd
      - const: fsl,scu-pd

  '#power-domain-cells':
    const: 1

required:
  - compatible
  - '#power-domain-cells'

additionalProperties: false

examples:
  - |
    power-controller {
        compatible = "fsl,imx8qxp-scu-pd", "fsl,scu-pd";
        #power-domain-cells = <1>;
    };
```

这段 YAML 文件描述了一个设备树（Device Tree）配置，用于定义 i.MX 系列处理器中的 SCU 客户端设备节点及其电源域控制。其中包含兼容性声明、必需属性等信息，并提供了一个示例配置。
~~~~
