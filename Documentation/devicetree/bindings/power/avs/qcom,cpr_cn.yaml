## Documentation/devicetree/bindings/power/mediatek,power-controller_cn.yaml
~~~~yaml
# SPDX-许可证标识符: (GPL-2.0-only 或 BSD-2-Clause)
%YAML 1.2
---
$id: http://devicetree.org/schemas/power/mediatek,power-controller.yaml#
$schema: http://devicetree.org/meta-schemas/core.yaml#

标题: Mediatek电源域控制器

维护者:
  - MandyJH Liu <mandyjh.liu@mediatek.com>
  - Matthias Brugger <mbrugger@suse.com>

描述: |
  Mediatek处理器包括对多个电源域的支持，这些电源域能够根据不同的应用场景由软件进行上电/断电以节省电力。
  属于某个电源域的 IP 核应包含一个名为 'power-domains' 的属性，该属性是表示该域的 SCPSYS 节点的 phandle。
属性:
  $nodename:
    模式: '^power-controller(@[0-9a-f]+)?$'

  compatible:
    枚举:
      - mediatek,mt6795-power-controller
      - mediatek,mt8167-power-controller
      - mediatek,mt8173-power-controller
      - mediatek,mt8183-power-controller
      - mediatek,mt8186-power-controller
      - mediatek,mt8188-power-controller
      - mediatek,mt8192-power-controller
      - mediatek,mt8195-power-controller
      - mediatek,mt8365-power-controller

  '#power-domain-cells':
    常量: 1

  '#address-cells':
    常量: 1

  '#size-cells':
    常量: 0

模式属性:
  "^power-domain@[0-9a-f]+$":
    $ref: "#/$defs/power-domain-node"
    模式属性:
      "^power-domain@[0-9a-f]+$":
        $ref: "#/$defs/power-domain-node"
        模式属性:
          "^power-domain@[0-9a-f]+$":
            $ref: "#/$defs/power-domain-node"
            模式属性:
              "^power-domain@[0-9a-f]+$":
                $ref: "#/$defs/power-domain-node"
                未评估属性: false
            未评估属性: false
        未评估属性: false
    未评估属性: false

$defs:
  power-domain-node:
    类型: 对象
    描述: |
      表示在文档 `Documentation/devicetree/bindings/power/power-domain.yaml` 中定义的电源控制器节点内的电源域
属性:

      '#power-domain-cells':
        描述:
          对于表示单一 PM 域的节点，必须为 0；对于提供多个 PM 域的节点，必须为 1
'#address-cells':
        常量: 1

      '#size-cells':
        常量: 0

      reg:
        描述: |
          电源域索引。有效值定义在：
              "include/dt-bindings/power/mt6795-power.h" - 对于 MT8167 类型电源域
"include/dt-bindings/power/mt8167-power.h" - 对于 MT8167 类型电源域
"include/dt-bindings/power/mt8173-power.h" - 对于 MT8173 类型电源域
"include/dt-bindings/power/mt8183-power.h" - 对于 MT8183 类型电源域
"include/dt-bindings/power/mediatek,mt8188-power.h" - 对于 MT8188 类型电源域
"include/dt-bindings/power/mt8192-power.h" - 对于 MT8192 类型电源域
```plaintext
"include/dt-bindings/power/mt8195-power.h" - 适用于 MT8195 类型的电源域
"include/dt-bindings/power/mediatek,mt8365-power.h" - 适用于 MT8365 类型的电源域
最大项目数：1

      时钟：
        描述： |
          需要在电源域上电顺序中启用的时钟的 phandle 数量。
clock-names（时钟名称）:
        描述： |
          时钟名称列表，为了匹配每个电源域的上电顺序，我们需要按名称对时钟进行分组。BASIC 时钟需要在启用相应的电源域之前启用，并且其名称中不应包含 '-' （例如 mm、mfg、venc）；
SUSBYS 时钟需要在释放总线保护之前启用，并且其名称应包含 '-' （例如 mm-0、isp-0、cam-0）。
为了正确遵循上电顺序，必须按顺序指定时钟，首先添加 BASIC 时钟，然后是 SUSBSYS 时钟。
domain-supply（域供电）:
        描述：电源域调节器供电
mediatek,infracfg：
        $ref: /schemas/types.yaml#/definitions/phandle
        描述：包含 INFRACFG 寄存器范围的设备的 phandle。
mediatek,infracfg-nao：
        $ref: /schemas/types.yaml#/definitions/phandle
        描述：包含 INFRACFG-NAO 寄存器范围的设备的 phandle。
mediatek,smi：
        $ref: /schemas/types.yaml#/definitions/phandle
        描述：包含 SMI 寄存器范围的设备的 phandle。
```
以上是对给定内容的中文翻译。请注意，这里使用了“phandle”这个术语，它在上下文中指的是设备树中的一个指针，指向另一个节点。
这段文本是 Device Tree (设备树) 的描述，用于定义硬件平台的配置信息。以下是中文翻译：

```yaml
# 必需字段：
- reg

必需字段：
  - compatible

额外属性： false

示例：
  - |
    #include <dt-bindings/clock/mt8173-clk.h>
    #include <dt-bindings/power/mt8173-power.h>

    soc {  # 系统芯片（SoC）节点
        #address-cells = <2>;  # 地址单元数
        #size-cells = <2>;  # 大小单元数

        scpsys: syscon@10006000 {  # 系统控制节点
            compatible = "mediatek,mt8173-scpsys", "syscon", "simple-mfd";  # 兼容性声明
            reg = <0 0x10006000 0 0x1000>;  # 寄存器地址和大小

            spm: power-controller {  # 电源控制器节点
                compatible = "mediatek,mt8173-power-controller";  # 兼容性声明
                #address-cells = <1>;  # 地址单元数
                #size-cells = <0>;  # 大小单元数
                #power-domain-cells = <1>;  # 电源域单元数

                # 以下为该SoC的各个电源域
                power-domain@MT8173_POWER_DOMAIN_VDEC {  # VDEC 电源域
                    reg = <MT8173_POWER_DOMAIN_VDEC>;  # 电源域标识符
                    clocks = <&topckgen CLK_TOP_MM_SEL>;  # 需要的时钟
                    clock-names = "mm";  # 时钟名称
                    #power-domain-cells = <0>;  # 电源域单元数
                };
                power-domain@MT8173_POWER_DOMAIN_VENC {  # VENC 电源域
                    reg = <MT8173_POWER_DOMAIN_VENC>;  # 电源域标识符
                    clocks = <&topckgen CLK_TOP_MM_SEL>, <&topckgen CLK_TOP_VENC_SEL>;  # 需要的时钟
                    clock-names = "mm", "venc";  # 时钟名称
                    #power-domain-cells = <0>;  # 电源域单元数
                };
                power-domain@MT8173_POWER_DOMAIN_ISP {  # ISP 电源域
                    reg = <MT8173_POWER_DOMAIN_ISP>;  # 电源域标识符
                    clocks = <&topckgen CLK_TOP_MM_SEL>;  # 需要的时钟
                    clock-names = "mm";  # 时钟名称
                    #power-domain-cells = <0>;  # 电源域单元数
                };
                power-domain@MT8173_POWER_DOMAIN_MM {  # MM 电源域
                    reg = <MT8173_POWER_DOMAIN_MM>;  # 电源域标识符
                    clocks = <&topckgen CLK_TOP_MM_SEL>;  # 需要的时钟
                    clock-names = "mm";  # 时钟名称
                    #power-domain-cells = <0>;  # 电源域单元数
                    mediatek,infracfg = <&infracfg>;  # 特定于MediaTek的配置
                };
                power-domain@MT8173_POWER_DOMAIN_VENC_LT {  # VENC_LT 电源域
                    reg = <MT8173_POWER_DOMAIN_VENC_LT>;  # 电源域标识符
                    clocks = <&topckgen CLK_TOP_MM_SEL>, <&topckgen CLK_TOP_VENC_LT_SEL>;  # 需要的时钟
                    clock-names = "mm", "venclt";  # 时钟名称
                    #power-domain-cells = <0>;  # 电源域单元数
                };
                power-domain@MT8173_POWER_DOMAIN_AUDIO {  # AUDIO 电源域
                    reg = <MT8173_POWER_DOMAIN_AUDIO>;  # 电源域标识符
                    #power-domain-cells = <0>;  # 电源域单元数
                };
                power-domain@MT8173_POWER_DOMAIN_USB {  # USB 电源域
                    reg = <MT8173_POWER_DOMAIN_USB>;  # 电源域标识符
                    #power-domain-cells = <0>;  # 电源域单元数
                };
                power-domain@MT8173_POWER_DOMAIN_MFG_ASYNC {  # MFG_ASYNC 电源域
                    reg = <MT8173_POWER_DOMAIN_MFG_ASYNC>;  # 电源域标识符
                    clocks = <&clk26m>;  # 需要的时钟
                    clock-names = "mfg";  # 时钟名称
                    #address-cells = <1>;  # 地址单元数
                    #size-cells = <0>;  # 大小单元数
                    #power-domain-cells = <1>;  # 电源域单元数

                    power-domain@MT8173_POWER_DOMAIN_MFG_2D {  # MFG_2D 电源域
                        reg = <MT8173_POWER_DOMAIN_MFG_2D>;  # 电源域标识符
                        #address-cells = <1>;  # 地址单元数
                        #size-cells = <0>;  # 大小单元数
                        #power-domain-cells = <1>;  # 电源域单元数

                        power-domain@MT8173_POWER_DOMAIN_MFG {  # MFG 电源域
                            reg = <MT8173_POWER_DOMAIN_MFG>;  # 电源域标识符
                            #power-domain-cells = <0>;  # 电源域单元数
                            mediatek,infracfg = <&infracfg>;  # 特定于MediaTek的配置
                        };
                    };
                };
            };
        };
    };
```
请注意，由于设备树语法的特殊性，这里的中文翻译保持了原有的语法结构，并尽可能地保留了原文中的关键字和符号。
~~~~

## Documentation/devicetree/bindings/power/mti,mips-cpc_cn.yaml
~~~~yaml
```yaml
# SPDX-License-Identifier: (GPL-2.0 OR BSD-2-Clause)
%YAML 1.2
---
$id: http://devicetree.org/schemas/power/mti,mips-cpc.yaml#
$schema: http://devicetree.org/meta-schemas/core.yaml#

title: MIPS 集群电源控制器

description: |
  定义了 MIPS 集群电源控制器寄存器的位置。
maintainers:
  - Paul Burton <paulburton@kernel.org>

properties:
  compatible:
    const: mti,mips-cpc

  reg:
    description: |
      未占用内存区域的基地址和大小，将用于映射 MIPS CPC 寄存器块。
maxItems: 1

required:
  - compatible
  - reg

additionalProperties: false

examples:
  - |
    cpc@1bde0000 {
      compatible = "mti,mips-cpc";
      reg = <0x1bde0000 0x8000>;
    };
```

这段 YAML 文件描述了一个设备树规范，定义了 MIPS 集群电源控制器的结构和配置要求。它指定了控制器的兼容性字符串、寄存器区域的基址及大小，并给出了一个示例配置。
~~~~

## Documentation/devicetree/bindings/power/pd-samsung_cn.yaml
~~~~yaml
```yaml
# SPDX-License-Identifier: GPL-2.0
%YAML 1.2
---
$id: 'http://devicetree.org/schemas/power/pd-samsung.yaml#'
$schema: 'http://devicetree.org/meta-schemas/core.yaml#'

title: 三星 Exynos SoC 电源域

maintainers:
  - Krzysztof Kozlowski <krzk@kernel.org>

description: |+
  Exynos 处理器包含对多个电源域的支持，这些电源域用于
  控制处理器上一个或多个外设的电源闸控。
allOf:
  - $ref: 'power-domain.yaml#'

properties:
  compatible:
    enum:
      - samsung,exynos4210-pd
      - samsung,exynos5433-pd

  reg:
    maxItems: 1

  clocks:
    deprecated: true
    maxItems: 1

  clock-names:
    deprecated: true
    maxItems: 1

  label:
    description:
      可读性良好的字符串，表示域名称。将在用户空间中可见，
      以便用户能够在 SoC 中的多个域之间进行区分。
"#power-domain-cells":
    const: 0

  power-domains:
    maxItems: 1

required:
  - compatible
  - "#power-domain-cells"
  - reg

unevaluatedProperties: false

examples:
  - |
    lcd0_pd: power-domain@10023c80 {
        compatible = "samsung,exynos4210-pd";
        reg = <0x10023c80 0x20>;
        #power-domain-cells = <0>;
        label = "LCD0";
    };

    mfc_pd: power-domain@10044060 {
        compatible = "samsung,exynos4210-pd";
        reg = <0x10044060 0x20>;
        #power-domain-cells = <0>;
        label = "MFC";
    };
```

以上是将给定的 YAML 文档翻译成中文版本。请注意，一些关键字（如 `compatible`, `reg` 等）和注释符号（如 `#` 和 `##`）保持不变以遵循 YAML 格式的要求。
~~~~

## Documentation/devicetree/bindings/power/power-domain_cn.yaml
~~~~yaml
# SPDX-License-Identifier: GPL-2.0
%YAML 1.2
---
$id: http://devicetree.org/schemas/power/power-domain.yaml#
$schema: http://devicetree.org/meta-schemas/core.yaml#

标题: 通用电源管理(PM)域

维护者:
  - Rafael J. Wysocki <rjw@rjwysocki.net>
  - Kevin Hilman <khilman@kernel.org>
  - Ulf Hansson <ulf.hansson@linaro.org>

描述: |+
  系统芯片设计通常被划分为多个PM域，这些PM域能够通过电源门控来选择性关闭某些IP块以减少泄漏电流，从而节省功耗。此外，在某些情况下，类似的PM域还可能能够为一组IP块提供性能缩放。
此设备树绑定可以用于将PM域消费者设备与PM域提供商提供的PM域进行绑定。PM域提供商可以由设备树中的任意节点表示，并且可以提供一个或多个PM域。消费者节点可以通过phandle和一组phandle参数（所谓的PM域标识符）来引用提供商，该组参数的长度由PM域提供商节点中的\#power-domain-cells属性指定。

属性:
  $nodename:
    模式: "^(power-controller|power-domain|performance-domain)([@-].*)?$"

  domain-idle-states:
    $ref: /schemas/types.yaml#/definitions/phandle-array
    items:
      最大项数: 1
    描述: |
      定义了PM域提供商可用状态的空闲状态phandle。空闲状态定义与domain-idle-state绑定兼容，具体在./domain-idle-state.yaml中指定。
注意，domain-idle-state属性反映的是这个PM域的空闲状态，而不是PM域内设备或子域的空闲状态。设备和子域拥有独立于父域空闲状态的自己的空闲状态。如果没有此属性，则认为该域能够处于上电或断电状态。
operating-points-v2:
    描述:
      可以进行性能缩放的PM域的OPP表的phandle，这些PM域由PM域提供商提供。如果提供商仅提供单一PM域，或者所有由提供商提供的PM域具有相同的OPP表，则此处应包含单个phandle。更多信息请参考../opp/opp-v2-base.yaml
"#power-domain-cells":
    描述:
      PM域标识符中的单元格数量。对于代表单一PM域的节点，通常是0；对于提供多个PM域的节点（例如电源控制器），通常是1，但也可以是任何值，具体取决于特定提供商的设备树绑定文档中的规定。
power-domains:
    描述:
      根据phandle指定的电源控制器绑定定义的phandle和PM域标识符。一些PM域可能从另一个PM域获取供电（或其他硬件特定依赖）。为了表示这种依赖关系，使用标准的PM域消费者绑定。当提供时，由给定提供商创建的所有域都应该是由本绑定指定的域的子域。
必需:
  - "#power-domain-cells"

附加属性: true

示例:
  - |
    power: power-controller@12340000 {
        compatible = "foo,power-controller";
        reg = <0x12340000 0x1000>;
        #power-domain-cells = <1>;
    };

    // 上面的节点定义了一个PM域提供商的电源控制器，并期望其phandle参数有一个单元格
- |
    parent2: power-controller@12340000 {
        compatible = "foo,power-controller";
        reg = <0x12340000 0x1000>;
        #power-domain-cells = <1>;
    };

    child2: power-controller@12341000 {
        compatible = "foo,power-controller";
        reg = <0x12341000 0x1000>;
        power-domains = <&parent2 0>;
        #power-domain-cells = <1>;
    };

    // 上面的节点定义了两个电源控制器：“parent”和“child”
// “child”电源控制器创建的域是“parent”电源控制器提供的“0”号PM域的子域
下面是给定的 Device Tree Blob (DTB) 配置片段的中文翻译：

```plaintext
# 父节点：power-controller@12340000 {
    compatible = "foo,power-controller";  // 兼容性标识为 "foo,power-controller"
    reg = <0x12340000 0x1000>;  // 寄存器地址范围从 0x12340000 到 0x12340fff
    #power-domain-cells = <0>;  // 指示电源域描述符的单元格数量为 0
    domain-idle-states = <&DOMAIN_RET>, <&DOMAIN_PWR_DN>;  // 定义了两个空闲状态：保留状态和功率下降状态
};

# 子节点：power-controller@12341000 {
    compatible = "foo,power-controller";  // 兼容性标识为 "foo,power-controller"
    reg = <0x12341000 0x1000>;  // 寄存器地址范围从 0x12341000 到 0x12341fff
    power-domains = <&parent3>;  // 所属的电源域为父节点
    #power-domain-cells = <0>;  // 指示电源域描述符的单元格数量为 0
    domain-idle-states = <&DOMAIN_PWR_DN>;  // 定义了一个空闲状态：功率下降状态
};

# 定义空闲状态
domain-idle-states {
    DOMAIN_RET: domain-retention {  // 保留状态
        compatible = "domain-idle-state";  // 兼容性标识为 "domain-idle-state"
        entry-latency-us = <1000>;  // 进入该状态的延迟为 1000 微秒
        exit-latency-us = <2000>;  // 退出该状态的延迟为 2000 微秒
        min-residency-us = <10000>;  // 最小驻留时间为 10000 微秒
    };

    DOMAIN_PWR_DN: domain-pwr-dn {  // 功率下降状态
        compatible = "domain-idle-state";  // 兼容性标识为 "domain-idle-state"
        entry-latency-us = <5000>;  // 进入该状态的延迟为 5000 微秒
        exit-latency-us = <8000>;  // 退出该状态的延迟为 8000 微秒
        min-residency-us = <7000>;  // 最小驻留时间为 7000 微秒
    };
};
```

这段配置描述了一个电源控制器及其子电源控制器，以及它们支持的不同空闲状态。
~~~~

## Documentation/devicetree/bindings/power/power_domain_cn.txt
~~~~
* 通用电源管理 (PM) 域

片上系统设计通常被划分为多个电源管理 (PM) 域，这些域可用于通过降低漏电流来关闭选定的 IP 模块以节省电力。此设备树绑定可以用于将使用 PM 域的设备（消费者）与提供 PM 域的设备（提供者）进行绑定。PM 域提供者可以由设备树中的任意节点表示，并且可以提供一个或多个 PM 域。消费者节点可以通过指针 (phandle) 和一组指针参数（即所谓的 PM 域标识符）来引用提供者，这些参数的长度由 PM 域提供者节点中的 #power-domain-cells 属性指定。

==PM 域提供者==

请参阅 `power-domain.yaml`

==PM 域消费者==

必需属性：
- `power-domains`：一个 PM 域标识符列表，如电源控制器（即 PM 域提供者）绑定中所定义的。
可选属性：
- `power-domain-names`：一个按名称字符串排序的列表，与 `power-domains` 属性中的顺序相同。消费者驱动程序会使用 `power-domain-names` 来匹配电源域与其标识符。
示例：

```device_tree
leaky-device@12350000 {
    compatible = "foo,i-leak-current";
    reg = <0x12350000 0x1000>;
    power-domains = <&power 0>;
    power-domain-names = "io";
};

leaky-device@12351000 {
    compatible = "foo,i-leak-current";
    reg = <0x12351000 0x1000>;
    power-domains = <&power 0>, <&power 1>;
    power-domain-names = "io", "clk";
};
```

第一个示例定义了一个典型的 PM 域消费者设备，该设备位于由标签为 "power" 的节点代表的电源控制器提供的索引为 0 的 PM 域内。在第二个示例中，消费者设备跨越两个 PM 域，第一个域索引为 0，第二个域索引为 1，这些域由标签为 "power" 的节点代表的电源控制器提供。

可选属性：
- `required-opps`：这个属性包含指向另一个设备的 OPP 表中的 OPP 节点的指针。它可以包含指向不同设备 OPP 的指针数组，但不应包含指向同一 OPP 表中多个 OPP 节点的多个指针。这指定了当前设备在当前 OPP（该属性存在的位置）下所需的最低 OPP。
示例：
- 提供两个域的 PM 域提供者的 OPP 表
```device_tree
domain0_opp_table: opp-table0 {
    compatible = "operating-points-v2";
    domain0_opp_0: opp-1000000000 {
        opp-hz = /bits/ 64 <1000000000>;
        opp-microvolt = <975000 970000 985000>;
    };
    domain0_opp_1: opp-1100000000 {
        opp-hz = /bits/ 64 <1100000000>;
        opp-microvolt = <1000000 980000 1010000>;
    };
};

domain1_opp_table: opp-table1 {
    compatible = "operating-points-v2";
    domain1_opp_0: opp-1200000000 {
        opp-hz = /bits/ 64 <1200000000>;
        opp-microvolt = <975000 970000 985000>;
    };
    domain1_opp_1: opp-1300000000 {
        opp-hz = /bits/ 64 <1300000000>;
        opp-microvolt = <1000000 980000 1010000>;
    };
};

power: power-controller@12340000 {
    compatible = "foo,power-controller";
    reg = <0x12340000 0x1000>;
    #power-domain-cells = <1>;
    operating-points-v2 = <&domain0_opp_table>, <&domain1_opp_table>;
};

leaky-device0@12350000 {
    compatible = "foo,i-leak-current";
    reg = <0x12350000 0x1000>;
    power-domains = <&power 0>;
    required-opps = <&domain0_opp_0>;
};

leaky-device1@12350000 {
    compatible = "foo,i-leak-current";
    reg = <0x12350000 0x1000>;
    power-domains = <&power 1>;
    required-opps = <&domain1_opp_1>;
};
```

[1]. 文档/devicetree/bindings/power/domain-idle-state.yaml
~~~~
