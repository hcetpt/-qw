## Documentation/devicetree/bindings/power/qcom,kpss-acc-v2_cn.yaml
```yaml
# SPDX-许可证标识符: GPL-2.0-only 或 BSD-2-Clause
%YAML 1.2
---
$id: http://devicetree.org/schemas/power/qcom,kpss-acc-v2.yaml#
$schema: http://devicetree.org/meta-schemas/core.yaml#

title: Krait 处理器子系统 (KPSS) 应用时钟控制器 (ACC) v2

maintainers:
  - Christian Marangi <ansuelsmth@gmail.com>

description:
  KPSS ACC 为 Krait CPU 提供时钟、电源管理和复位控制。在 KPSS 重映射区域内，每个 CPU 对应一个 ACC 寄存器区域，以及一个别名寄存器区域，该区域将访问重映射到与访问该区域的 CPU 相关联的 ACC。目前，ACC v2 被用作用于启用 CPU 的电源管理器。

properties:
  compatible:
    const: qcom,kpss-acc-v2

  reg:
    items:
      - description: 寄存器区域的基本地址和大小
      - description: 可选的基本地址和大小的别名寄存器区域
    minItems: 1

required:
  - compatible
  - reg

additionalProperties: false

examples:
  - |
    power-manager@f9088000 {
      compatible = "qcom,kpss-acc-v2";
      reg = <0xf9088000 0x1000>,
            <0xf9008000 0x1000>;
    };
```

## Documentation/devicetree/bindings/power/renesas,apmu_cn.yaml
```yaml
# SPDX-License-Identifier: (GPL-2.0-only OR BSD-2-Clause)
%YAML 1.2
---
$id: http://devicetree.org/schemas/power/renesas,apmu.yaml#
$schema: http://devicetree.org/meta-schemas/core.yaml#

title: Renesas 高级电源管理单元

maintainers:
  - Geert Uytterhoeven <geert+renesas@glider.be>
  - Magnus Damm <magnus.damm@gmail.com>

description:
  Renesas R-Car Gen2 和 RZ/G1 系统芯片使用一个或多个 APMU（高级电源管理单元）硬件单元来控制 CPU 核心电源域，包括对称多处理启动和 CPU 热插拔。

properties:
  compatible:
    items:
      - enum:
          - renesas,r8a7742-apmu  # RZ/G1H
          - renesas,r8a7743-apmu  # RZ/G1M
          - renesas,r8a7744-apmu  # RZ/G1N
          - renesas,r8a7745-apmu  # RZ/G1E
          - renesas,r8a77470-apmu # RZ/G1C
          - renesas,r8a7790-apmu  # R-Car H2
          - renesas,r8a7791-apmu  # R-Car M2-W
          - renesas,r8a7792-apmu  # R-Car V2H
          - renesas,r8a7793-apmu  # R-Car M2-N
          - renesas,r8a7794-apmu  # R-Car E2
      - const: renesas,apmu

  reg:
    maxItems: 1

  cpus:
    minItems: 1
    maxItems: 4
    description: |
      指向 CPU 核心的句柄数组，应与设备数据手册中高级电源管理单元部分的 WUPCR 和 PSTR 寄存器所使用的 CPU 核心顺序相匹配。
required:
  - compatible
  - reg
  - cpus

additionalProperties: false

examples:
  - |
    apmu@e6152000 {
            compatible = "renesas,r8a7791-apmu", "renesas,apmu";
            reg = <0xe6152000 0x188>;
            cpus = <&cpu0>, <&cpu1>;
    };
```

## Documentation/devicetree/bindings/power/renesas,rcar-sysc_cn.yaml
~~~~yaml
```yaml
# SPDX-许可证标识符: (GPL-2.0-only 或 BSD-2-Clause)
%YAML 1.2
---
$id: http://devicetree.org/schemas/power/renesas,rcar-sysc.yaml#
$schema: http://devicetree.org/meta-schemas/core.yaml#

标题: Renesas R-Car 和 RZ/G 系统控制器

维护者:
  - Geert Uytterhoeven <geert+renesas@glider.be>
  - Magnus Damm <magnus.damm@gmail.com>

描述: |
  R-Car (RZ/G) 系统控制器为 CPU 核心和各种协处理器提供电源管理。
  消费者的电源域 ID 在头文件中定义 ::
    include/dt-bindings/power/r8*-sysc.h

属性:
  compatible:
    枚举:
      - renesas,r8a7742-sysc  # RZ/G1H
      - renesas,r8a7743-sysc  # RZ/G1M
      - renesas,r8a7744-sysc  # RZ/G1N
      - renesas,r8a7745-sysc  # RZ/G1E
      - renesas,r8a77470-sysc # RZ/G1C
      - renesas,r8a774a1-sysc # RZ/G2M
      - renesas,r8a774b1-sysc # RZ/G2N
      - renesas,r8a774c0-sysc # RZ/G2E
      - renesas,r8a774e1-sysc # RZ/G2H
      - renesas,r8a7779-sysc  # R-Car H1
      - renesas,r8a7790-sysc  # R-Car H2
      - renesas,r8a7791-sysc  # R-Car M2-W
      - renesas,r8a7792-sysc  # R-Car V2H
      - renesas,r8a7793-sysc  # R-Car M2-N
      - renesas,r8a7794-sysc  # R-Car E2
      - renesas,r8a7795-sysc  # R-Car H3
      - renesas,r8a77961-sysc # R-Car M3-W+
      - renesas,r8a77965-sysc # R-Car M3-N
      - renesas,r8a7796-sysc  # R-Car M3-W
      - renesas,r8a77970-sysc # R-Car V3M
      - renesas,r8a77980-sysc # R-Car V3H
      - renesas,r8a77990-sysc # R-Car E3
      - renesas,r8a77995-sysc # R-Car D3
      - renesas,r8a779a0-sysc # R-Car V3U
      - renesas,r8a779f0-sysc # R-Car S4-8
      - renesas,r8a779g0-sysc # R-Car V4H
      - renesas,r8a779h0-sysc # R-Car V4M

  reg:
    maxItems: 1

  '#power-domain-cells':
    常量: 1

必需:
  - compatible
  - reg
  - '#power-domain-cells'

额外属性: false

示例:
  - |
    // 系统控制器节点
    sysc: system-controller@e6180000 {
            compatible = "renesas,r8a7791-sysc";
            reg = <0xe6180000 0x0200>;
            #power-domain-cells = <1>;
    };
```
请注意，部分 YAML 关键字如 `title`、`maintainers`、`description` 等被翻译成了更符合中文习惯的词汇，而 YAML 的结构和内容保持不变。
~~~~

## Documentation/devicetree/bindings/power/renesas,sysc-rmobile_cn.yaml
```yaml
下面是给定内容的中文翻译：

# SPDX-许可证标识符: (GPL-2.0-only 或 BSD-2-Clause)
%YAML 1.2
---
$id: http://devicetree.org/schemas/power/renesas,sysc-rmobile.yaml#
$schema: http://devicetree.org/meta-schemas/core.yaml#

标题: Renesas R-Mobile 系统控制器

维护者:
  - Geert Uytterhoeven <geert+renesas@glider.be>
  - Magnus Damm <magnus.damm@gmail.com>

描述: |
  R-Mobile 系统控制器提供了以下功能：
    - 启动模式管理，
    - 重置生成，
    - 电源管理
属性:
  compatible:
    items:
      - 枚举:
          - renesas,sysc-r8a73a4    # R-Mobile APE6
          - renesas,sysc-r8a7740    # R-Mobile A1
          - renesas,sysc-sh73a0     # SH-Mobile AG5
      - 常量: renesas,sysc-rmobile # 通用 SH/R-Mobile

  reg:
    items:
      - 描述: 正常可访问寄存器块
      - 描述: 受 HPB 半导体保护的寄存器块

  pm-domains:
    类型: 对象
    描述: |
      此节点包含 PM 域节点的层次结构，应与设备数据手册中“电源域规范”部分中的电源区域层次结构相匹配。
属性:
      '#address-cells':
        常量: 1

      '#size-cells':
        常量: 0

    additionalProperties:
      $ref: "#/$defs/pd-node"

必需:
  - compatible
  - reg
  - pm-domains

additionalProperties: false

$defs:
  pd-node:
    类型: 对象
    描述:
      PM 域节点表示一个 PM 域。此节点应以其实际的电源区域名称命名，因此其名称应是唯一的。
属性:
      reg:
        maxItems: 1
        描述:
          如果 PM 域不是始终开启，则此属性必须包含对应电源区域在各种电源控制和状态寄存器中的位索引号。
          如果 PM 域始终开启，则必须省略此属性。
'#address-cells':
        常量: 1

      '#size-cells':
        常量: 0

      '#power-domain-cells':
        常量: 0

    必需:
      - '#power-domain-cells'

    additionalProperties:
      $ref: "#/$defs/pd-node"

示例:
  - |
    // 这里展示的是 r8a7740 PM 域层次结构的一个子集，包括
    // C5 “始终开启” 域、它的两个子域（A4S 和 A4SU），以及 A3SP 域，
    // A3SP 是 A4S 的子域
sysc: system-controller@e6180000 {
            compatible = "renesas,sysc-r8a7740", "renesas,sysc-rmobile";
            reg = <0xe6180000 0x8000>, <0xe6188000 0x8000>;

            pm-domains {
                    pd_c5: c5 {
                            #address-cells = <1>;
                            #size-cells = <0>;
                            #power-domain-cells = <0>;

                            pd_a4s: a4s@10 {
                                    reg = <10>;
                                    #address-cells = <1>;
                                    #size-cells = <0>;
                                    #power-domain-cells = <0>;

                                    pd_a3sp: a3sp@11 {
                                            reg = <11>;
                                            #power-domain-cells = <0>;
                                    };
                            };

                            pd_a4su: a4su@20 {
                                    reg = <20>;
                                    #power-domain-cells = <0>;
                            };
                    };
            };
    };
```

## Documentation/devicetree/bindings/power/reset/atmel,at91sam9260-shdwc_cn.yaml
```yaml
# SPDX-License-Identifier: (GPL-2.0-only OR BSD-2-Clause)
%YAML 1.2
---
$id: http://devicetree.org/schemas/power/reset/atmel,at91sam9260-shdwc.yaml#
$schema: http://devicetree.org/meta-schemas/core.yaml#

title: Microchip AT91 SHDWC 断电控制器

maintainers:
  - Claudiu Beznea <claudiu.beznea@microchip.com>

description: |
  Microchip AT91 SHDWC 断电控制器控制电源供应 VDDIO 和 VDDCORE，以及在去抖输入线上检测唤醒。

properties:
  compatible:
    enum:
      - atmel,at91sam9260-shdwc
      - atmel,at91sam9rl-shdwc
      - atmel,at91sam9x5-shdwc

  reg:
    maxItems: 1

  clocks:
    maxItems: 1

  atmel,wakeup-mode:
    description: 唤醒模式的操作模式
    $ref: /schemas/types.yaml#/definitions/string
    enum: [ none, high, low, any ]

  atmel,wakeup-counter:
    description: 唤醒 0 上的计数器
    $ref: /schemas/types.yaml#/definitions/uint32
    minimum: 0
    maximum: 15

  atmel,wakeup-rtt-timer:
    description: 启用实时定时器唤醒
    type: boolean

  atmel,wakeup-rtc-timer:
    description: 启用实时时钟唤醒
    type: boolean

required:
  - compatible
  - reg
  - clocks

allOf:
  - if:
      properties:
        compatible:
          contains:
            const: atmel,at91sam9x5-shdwc
    then:
      properties:
        atmel,wakeup-rtt-timer: false

  - if:
      properties:
        compatible:
          contains:
            const: atmel,at91sam9260-shdwc
    then:
      properties:
        atmel,wakeup-rtc-timer: false

additionalProperties: false

examples:
  - |
    shdwc: poweroff@fffffd10 {
        compatible = "atmel,at91sam9260-shdwc";
        reg = <0xfffffd10 0x10>;
        clocks = <&clk32k>;
    };
```

## Documentation/devicetree/bindings/power/reset/atmel,sama5d2-shdwc_cn.yaml
~~~~yaml
下面是给定 YAML 文档的中文翻译：

```yaml
# SPDX-文件许可标识符: (GPL-2.0-only 或 BSD-2-Clause)
%YAML 1.2
---
$id: http://devicetree.org/schemas/power/reset/atmel,sama5d2-shdwc.yaml#
$schema: http://devicetree.org/meta-schemas/core.yaml#

标题: Microchip AT91 SAMA5D2 SHDWC 关机控制器

维护者:
  - Claudiu Beznea <claudiu.beznea@microchip.com>

描述: |
  Microchip AT91 SHDWC 关机控制器控制电源供应 VDDIO 和 VDDCORE 以及在消抖输入线上进行唤醒检测
属性:
  compatible:
    oneOf:
      - items:
          - const: microchip,sama7g5-shdwc
          - const: syscon
      - enum:
          - atmel,sama5d2-shdwc
          - microchip,sam9x60-shdwc

  reg:
    maxItems: 1

  clocks:
    maxItems: 1

  "#address-cells":
    const: 1

  "#size-cells":
    const: 0

  debounce-delay-us:
    描述:
      最小唤醒输入消抖周期（微秒）。通常这是一个与板卡相关联的属性

atmel,wakeup-rtc-timer:
    描述: 启用实时钟唤醒
    类型: 布尔值

  atmel,wakeup-rtt-timer:
    描述: 启用实时定时器唤醒
    类型: 布尔值

模式属性:
  "^input@[0-15]$":
    描述:
      唤醒输入节点。这些节点通常在设备树的“板卡”部分中描述。需要注意的是，输入 0 与唤醒引脚相连，并且经常被使用
类型: 对象
    属性:
      reg:
        描述: 包含唤醒输入索引
        最小值: 0
        最大值: 15

      atmel,wakeup-active-high:
        描述:
          该子节点所描述的对应唤醒输入在高电平时强制唤醒核心电源。默认情况下为低电平激活
类型: 布尔值

    必需:
      - reg

    其他属性: false

必需:
  - compatible
  - reg
  - clocks

全部:
  - 如果:
      属性:
        compatible:
          包含:
            const: atmel,sama5d2-shdwc
    然后:
      属性:
        atmel,wakeup-rtt-timer: false

其他属性: false

示例:
  - |
    shdwc: poweroff@f8048010 {
        compatible = "atmel,sama5d2-shdwc";
        reg = <0xf8048010 0x10>;
        clocks = <&clk32k>;
        #address-cells = <1>;
        #size-cells = <0>;
        atmel,wakeup-rtc-timer;
        debounce-delay-us = <976>;

        input@0 {
            reg = <0>;
        };

        input@1 {
            reg = <1>;
            atmel,wakeup-active-high;
        };
    };
```

请注意，这个翻译尽可能保持了原始 YAML 的结构和格式，仅将文本内容翻译成了中文。
~~~~

## Documentation/devicetree/bindings/power/reset/axxia-reset_cn.txt
~~~~
Axxia 重启驱动程序

此驱动程序可以对 Axxia 系统级芯片 (SoC) 进行复位。它使用 syscon 模块中的寄存器来发起芯片复位。
必需的属性：
  -compatible: "lsi,axm55xx-reset"
  -syscon: 对 syscon 节点的 phandle 引用
示例：

```
syscon: syscon@2010030000 { 
	compatible = "lsi,axxia-syscon", "syscon";
	reg = <0x20 0x10030000 0 0x2000>;
};

reset: reset@2010031000 { 
	compatible = "lsi,axm55xx-reset";
	syscon = <&syscon>;
};
```

以上内容描述了一个用于 Axxia SoC 的复位驱动程序，它可以利用 syscon 块中的寄存器来执行芯片复位操作。在 Device Tree 中，定义了必要的属性和示例配置。
~~~~

## Documentation/devicetree/bindings/power/reset/brcm,bcm21664-resetmgr_cn.yaml
~~~~yaml
```yaml
# SPDX-文件许可标识: GPL-2.0-only 或 BSD-2-Clause
%YAML 1.2
---
$id: http://devicetree.org/schemas/power/reset/brcm,bcm21664-resetmgr.yaml#
$schema: http://devicetree.org/meta-schemas/core.yaml#

title: Broadcom Kona 系列重置管理器

maintainers:
  - Florian Fainelli <f.fainelli@gmail.com>

properties:
  compatible:
    const: brcm,bcm21664-resetmgr

  reg:
    maxItems: 1

required:
  - compatible
  - reg

additionalProperties: false

examples:
  - |
    reset-controller@35001f00 {
        compatible = "brcm,bcm21664-resetmgr";
        reg = <0x35001f00 0x24>;
    };
```

此段文本描述了一个设备树（Device Tree）配置文件的模式，用于定义Broadcom Kona系列中的重置管理器。该模式规定了必要的属性和其格式要求，并给出了一个示例。
~~~~

## Documentation/devicetree/bindings/power/reset/gemini-poweroff_cn.txt
~~~~
Cortina Systems Gemini 关机设备树绑定

这是 Cortina Gemini 系统芯片 (SoC) 中的一个特殊 IP 模块，仅处理系统的各种关机方式。
必需的属性：
- compatible（兼容性）：应为 "cortina,gemini-power-controller"
- reg（寄存器）：应包含物理内存基址和大小
- interrupts（中断）：应包含电源管理中断

示例：

``` 
power-controller@4b000000 { 
	compatible = "cortina,gemini-power-controller"; 
	reg = <0x4b000000 0x100>; 
	interrupts = <26 IRQ_TYPE_EDGE_FALLING>; 
};
```
这段代码表示了一个位于物理地址 `0x4b000000` 处、大小为 `0x100` 的电源控制器模块。它与 "cortina,gemini-power-controller" 兼容，并且通过编号为 26 的中断，以下降沿触发的方式进行电源管理。
~~~~

## Documentation/devicetree/bindings/power/reset/gpio-poweroff_cn.yaml
```yaml
# SPDX-许可证标识符: (GPL-2.0-only 或 BSD-2-Clause)
%YAML 1.2
---
$id: http://devicetree.org/schemas/power/reset/gpio-poweroff.yaml#
$schema: http://devicetree.org/meta-schemas/core.yaml#

标题: 通过 GPIO 控制的关机

维护者:
  - Sebastian Reichel <sre@kernel.org>

描述: >
  通过一个 GPIO 线来支持系统关机。当执行关机时，
  操作系统预期将 GPIO 从非激活状态切换到激活状态。
  经过一段时间延迟（active-delay-ms）后，它预期被切换回非激活状态。
  再经过另一段延迟时间（inactive-delay-ms）后，它被配置为激活状态。
  最后，如果系统在等待一段时间（timeout-ms）后仍然运行，则操作系统假定关机失败。
allOf:
  - $ref: restart-handler.yaml#

属性:
  compatible:
    常量: gpio-poweroff

  gpios:
    maxItems: 1

  input:
    类型: 布尔值
    描述: >
      初始时将 GPIO 线配置为输入。仅当启动关机序列时重新配置它为输出。
      如果此可选属性未指定，则 GPIO 初始化为其非激活状态下的输出。

  active-delay-ms:
    默认: 100
    描述: 在驱动 GPIO 激活后等待的延迟时间

  inactive-delay-ms:
    默认: 100
    描述: 在驱动 GPIO 非激活后等待的延迟时间

  priority:
    默认: 0

  timeout-ms:
    默认: 3000
    描述: 在假设关机序列失败前等待的时间
required:
  - compatible
  - gpios

additionalProperties: false

示例:
  - |
    gpio-poweroff {
        compatible = "gpio-poweroff";
        gpios = <&gpio 4 0>;
        timeout-ms = <3000>;
    };
```

## Documentation/devicetree/bindings/power/reset/gpio-restart_cn.yaml
```yaml
# SPDX-License-Identifier: (GPL-2.0-only OR BSD-2-Clause)
%YAML 1.2
---
$id: http://devicetree.org/schemas/power/reset/gpio-restart.yaml#
$schema: http://devicetree.org/meta-schemas/core.yaml#

标题: 由GPIO控制的重启

维护者:
  - Sebastian Reichel <sre@kernel.org>

描述: >
  驱动一个GPIO线，该线可以从重启处理程序中用来重启系统。
此绑定支持电平触发和边沿触发的重启。在驱动加载时，驱动会请求给定的GPIO线并安装重启处理程序。如果可选属性
  'open-source' 不存在，则GPIO线将被置于非活动状态。否则，在发起重启之前不会驱动它。
当系统重启时，将按照优先级顺序调用重启处理程序。GPIO配置为输出，并被驱动至活动状态，触发电平触发的重启条件。
这也将导致非活动到活动的边沿条件，从而触发正边沿触发的重启。在指定的active-delay之后，
GPIO被设置为非活动状态，从而触发负边沿触发的重启。在指定的inactive-delay之后，GPIO再次被驱动至活动状态。
在指定的wait-delay之后，重启处理程序完成，允许尝试其他重启处理程序。

allOf:
  - $ref: restart-handler.yaml#

属性:
  compatible:
    常量: gpio-restart

  gpios:
    描述: 要设置为高或低的GPIO，参见 "gpios 属性" 在
      文档/devicetree/bindings/gpio/gpio.txt。如果要通过使引脚处于低电平来重启板子，请将其设置为 "Active Low"，
      否则将GPIO设置为 "Active High"。

  open-source:
    $ref: /schemas/types.yaml#/definitions/flag
    描述: 将GPIO视为开路源，并推迟到重启开始时才进行驱动。如果没有指定这个可选属性，
      则GPIO将以非活动状态初始化为输出。

  priority:
    默认值: 129

  active-delay:
    $ref: /schemas/types.yaml#/definitions/uint32
    描述: 驱动GPIO至活动状态后的延迟（默认100）[毫秒]
    默认值: 100

  inactive-delay:
    $ref: /schemas/types.yaml#/definitions/uint32
    描述: 驱动GPIO至非活动状态后的延迟（默认100）[毫秒]
    默认值: 100

  wait-delay:
    $ref: /schemas/types.yaml#/definitions/uint32
    描述: 完成重启序列后的等待延迟（默认3000）[毫秒]
    默认值: 3000

其他属性: false

必需:
  - compatible
  - gpios

示例:
  - |
    gpio-restart {
      compatible = "gpio-restart";
      gpios = <&gpio 4 0>;
      priority = <128>;
      active-delay = <100>;
      inactive-delay = <100>;
      wait-delay = <3000>;
    };
```
