## Documentation/devicetree/bindings/power/supply/richtek,rt9455_cn.yaml
~~~~yaml
```yaml
# SPDX-许可证标识符: GPL-2.0
%YAML 1.2
---
$id: http://devicetree.org/schemas/power/supply/richtek,rt9455.yaml#
$schema: http://devicetree.org/meta-schemas/core.yaml#

title: Richtek rt9455 电池充电器

maintainers:
  - Sebastian Reichel <sre@kernel.org>

allOf:
  - $ref: power-supply.yaml#

properties:
  compatible:
    const: richtek,rt9455

  reg:
    maxItems: 1

  interrupts:
    maxItems: 1

  richtek,output-charge-current:
    $ref: /schemas/types.yaml#/definitions/uint32
    description: 充电器向电池输出的电流，单位为微安（uA）
richtek,end-of-charge-percentage:
    $ref: /schemas/types.yaml#/definitions/uint32
    description: |
      输出充电电流的百分比。当恒压阶段的电流降至output_charge_current乘以end_of_charge_percentage时，充电终止
richtek,battery-regulation-voltage:
    $ref: /schemas/types.yaml#/definitions/uint32
    description: 电池的最大电压，单位为微伏（uV）
richtek,boost-output-voltage:
    $ref: /schemas/types.yaml#/definitions/uint32
    description: |
      当充电器处于升压模式时，提供给终端设备的最大电压，单位为微伏（uV）
richtek,min-input-voltage-regulation:
    $ref: /schemas/types.yaml#/definitions/uint32
    description: |
      输入电压等级，单位为微伏（uV），用于在输入电源发生过流时降低电压等级。这可以防止由于电源提供的电流不足而导致的输入电压下降。默认值为4500000 uV (4.5V)
richtek,avg-input-current-regulation:
    $ref: /schemas/types.yaml#/definitions/uint32
    description: |
      充电器从电源抽取的输入电流值，单位为微安（uA）。默认值为500000 uA (500mA)
required:
  - compatible
  - reg
  - interrupts
  - richtek,output-charge-current
  - richtek,end-of-charge-percentage
  - richtek,battery-regulation-voltage
  - richtek,boost-output-voltage

additionalProperties: false

examples:
  - |
    #include <dt-bindings/interrupt-controller/irq.h>
    i2c {
      #address-cells = <1>;
      #size-cells = <0>;

      charger@22 {
        compatible = "richtek,rt9455";
        reg = <0x22>;

        interrupt-parent = <&gpio1>;
        interrupts = <0 IRQ_TYPE_LEVEL_LOW>;

        richtek,output-charge-current = <500000>;
        richtek,end-of-charge-percentage = <10>;
        richtek,battery-regulation-voltage = <4200000>;
        richtek,boost-output-voltage = <5050000>;

        richtek,min-input-voltage-regulation = <4500000>;
        richtek,avg-input-current-regulation = <500000>;
      };
    };
```

以上是将给出的 YAML 文件翻译成了中文版本。注意某些专业术语和描述保持了英文原样，以确保准确性和技术细节的一致性。
~~~~

## Documentation/devicetree/bindings/power/supply/richtek,rt9467_cn.yaml
~~~~yaml
```yaml
# SPDX-License-Identifier: (GPL-2.0-only OR BSD-2-Clause)
%YAML 1.2
---
$id: http://devicetree.org/schemas/power/supply/richtek,rt9467.yaml#
$schema: http://devicetree.org/meta-schemas/core.yaml#

title: Richtek RT9467 开关式电池充电器带电源路径管理

maintainers:
  - ChiYuan Huang <cy_huang@richtek.com>
  - ChiaEn Wu <chiaen_wu@richtek.com>

description: |
  RT9467 是一款用于便携式应用的单节锂离子/锂聚合物电池的开关模式充电器。它集成了同步脉宽调制控制器、功率MOSFET、输入电流检测和调节、高精度电压调节以及充电终止功能。充电电流通过集成的检测电阻进行调节。
  RT9467还支持USB On-The-Go (OTG)功能。它还集成了用于USB主机/充电端口检测的D+/D-引脚。
数据手册可在以下网址获取：
  https://www.richtek.com/assets/product_file/RT9467/DS9467-01.pdf

properties:
  compatible:
    const: richtek,rt9467

  reg:
    maxItems: 1

  wakeup-source: true

  interrupts:
    maxItems: 1

  charge-enable-gpios:
    description: 用于开启和关闭充电功能的GPIO
    maxItems: 1

  usb-otg-vbus-regulator:
    type: object
    description: OTG升压稳压器
    unevaluatedProperties: false
    $ref: /schemas/regulator/regulator.yaml#

    properties:
      enable-gpios: true

required:
  - compatible
  - reg
  - wakeup-source
  - interrupts

additionalProperties: false

examples:
  - |
    #include <dt-bindings/interrupt-controller/irq.h>
    #include <dt-bindings/gpio/gpio.h>
    i2c {
      #address-cells = <1>;
      #size-cells = <0>;

      charger@5b {
        compatible = "richtek,rt9467";
        reg = <0x5b>;
        wakeup-source;
        interrupts-extended = <&gpio_intc 32 IRQ_TYPE_LEVEL_LOW>;
        charge-enable-gpios = <&gpio26 1 GPIO_ACTIVE_LOW>;

        rt9467_otg_vbus: usb-otg-vbus-regulator {
          regulator-name = "rt9467-usb-otg-vbus";
          regulator-min-microvolt = <4425000>;
          regulator-max-microvolt = <5825000>;
          regulator-min-microamp = <500000>;
          regulator-max-microamp = <3000000>;
        };
      };
    };
```

以上是Richtek RT9467开关式电池充电器设备树配置文件的中文翻译。
~~~~

## Documentation/devicetree/bindings/power/supply/richtek,rt9471_cn.yaml
~~~~yaml
```yaml
# SPDX-License-Identifier: (GPL-2.0-only OR BSD-2-Clause)
%YAML 1.2
---
$id: 'http://devicetree.org/schemas/power/supply/richtek,rt9471.yaml#'
$schema: 'http://devicetree.org/meta-schemas/core.yaml#'

title: Richtek RT9471 3A 单节电池开关式充电器

maintainers:
  - Alina Yu <alina_yu@richtek.com>
  - ChiYuan Huang <cy_huang@richtek.com>

description: |
  RT9471 是一种适用于便携式应用的单节锂离子/锂聚合物电池的开关模式充电器。它支持 USB BC1.2 端口检测，在充电和升压模式下支持电流和电压调节。
数据手册可从以下网址获取：
  https://www.richtek.com/assets/product_file/RT9471=RT9471D/DS9471D-02.pdf

properties:
  compatible:
    const: 'richtek,rt9471'

  reg:
    maxItems: 1

  charge-enable-gpios:
    description: 用于控制充电开启和关闭的 GPIO
    maxItems: 1

  wakeup-source: true

  interrupts:
    maxItems: 1

  usb-otg-vbus-regulator:
    type: object
    $ref: '/schemas/regulator/regulator.yaml#'
    unevaluatedProperties: false

required:
  - compatible
  - reg
  - wakeup-source
  - interrupts

additionalProperties: false

examples:
  - |
    #include <dt-bindings/interrupt-controller/irq.h>
    #include <dt-bindings/gpio/gpio.h>
    i2c {
      #address-cells = <1>;
      #size-cells = <0>;

      charger@53 {
        compatible = "richtek,rt9471";
        reg = <0x53>;
        charge-enable-gpios = <&gpio26 1 GPIO_ACTIVE_LOW>;
        wakeup-source;
        interrupts-extended = <&gpio_intc 32 IRQ_TYPE_EDGE_FALLING>;

        usb-otg-vbus-regulator {
          regulator-name = "usb-otg-vbus";
          regulator-min-microvolt = <4850000>;
          regulator-max-microvolt = <5300000>;
          regulator-min-microamp = <500000>;
          regulator-max-microamp = <1200000>;
        };
      };
    };
```

以上是 Richtek RT9471 3A 单节电池开关式充电器在 Device Tree 中的配置示例。
~~~~

## Documentation/devicetree/bindings/power/supply/rohm,bd99954_cn.yaml
~~~~yaml
```yaml
# SPDX-License-Identifier: GPL-2.0-only OR BSD-2-Clause
%YAML 1.2
---
$id: http://devicetree.org/schemas/power/supply/rohm,bd99954.yaml#
$schema: http://devicetree.org/meta-schemas/core.yaml#

title: ROHM BD99954 电池充电器

maintainers:
  - Matti Vaittinen <mazziesaccount@gmail.com>
  - Markus Laine <markus.laine@fi.rohmeurope.com>
  - Mikko Mutanen <mikko.mutanen@fi.rohmeurope.com>

description: |
  ROHM BD99954 是一款用于 1-4 节锂离子二次电池的电池管理 LSI，旨在用于空间受限的设备，如低剖面笔记本电脑、平板电脑等应用。BD99954 提供双源电池充电器、两个端口的 BC1.2 检测以及电池监控。
$ref: power-supply.yaml#

properties:
  compatible:
    const: rohm,bd99954
#
#    BD99954 的电池充电配置文件
#
#    曲线 (1) 表示充电电流
#    曲线 (2) 表示电池电压
#
#    BD99954 数据手册将充电分为三个阶段
#    a) 恒流涓流充电 (8)
#    b) 恒流预充电 (6)
#    c) 快速充电：
#       首先是一个恒流 (5) 阶段 (CC)
#       然后是当电池电压达到目标水平后进入的恒压 (CV) 阶段（直到充电电流降至终止水平 (7))
#
#     V ^                                                        ^ I
#       .
#       .
# (4)- -.- - - - - - - - - - - - - -  +++++++++++++++++++++++++++
#       .                            /
```
这段文字似乎是用特殊的字符绘制的一幅简单的图形或者图案，并没有实际的文字含义，所以无法直接翻译。但是，我可以尝试描述一下这个图案。

如果将其描述为中文，可以是这样的：

```
这是由特殊字符组成的一个简单图案，看起来像是一个倾斜的、抽象的树或植物。
在第五行有一个数字(5)，似乎标记了某一部分。
从第二行开始，逐渐展开，形成树枝或叶片的部分。
在第二行还有一个数字(2)，可能标记了另一部分。
整个图案由点(.), 加号(+), 减号(-), 和引号(")等字符构成。
```

请注意，由于原始文本是由特殊符号组成的图形而非具有明确含义的文字，因此上述描述仅是对图案的大致解释。
此文档描述了一个基于Rohm BD99954芯片的充电器配置示例，用于在设备树中定义电池充电管理。下面是文档的中文翻译：

```
# (3)- -.-.""- - - - -+++++++++ - - - - - - -.:- - - - - - - - - .- - (6)
#       .             +                       `:.
#       .             +               |         -:
#       .             +                           -:
#       .             +                             ..
#       .   (1)       +               |               "+++- - - -.- - (7)
#       -++++++++++++++- - - - - - - - - - - - - - - - - + - - - .- - (8)
#       .                                                +       -
#       -------------------------------------------------+++++++++-->
#       |             |       |   CC   |      CV         |
#       | --trickle-- | -pre- | ---------fast----------- |
#
# 充电器使用了以下电池属性：
# - 滴流充电电流（微安）：
#     在滴流充电阶段（图中8）使用的电流
#     最小值：64000
#     最大值：1024000
#     倍数：64000
# - 预充电电流（微安）：
#     在预充电阶段（图中6）使用的电流
#     最小值：64000
#     最大值：1024000
#     倍数：64000
# - 快充恒流最大电流（微安）
#     在快速充电恒流阶段（图中5）使用的电流
#     最小值：64000
#     最大值：1024000
#     倍数：64000
# - 快充恒压最大电压（微伏）
#     在快速充电阶段使用的恒定电压（图中4）
#     最小值：2560000
#     最大值：19200000
#     倍数：16000
# - 预充电上限电压（微伏）
#     当电池电压超过这个限值时，充电模式会从滴流充电转变为预充电（图中3）
#     最小值：2048000
#     最大值：19200000
#     倍数：64000
# - 再充电电压（微伏）
#     最小值：2560000
#     最大值：19200000
#     倍数：16000
#     当电池放电至电压低于此阈值时，自动开始再充电
# - 过压阈值（微伏）
#     如果电池电压超过此限值，则认为电池有问题
#     充电器将进入“电池故障”状态
#     最小值：2560000
#     最大值：19200000
#     倍数：16000
# - 充电终止电流（微安）
#     最小值：0
#     最大值：1024000
#     倍数：64000
#     当电池电压高于再充电阈值且电流低于此设置时（图中7），一个充电周期结束
# 参见：Documentation/devicetree/bindings/power/supply/battery.yaml

reg:
  maxItems: 1

interrupts:
  maxItems: 1

monitored-battery:
  description:
    电池特性的设备树节点的phandle

rohm,vsys-regulation-microvolt:
  description: 系统特定的系统电压下限
  minimum: 2560000
  maximum: 19200000
  multipleOf: 64000

rohm,vbus-input-current-limit-microamp:
  description: 系统特定的VBUS输入电流限制（微安）
  minimum: 32000
  maximum: 16352000
  multipleOf: 32000

rohm,vcc-input-current-limit-microamp:
  description: 系统特定的VCC/VACP输入电流限制（微安）
  minimum: 32000
  maximum: 16352000
  multipleOf: 32000

required:
  - compatible

additionalProperties: false

examples:
  - |
    i2c {
        #address-cells = <1>;
        #size-cells = <0>;
        charger@9 {
            compatible = "rohm,bd99954";
            monitored-battery = <&battery>;
            reg = <0x9>;
            interrupt-parent = <&gpio1>;
            interrupts = <29 8>;
            rohm,vsys-regulation-microvolt = <8960000>;
            rohm,vbus-input-current-limit-microamp = <1472000>;
            rohm,vcc-input-current-limit-microamp = <1472000>;
        };
    };
```

请注意，此配置示例用于说明如何在设备树中定义Rohm BD99954充电器节点。其中包含了充电器与电池交互的关键参数及其范围。```
~~~~

## Documentation/devicetree/bindings/power/supply/samsung,battery_cn.yaml
```yaml
# SPDX-License-Identifier: (GPL-2.0-only OR BSD-2-Clause)
%YAML 1.2
---
$id: http://devicetree.org/schemas/power/supply/samsung,battery.yaml#
$schema: http://devicetree.org/meta-schemas/core.yaml#

title: 三星SDI电池

maintainers:
  - Linus Walleij <linus.walleij@linaro.org>

description: |
  三星SDI（三星数字接口）电池是用于移动电话、笔记本电脑和其他便携式电子设备的锂离子化学电池的不同版本。这些电池针对特定产品进行了调整，并且由于物理限制，无法在产品上使用其他电池，因此产品的设备树可以指定这些电池。操作系统应该从兼容字符串中确定电池的硬件特性。

properties:
  compatible:
    oneOf:
      - const: samsung,eb-l1m7flu
        description: 三星GT-I8190中使用的3.8V 1500 mAh电池
      - const: samsung,eb425161la
        description: 三星SGH-T599和SGH-I407中使用的3.8V 1500 mAh电池
      - const: samsung,eb425161lu
        description: 三星GT-I8160中使用的3.8V 1500 mAh电池
      - const: samsung,eb485159lu
        description: 三星GT-S7710中使用的3.8V 1700 mAh电池
      - const: samsung,eb535151vu
        description: 三星GT-I9070中使用的3.8V 1500 mAh电池
      - const: samsung,eb585157lu
        description: 三星GT-I8530中使用的3.8V 2000 mAh电池

required:
  - compatible

additionalProperties: false

examples:
  - |
    power {
      #address-cells = <1>;
      #size-cells = <0>;

      battery: battery {
        compatible = "samsung,eb425161la";
      };

      charger@11 {
        reg = <0x11>;
        monitored-battery = <&battery>;
      };
    };
```

## Documentation/devicetree/bindings/power/supply/sbs,sbs-battery_cn.yaml
```yaml
# SPDX-许可证标识符: GPL-2.0
%YAML 1.2
---
$id: http://devicetree.org/schemas/power/supply/sbs,sbs-battery.yaml#
$schema: http://devicetree.org/meta-schemas/core.yaml#

title: 符合SBS规范的电池

maintainers:
  - Sebastian Reichel <sre@kernel.org>

description: |
  与智能电池系统规范兼容的电池

allOf:
  - $ref: power-supply.yaml#

properties:
  compatible:
    oneOf:
      - items:
          - enum:
              - ti,bq20z45
              - ti,bq20z65
              - ti,bq20z75
          - enum:
              - sbs,sbs-battery
      - items:
          - const: sbs,sbs-battery

  reg:
    maxItems: 1

  sbs,i2c-retry-count:
    description:
      在I2C IO失败时重试I2C事务的次数
    default: 0
    $ref: /schemas/types.yaml#/definitions/uint32

  sbs,poll-retry-count:
    description:
      在外部更改通知后尝试查找新状态的次数
    default: 0
    $ref: /schemas/types.yaml#/definitions/uint32

  sbs,battery-detect-gpios:
    description:
      用于指示电池检测的GPIO。如果没有提供这个属性，需要通过轮询总线来检测电池
    maxItems: 1

  sbs,disable-charger-broadcasts:
    description:
      SBS电池默认向符合SBS规范的充电器发送广播消息以配置最大充电电流/电压。如果你的硬件没有SBS兼容的充电器，则应通过此属性禁用它以避免阻塞总线。此外，已知某些SBS电池燃料表具有错误的多主控实现。
    type: boolean

required:
  - compatible
  - reg

unevaluatedProperties: false

examples:
  - |
    #include <dt-bindings/gpio/gpio.h>

    i2c {
        #address-cells = <1>;
        #size-cells = <0>;

        battery@b {
            compatible = "ti,bq20z75", "sbs,sbs-battery";
            reg = <0xb>;
            sbs,i2c-retry-count = <2>;
            sbs,poll-retry-count = <10>;
            sbs,battery-detect-gpios = <&gpio 122 GPIO_ACTIVE_HIGH>;
            sbs,disable-charger-broadcasts;
       };
    };
```

## Documentation/devicetree/bindings/power/supply/sbs,sbs-charger_cn.yaml
~~~~yaml
```yaml
# SPDX-许可证标识符: GPL-2.0
%YAML 1.2
---
$id: http://devicetree.org/schemas/power/supply/sbs,sbs-charger.yaml#
$schema: http://devicetree.org/meta-schemas/core.yaml#

title: 符合SBS规范的充电器

maintainers:
  - Sebastian Reichel <sre@kernel.org>

description: |
  与智能电池系统规范兼容的充电器

allOf:
  - $ref: power-supply.yaml#

properties:
  compatible:
    oneOf:
      - items:
          - enum:
              - lltc,ltc4100
          - enum:
              - sbs,sbs-charger
      - items:
          - const: sbs,sbs-charger

  reg:
    maxItems: 1

  interrupts:
    maxItems: 1

required:
  - compatible
  - reg

additionalProperties: false

examples:
  - |
    #include <dt-bindings/interrupt-controller/irq.h>

    i2c {
        #address-cells = <1>;
        #size-cells = <0>;

        charger@9 {
            compatible = "lltc,ltc4100", "sbs,sbs-charger";
            reg = <0x9>;
            interrupt-parent = <&gpio6>;
            interrupts = <7 IRQ_TYPE_LEVEL_LOW>;
       };
    };
```

这段 Device Tree 配置描述了一个符合 Smart Battery System (SBS) 规范的充电器节点。它指定了充电器的兼容性、地址注册信息、中断配置等，并提供了一个示例。
~~~~

## Documentation/devicetree/bindings/power/supply/sc2731-charger_cn.yaml
```yaml
# SPDX-许可证标识符: GPL-2.0
%YAML 1.2
---
$id: http://devicetree.org/schemas/power/supply/sc2731-charger.yaml#
$schema: http://devicetree.org/meta-schemas/core.yaml#

title: Spreadtrum SC2731 电源管理集成电路 (PMIC) 电池充电器

maintainers:
  - Sebastian Reichel <sre@kernel.org>

allOf:
  - $ref: power-supply.yaml#

properties:
  compatible:
    const: sprd,sc2731-charger

  reg:
    maxItems: 1

  phys:
    maxItems: 1
    description: USB PHY 的 phandle

  monitored-battery:
    description: |
      充电器使用以下电池属性：
      - charge-term-current-microamp: 充电终止阶段的电流
      - constant-charge-voltage-max-microvolt: 最大恒定输入电压
additionalProperties: false

examples:
  - |
    bat: battery {
      compatible = "simple-battery";
      charge-term-current-microamp = <120000>;
      constant-charge-voltage-max-microvolt = <4350000>;
    };

    pmic {
      #address-cells = <1>;
      #size-cells = <0>;

      battery@a00 {
        compatible = "sprd,sc2731-charger";
        reg = <0x0>;
        phys = <&ssphy>;
        monitored-battery = <&bat>;
      };
    };
```
