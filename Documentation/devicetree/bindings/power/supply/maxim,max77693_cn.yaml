## Documentation/devicetree/bindings/power/supply/maxim,max77693_cn.yaml
~~~~yaml
```yaml
# SPDX-许可证标识符: GPL-2.0-only 或 BSD-2-Clause
%YAML 1.2
---
$id: http://devicetree.org/schemas/power/supply/maxim,max77693.yaml#
$schema: http://devicetree.org/meta-schemas/core.yaml#

title: Maxim MAX77693 MicroUSB 和 伴侣电源管理 IC 充电器

maintainers:
  - Krzysztof Kozlowski <krzk@kernel.org>

description: |
  这是 Maxim MAX77693 MicroUSB 集成电路 (MUIC) 的设备树绑定的一部分。
更多信息和示例，请参阅文档 devicetree/bindings/mfd/maxim,max77693.yaml
properties:
  compatible:
    const: maxim,max77693-charger

  maxim,constant-microvolt:
    description: |
      电池恒压电压值（微伏）。充电器在电池电压达到此水平之前将运行于快速充电恒流模式，
然后充电器将切换到快速充电恒压模式。同时，当提供直流电源但未启用充电器时，系统电压(vsys)也将设置为此值。
有效值范围：3650000 - 4400000，步长为 25000（向下取整）
    minimum: 3650000
    maximum: 4400000
    default: 4200000

  maxim,min-system-microvolt:
    description: |
      最小系统电压（微伏）。
enum: [3000000, 3100000, 3200000, 3300000, 3400000, 3500000,
           3600000, 3700000]
    default: 3600000

  maxim,thermal-regulation-celsius:
    description: |
      进入高温充电模式的温度阈值（摄氏度）。
如果芯片温度超过此值，则充电电流将以每摄氏度 105 毫安的比例减少。
enum: [70, 85, 100, 115]
    default: 100

  maxim,battery-overcurrent-microamp:
    description: |
      从电池到系统的过流保护阈值（微安）。
有效值范围：2000000 - 3500000，步长为 250000（向下取整）
    minimum: 2000000
    maximum: 3500000
    default: 3500000

  maxim,charge-input-threshold-microvolt:
    description: |
      触发输入电压调节环路的阈值电压（微伏）。
```

请注意，上述翻译尽可能保持了原始 YAML 格式，并对描述进行了适当的中文翻译。
如果输入电压降低到低于这个值，输入电流将会减少以达到阈值电压。

枚举：[4300000, 4700000, 4800000, 4900000]
默认值：4300000

所需属性：
  - 兼容性

其他属性：不允许
~~~~

## Documentation/devicetree/bindings/power/supply/maxim,max77976_cn.yaml
```yaml
# SPDX-许可证标识符: (GPL-2.0 或 BSD-2-Clause)
%YAML 1.2
---
$id: http://devicetree.org/schemas/power/supply/maxim,max77976.yaml#
$schema: http://devicetree.org/meta-schemas/core.yaml#

title: Maxim Integrated MAX77976 电池充电器

maintainers:
  - Luca Ceresoli <luca.ceresoli@bootlin.com>

description: |
  Maxim MAX77976 是一款 19Vin / 5.5A, 1-单元 Li+ 电池充电器，
  可通过 I2C 配置
allOf:
  - $ref: power-supply.yaml#

properties:
  compatible:
    const: maxim,max77976

  reg:
    maxItems: 1

required:
  - compatible
  - reg

unevaluatedProperties: false

examples:
  - |
    i2c {
      #address-cells = <1>;
      #size-cells = <0>;

      charger@6b {
        compatible = "maxim,max77976";
        reg = <0x6b>;
      };
    };

..
```

## Documentation/devicetree/bindings/power/supply/maxim,max8903_cn.yaml
```yaml
# SPDX-文件许可人: GPL-2.0
%YAML 1.2
---
$id: http://devicetree.org/schemas/power/supply/maxim,max8903.yaml#
$schema: http://devicetree.org/meta-schemas/core.yaml#

标题: Maxim Semiconductor MAX8903 电池充电器

维护者:
  - Sebastian Reichel <sre@kernel.org>

allOf:
  - $ref: power-supply.yaml#

属性:
  compatible:
    常量: maxim,max8903

  dok-gpios:
    最大项数: 1
    描述: 检测到有效的直流电源（低电平有效，输入）

  uok-gpios:
    最大项数: 1
    描述: 检测到有效的USB电源（低电平有效，输入）

  cen-gpios:
    最大项数: 1
    描述: 充电使能引脚（低电平有效，输出）

  chg-gpios:
    最大项数: 1
    描述: 充电器状态引脚（低电平有效，输入）

  flt-gpios:
    最大项数: 1
    描述: 故障引脚（低电平有效，输入）

  dcm-gpios:
    最大项数: 1
    描述: 电流限制模式设置（DC=1 或 USB=0，输出）

  usus-gpios:
    最大项数: 1
    描述: USB挂起引脚（高电平有效，输出）

必需:
  - compatible

anyOf:
  - 必需:
      - dok-gpios
  - 必需:
      - uok-gpios

附加属性: false

示例:
  - |
    #include <dt-bindings/gpio/gpio.h>
    charger {
      compatible = "maxim,max8903";
      dok-gpios = <&gpio2 3 GPIO_ACTIVE_LOW>;
      flt-gpios = <&gpio2 2 GPIO_ACTIVE_LOW>;
      chg-gpios = <&gpio3 15 GPIO_ACTIVE_LOW>;
      cen-gpios = <&gpio2 5 GPIO_ACTIVE_LOW>;
    };
```

## Documentation/devicetree/bindings/power/supply/mediatek,mt6370-charger_cn.yaml
```yaml
下面是给定内容的中文翻译：

# SPDX-许可证标识符: (GPL-2.0-only 或 BSD-2-Clause)
%YAML 1.2
---
$id: http://devicetree.org/schemas/power/supply/mediatek,mt6370-charger.yaml#
$schema: http://devicetree.org/meta-schemas/core.yaml#

标题: MediaTek MT6370 电池充电器

维护者:
  - 吴家恩 <chiaen_wu@richtek.com>

描述: |
  本模块是 MT6370 MFD 设备的一部分。
提供电池充电器、OTG 设备的升压和 BC1.2 检测功能。

属性:
  compatible:
    常量: mediatek,mt6370-charger

  interrupts:
    描述: |
      指定哪些中断需要由 MT6370 充电器驱动程序处理。
我们需要使用中断 "MT6370_IRQ_OVPCTRL_UVP_D" 来检测 USB 是否插入，
然后驱动程序将启用 BC1.2 检测。
在 MT6370 硬件完成 BC1.2 检测后，
将触发中断 "MT6370_IRQ_ATTACH"，驱动程序将获知 BC1.2 检测的结果。
当触发中断 "MT6370_IRQ_CHG_MIVR" 时，意味着硬件进入 "最小输入电压调节环路"，
此时需要应用一种变通方案。
综上所述，此充电器驱动程序需要 "MT6370_IRQ_OVPCTRL_UVP_D"、"MT6370_IRQ_ATTACH" 和 "MT6370_IRQ_CHG_MIVR" 这三个中断。
项目:
      - 描述: "USB 插入" 的中断
      - 描述: "BC1.2 完成" 的中断
      - 描述: "最小输入电压调节环路活跃" 的中断

  interrupt-names:
    项目:
      - 常量: uvp_d_evt
      - 常量: attach_i
      - 常量: mivr

  io-channels:
    描述: |
      使用 ADC 通道读取 VBUS、IBUS、IBAT 等信息。
最少项数: 1
    项目:
      - 描述: |
          低精度（±75mV）但测量范围更广（1~22V）的 VBUS 电压
      - 描述: |
          高精度（±30mV）但测量范围较小（1~9.76V）的 VBUS 电压
      - 描述: 主系统输入电压
      - 描述: 电池电压
      - 描述: 电池温度感应输入电压
      - 描述: IBUS 电流（必需）
      - 描述: 电池电流
      - 描述: |
          调节输出电压以供应 PWM 低压侧门驱动器和自举电容器
      - 描述: 芯片结温

  io-channel-names:
    最少项数: 1
    项目:
      - 常量: vbusdiv5
      - 常量: vbusdiv2
      - 常量: vsys
      - 常量: vbat
      - 常量: ts_bat
      - 常量: ibus
      - 常量: ibat
      - 常量: chg_vddp
      - 常量: temp_jc

  usb-otg-vbus-regulator:
    类型: 对象
    描述: OTG 升压稳压器
未评估属性: false
    $ref: /schemas/regulator/regulator.yaml#

    属性:
      enable-gpios:
        最大项数: 1

必需:
  - compatible
  - interrupts
  - interrupt-names
  - io-channels

额外属性: false

..
您没有提供需要翻译的文本。请提供需要翻译成中文的英文或其他语言的文本。
```

## Documentation/devicetree/bindings/power/supply/microchip,ucs1002_cn.yaml
```yaml
下面是给定内容的中文翻译：

# SPDX-许可证标识符: GPL-2.0
%YAML 1.2
---
$id: http://devicetree.org/schemas/power/supply/microchip,ucs1002.yaml#
$schema: http://devicetree.org/meta-schemas/core.yaml#

title: Microchip UCS1002 USB端口电源控制器

维护者:
  - Sebastian Reichel <sre@kernel.org>

属性:
  compatible:
    常量: microchip,ucs1002

  reg:
    最大项数: 1

  interrupts:
    最大项数: 2

  interrupt-names:
    以下任一选项:
      - 项:
          - 常量: a_det
          - 常量: alert
      - 常量: a_det
      - 常量: alert

必需:
  - compatible
  - reg

附加属性: false

示例:
  - |
    #include <dt-bindings/interrupt-controller/irq.h>

    i2c {
        #address-cells = <1>;
        #size-cells = <0>;

        charger@32 {
            compatible = "microchip,ucs1002";
            reg = <0x32>;
            interrupts-extended = <&gpio5 2 IRQ_TYPE_EDGE_BOTH>,
                                  <&gpio3 21 IRQ_TYPE_EDGE_BOTH>;
            interrupt-names = "a_det", "alert";
       };
    };
```

## Documentation/devicetree/bindings/power/supply/mitsumi,mm8013_cn.yaml
~~~~yaml
```yaml
# SPDX-许可证标识符: GPL-2.0-only 或 BSD-2-Clause
%YAML 1.2
---
$id: http://devicetree.org/schemas/power/supply/mitsumi,mm8013.yaml#
$schema: http://devicetree.org/meta-schemas/core.yaml#

title: Mitsumi MM8013 燃料计

maintainers:
  - Konrad Dybcio <konradybcio@kernel.org>

allOf:
  - $ref: power-supply.yaml#

properties:
  compatible:
    const: mitsumi,mm8013

  reg:
    maxItems: 1

required:
  - compatible
  - reg

additionalProperties: false

examples:
  - |
    i2c {
      #address-cells = <1>;
      #size-cells = <0>;

      fuel-gauge@55 {
        compatible = "mitsumi,mm8013";
        reg = <0x55>;
      };
    };
```

这段代码定义了一个 Device Tree 的 YAML 格式文件，用于描述 Mitsumi MM8013 燃料计（电量计）的配置信息。它包括了设备兼容性、寄存器地址等属性，并提供了一个示例来展示如何在 Device Tree 中配置这个设备。
~~~~

## Documentation/devicetree/bindings/power/supply/mt6360_charger_cn.yaml
~~~~yaml
```yaml
# SPDX-许可证标识符: (GPL-2.0-only 或 BSD-2-Clause)
%YAML 1.2
---
$id: http://devicetree.org/schemas/power/supply/mt6360_charger.yaml#
$schema: http://devicetree.org/meta-schemas/core.yaml#

title: 来自MediaTek Integrated的MT6360 PMIC电池充电器驱动程序
maintainers:
  - Gene Chen <gene_chen@richtek.com>

description: |
  本模块是MT6360 MFD设备的一部分
提供电池充电器、OTG设备的升压以及BC1.2检测功能
properties:
  compatible:
    const: mediatek,mt6360-chg

  richtek,vinovp-microvolt:
    description: 最大CHGIN调节电压（以微伏为单位）
enum: [ 5500000, 6500000, 11000000, 14500000 ]


  usb-otg-vbus-regulator:
    type: object
    description: OTG升压稳压器
$ref: /schemas/regulator/regulator.yaml#
    unevaluatedProperties: false

required:
  - compatible

additionalProperties: false

examples:
  - |
    mt6360_charger: charger {
      compatible = "mediatek,mt6360-chg";
      richtek,vinovp-microvolt = <14500000>;

      otg_vbus_regulator: usb-otg-vbus-regulator {
        regulator-name = "usb-otg-vbus";
        regulator-min-microvolt = <4425000>;
        regulator-max-microvolt = <5825000>;
      };
    };
```

请注意，此翻译将原始英文文档中的术语和概念转换成了中文。其中一些术语可能有多种中文译法，这里选择了一种常见的翻译方式。
~~~~

## Documentation/devicetree/bindings/power/supply/nokia,n900-battery_cn.yaml
```yaml
# SPDX-许可证标识符: GPL-2.0
%YAML 1.2
---
$id: http://devicetree.org/schemas/power/supply/nokia,n900-battery.yaml#
$schema: http://devicetree.org/meta-schemas/core.yaml#

title: 诺基亚 N900 电池

maintainers:
  - Pali Rohár <pali@kernel.org>
  - Sebastian Reichel <sre@kernel.org>

allOf:
  - $ref: power-supply.yaml#

properties:
  compatible:
    const: nokia,n900-battery

  io-channels:
    items:
      - description: 用于温度读数的ADC通道
      - description: 用于识别电池容量的ADC通道
      - description: 用于测量电池电压的ADC通道

  io-channel-names:
    items:
      - const: temp
      - const: bsi
      - const: vbat

required:
  - compatible
  - io-channels
  - io-channel-names

additionalProperties: false

examples:
  - |
    battery {
      compatible = "nokia,n900-battery";
      io-channels = <&twl4030_madc 0>,
                    <&twl4030_madc 4>,
                    <&twl4030_madc 12>;
      io-channel-names = "temp",
                         "bsi",
                         "vbat";
    };
```

## Documentation/devicetree/bindings/power/supply/olpc-battery_cn.yaml
```yaml
# SPDX-许可证标识符: GPL-2.0
%YAML 1.2
---
$id: http://devicetree.org/schemas/power/supply/olpc-battery.yaml#
$schema: http://devicetree.org/meta-schemas/core.yaml#

标题: OLPC 电池

维护者:
  - Sebastian Reichel <sre@kernel.org>

allOf:
  - $ref: power-supply.yaml#

属性:
  compatible:
    oneOf:
      - items:
          - const: olpc,xo1.5-battery
          - const: olpc,xo1-battery
      - items:
          - const: olpc,xo1-battery

必需:
  - compatible

额外属性: false
请注意，上述翻译尽量保持了原文件的结构和内容，但某些术语如“$ref”、“oneOf”等在中文环境中并无确切对应词，因此保留了原文。此外，“标题”和“维护者”等词汇是为了适应中文环境而进行的翻译，在具体的技术文档中可能有特定的习惯用语。
```

## Documentation/devicetree/bindings/power/supply/power-supply_cn.yaml
```yaml
# SPDX-文件许可人: GPL-2.0
%YAML 1.2
---
$id: http://devicetree.org/schemas/power/supply/power-supply.yaml#
$schema: http://devicetree.org/meta-schemas/core.yaml#

title: 电源供应核心支持

maintainers:
  - Sebastian Reichel <sre@kernel.org>

properties:
  power-supplies:
    $ref: /schemas/types.yaml#/definitions/phandle-array
    items:
      maxItems: 1
    description:
      此属性被添加到一个供电设备中，以列出为其提供电力的设备，通过它们的phandle进行引用。
monitored-battery:
    $ref: /schemas/types.yaml#/definitions/phandle
    description:
      该电源供应监控的电池（兼容"simple-battery"）。
additionalProperties: true
```

## Documentation/devicetree/bindings/power/supply/qcom,pm8916-bms-vm_cn.yaml
```yaml
# SPDX-文件许可人: (GPL-2.0-only 或 BSD-2-Clause)
%YAML 1.2
---
$id: http://devicetree.org/schemas/power/supply/qcom,pm8916-bms-vm.yaml#
$schema: http://devicetree.org/meta-schemas/core.yaml#

title: 高通电压模式电池管理系统(BMS)

maintainers:
  - 尼基塔·特拉夫金 <nikita@trvn.ru>

description:
  电压模式BMS是在一些高通电源管理集成电路(PMIC)中发现的一个硬件模块，例如pm8916。该模块执行电池电压监控。
allOf:
  - $ref: power-supply.yaml#

properties:
  compatible:
    const: qcom,pm8916-bms-vm

  reg:
    maxItems: 1

  interrupts:
    items:
      - description: BMS有限状态机离开S3模式
      - description: BMS有限状态机进入S2模式
      - description: 在S3模式下测量到开路电压(OCV)良好
      - description: 开路电压低于阈值
      - description: 先入先出(FIFO)更新完成
      - description: BMS有限状态机切换状态

  interrupt-names:
    items:
      - const: cv_leave
      - const: cv_enter
      - const: ocv_good
      - const: ocv_thr
      - const: fifo
      - const: state_chg

  monitored-battery: true

  power-supplies: true

required:
  - compatible
  - reg
  - interrupts
  - interrupt-names
  - monitored-battery

additionalProperties: false

examples:
  - |
    #include <dt-bindings/interrupt-controller/irq.h>
    pmic {
      #address-cells = <1>;
      #size-cells = <0>;

      battery@4000 {
        compatible = "qcom,pm8916-bms-vm";
        reg = <0x4000>;
        interrupts = <0x0 0x40 0 IRQ_TYPE_EDGE_RISING>,
                     <0x0 0x40 1 IRQ_TYPE_EDGE_RISING>,
                     <0x0 0x40 2 IRQ_TYPE_EDGE_RISING>,
                     <0x0 0x40 3 IRQ_TYPE_EDGE_RISING>,
                     <0x0 0x40 4 IRQ_TYPE_EDGE_RISING>,
                     <0x0 0x40 5 IRQ_TYPE_EDGE_RISING>;
        interrupt-names = "cv_leave",
                          "cv_enter",
                          "ocv_good",
                          "ocv_thr",
                          "fifo",
                          "state_chg";

        monitored-battery = <&battery>;
        power-supplies = <&pm8916_charger>;
      };
    };
```
