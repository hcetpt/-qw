## Documentation/devicetree/bindings/power/supply/qcom,pm8916-lbc_cn.yaml
```yaml
下面是给定 YAML 文档的中文翻译：

# SPDX-许可证标识符: (GPL-2.0-only 或 BSD-2-Clause)
%YAML 1.2
---
$id: http://devicetree.org/schemas/power/supply/qcom,pm8916-lbc.yaml#
$schema: http://devicetree.org/meta-schemas/core.yaml#

title: 高通线性电池充电器

maintainers:
  - Nikita Travkin <nikita@trvn.ru>

description:
  线性电池充电器硬件模块，在一些高通电源管理集成电路（PMIC）中发现，如pm8916。实现了一个简单的、自主的恒流/恒压(CC/CV)充电器。
allOf:
  - $ref: power-supply.yaml#

properties:
  compatible:
    const: qcom,pm8916-lbc

  reg:
    items:
      - description: 充电器
      - description: 电池接口
      - description: USB
      - description: 杂项

  reg-names:
    items:
      - const: chgr
      - const: bat_if
      - const: usb
      - const: misc

  interrupts:
    items:
      - description: 电池检测
      - description: 快速充电
      - description: 充电失败
      - description: 充电完成
      - description: 电池存在
      - description: 温度正常
      - description: USB粗检测
      - description: USB输入有效
      - description: 充电器断开
      - description: 过温

  interrupt-names:
    items:
      - const: vbat_det
      - const: fast_chg
      - const: chg_fail
      - const: chg_done
      - const: bat_pres
      - const: temp_ok
      - const: coarse_det
      - const: usb_vbus
      - const: chg_gone
      - const: overtemp

  qcom,fast-charge-safe-voltage:
    $ref: /schemas/types.yaml#/definitions/uint32
    minimum: 4000000
    maximum: 4775000
    description:
      最大安全电池电压（微伏）；可能由引导加载程序预设，在这种情况下，设置此值将无害地失败。
  qcom,fast-charge-safe-current:
    $ref: /schemas/types.yaml#/definitions/uint32
    minimum: 90000
    maximum: 1440000
    description:
      最大安全电池充电电流（微安）；可能由引导加载程序预设，在这种情况下设置此值将无害地失败。
monitored-battery: true

required:
  - compatible
  - reg
  - interrupts
  - interrupt-names
  - qcom,fast-charge-safe-voltage
  - qcom,fast-charge-safe-current

additionalProperties: false

examples:
  - |
    #include <dt-bindings/interrupt-controller/irq.h>
    pmic {
      #address-cells = <1>;
      #size-cells = <0>;

      charger@1000 {
        compatible = "qcom,pm8916-lbc";
        reg = <0x1000>, <0x1200>, <0x1300>, <0x1600>;
        reg-names = "chgr", "bat_if", "usb", "misc";

        interrupts = <0x0 0x10 0 IRQ_TYPE_EDGE_BOTH>,
                     <0x0 0x10 5 IRQ_TYPE_EDGE_BOTH>,
                     <0x0 0x10 6 IRQ_TYPE_EDGE_BOTH>,
                     <0x0 0x10 7 IRQ_TYPE_EDGE_BOTH>,
                     <0x0 0x12 0 IRQ_TYPE_EDGE_BOTH>,
                     <0x0 0x12 1 IRQ_TYPE_EDGE_BOTH>,
                     <0x0 0x13 0 IRQ_TYPE_EDGE_BOTH>,
                     <0x0 0x13 1 IRQ_TYPE_EDGE_BOTH>,
                     <0x0 0x13 2 IRQ_TYPE_EDGE_BOTH>,
                     <0x0 0x13 4 IRQ_TYPE_EDGE_BOTH>;
        interrupt-names = "vbat_det",
                          "fast_chg",
                          "chg_fail",
                          "chg_done",
                          "bat_pres",
                          "temp_ok",
                          "coarse_det",
                          "usb_vbus",
                          "chg_gone",
                          "overtemp";
        monitored-battery = <&battery>;

        qcom,fast-charge-safe-current = <900000>;
        qcom,fast-charge-safe-voltage = <4300000>;
      };
    };
```

## Documentation/devicetree/bindings/power/supply/qcom,pm8941-charger_cn.yaml
```yaml
# SPDX-许可证标识符: GPL-2.0
%YAML 1.2
---
$id: http://devicetree.org/schemas/power/supply/qcom,pm8941-charger.yaml#
$schema: http://devicetree.org/meta-schemas/core.yaml#

title: 高通开关模式电池充电器和升压

maintainers:
  - Sebastian Reichel <sre@kernel.org>

properties:
  compatible:
    enum:
      - qcom,pm8226-charger
      - qcom,pm8941-charger

  reg:
    maxItems: 1

  interrupts:
    items:
      - description: 充电完成
      - description: 快速充电模式
      - description: 滴流充电模式
      - description: 电池温度正常
      - description: 电池存在
      - description: 充电器断开
      - description: USB输入有效
      - description: DC输入有效

  interrupt-names:
    items:
      - const: chg-done
      - const: chg-fast
      - const: chg-trkl
      - const: bat-temp-ok
      - const: bat-present
      - const: chg-gone
      - const: usb-valid
      - const: dc-valid

  qcom,fast-charge-current-limit:
    $ref: /schemas/types.yaml#/definitions/uint32
    minimum: 100000
    maximum: 3000000
    description: 最大充电电流（微安）；可能会受到安全限制；默认为1A

  qcom,fast-charge-low-threshold-voltage:
    $ref: /schemas/types.yaml#/definitions/uint32
    minimum: 2100000
    maximum: 3600000
    description: |
      电池电压限制（微伏），在此电压之上可进行快速充电；默认为3.2V
      在此电压以下将自动进行线性或开关模式滴流充电

  qcom,fast-charge-high-threshold-voltage:
    $ref: /schemas/types.yaml#/definitions/uint32
    minimum: 3240000
    maximum: 5000000
    description: |
      电池电压限制（微伏），在此电压之下可进行快速充电；默认为4.2V
      快速充电器将尝试将电池充电至该电压；可能会受到安全限制

  qcom,fast-charge-safe-voltage:
    $ref: /schemas/types.yaml#/definitions/uint32
    minimum: 3240000
    maximum: 5000000
    description: |
      最大安全电池电压（微伏）；可能由引导加载程序预设，在这种情况下，
      设置此值将无害地失败。属性“fast-charge-high-watermark”将被此值限制。默认为4.2V

  qcom,fast-charge-safe-current:
    $ref: /schemas/types.yaml#/definitions/uint32
    minimum: 100000
    maximum: 3000000
    description: |
      最大安全电池充电电流（微安）；可能由引导加载程序预设，在这种情况下，
      设置此值将无害地失败。属性“qcom,fast-charge-current-limit”将被此值限制。默认为1A

  qcom,auto-recharge-threshold-voltage:
    $ref: /schemas/types.yaml#/definitions/uint32
    minimum: 3240000
    maximum: 5000000
    description: |
      电池电压限制（微伏），低于此电压时，自动再充电功能将在充电结束之后重新开始充电；
      自动再充电的高截止限制为此值的5%以上。默认为4.1V

  qcom,minimum-input-voltage:
    $ref: /schemas/types.yaml#/definitions/uint32
    minimum: 4200000
    maximum: 9600000
    description: |
      输入电压水平（微伏），高于此电压时，充电操作可以进行。默认为4.3V

  qcom,dc-current-limit:
    $ref: /schemas/types.yaml#/definitions/uint32
    minimum: 100000
    maximum: 2500000
    description: |
      默认DC充电电流限制（微安）。默认为100mA

  qcom,disable-dc:
    type: boolean
    description: 禁用DC充电器

  qcom,jeita-extended-temp-range:
    type: boolean
    description: |
      启用JEITA扩展温度范围；这*不会*调整在扩展温度范围内的最大充电
      电压或电流。它只允许在电池处于扩展温度范围内进行充电。如果设置了此标志，
      为了完全符合JEITA安全指南，必须外部调节电压/电流。
The provided text describes a Device Tree (DT) fragment that configures a Power Management IC (PMIC) component, specifically focusing on its charger and USB On-The-Go (OTG) capabilities. Here's a translation into Chinese:

`usb-charge-current-limit`:
    `$ref`: /schemas/types.yaml#/definitions/uint32
    最小值: 100000
    最大值: 2500000
    描述: 默认的USB充电电流限制（以微安为单位）

`usb-otg-in-supply`:
    描述: 指向为USB_OTG_IN引脚供电的稳压器的引用

`otg-vbus`:
    `$ref`: /schemas/regulator/regulator.yaml#
    描述: 
      此节点定义了一个用于控制VBUS电压方向的稳压器。
      特别地，是指定是否为OTG端口的主机模式操作向VBUS提供电压，
      或者允许从外部VBUS输入电压进行充电。在硬件中，该稳压器的电源来自`usb-otg-in-supply`

必需字段:
  - `compatible`
  - `reg`
  - `interrupts`
  - `interrupt-names`

不允许额外属性。

示例:
  - |
    #include <dt-bindings/interrupt-controller/irq.h>
    pmic {
      #address-cells = <1>;
      #size-cells = <0>;

      charger@1000 {
        compatible = "qcom,pm8941-charger";
        reg = <0x1000>;
        interrupts = <0x0 0x10 7 IRQ_TYPE_EDGE_BOTH>,
                     <0x0 0x10 5 IRQ_TYPE_EDGE_BOTH>,
                     <0x0 0x10 4 IRQ_TYPE_EDGE_BOTH>,
                     <0x0 0x12 1 IRQ_TYPE_EDGE_BOTH>,
                     <0x0 0x12 0 IRQ_TYPE_EDGE_BOTH>,
                     <0x0 0x13 2 IRQ_TYPE_EDGE_BOTH>,
                     <0x0 0x13 1 IRQ_TYPE_EDGE_BOTH>,
                     <0x0 0x14 1 IRQ_TYPE_EDGE_BOTH>;
        interrupt-names = "chg-done",
                          "chg-fast",
                          "chg-trkl",
                          "bat-temp-ok",
                          "bat-present",
                          "chg-gone",
                          "usb-valid",
                          "dc-valid";
        qcom,fast-charge-current-limit = <1000000>;
        qcom,dc-current-limit = <1000000>;
        usb-otg-in-supply = <&pm8941_5vs1>;

        otg-vbus {};
      };
    };

这个示例配置了一个PMIC组件，包括一个充电器和与USB OTG相关的配置。它定义了充电器的兼容性、寄存器地址、中断以及一些特定的属性，例如快速充电电流限制和DC电流限制。此外，还指定了USB OTG输入的电源供应和用于控制VBUS电压方向的节点。
```

## Documentation/devicetree/bindings/power/supply/qcom,pm8941-coincell_cn.yaml
```yaml
# SPDX-文件许可人: GPL-2.0
%YAML 1.2
---
$id: http://devicetree.org/schemas/power/supply/qcom,pm8941-coincell.yaml#
$schema: http://devicetree.org/meta-schemas/core.yaml#

标题: 高通CoinCell充电器

描述: |
  硬件模块控制CoinCell或电容器的充电，这些CoinCell或电容器用于为电源管理集成电路（PMIC）的某些特性提供电力备份。

维护者:
  - Sebastian Reichel <sre@kernel.org>

属性:
  compatible:
    oneOf:
      - items:
          - enum:
              - qcom,pm8998-coincell
          - const: qcom,pm8941-coincell

      - const: qcom,pm8941-coincell

  reg:
    maxItems: 1

  qcom,rset-ohms:
    描述: |
      电流限制电阻器的阻值（以欧姆为单位）。如果未指定，则继承之前的配置（例如，来自启动加载程序或硬件默认值）
    enum: [ 800, 1200, 1700, 2100 ]

  qcom,vset-millivolts:
    $ref: /schemas/types.yaml#/definitions/uint32
    描述: |
      用于充电的电压（以毫伏为单位）。如果未指定，则继承之前的配置（例如，来自启动加载程序或硬件默认值）
    enum: [ 2500, 3000, 3100, 3200 ]

  qcom,charger-disable:
    类型: 布尔
    描述: 定义此属性会禁用充电功能

必需:
  - compatible
  - reg

额外属性: false

示例:
  - |
    pmic {
      #address-cells = <1>;
      #size-cells = <0>;

      charger@2800 {
        compatible = "qcom,pm8941-coincell";
        reg = <0x2800>;
        qcom,rset-ohms = <2100>;
        qcom,vset-millivolts = <3000>;
      };
    };
```

## Documentation/devicetree/bindings/power/supply/qcom,pmi8998-charger_cn.yaml
~~~~yaml
```yaml
# SPDX-文件许可标识符: GPL-2.0 或 BSD-2-Clause
%YAML 1.2
---
$id: http://devicetree.org/schemas/power/supply/qcom,pmi8998-charger.yaml#
$schema: http://devicetree.org/meta-schemas/core.yaml#

title: 高通 PMI8998/PM660 开关模式电池充电器 "2"

maintainers:
  - Caleb Connolly <caleb.connolly@linaro.org>

properties:
  compatible:
    enum:
      - qcom,pmi8998-charger
      - qcom,pm660-charger

  reg:
    maxItems: 1

  interrupts:
    maxItems: 4

  interrupt-names:
    items:
      - const: usb-plugin
      - const: bat-ov
      - const: wdog-bark
      - const: usbin-icl-change

  io-channels:
    items:
      - description: USB 输入电流 (微安)
      - description: USB 输入电压 (微伏)

  io-channel-names:
    items:
      - const: usbin_i
      - const: usbin_v

  monitored-battery:
    description: 指向简单电池节点的 phandle
    $ref: /schemas/types.yaml#/definitions/phandle

required:
  - compatible
  - reg
  - interrupts
  - interrupt-names
  - io-channels
  - io-channel-names
  - monitored-battery

additionalProperties: false

examples:
  - |
    #include <dt-bindings/interrupt-controller/irq.h>

    pmic {
      #address-cells = <1>;
      #size-cells = <0>;
      #interrupt-cells = <4>;

      charger@1000 {
        compatible = "qcom,pmi8998-charger";
        reg = <0x1000>;

        interrupts = <0x2 0x12 0x2 IRQ_TYPE_EDGE_BOTH>,
                     <0x2 0x13 0x4 IRQ_TYPE_EDGE_BOTH>,
                     <0x2 0x13 0x6 IRQ_TYPE_EDGE_RISING>,
                     <0x2 0x16 0x1 IRQ_TYPE_EDGE_RISING>;
        interrupt-names = "usb-plugin", "bat-ov", "wdog-bark", "usbin-icl-change";

        io-channels = <&pmi8998_rradc 3>,
                      <&pmi8998_rradc 4>;
        io-channel-names = "usbin_i",
                           "usbin_v";

        monitored-battery = <&battery>;
      };
    };
```

请注意，这个文档描述了一个设备树片段，用于配置高通 PMI8998/PM660 开关模式电池充电器。它定义了必要的属性和示例配置。
~~~~

## Documentation/devicetree/bindings/power/supply/richtek,rt5033-battery_cn.yaml
~~~~yaml
```yaml
# SPDX-许可证标识符: (GPL-2.0 或 BSD-2-Clause)
%YAML 1.2
---
$id: http://devicetree.org/schemas/power/supply/richtek,rt5033-battery.yaml#
$schema: http://devicetree.org/meta-schemas/core.yaml#

title: Richtek RT5033 PMIC 燃料计量表

maintainers:
  - Stephan Gerhold <stephan@gerhold.net>

allOf:
  - $ref: power-supply.yaml#

properties:
  compatible:
    const: richtek,rt5033-battery

  reg:
    maxItems: 1

  interrupts:
    maxItems: 1

required:
  - compatible
  - reg

unevaluatedProperties: false

examples:
  - |
    i2c {
      #address-cells = <1>;
      #size-cells = <0>;

      battery@35 {
        compatible = "richtek,rt5033-battery";
        reg = <0x35>;
      };
    };
  - |
    #include <dt-bindings/interrupt-controller/irq.h>
    i2c {
      #address-cells = <1>;
      #size-cells = <0>;

      battery@35 {
        compatible = "richtek,rt5033-battery";
        reg = <0x35>;
        interrupt-parent = <&msmgpio>;
        interrupts = <121 IRQ_TYPE_EDGE_FALLING>;
      };
    };
```

请注意，上述内容是直接翻译，其中的代码示例和注释保留了其原有的英文形式。这是因为这些内容通常在技术文档中以英文提供，并且在这种上下文中，它们保持原样是标准做法。
~~~~

## Documentation/devicetree/bindings/power/supply/richtek,rt5033-charger_cn.yaml
```yaml
# SPDX-文件许可人: (GPL-2.0 或 BSD-2-Clause)
%YAML 1.2
---
$id: http://devicetree.org/schemas/power/supply/richtek,rt5033-charger.yaml#
$schema: http://devicetree.org/meta-schemas/core.yaml#

title: Richtek RT5033 PMIC 电池充电器

maintainers:
  - Jakob Hauser <jahau@rocketmail.com>

description:
  多功能设备 RT5033 的电池充电器需要以如下格式在名为 "charger" 的子节点下实例化。
properties:
  compatible:
    const: richtek,rt5033-charger

  monitored-battery:
    $ref: /schemas/types.yaml#/definitions/phandle
    description: |
      根据 battery.yaml 中定义的被监控电池的句柄。电池节点需要包含五个参数：
      
      precharge-current-microamp:
        预充模式下的电流。预充电流级别范围是 350 毫安到 650 毫安，通过 I2C 每 100 毫安进行编程。
      
      constant-charge-current-max-microamp:
        快速充电模式下的电流。快速充电电流级别范围是 700 毫安到 2000 毫安，通过 I2C 每 100 毫安进行编程。
      
      charge-term-current-microamp:
        此属性为充电结束时的电流。其级别范围从 150 毫安到 600 毫安。在 150 毫安和 300 毫安之间，每 50 毫安一个步进；在 300 毫安和 600 毫安之间，每 100 毫安一个步进。
      
      precharge-upper-limit-microvolt:
        预充模式下的电压。如果电池电压低于预充阈值电压，则充电器处于预充模式，并使用预充电流。其级别范围是 2.3 伏到 3.8 伏，通过 I2C 每 0.1 伏进行编程。
      
      constant-charge-voltage-max-microvolt:
        恒压模式下的电池调节电压。此电压级别范围是从 3.65 伏到 4.4 伏，通过 I2C 每 0.025 伏进行编程。
      
      richtek,usb-connector:
        $ref: /schemas/types.yaml#/definitions/phandle
        description:
          根据 usb-connector.yaml 定义的 USB 连接器的句柄。该连接器应为 extcon 设备的子项。
required:
  - monitored-battery

additionalProperties: false

examples:
  - |
    charger {
        compatible = "richtek,rt5033-charger";
        monitored-battery = <&battery>;
        richtek,usb-connector = <&usb_con>;
    };
```
