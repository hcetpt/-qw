## Documentation/devicetree/bindings/ptp/fsl,ptp_cn.yaml
~~~~yaml
# SPDX-许可证标识符: (GPL-2.0-only 或 BSD-2-Clause)
%YAML 1.2
---
$id: http://devicetree.org/schemas/ptp/fsl,ptp.yaml#
$schema: http://devicetree.org/meta-schemas/core.yaml#

标题: Freescale QorIQ 基于 1588 定时器的 PTP 时钟

维护者:
  - Frank Li <Frank.Li@nxp.com>

属性:
  compatible:
    枚举:
      - fsl,etsec-ptp
      - fsl,fman-ptp-timer
      - fsl,dpaa2-ptp
      - fsl,enetc-ptp

  reg:
    最大项数: 1

  interrupts:
    最大项数: 1

  clocks:
    最大项数: 1

  fsl,cksel:
    $ref: /schemas/types.yaml#/definitions/uint32
    描述: |
      定时器参考时钟源
      参考时钟源由 TMR_CTRL 寄存器中的 CKSEL 位所保存的值决定。"fsl,cksel" 属性保留了将直接写入这些位的值，因此根据参考手册，可以使用以下时钟源：

      对于 eTSEC，
      <0> - 外部高精度定时器参考时钟 (TSEC_TMR_CLK 输入用于此目的)；
      <1> - eTSEC 系统时钟；
      <2> - eTSEC1 发送时钟；
      <3> - RTC 时钟输入
      对于 DPAA FMan，
      <0> - 外部高精度定时器参考时钟 (TMR_1588_CLK)
      <1> - MAC 系统时钟 (1/2 FMan 时钟)
      <2> - 保留
      <3> - RTC 时钟振荡器

  fsl,tclk-period:
    $ref: /schemas/types.yaml#/definitions/uint32
    描述: 定时器参考时钟周期（纳秒）
  fsl,tmr-prsc:
    $ref: /schemas/types.yaml#/definitions/uint32
    描述: 预分频器，对输出时钟进行分频
  fsl,tmr-add:
    $ref: /schemas/types.yaml#/definitions/uint32
    描述: 频率补偿值
  fsl,tmr-fiper1:
    $ref: /schemas/types.yaml#/definitions/uint32
    描述: 固定间隔周期脉冲发生器
  fsl,tmr-fiper2:
    $ref: /schemas/types.yaml#/definitions/uint32
    描述: 固定间隔周期脉冲发生器
  fsl,tmr-fiper3:
    $ref: /schemas/types.yaml#/definitions/uint32
    描述:
      固定间隔周期脉冲发生器
      仅在 DPAA2 和 ENETC 硬件上支持
  fsl,max-adj:
    $ref: /schemas/types.yaml#/definitions/uint32
    描述: |
      频率调整的最大值（每十亿分之一）
These properties set the operational parameters for the Precision Time Protocol (PTP) clock. You must choose these carefully for the clock to work correctly. Here is how to calculate appropriate values:

- `TimerOsc` = selected reference clock (in MHz)
- `tclk_period` = desired clock period (in nanoseconds)
- `NominalFreq` = 1000 / `tclk_period` (in MHz)
- `FreqDivRatio` = `TimerOsc` / `NominalFreq` (must be greater than 1.0)
- `tmr_add` = ceiling(2^32 / `FreqDivRatio`)
- `OutputClock` = `NominalFreq` / `tmr_prsc` (in MHz)
- `PulseWidth` = 1 / `OutputClock` (in microseconds)
- `FiperFreq1` = desired frequency (in Hz)
- `FiperDiv1` = 1000000 * `OutputClock` / `FiperFreq1`
- `tmr_fiper1` = `tmr_prsc` * `tclk_period` * `FiperDiv1` - `tclk_period`
- `max_adj` = 1000000000 * (`FreqDivRatio` - 1.0) - 1

The calculation for `tmr_fiper2` is the same as for `tmr_fiper1`. The driver expects that `tmr_fiper1` will be correctly set to produce a 1 Pulse Per Second (PPS) signal, since this will be offered to the PPS subsystem to synchronize the Linux clock.

When this attribute is not used, the IEEE 1588 timer reference clock will use the eTSEC system clock (for Gianfar) or the MAC system clock (for DPAA).

`fsl,extts-fifo`:  
This property indicates hardware support for the external trigger stamp FIFO.

`little-endian`:  
This property indicates that the 1588 timer supports the external trigger stamp FIFO and operates in little-endian mode. The default endian mode is big-endian.

Required properties:
- `compatible`
- `reg`

Additional properties are not allowed.

Example:
```yaml
#include <dt-bindings/interrupt-controller/irq.h>

phc@24e00 {
    compatible = "fsl,etsec-ptp";
    reg = <0x24e00 0xb0>;
    interrupts = <12 IRQ_TYPE_LEVEL_LOW>;
    interrupt-parent = <&ipic>;
    fsl,cksel       = <1>;
    fsl,tclk-period = <10>;
    fsl,tmr-prsc    = <100>;
    fsl,tmr-add     = <0x999999a4>;
    fsl,tmr-fiper1  = <0x3b9ac9f6>;
    fsl,tmr-fiper2  = <0x00018696>;
    fsl,max-adj     = <659999998>;
};
```
This example demonstrates the configuration of a PTP clock with specific settings.
~~~~

## Documentation/devicetree/bindings/ptp/ptp-idt82p33_cn.yaml
~~~~yaml
```yaml
# SPDX-许可证标识符: (GPL-2.0 或 BSD-2-Clause)
%YAML 1.2
---
$id: http://devicetree.org/schemas/ptp/ptp-idt82p33.yaml#
$schema: http://devicetree.org/meta-schemas/core.yaml#

title: IDT 82P33 PTP 时钟

description: |
  基于 IDT 82P33XXX 同步管理单元 (SMU) 的 PTP 时钟

maintainers:
  - Min Li <min.li.xe@renesas.com>

properties:
  compatible:
    enum:
      - idt,82p33810
      - idt,82p33813
      - idt,82p33814
      - idt,82p33831
      - idt,82p33910
      - idt,82p33913
      - idt,82p33914
      - idt,82p33931

  reg:
    maxItems: 1

required:
  - compatible
  - reg

additionalProperties: false

examples:
  - |
    i2c {
        #address-cells = <1>;
        #size-cells = <0>;
        phc@51 {
            compatible = "idt,82p33810";
            reg = <0x51>;
        };
    };
```

这段 YAML 文档描述了 IDT 82P33 系列 PTP 时钟的设备树配置，用于在嵌入式系统中定义硬件组件。
~~~~

## Documentation/devicetree/bindings/ptp/ptp-idtcm_cn.yaml
~~~~yaml
```yaml
# SPDX-许可证标识符: (GPL-2.0 或 BSD-2-Clause)
%YAML 1.2
---
$id: http://devicetree.org/schemas/ptp/ptp-idtcm.yaml#
$schema: http://devicetree.org/meta-schemas/core.yaml#

title: IDT ClockMatrix (TM) PTP 时钟

maintainers:
  - Vincent Cheng <vincent.cheng.xh@renesas.com>

properties:
  compatible:
    enum:
      # 对于系统同步器
      - idt,8a34000
      - idt,8a34001
      - idt,8a34002
      - idt,8a34003
      - idt,8a34004
      - idt,8a34005
      - idt,8a34006
      - idt,8a34007
      - idt,8a34008
      - idt,8a34009
      # 对于端口同步器
      - idt,8a34010
      - idt,8a34011
      - idt,8a34012
      - idt,8a34013
      - idt,8a34014
      - idt,8a34015
      - idt,8a34016
      - idt,8a34017
      - idt,8a34018
      - idt,8a34019
      # 对于通用频率转换器 (UFT)
      - idt,8a34040
      - idt,8a34041
      - idt,8a34042
      - idt,8a34043
      - idt,8a34044
      - idt,8a34045
      - idt,8a34046
      - idt,8a34047
      - idt,8a34048
      - idt,8a34049

  reg:
    maxItems: 1
    description:
      设备的I2C从地址
required:
  - compatible
  - reg

additionalProperties: false

examples:
  - |
    i2c {
        #address-cells = <1>;
        #size-cells = <0>;
        phc@5b {
            compatible = "idt,8a34000";
            reg = <0x5b>;
        };
    };
```

以上是将给定的 YAML 文档翻译成中文。请注意，某些术语（如“compatible”、“reg”等）保持英文原样，因为这些是 YAML 结构中的关键字，并且在不同的编程语言或框架中通常保持一致。
~~~~

## Documentation/devicetree/bindings/ptp/ptp-ines_cn.txt
```
ZHAW InES PTP 时间戳 IP 核心模块

该 IP 核心模块需要两种不同类型的节点。控制节点位于内存映射的某个位置，并指定了控制寄存器的地址。最多可以在 PHY 节点中作为属性放置三个端口句柄。这些句柄将特定的 MII 总线与 IP 核心模块中的端口索引相关联。
控制节点所需属性：

- compatible:		"ines,ptp-ctrl"
- reg:			寄存器组的物理地址和大小

PHY 节点内端口句柄所需格式：

- timestamper:		提供对控制节点的引用以及
			IP 核心模块内的端口通道

示例：

	tstamper: timestamper@60000000 {
		compatible = "ines,ptp-ctrl";
		reg = <0x60000000 0x80>;
	};

	ethernet@80000000 {
		..
mdio {
			..
ethernet-phy@3 {
				..
timestamper = <&tstamper 0>;
			};
		};
	};
```

## Documentation/devicetree/bindings/ptp/timestamper_cn.txt
```
来自MII总线窥探设备的时间戳

此绑定支持非PHY设备，这些设备窥探MII总线并提供时间戳。与PHY时间戳驱动程序（可以直接将其接口连接到PHY实例）不同，独立的MII时间戳驱动程序使用此绑定来指定窥探设备与特定网络接口之间的连接。非PHY MII时间戳驱动程序通常通过另一个总线（如I2C、SPI、UART或通过内存映射的外围设备）与控制接口通信。此控制器设备与一个或多个时间戳通道相关联，每个通道都窥探MII总线。

“timestamper”属性位于phy节点中，并将控制器设备的时间戳通道链接到该phy的MII总线。

示例：

	tstamper: timestamper@10000000 {
		compatible = "ines,ptp-ctrl";
		reg = <0x10000000 0x80>;
	};

	ethernet@20000000 {
		mdio {
			ethernet-phy@1 {
				timestamper = <&tstamper 0>;
			};
		};
	};

	ethernet@30000000 {
		mdio {
			ethernet-phy@2 {
				timestamper = <&tstamper 1>;
			};
		};
	};

在此示例中，连接到phy@1的MII总线上的时间戳将出现在时间戳通道0（零）上，而phy@2上的时间戳将出现在通道1上。
```

## Documentation/devicetree/bindings/riscv/canaan_cn.yaml
```yaml
# SPDX-许可证标识符: (GPL-2.0-only 或 BSD-2-Clause)
%YAML 1.2
---
$id: http://devicetree.org/schemas/riscv/canaan.yaml#
$schema: http://devicetree.org/meta-schemas/core.yaml#

标题: 基于Canaan SoC的开发板

维护者:
  - Damien Le Moal <dlemoal@kernel.org>

描述:
  基于Canaan Kendryte K210 SoC的开发板

属性:
  $nodename:
    常量: '/'
  compatible:
    oneOf:
      - items:
          - 常量: sipeed,maix-bit
          - 常量: sipeed,maix-bitm
          - 常量: canaan,kendryte-k210

      - items:
          - 常量: sipeed,maix-go
          - 常量: canaan,kendryte-k210

      - items:
          - 常量: sipeed,maix-dock-m1
          - 常量: sipeed,maix-dock-m1w
          - 常量: canaan,kendryte-k210

      - items:
          - 常量: sipeed,maixduino
          - 常量: canaan,kendryte-k210

      - items:
          - 常量: canaan,kendryte-kd233
          - 常量: canaan,kendryte-k210

      - items:
          - 常量: canaan,kendryte-k210

其他属性: true

..
```

## Documentation/devicetree/bindings/riscv/cpus_cn.yaml
```yaml
以下是文档的中文翻译：

# SPDX-许可证标识符: (GPL-2.0 或 MIT)
%YAML 1.2
---
$id: http://devicetree.org/schemas/riscv/cpus.yaml#
$schema: http://devicetree.org/meta-schemas/core.yaml#

标题: RISC-V 处理器

维护者:
  - Paul Walmsley <paul.walmsley@sifive.com>
  - Palmer Dabbelt <palmer@sifive.com>
  - Conor Dooley <conor@kernel.org>

描述: |
  本文件使用了一些 RISC-V 社区中常用但并非广泛使用的术语，其定义如下：

  hart: 硬件执行上下文，包含 RISC-V 指令集架构要求的所有状态：程序计数器（PC）和一些寄存器。这种术语旨在区分软件视角中的执行上下文与任何特定微架构实现策略。例如，一台包含一个插槽、两个核心且每个核心有两个超线程的英特尔笔记本电脑可以被描述为拥有四个 hart。
allOf:
  - $ref: /schemas/cpu.yaml#
  - $ref: extensions.yaml

属性:
  compatible:
    oneOf:
      - items:
          - enum:
              - amd,mbv32
              - andestech,ax45mp
              - canaan,k210
              - sifive,bullet0
              - sifive,e5
              - sifive,e7
              - sifive,e71
              - sifive,rocket0
              - sifive,s7
              - sifive,u5
              - sifive,u54
              - sifive,u7
              - sifive,u74
              - sifive,u74-mc
              - thead,c906
              - thead,c908
              - thead,c910
              - thead,c920
          - const: riscv
      - items:
          - enum:
              - sifive,e51
              - sifive,u54-mc
          - const: sifive,rocket0
          - const: riscv
      - const: riscv    # 仅模拟器
    description:
      标识 hart 使用 RISC-V 指令集并标识 hart 的类型
mmu-type:
    description:
      标识此 hart 支持的最大 MMU 地址转换模式。这些值源自 RISC-V 特权规范文档，可从 https://riscv.org/specifications/ 获取
    $ref: /schemas/types.yaml#/definitions/string
    enum:
      - riscv,sv32
      - riscv,sv39
      - riscv,sv48
      - riscv,sv57
      - riscv,none

  reg:
    description:
      此 CPU 节点的 hart ID
riscv,cbom-block-size:
    $ref: /schemas/types.yaml#/definitions/uint32
    description:
      用于 Zicbom 缓存操作的块大小（以字节为单位）
riscv,cbop-block-size:
    $ref: /schemas/types.yaml#/definitions/uint32
    description:
      用于 Zicbop 缓存操作的块大小（以字节为单位）
riscv,cboz-block-size:
    $ref: /schemas/types.yaml#/definitions/uint32
    description:
      用于 Zicboz 缓存操作的块大小（以字节为单位）
# RISC-V 有多个缓存操作块大小的属性，因为不同 CBO 扩展之间的大小不同
  cache-op-block-size: false
  # RISC-V 需要在 /cpus 中设置 'timebase-frequency'，因此在此处禁止
  timebase-frequency: false

  interrupt-controller:
    类型: 对象
    additionalProperties: false
    description: 描述 CPU 的本地中断控制器

    属性:
      '#interrupt-cells':
        const: 1

      compatible:
        oneOf:
          - items:
              - const: andestech,cpu-intc
              - const: riscv,cpu-intc
          - const: riscv,cpu-intc

      interrupt-controller: true

    必需:
      - '#interrupt-cells'
      - compatible
      - interrupt-controller

  cpu-idle-states:
    $ref: /schemas/types.yaml#/definitions/phandle-array
    items:
      maxItems: 1
    description: |
      支持此 hart 的空闲状态节点的句柄列表
      （参见 ./idle-states.yaml）
capacity-dmips-mhz:
    description:
      u32 值表示 CPU 容量（参见 ../cpu/cpu-capacity.txt），单位为 DMIPS/MHz，
      相对于系统中最高的 capacity-dmips-mhz
anyOf:
  - required:
      - riscv,isa
  - required:
      - riscv,isa-base

依赖项:
  riscv,isa-base: [ "riscv,isa-extensions" ]
  riscv,isa-extensions: [ "riscv,isa-base" ]

必需:
  - interrupt-controller

未评估属性: false

示例:
  - |
    // 示例 1: SiFive Freedom U540G 开发套件
    cpus {
        #address-cells = <1>;
        #size-cells = <0>;
        timebase-frequency = <1000000>;
        cpu@0 {
                clock-frequency = <0>;
                compatible = "sifive,rocket0", "riscv";
                device_type = "cpu";
                i-cache-block-size = <64>;
                i-cache-sets = <128>;
                i-cache-size = <16384>;
                reg = <0>;
                riscv,isa-base = "rv64i";
                riscv,isa-extensions = "i", "m", "a", "c";

                cpu_intc0: interrupt-controller {
                        #interrupt-cells = <1>;
                        compatible = "riscv,cpu-intc";
                        interrupt-controller;
                };
        };
        cpu@1 {
                clock-frequency = <0>;
                compatible = "sifive,rocket0", "riscv";
                d-cache-block-size = <64>;
                d-cache-sets = <64>;
                d-cache-size = <32768>;
                d-tlb-sets = <1>;
                d-tlb-size = <32>;
                device_type = "cpu";
                i-cache-block-size = <64>;
                i-cache-sets = <64>;
                i-cache-size = <32768>;
                i-tlb-sets = <1>;
                i-tlb-size = <32>;
                mmu-type = "riscv,sv39";
                reg = <1>;
                tlb-split;
                riscv,isa-base = "rv64i";
                riscv,isa-extensions = "i", "m", "a", "f", "d", "c";

                cpu_intc1: interrupt-controller {
                        #interrupt-cells = <1>;
                        compatible = "riscv,cpu-intc";
                        interrupt-controller;
                };
        };
    };

  - |
    // 示例 2: Spike ISA 模拟器，含 1 个 hart
    cpus {
        #address-cells = <1>;
        #size-cells = <0>;
        cpu@0 {
                device_type = "cpu";
                reg = <0>;
                compatible = "riscv";
                mmu-type = "riscv,sv48";
                riscv,isa-base = "rv64i";
                riscv,isa-extensions = "i", "m", "a", "f", "d", "c";

                interrupt-controller {
                        #interrupt-cells = <1>;
                        interrupt-controller;
                        compatible = "riscv,cpu-intc";
                };
        };
    };
..
```
