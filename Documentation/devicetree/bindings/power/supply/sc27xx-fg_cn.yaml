## Documentation/devicetree/bindings/power/supply/sc27xx-fg_cn.yaml
~~~~yaml
```yaml
# SPDX-许可证标识符: GPL-2.0
%YAML 1.2
---
$id: http://devicetree.org/schemas/power/supply/sc27xx-fg.yaml#
$schema: http://devicetree.org/meta-schemas/core.yaml#

title: Spreadtrum SC27XX PMICs 燃料计量单元电源供应

maintainers:
  - Sebastian Reichel <sre@kernel.org>

allOf:
  - $ref: power-supply.yaml#

properties:
  compatible:
    enum:
      - sprd,sc2720-fgu
      - sprd,sc2721-fgu
      - sprd,sc2723-fgu
      - sprd,sc2730-fgu
      - sprd,sc2731-fgu

  reg:
    maxItems: 1

  battery-detect-gpios:
    maxItems: 1

  io-channels:
    items:
      - description: 电池温度 ADC
      - description: 电池充电电压 ADC

  io-channel-names:
    items:
      - const: bat-temp
      - const: charge-vol

  nvmem-cells:
    maxItems: 1
    description: 由 eFuse 设备提供的校准单元

  nvmem-cell-names:
    const: fgu_calib

  sprd,calib-resistance-micro-ohms:
    description: 库仑计芯片的实际电阻（微欧姆）

  monitored-battery: true

required:
  - compatible
  - reg
  - battery-detect-gpios
  - io-channels
  - io-channel-names
  - nvmem-cells
  - nvmem-cell-names
  - sprd,calib-resistance-micro-ohms
  - monitored-battery

additionalProperties: false

examples:
  - |
    #include <dt-bindings/gpio/gpio.h>
    bat: battery {
      compatible = "simple-battery";
      charge-full-design-microamp-hours = <1900000>;
      constant-charge-voltage-max-microvolt = <4350000>;
      ocv-capacity-celsius = <20>;
      ocv-capacity-table-0 = <4185000 100>, <4113000 95>, <4066000 90>,
                             <4022000 85>, <3983000 80>, <3949000 75>,
                             <3917000 70>, <3889000 65>, <3864000 60>,
                             <3835000 55>, <3805000 50>, <3787000 45>,
                             <3777000 40>, <3773000 35>, <3770000 30>,
                             <3765000 25>, <3752000 20>, <3724000 15>,
                             <3680000 10>, <3605000 5>, <3400000 0>;
                             // ..
};

    pmic {
      #address-cells = <1>;
      #size-cells = <0>;

      battery@a00 {
        compatible = "sprd,sc2731-fgu";
        reg = <0xa00>;
        battery-detect-gpios = <&pmic_eic 9 GPIO_ACTIVE_HIGH>;
        io-channels = <&pmic_adc 5>, <&pmic_adc 14>;
        io-channel-names = "bat-temp", "charge-vol";
        nvmem-cells = <&fgu_calib>;
        nvmem-cell-names = "fgu_calib";
        monitored-battery = <&bat>;
        sprd,calib-resistance-micro-ohms = <21500>;
      };
    };
```
```markdown
此示例定义了使用 Spreadtrum SC27XX PMIC 的燃料计量单元电源供应的 Device Tree 配置。在例子中，配置了一个具体的电池节点 `bat` 和一个 PMIC 节点，其中包含与燃料计量单元相关的具体属性和配置信息。
```
~~~~

## Documentation/devicetree/bindings/power/supply/stericsson,ab8500-btemp_cn.yaml
~~~~yaml
下面是给定内容的中文翻译：

```yaml
# SPDX-文件许可标识符: GPL-2.0
# 版权 (C) 2021 Sebastian Reichel
%YAML 1.2
---
$id: http://devicetree.org/schemas/power/supply/stericsson,ab8500-btemp.yaml#
$schema: http://devicetree.org/meta-schemas/core.yaml#

title: AB8500 电池温度监控器

maintainers:
  - Sebastian Reichel <sre@kernel.org>

allOf:
  - $ref: power-supply.yaml#

properties:
  compatible:
    const: stericsson,ab8500-btemp

  monitored-battery:
    $ref: /schemas/types.yaml#/definitions/phandle
    description: 指向电池节点的phandle

  battery:
    $ref: /schemas/types.yaml#/definitions/phandle
    deprecated: true

  interrupts:
    maxItems: 5

  interrupt-names:
    items:
      - const: BAT_CTRL_INDB
      - const: BTEMP_LOW
      - const: BTEMP_HIGH
      - const: BTEMP_LOW_MEDIUM
      - const: BTEMP_MEDIUM_HIGH

  io-channels:
    maxItems: 2

  io-channel-names:
    items:
      - const: btemp_ball
      - const: bat_ctrl

required:
  - compatible
  - monitored-battery
  - interrupts
  - interrupt-names
  - io-channels
  - io-channel-names

additionalProperties: false

examples:
  - |
    #include <dt-bindings/interrupt-controller/irq.h>
    pmic {
      battery-temperature {
        compatible = "stericsson,ab8500-btemp";
        monitored-battery = <&battery>;
        interrupts = <20 IRQ_TYPE_LEVEL_HIGH>,
                     <80 IRQ_TYPE_LEVEL_HIGH>,
                     <83 IRQ_TYPE_LEVEL_HIGH>,
                     <81 IRQ_TYPE_LEVEL_HIGH>,
                     <82 IRQ_TYPE_LEVEL_HIGH>;
        interrupt-names = "BAT_CTRL_INDB",
                          "BTEMP_LOW",
                          "BTEMP_HIGH",
                          "BTEMP_LOW_MEDIUM",
                          "BTEMP_MEDIUM_HIGH";
        io-channels = <&gpadc 0x02>, <&gpadc 0x01>;
        io-channel-names = "btemp_ball", "bat_ctrl";
      };
    };
```

请注意，代码示例中的注释和内容保持了原始格式。
~~~~

## Documentation/devicetree/bindings/power/supply/stericsson,ab8500-chargalg_cn.yaml
```yaml
下面是给定内容的中文翻译：

# SPDX-许可证标识符: GPL-2.0
# 版权所有 (C) 2021 Sebastian Reichel
%YAML 1.2
---
$id: http://devicetree.org/schemas/power/supply/stericsson,ab8500-chargalg.yaml#
$schema: http://devicetree.org/meta-schemas/core.yaml#

标题: AB8500 充电算法

维护者:
  - Sebastian Reichel <sre@kernel.org>

allOf:
  - $ref: power-supply.yaml#

属性:
  compatible:
    常量: stericsson,ab8500-chargalg

  monitored-battery:
    $ref: /schemas/types.yaml#/definitions/phandle
    描述: 指向电池节点的 phandle

  battery:
    $ref: /schemas/types.yaml#/definitions/phandle
    过时: true

必需:
  - compatible
  - monitored-battery

额外属性: false

示例:
  - |
    pmic {
      charging-algorithm {
        compatible = "stericsson,ab8500-chargalg";
        monitored-battery = <&ab8500_battery>;
      };
    };
```

## Documentation/devicetree/bindings/power/supply/stericsson,ab8500-charger_cn.yaml
~~~~yaml
下面是给定内容的中文翻译：

```yaml
# SPDX-文件许可标识符: GPL-2.0
# 版权 (C) 2021 Sebastian Reichel
%YAML 1.2
---
$id: http://devicetree.org/schemas/power/supply/stericsson,ab8500-charger.yaml#
$schema: http://devicetree.org/meta-schemas/core.yaml#

标题: AB8500 充电器

维护者:
  - Sebastian Reichel <sre@kernel.org>

allOf:
  - $ref: power-supply.yaml#

属性:
  compatible:
    常量: stericsson,ab8500-charger

  monitored-battery:
    $ref: /schemas/types.yaml#/definitions/phandle
    描述: 指向电池节点的 phandle

  battery:
    $ref: /schemas/types.yaml#/definitions/phandle
    过时: true

  vddadc-supply:
    描述: 为 USB 和主充电器供电

  autopower_cfg:
    类型: 布尔值
    描述: 断电后自动开机

  interrupts:
    最大项数: 14

  interrupt-names:
    项:
      - 常量: MAIN_CH_UNPLUG_DET
      - 常量: MAIN_CHARGE_PLUG_DET
      - 常量: MAIN_EXT_CH_NOT_OK
      - 常量: MAIN_CH_TH_PROT_R
      - 常量: MAIN_CH_TH_PROT_F
      - 常量: VBUS_DET_F
      - 常量: VBUS_DET_R
      - 常量: USB_LINK_STATUS
      - 常量: USB_CH_TH_PROT_R
      - 常量: USB_CH_TH_PROT_F
      - 常量: USB_CHARGER_NOT_OKR
      - 常量: VBUS_OVV
      - 常量: CH_WD_EXP
      - 常量: VBUS_CH_DROP_END

  io-channels:
    最小项数: 2
    最大项数: 4

  io-channel-names:
    oneOf:
      - 项:
          - 常量: main_charger_v
          - 常量: main_charger_c
          - 常量: vbus_v
          - 常量: usb_charger_c
      - 项:
          - 常量: vbus_v
          - 常量: usb_charger_c


必需:
  - compatible
  - monitored-battery
  - vddadc-supply
  - interrupts
  - interrupt-names
  - io-channels
  - io-channel-names

额外属性: false

示例:
  - |
    #include <dt-bindings/interrupt-controller/irq.h>
    pmic {
      charger {
        compatible = "stericsson,ab8500-charger";
        monitored-battery = <&battery>;
        vddadc-supply = <&ab8500_ldo_tvout_reg>;
        interrupts = <10 IRQ_TYPE_LEVEL_HIGH>,
                     <11 IRQ_TYPE_LEVEL_HIGH>,
                     <0 IRQ_TYPE_LEVEL_HIGH>,
                     <107 IRQ_TYPE_LEVEL_HIGH>,
                     <106 IRQ_TYPE_LEVEL_HIGH>,
                     <14 IRQ_TYPE_LEVEL_HIGH>,
                     <15 IRQ_TYPE_LEVEL_HIGH>,
                     <79 IRQ_TYPE_LEVEL_HIGH>,
                     <105 IRQ_TYPE_LEVEL_HIGH>,
                     <104 IRQ_TYPE_LEVEL_HIGH>,
                     <89 IRQ_TYPE_LEVEL_HIGH>,
                     <22 IRQ_TYPE_LEVEL_HIGH>,
                     <21 IRQ_TYPE_LEVEL_HIGH>,
                     <16 IRQ_TYPE_LEVEL_HIGH>;
        interrupt-names = "MAIN_CH_UNPLUG_DET",
                          "MAIN_CHARGE_PLUG_DET",
                          "MAIN_EXT_CH_NOT_OK",
                          "MAIN_CH_TH_PROT_R",
                          "MAIN_CH_TH_PROT_F",
                          "VBUS_DET_F",
                          "VBUS_DET_R",
                          "USB_LINK_STATUS",
                          "USB_CH_TH_PROT_R",
                          "USB_CH_TH_PROT_F",
                          "USB_CHARGER_NOT_OKR",
                          "VBUS_OVV",
                          "CH_WD_EXP",
                          "VBUS_CH_DROP_END";
        io-channels = <&gpadc 0x03>,
                      <&gpadc 0x0a>,
                      <&gpadc 0x09>,
                      <&gpadc 0x0b>;
        io-channel-names = "main_charger_v",
                           "main_charger_c",
                           "vbus_v",
                           "usb_charger_c";
      };
    };
```
```
~~~~

## Documentation/devicetree/bindings/power/supply/stericsson,ab8500-fg_cn.yaml
~~~~yaml
```yaml
# SPDX-文件许可标识符: GPL-2.0
# 版权所有 (C) 2021 Sebastian Reichel
%YAML 1.2
---
$id: 'http://devicetree.org/schemas/power/supply/stericsson,ab8500-fg.yaml#'
$schema: 'http://devicetree.org/meta-schemas/core.yaml#'

title: AB8500 燃料表

maintainers:
  - Sebastian Reichel <sre@kernel.org>

allOf:
  - $ref: 'power-supply.yaml#'

properties:
  compatible:
    const: stericsson,ab8500-fg

  monitored-battery:
    $ref: '/schemas/types.yaml#/definitions/phandle'
    description: 指向电池节点的 phandle

  battery:
    $ref: '/schemas/types.yaml#/definitions/phandle'
    deprecated: true

  line-impedance-micro-ohms:
    description: 电池与 AB8500 输入端之间的线路阻抗，为了在确定内部电阻时进行补偿

interrupts:
    maxItems: 5

  interrupt-names:
    items:
      - const: NCONV_ACCU
      - const: BATT_OVV
      - const: LOW_BAT_F
      - const: CC_INT_CALIB
      - const: CCEOC

  io-channels:
    maxItems: 1

  io-channel-names:
    items:
      - const: main_bat_v

required:
  - compatible
  - monitored-battery
  - interrupts
  - interrupt-names
  - io-channels
  - io-channel-names

additionalProperties: false

examples:
  - |
    #include <dt-bindings/interrupt-controller/irq.h>
    pmic {
      fuel-gauge {
        compatible = "stericsson,ab8500-fg";
        monitored-battery = <&battery>;
        interrupts = <24 IRQ_TYPE_LEVEL_HIGH>,
                     <8 IRQ_TYPE_LEVEL_HIGH>,
                     <28 IRQ_TYPE_LEVEL_HIGH>,
                     <27 IRQ_TYPE_LEVEL_HIGH>,
                     <26 IRQ_TYPE_LEVEL_HIGH>;
        interrupt-names = "NCONV_ACCU",
                          "BATT_OVV",
                          "LOW_BAT_F",
                          "CC_INT_CALIB",
                          "CCEOC";
        io-channels = <&gpadc 0x08>;
        io-channel-names = "main_bat_v";
      };
    };
```

请注意，某些 YAML 元素（例如 `maxItems`、`items` 和 `const`）的翻译可能没有完全对应到中文，因为这些是 YAML 或 JSON 架构中的专有名词。同时，由于 YAML 文件中包含了一些特定于设备树规范的内容，部分术语直接保留了英文形式以保持其专业性和准确性。
~~~~

## Documentation/devicetree/bindings/power/supply/summit,smb347-charger_cn.yaml
~~~~yaml
下面是给定 YAML 文档的中文翻译：

```yaml
# SPDX-许可证标识符: (GPL-2.0-only 或 BSD-2-Clause)
%YAML 1.2
---
$id: http://devicetree.org/schemas/power/supply/summit,smb347-charger.yaml#
$schema: http://devicetree.org/meta-schemas/core.yaml#

标题: SMB345、SMB347 和 SMB358 的电池充电器驱动程序

维护者:
  - David Heidelberg <david@ixit.cz>
  - Dmitry Osipenko <digetx@gmail.com>

属性:
  compatible:
    枚举:
      - summit,smb345
      - summit,smb347
      - summit,smb358

  reg:
    最大项数: 1

  interrupts:
    最大项数: 1

  monitored-battery:
    描述: 指向电池节点的 phandle
    $ref: /schemas/types.yaml#/definitions/phandle

  summit,enable-usb-charging:
    类型: 布尔值
    描述: 启用通过 USB 充电

  summit,enable-otg-charging:
    类型: 布尔值
    描述: 提供 USB OTG 的电源

  summit,enable-mains-charging:
    类型: 布尔值
    描述: 启用通过市电充电

  summit,enable-charge-control:
    描述: 启用充电控制
    $ref: /schemas/types.yaml#/definitions/uint32
    枚举:
      - 0 # SMB3XX_CHG_ENABLE_SW 软件控制 (I2C 接口)
      - 1 # SMB3XX_CHG_ENABLE_PIN_ACTIVE_LOW 引脚控制 (低电平有效)
      - 2 # SMB3XX_CHG_ENABLE_PIN_ACTIVE_HIGH 引脚控制 (高电平有效)

  summit,fast-voltage-threshold-microvolt:
    描述: 进入快速充电模式的电压阈值（微伏）
    最小值: 2400000
    最大值: 3000000

  summit,mains-current-limit-microamp:
    描述: 来自交流/直流输入的最大输入电流（微安）

  summit,usb-current-limit-microamp:
    描述: 来自 USB 输入的最大输入电流（微安）

  summit,charge-current-compensation-microamp:
    描述: 充电电流补偿（微安）

  summit,chip-temperature-threshold-celsius:
    描述: 热调节芯片温度（摄氏度）
    枚举: [100, 110, 120, 130]

  summit,soft-compensation-method:
    描述: 温度软限补偿方法
    $ref: /schemas/types.yaml#/definitions/uint32
    枚举:
      - 0 # SMB3XX_SOFT_TEMP_COMPENSATE_NONE 无补偿
      - 1 # SMB3XX_SOFT_TEMP_COMPENSATE_CURRENT 电流补偿
      - 2 # SMB3XX_SOFT_TEMP_COMPENSATE_VOLTAGE 电压补偿

  summit,inok-polarity:
    描述: |
      表示外部电源存在的 INOK 信号极性
    $ref: /schemas/types.yaml#/definitions/uint32
    枚举:
      - 0 # SMB3XX_SYSOK_INOK_ACTIVE_LOW
      - 1 # SMB3XX_SYSOK_INOK_ACTIVE_HIGH

  usb-vbus:
    $ref: /schemas/regulator/regulator.yaml#
    类型: 对象

    属性:
      summit,needs-inok-toggle:
        类型: 布尔值
        描述: INOK 信号固定且需要切换极性以启用/禁用输出模式

unevaluatedProperties: false

allOf:
  - 如果:
      属性:
        compatible:
          枚举:
            - summit,smb345
            - summit,smb358

    那么:
      属性:
        summit,mains-current-limit-microamp:
          枚举: [300000, 500000, 700000, 1000000, 1500000, 1800000, 2000000]

        summit,usb-current-limit-microamp:
          枚举: [300000, 500000, 700000, 1000000, 1500000, 1800000, 2000000]

        summit,charge-current-compensation-microamp:
          枚举: [200000, 450000, 600000, 900000]

    否则:
      属性:
        summit,mains-current-limit-microamp:
          枚举: [300000, 500000, 700000, 900000, 1200000, 1500000, 1800000, 2000000, 2200000, 2500000]

        summit,usb-current-limit-microamp:
          枚举: [300000, 500000, 700000, 900000, 1200000, 1500000, 1800000, 2000000, 2200000, 2500000]

        summit,charge-current-compensation-microamp:
          枚举: [250000, 700000, 900000, 1200000]

必需:
  - compatible
  - reg

anyOf:
  - 必需:
      - summit,enable-usb-charging
  - 必需:
      - summit,enable-otg-charging
  - 必需:
      - summit,enable-mains-charging

additionalProperties: false

例子:
  - |
    #include <dt-bindings/power/summit,smb347-charger.h>

    i2c {
        #address-cells = <1>;
        #size-cells = <0>;

        charger@7f {
            compatible = "summit,smb347";
            reg = <0x7f>;

            summit,enable-charge-control = <SMB3XX_CHG_ENABLE_PIN_ACTIVE_HIGH>;
            summit,inok-polarity = <SMB3XX_SYSOK_INOK_ACTIVE_LOW>;
            summit,chip-temperature-threshold-celsius = <110>;
            summit,mains-current-limit-microamp = <2000000>;
            summit,usb-current-limit-microamp = <500000>;
            summit,enable-usb-charging;
            summit,enable-mains-charging;

            monitored-battery = <&battery>;

            usb-vbus {
                regulator-name = "usb_vbus";
                regulator-min-microvolt = <5000000>;
                regulator-max-microvolt = <5000000>;
                regulator-min-microamp = <750000>;
                regulator-max-microamp = <750000>;
                summit,needs-inok-toggle;
            };
        };
    };

    battery: battery-cell {
        compatible = "simple-battery";
        constant-charge-current-max-microamp = <1800000>;
        operating-range-celsius = <0 45>;
        alert-celsius = <3 42>;
    };
```

请注意，上述翻译尽可能地保留了原始文档中的格式和结构。
~~~~
