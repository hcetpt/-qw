## Documentation/devicetree/bindings/power/supply/charger-manager_cn.yaml
```yaml
# SPDX-许可证标识符: GPL-2.0
%YAML 1.2
---
$id: http://devicetree.org/schemas/power/supply/charger-manager.yaml#
$schema: http://devicetree.org/meta-schemas/core.yaml#

标题: 充电器管理器

维护者:
  - Sebastian Reichel <sre@kernel.org>

描述: |
  针对传统充电器管理驱动程序的绑定
请勿在新产品中使用
属性:
  compatible:
    常量: charger-manager

  cm-chargers:
    描述: 充电器名称
    $ref: /schemas/types.yaml#/definitions/string-array

  cm-num-chargers:
    $ref: /schemas/types.yaml#/definitions/uint32
    过时: true

  cm-fuel-gauge:
    描述: 电池电量计名称
    $ref: /schemas/types.yaml#/definitions/string

  cm-name:
    描述: 充电器管理器名称
    默认: battery
    $ref: /schemas/types.yaml#/definitions/string

  cm-poll-mode:
    描述: 轮询模式
    $ref: /schemas/types.yaml#/definitions/uint32
    默认: 0
    枚举:
      - 0 # 禁用
      - 1 # 总是
      - 2 # 当外部电源连接时
      - 3 # 在充电时

  cm-poll-interval:
    描述: 轮询间隔（以毫秒为单位）
    $ref: /schemas/types.yaml#/definitions/uint32

  cm-battery-stat:
    描述: 电池状态
    $ref: /schemas/types.yaml#/definitions/uint32
    枚举:
      - 0 # 电池始终存在
      - 1 # 没有电池
      - 2 # 通过电量计检查存在
      - 3 # 通过充电器检查存在

  cm-fullbatt-vchkdrop-volt:
    描述: 在重启充电前电压下降值（以微伏为单位）
    $ref: /schemas/types.yaml#/definitions/uint32

  cm-fullbatt-vchkdrop-ms:
    过时: true

  cm-fullbatt-voltage:
    描述: 满电电池电压（以微伏为单位）
    $ref: /schemas/types.yaml#/definitions/uint32

  cm-fullbatt-soc:
    描述: 视为满电电池的荷电状态百分比
    $ref: /schemas/types.yaml#/definitions/uint32

  cm-fullbatt-capacity:
    描述: 视为满电电池的容量（以微安时为单位）
    $ref: /schemas/types.yaml#/definitions/uint32

  cm-thermal-zone:
    描述: 外部温度计的热区名称
    $ref: /schemas/types.yaml#/definitions/string

  cm-discharging-max:
    描述: 放电持续时间限制（以毫秒为单位）
    $ref: /schemas/types.yaml#/definitions/uint32

  cm-charging-max:
    描述: 充电持续时间限制（以毫秒为单位）
    $ref: /schemas/types.yaml#/definitions/uint32

  cm-battery-cold:
    描述: 充电时电池临界低温（以十分之一摄氏度为单位）
    $ref: /schemas/types.yaml#/definitions/uint32

  cm-battery-cold-in-minus:
    描述: 如果设置，则cm-battery-cold温度是在零下
    类型: 布尔值

  cm-battery-hot:
    描述: 充电时电池临界高温（以十分之一摄氏度为单位）
    $ref: /schemas/types.yaml#/definitions/uint32

  cm-battery-temp-diff:
    描述: 允许重新充电的温差（以十分之一摄氏度为单位）
    $ref: /schemas/types.yaml#/definitions/uint32

模式属性:
  "-supply$":
    描述: 根据cm-regulator-name命名的稳压器消费者
    $ref: /schemas/types.yaml#/definitions/phandle

  "^regulator[@-][0-9]$":
    类型: 对象
    属性:
      cm-regulator-name:
        描述: 充电器稳压器名称
        $ref: /schemas/types.yaml#/definitions/string

    必需:
      - cm-regulator-name

    额外属性: false

    模式属性:
      "^cable[@-][0-9]$":
        类型: 对象
        属性:
          cm-cable-name:
            描述: 充电器电缆名称
            枚举:
              - USB
              - USB-HOST
              - SDP
              - DCP
              - CDP
              - ACA
              - FAST-CHARGER
              - SLOW-CHARGER
              - WPT
              - PD
              - DOCK
              - JIG
              - MECHANICAL

          cm-cable-extcon:
            描述: extcon设备名称
            $ref: /schemas/types.yaml#/definitions/string

          cm-cable-min:
            描述: 电缆最小电流（以微安为单位）
            $ref: /schemas/types.yaml#/definitions/uint32

          cm-cable-max:
            描述: 电缆最大电流（以微安为单位）
            $ref: /schemas/types.yaml#/definitions/uint32

        必需:
          - cm-cable-name
          - cm-cable-extcon

        额外属性: false

必需:
  - compatible
  - cm-chargers
  - cm-fuel-gauge

额外属性: false

示例:
  - |
    charger-manager {
        compatible = "charger-manager";
        chg-reg-supply = <&charger_regulator>;

        cm-name = "battery";
        /* 始终开启轮询：30秒 */
        cm-poll-mode = <1>;
        cm-poll-interval = <30000>;

        cm-fullbatt-vchkdrop-volt = <150000>;
        cm-fullbatt-soc = <100>;

        cm-battery-stat = <3>;

        cm-chargers = "charger0", "charger1", "charger2";

        cm-fuel-gauge = "fuelgauge0";

        cm-thermal-zone = "thermal_zone.1";
        /* 十分之一摄氏度 */
        cm-battery-cold = <50>;
        cm-battery-cold-in-minus;
        cm-battery-hot = <800>;
        cm-battery-temp-diff = <100>;

        /* 允许充电5小时 */
        cm-charging-max = <18000000>;
        /* 允许放电2小时 */
        cm-discharging-max = <7200000>;

        regulator-0 {
            cm-regulator-name = "chg-reg";
            cable-0 {
                cm-cable-name = "USB";
                cm-cable-extcon = "extcon-dev.0";
                cm-cable-min = <475000>;
                cm-cable-max = <500000>;
            };
            cable-1 {
                cm-cable-name = "SDP";
                cm-cable-extcon = "extcon-dev.0";
                cm-cable-min = <650000>;
                cm-cable-max = <675000>;
            };
        };
    };
```

## Documentation/devicetree/bindings/power/supply/cpcap-charger_cn.yaml
~~~~yaml
下面是给定内容的中文翻译：

```yaml
# SPDX-文件许可人: GPL-2.0
# 版权 (C) 2021 Sebastian Reichel
%YAML 1.2
---
$id: http://devicetree.org/schemas/power/supply/cpcap-charger.yaml#
$schema: http://devicetree.org/meta-schemas/core.yaml#

标题: Motorola CPCAP 电源管理 IC 充电器

维护者:
  - Tony Lindgren <tony@atomide.com>
  - Sebastian Reichel <sre@kernel.org>

描述: |
  Motorola CPCAP 是一款在某些移动电话中发现的电源管理 IC，例如
Droid 4。此绑定描述了其电池充电器
子功能。
allOf:
  - $ref: power-supply.yaml#

属性:
  compatible:
    常量: motorola,mapphone-cpcap-charger

  interrupts:
    项目:
      - 描述: 充电检测中断
      - 描述: 反向充电中断
      - 描述: SE1 充电检测中断
      - 描述: SE0 连接中断
      - 描述: 反向模式中断
      - 描述: 充电电流 2 中断
      - 描述: 充电电流 1 中断
      - 描述: VBUS 有效中断
      - 描述: 电池检测中断

  interrupt-names:
    项目:
      - 常量: chrg_det
      - 常量: rvrs_chrg
      - 常量: chrg_se1b
      - 常量: se0conn
      - 常量: rvrs_mode
      - 常量: chrgcurr2
      - 常量: chrgcurr1
      - 常量: vbusvld
      - 常量: battdetb

  io-channels:
    项目:
      - 描述: 电池温度
      - 描述: 电池电压
      - 描述: VBUS 电压
      - 描述: 电池充电电流
      - 描述: 电池电流

  io-channel-names:
    项目:
      - 常量: battdetb
      - 常量: battp
      - 常量: vbus
      - 常量: chg_isense
      - 常量: batti

  mode-gpios:
    描述: |
      可选地，CPCAP 充电器可以有一个伴随的无线
      充电控制器，该控制器通过两个 GPIO 控制，
      这些 GPIO 为低电平有效
最小项目: 2
    最大项目: 2

必需:
  - compatible
  - interrupts
  - interrupt-names
  - io-channels
  - io-channel-names

附加属性: false

示例:
  - |
    #include <dt-bindings/gpio/gpio.h>
    cpcap {
      charger {
        compatible = "motorola,mapphone-cpcap-charger";
        interrupts-extended =
                <&cpcap 13 0>, <&cpcap 12 0>, <&cpcap 29 0>, <&cpcap 28 0>,
                <&cpcap 22 0>, <&cpcap 21 0>, <&cpcap 20 0>, <&cpcap 19 0>,
                <&cpcap 54 0>;
        interrupt-names =
                "chrg_det", "rvrs_chrg", "chrg_se1b", "se0conn",
                "rvrs_mode", "chrgcurr2", "chrgcurr1", "vbusvld",
                "battdetb";
        mode-gpios = <&gpio3 29 GPIO_ACTIVE_LOW>,
                     <&gpio3 23 GPIO_ACTIVE_LOW>;
        io-channels = <&cpcap_adc 0>, <&cpcap_adc 1>,
                      <&cpcap_adc 2>, <&cpcap_adc 5>,
                      <&cpcap_adc 6>;
        io-channel-names = "battdetb", "battp",
                           "vbus", "chg_isense",
                           "batti";
      };
    };
```
```
~~~~

## Documentation/devicetree/bindings/power/supply/cw2015_battery_cn.yaml
```yaml
下面是给定内容的中文翻译：

# SPDX-许可证标识符: (GPL-2.0-only 或 BSD-2-Clause)
%YAML 1.2
---
$id: http://devicetree.org/schemas/power/supply/cw2015_battery.yaml#
$schema: http://devicetree.org/meta-schemas/core.yaml#

title: 适用于 CellWise CW2015 无分流燃料表的电池驱动程序
maintainers:
  - Tobias Schramm <t.schramm@manjaro.org>

description: |
  驱动程序可以从通过 phandle 在 monitored-battery 中链接的简单电池获取信息。如果指定了该驱动程序，将使用电池的 charge-full-design-microamp-hours 属性
allOf:
  - $ref: power-supply.yaml#

properties:
  compatible:
    const: cellwise,cw2015

  reg:
    maxItems: 1

  cellwise,battery-profile:
    description: |
      此属性指定了所用电池的特性。此二进制数据块的格式由 CellWise 保密。唯一获取它的方法是向 CellWise 的测试设施邮寄两块电池，并接收带有二进制数据块的测试报告。
$ref: /schemas/types.yaml#/definitions/uint8-array
    minItems: 64
    maxItems: 64

  cellwise,monitor-interval-ms:
    description:
      指定以毫秒为单位的测量间隔
    minimum: 250

  power-supplies:
    minItems: 1
    maxItems: 8 # 应该足够用了

  monitored-battery:
    description:
      指定与此仪表相连的简单电池的 phandle
    $ref: /schemas/types.yaml#/definitions/phandle

required:
  - compatible
  - reg

additionalProperties: false

examples:
  - |
    i2c {
        #address-cells = <1>;
        #size-cells = <0>;

        cw2015@62 {
            compatible = "cellwise,cw2015";
            reg = <0x62>;
            cellwise,battery-profile = /bits/ 8 <
                0x17 0x67 0x80 0x73 0x6E 0x6C 0x6B 0x63
                0x77 0x51 0x5C 0x58 0x50 0x4C 0x48 0x36
                0x15 0x0C 0x0C 0x19 0x5B 0x7D 0x6F 0x69
                0x69 0x5B 0x0C 0x29 0x20 0x40 0x52 0x59
                0x57 0x56 0x54 0x4F 0x3B 0x1F 0x7F 0x17
                0x06 0x1A 0x30 0x5A 0x85 0x93 0x96 0x2D
                0x48 0x77 0x9C 0xB3 0x80 0x52 0x94 0xCB
                0x2F 0x00 0x64 0xA5 0xB5 0x11 0xF0 0x11
           >;
           cellwise,monitor-interval-ms = <5000>;
           monitored-battery = <&bat>;
           power-supplies = <&mains_charger>, <&usb_charger>;
       };
    };
```

## Documentation/devicetree/bindings/power/supply/dlg,da9150-charger_cn.yaml
```yaml
# SPDX-许可证标识符: GPL-2.0
%YAML 1.2
---
$id: http://devicetree.org/schemas/power/supply/dlg,da9150-charger.yaml#
$schema: http://devicetree.org/meta-schemas/core.yaml#

title: Dialog 半导体 DA9150 充电器电源供应

maintainers:
  - Sebastian Reichel <sre@kernel.org>

allOf:
  - $ref: power-supply.yaml#

properties:
  compatible:
    const: dlg,da9150-charger

  io-channels:
    items:
      - description: 电流的 ADC 通道
      - description: 总线电压的 ADC 通道
      - description: 结温的 ADC 通道
      - description: 电池电压的 ADC 通道

  io-channel-names:
    items:
      - const: CHAN_IBUS
      - const: CHAN_VBUS
      - const: CHAN_TJUNC
      - const: CHAN_VBAT

required:
  - compatible

additionalProperties: false

examples:
  - |
    pmic {
      charger {
        compatible = "dlg,da9150-charger";
        io-channels = <&gpadc 0>,
                      <&gpadc 2>,
                      <&gpadc 8>,
                      <&gpadc 5>;
        io-channel-names = "CHAN_IBUS",
                           "CHAN_VBUS",
                           "CHAN_TJUNC",
                           "CHAN_VBAT";
      };
    };
```

## Documentation/devicetree/bindings/power/supply/dlg,da9150-fuel-gauge_cn.yaml
```yaml
# SPDX-许可证标识符: GPL-2.0
%YAML 1.2
---
$id: http://devicetree.org/schemas/power/supply/dlg,da9150-fuel-gauge.yaml#
$schema: http://devicetree.org/meta-schemas/core.yaml#

title: Dialog 半导体 DA9150 燃料表电源供应

maintainers:
  - Sebastian Reichel <sre@kernel.org>

allOf:
  - $ref: power-supply.yaml#

properties:
  compatible:
    const: dlg,da9150-fuel-gauge

  dlg,update-interval:
    $ref: /schemas/types.yaml#/definitions/uint32
    description: 电池级别检查之间的间隔时间（毫秒）
  dlg,warn-soc-level:
    $ref: /schemas/types.yaml#/definitions/uint8
    minimum: 1
    maximum: 100
    description: 触发警告事件时的电池放电水平（百分比）
  dlg,crit-soc-level:
    $ref: /schemas/types.yaml#/definitions/uint8
    minimum: 1
    maximum: 100
    description: |
      触发关键事件时的电池放电水平（百分比）
      这个值应该低于警告级别的值
required:
  - compatible

additionalProperties: false

examples:
  - |
    pmic {
      battery {
        compatible = "dlg,da9150-fuel-gauge";
        dlg,update-interval = <10000>;
        dlg,warn-soc-level = /bits/ 8 <15>;
        dlg,crit-soc-level = /bits/ 8 <5>;
      };
    };
```

## Documentation/devicetree/bindings/power/supply/gpio-charger_cn.yaml
```yaml
# SPDX-许可证标识符: GPL-2.0
%YAML 1.2
---
$id: http://devicetree.org/schemas/power/supply/gpio-charger.yaml#
$schema: http://devicetree.org/meta-schemas/core.yaml#

标题: 仅通过 GPIO 进行通信的简易电池充电器

维护者:
  - Sebastian Reichel <sre@kernel.org>

描述:
  此绑定适用于所有以或多或少自主方式工作的充电器，它们仅提供一些状态 GPIO，并可能提供一些用于限制充电过程控制的 GPIO。

属性:
  compatible:
    常量: gpio-charger

  charger-type:
    枚举:
      - 未知
      - 电池
      - 不间断电源(UPS)
      - 主电源
      - usb-sdp                   # USB 标准下游端口
      - usb-dcp                   # USB 专用充电端口
      - usb-cdp                   # USB 充电下游端口
      - usb-aca                   # USB 配件充电适配器
    描述:
      充电器类型，例如“主电源”代表墙壁充电器

gpios:
    最大项数: 1
    描述: 表示充电器存在的 GPIO

  charge-status-gpios:
    最大项数: 1
    描述: 表示充电状态的 GPIO

  charge-current-limit-gpios:
    最小项数: 1
    最大项数: 32
    描述: 用于电流限制的 GPIO

  charge-current-limit-mapping:
    描述: 包含电流（单位：微安）和 GPIO 比特图的元组列表（按此顺序）。这些元组必须按照电流限制降序排列。
$ref: /schemas/types.yaml#/definitions/uint32-matrix
    项:
      项:
        - 描述:
            电流限制（单位：微安）
        - 描述:
            编码后的 GPIO 设置。比特 0 代表来自 charge-current-limit-gpios 属性中的最后一个 GPIO。比特 1 代表倒数第二个 GPIO，以此类推

必需:
  - compatible

anyOf:
  - 必需:
      - gpios
  - 必需:
      - charge-status-gpios
  - 必需:
      - charge-current-limit-gpios

依赖关系:
  charge-current-limit-gpios: [ charge-current-limit-mapping ]
  charge-current-limit-mapping: [ charge-current-limit-gpios ]

额外属性: false

示例:
  - |
    #include <dt-bindings/gpio/gpio.h>

    charger {
      compatible = "gpio-charger";
      charger-type = "usb-sdp";

      gpios = <&gpd 28 GPIO_ACTIVE_LOW>;
      charge-status-gpios = <&gpc 27 GPIO_ACTIVE_LOW>;

      charge-current-limit-gpios = <&gpioA 11 GPIO_ACTIVE_HIGH>,
                                   <&gpioA 12 GPIO_ACTIVE_HIGH>;
      charge-current-limit-mapping = <2500000 0x00>, // 2.5 A => 两个 GPIO 低电平
                                     <700000 0x01>, // 700 mA => GPIO A.12 高电平
                                     <0 0x02>; // 0 mA => GPIO A.11 高电平
    };
```

## Documentation/devicetree/bindings/power/supply/ingenic,battery_cn.yaml
~~~~yaml
```yaml
# SPDX-文件许可标识符: (GPL-2.0 或 BSD-2-Clause)
# 版权所有 2019-2020 Artur Rojek
%YAML 1.2
---
$id: http://devicetree.org/schemas/power/supply/ingenic,battery.yaml#
$schema: http://devicetree.org/meta-schemas/core.yaml#

title: Ingenic JZ47xx 电池

maintainers:
  - Artur Rojek <contact@artur-rojek.eu>

$ref: power-supply.yaml#

properties:
  compatible:
    oneOf:
      - const: ingenic,jz4740-battery
      - items:
          - enum:
              - ingenic,jz4725b-battery
              - ingenic,jz4770-battery
          - const: ingenic,jz4740-battery

  io-channels:
    maxItems: 1

  io-channel-names:
    const: battery

  monitored-battery:
    description: >
      此属性必须是指向使用在 battery.yaml 中描述的格式的节点的 phandle，并且需要以下属性：
      - voltage-min-design-microvolt: 电池耗尽时的电压，
      - voltage-max-design-microvolt: 电池充满电时的电压
required:
  - compatible
  - io-channels
  - io-channel-names
  - monitored-battery

additionalProperties: false

examples:
  - |
    #include <dt-bindings/iio/adc/ingenic,adc.h>

    simple_battery: battery {
            compatible = "simple-battery";
            voltage-min-design-microvolt = <3600000>;
            voltage-max-design-microvolt = <4200000>;
    };

    ingenic-battery {
            compatible = "ingenic,jz4740-battery";
            io-channels = <&adc INGENIC_ADC_BATTERY>;
            io-channel-names = "battery";
            monitored-battery = <&simple_battery>;
    };
```

请注意，由于 YAML 是一种通用的数据序列化语言，并不直接支持中文字符作为关键字或者保留字。因此，在这里将英文关键字翻译为中文可能会影响 YAML 文件的解析。上述翻译仅适用于阅读理解，实际配置文件应使用原始的英文版本。
~~~~
