## Documentation/devicetree/bindings/power/supply/isp1704_cn.yaml
```yaml
下面是给定内容的中文翻译：

# SPDX-许可证标识符: GPL-2.0
# 版权 (C) 2021 Sebastian Reichel
%YAML 1.2
---
$id: http://devicetree.org/schemas/power/supply/isp1704.yaml#
$schema: http://devicetree.org/meta-schemas/core.yaml#

标题: NXP ISP1704 USB 充电检测

维护者:
  - Sebastian Reichel <sre@kernel.org>

allOf:
  - $ref: power-supply.yaml#

属性:
  compatible:
    常量: nxp,isp1704

  nxp,enable-gpio:
    最大项目数: 1
    描述: 连接到芯片使能引脚的 GPIO

  usb-phy:
    $ref: /schemas/types.yaml#/definitions/phandle
    描述: ISP1704 连接的 USB PHY

必需:
  - compatible
  - nxp,enable-gpio
  - usb-phy

附加属性: false

示例:
  - |
    #include <dt-bindings/gpio/gpio.h>
    charger-detect {
      compatible = "nxp,isp1704";
      nxp,enable-gpio = <&gpio3 3 GPIO_ACTIVE_LOW>;
      usb-phy = <&usb2_phy>;
    };
```

## Documentation/devicetree/bindings/power/supply/lego,ev3-battery_cn.yaml
```yaml
# SPDX-许可证标识符: GPL-2.0
%YAML 1.2
---
$id: http://devicetree.org/schemas/power/supply/lego,ev3-battery.yaml#
$schema: http://devicetree.org/meta-schemas/core.yaml#

标题: LEGO MINDSTORMS EV3 电池

维护者:
  - David Lechner <david@lechnology.com>
  - Sebastian Reichel <sre@kernel.org>

描述: |
  LEGO MINDSTORMS EV3 具有一些内置的功能来监控电池状态。
  它使用 6 节 AA 电池或一种特殊的锂离子可充电电池包，该电池包通过电池仓内的钥匙开关进行检测。
allOf:
  - $ref: power-supply.yaml#

属性:
  compatible:
    常量: lego,ev3-battery

  io-channels:
    项目:
      - 描述: 用于电池电压的 ADC 通道
      - 描述: 用于电池电流的 ADC 通道

  io-channel-names:
    项目:
      - 常量: voltage
      - 常量: current

  rechargeable-gpios:
    最大项目数: 1
    描述: 可充电电池指示的 GPIO

必需:
  - compatible
  - io-channels
  - io-channel-names
  - rechargeable-gpios

附加属性: false

示例:
  - |
    #include <dt-bindings/gpio/gpio.h>
    battery {
      compatible = "lego,ev3-battery";
      io-channels = <&adc 4>, <&adc 3>;
      io-channel-names = "voltage", "current";
      rechargeable-gpios = <&gpio 136 GPIO_ACTIVE_LOW>;
    };
```

## Documentation/devicetree/bindings/power/supply/lltc,lt3651-charger_cn.yaml
~~~~yaml
```yaml
# SPDX-许可证标识符: GPL-2.0
%YAML 1.2
---
$id: http://devicetree.org/schemas/power/supply/lltc,lt3651-charger.yaml#
$schema: http://devicetree.org/meta-schemas/core.yaml#

title: Analog Devices LT3651 充电器电源供应

maintainers:
  - Sebastian Reichel <sre@kernel.org>

allOf:
  - $ref: power-supply.yaml#

properties:
  compatible:
    enum:
      - lltc,lt3651-charger
      - lltc,ltc3651-charger  # 过时，应使用 lltc,lt3651-charger

  lltc,acpr-gpios:
    maxItems: 1

  lltc,fault-gpios:
    maxItems: 1

  lltc,chrg-gpios:
    maxItems: 1

required:
  - compatible
  - lltc,acpr-gpios

additionalProperties: false

examples:
  - |
    #include <dt-bindings/gpio/gpio.h>
    charger {
      compatible = "lltc,lt3651-charger";
      lltc,acpr-gpios = <&gpio0 68 GPIO_ACTIVE_LOW>;
      lltc,fault-gpios = <&gpio0 64 GPIO_ACTIVE_LOW>;
      lltc,chrg-gpios = <&gpio0 63 GPIO_ACTIVE_LOW>;
    };
```

以上是将原始英文 YAML 文件翻译成中文版本。请注意，某些专有名词和技术术语保持了英文形式以确保准确性和专业性。
~~~~

## Documentation/devicetree/bindings/power/supply/lltc,ltc294x_cn.yaml
~~~~yaml
```yaml
# SPDX-许可证标识符: GPL-2.0
%YAML 1.2
---
$id: http://devicetree.org/schemas/power/supply/lltc,ltc294x.yaml#
$schema: http://devicetree.org/meta-schemas/core.yaml#

title: LTC2941, LTC2942, LTC2943 和 LTC2944 电池电量计

description: |
  所有芯片均测量电池容量。
LTC2942 与 LTC2941 引脚兼容，它增加了电压和温度监测，并可在运行时检测。LTC2943 和 LTC2944 在软件上兼容，使用了略有不同的电荷计数器转换公式，并增加了电压、电流和温度监测功能。
maintainers:
  - Sebastian Reichel <sre@kernel.org>

allOf:
  - $ref: power-supply.yaml#

properties:
  compatible:
    enum:
      - lltc,ltc2941
      - lltc,ltc2942
      - lltc,ltc2943
      - lltc,ltc2944

  reg:
    maxItems: 1

  lltc,resistor-sense:
    $ref: /schemas/types.yaml#/definitions/int32
    description: |
      检测电阻值（毫欧）
当电池被错误地连接到电阻的一端时，可以是负值。
  lltc,prescaler-exponent:
    $ref: /schemas/types.yaml#/definitions/uint32
    description: |
      如数据手册中所述的分频器指数。
这决定了电量计的范围和精度。
仅当该值与当前设置不同时才将其编程到芯片中。
当断开电池连接时，该设置将丢失。
required:
  - compatible
  - reg
  - lltc,resistor-sense
  - lltc,prescaler-exponent

additionalProperties: false

examples:
  - |
    i2c {
      #address-cells = <1>;
      #size-cells = <0>;
      battery@64 {
        compatible = "lltc,ltc2943";
        reg = <0x64>;
        lltc,resistor-sense = <15>;
        lltc,prescaler-exponent = <5>; /* 2^(2*5) = 1024 */
      };
    };
```

这段 YAML 文件定义了一个设备树配置文件，用于描述 LTC2941, LTC2942, LTC2943 和 LTC2944 系列电池电量计的硬件配置。
~~~~

## Documentation/devicetree/bindings/power/supply/ltc4162-l_cn.yaml
~~~~yaml
下面是给定内容的中文翻译：

```
# SPDX-文件许可标识: (GPL-2.0 或 BSD-2-Clause)
# 版权所有 (C) 2020 Topic 嵌入式产品
%YAML 1.2
---
$id: http://devicetree.org/schemas/power/supply/ltc4162-l.yaml#
$schema: http://devicetree.org/meta-schemas/core.yaml#

标题: Linear Technology (Analog Devices) LTC4162-L 充电器

维护者:
  - Mike Looijmans <mike.looijmans@topic.nl>

描述: |
  LTC® 4162-L 是一款先进的单片同步降压型开关电池充电器和 PowerPath™ 管理器，它可以无缝地管理诸如墙壁适配器、背板、太阳能电池板等输入源与可充电锂离子/聚合物电池之间的电源分配。
  关于充电器的详细规格可以在此处找到：
    https://www.analog.com/en/products/ltc4162-s.html

属性:
  compatible:
    枚举:
      - lltc,ltc4162-l

  reg:
    最大项数: 1
    描述: 充电器的 I2C 地址

  lltc,rsnsb-micro-ohms:
    描述: 电池检测电阻（微欧姆）
    最小值: 1000

  lltc,rsnsi-micro-ohms:
    描述: 输入电流检测电阻（微欧姆）
    最小值: 1000

  lltc,cell-count:
    $ref: /schemas/types.yaml#/definitions/uint32
    描述: |
      电池单元的数量。如果没有提供，将在外部电源接入后从芯片中获取。当电池单元数量有所动态变化时，可以省略此项。没有它，某些测量结果在充电器连接到外部电源之前将返回 0。

必需项:
  - compatible
  - reg
  - lltc,rsnsb-micro-ohms
  - lltc,rsnsi-micro-ohms

其他属性: false

示例:
  - |
    i2c {
      #address-cells = <1>;
      #size-cells = <0>;
      charger: battery-charger@68 {
              compatible = "lltc,ltc4162-l";
              reg = <0x68>;
              lltc,rsnsb-micro-ohms = <10000>;
              lltc,rsnsi-micro-ohms = <16000>;
              lltc,cell-count = <2>;
      };
    };
```
~~~~

## Documentation/devicetree/bindings/power/supply/max77650-charger_cn.yaml
```yaml
# SPDX-许可证标识符: GPL-2.0
%YAML 1.2
---
$id: http://devicetree.org/schemas/power/supply/max77650-charger.yaml#
$schema: http://devicetree.org/meta-schemas/core.yaml#

title: 来自Maxim Integrated的MAX77650电源管理集成电路电池充电器驱动程序
maintainers:
  - Bartosz Golaszewski <bgolaszewski@baylibre.com>

description: |
  该模块是MAX77650 MFD设备的一部分。更多细节请参阅
  文档/devicetree/bindings/mfd/max77650.yaml
充电器在设备树中作为PMIC节点的子节点表示。
properties:
  compatible:
    const: maxim,max77650-charger

  input-voltage-min-microvolt:
    description:
      最小CHGIN调节电压
enum: [ 4000000, 4100000, 4200000, 4300000,
            4400000, 4500000, 4600000, 4700000 ]

  input-current-limit-microamp:
    description:
      CHGIN输入电流限制（微安）
enum: [ 95000, 190000, 285000, 380000, 475000 ]

required:
  - compatible
additionalProperties: false

..
```

## Documentation/devicetree/bindings/power/supply/maxim,ds2760_cn.yaml
~~~~yaml
```yaml
# SPDX-许可证标识符: GPL-2.0
%YAML 1.2
---
$id: http://devicetree.org/schemas/power/supply/maxim,ds2760.yaml#
$schema: http://devicetree.org/meta-schemas/core.yaml#

title: Maxim DS2760

maintainers:
  - Sebastian Reichel <sre@kernel.org>

description: |
  DS2760 是一个 1 线 (w1) 奴隶设备，因此必须在设备树 (DT) 中的 1 线总线主节点下有一个子节点。
allOf:
  - $ref: power-supply.yaml#

properties:
  compatible:
    const: maxim,ds2760

  maxim,pmod-enabled:
    description: |
      允许 DS2760 在 DQ 线低于阈值超过 2 秒后进入睡眠模式，并在 DQ 线变高时退出睡眠模式。
    type: boolean

  maxim,cache-time-ms:
    description: |
      缓存数据的时间（以毫秒为单位）。
      当这个时间到期时，将再次从硬件读取值。默认值为 1000 毫秒。
  rated-capacity-microamp-hours:
    description: |
      电池的额定容量（以毫安小时为单位）。
      如果未指定，则使用非易失性芯片内存中存储的值。
required:
  - compatible

unevaluatedProperties: false
```

请注意，上述 YAML 文件中的 `rated-capacity-microamp-hours` 属性并未出现在原始文件中，这可能是由于原始文件的缺失或错误。如果这是必需的属性，请确保将其添加到 `required` 数组中。如果它不是必需的，则可以将其从文件中删除或者保持不变。
~~~~

## Documentation/devicetree/bindings/power/supply/maxim,max14577_cn.yaml
~~~~yaml
```yaml
# SPDX-许可证标识符: GPL-2.0-only 或 BSD-2-Clause
%YAML 1.2
---
$id: http://devicetree.org/schemas/power/supply/maxim,max14577.yaml#
$schema: http://devicetree.org/meta-schemas/core.yaml#

title: Maxim MAX14577/MAX77836 微型USB 和 配套电源管理集成电路充电器

maintainers:
  - Krzysztof Kozlowski <krzk@kernel.org>

description: |
  这是针对Maxim MAX14577/MAX77836 微型USB
  集成电路 (MUIC) 的设备树绑定的一部分。
更多详细信息和示例，请参见文档/devicetree/bindings/mfd/maxim,max14577.yaml
properties:
  compatible:
    enum:
      - maxim,max14577-charger
      - maxim,max77836-charger

  maxim,constant-uvolt:
    description:
      电池恒定电压值（微伏）
    $ref: /schemas/types.yaml#/definitions/uint32
    minimum: 4000000
    maximum: 4350000

  maxim,eoc-uamp:
    description: |
      充电结束模式时的电流（微安）
      MAX14577: 50000-200000
      MAX77836: 5000-100000
    $ref: /schemas/types.yaml#/definitions/uint32

  maxim,fast-charge-uamp:
    description: |
      快速充电模式下的电流（微安）
      MAX14577: 90000-950000
      MAX77836: 45000-475000
    $ref: /schemas/types.yaml#/definitions/uint32

  maxim,ovp-uvolt:
    description:
      过压保护阈值（微伏）；在过压条件下，中断被触发并停止充电
    $ref: /schemas/types.yaml#/definitions/uint32
    enum: [6000000, 6500000, 7000000, 7500000]

required:
  - compatible
  - maxim,constant-uvolt
  - maxim,eoc-uamp
  - maxim,fast-charge-uamp
  - maxim,ovp-uvolt

allOf:
  - if:
      properties:
        compatible:
          contains:
            const: maxim,max14577-charger
    then:
      properties:
        maxim,eoc-uamp:
          minimum: 50000
          maximum: 200000
        maxim,fast-charge-uamp:
          minimum: 90000
          maximum: 950000
    else:
      # max77836
      properties:
        maxim,eoc-uamp:
          minimum: 5000
          maximum: 100000
        maxim,fast-charge-uamp:
          minimum: 45000
          maximum: 475000

additionalProperties: false
```
请注意，此翻译保持了原文档中的 YAML 结构，并尽可能地保留了原文的意思。
~~~~

## Documentation/devicetree/bindings/power/supply/maxim,max14656_cn.yaml
~~~~yaml
下面是给定内容的中文翻译：

```yaml
# SPDX-文件许可人: GPL-2.0
%YAML 1.2
---
$id: http://devicetree.org/schemas/power/supply/maxim,max14656.yaml#
$schema: http://devicetree.org/meta-schemas/core.yaml#

title: Maxim MAX14656

maintainers:
  - Sebastian Reichel <sre@kernel.org>

allOf:
  - $ref: power-supply.yaml#

properties:
  compatible:
    const: maxim,max14656

  reg:
    maxItems: 1

  interrupts:
    maxItems: 1

required:
  - compatible
  - reg
  - interrupts

additionalProperties: false

examples:
  - |
    #include <dt-bindings/interrupt-controller/irq.h>
    i2c {
      #address-cells = <1>;
      #size-cells = <0>;

      charger-detector@35 {
        compatible = "maxim,max14656";
        reg = <0x35>;
        interrupt-parent = <&gpio6>;
        interrupts = <26 IRQ_TYPE_LEVEL_HIGH>;
      };
    };
```

注释：
- `SPDX-文件许可人`: 指定此文档遵循的许可证。
- `%YAML`: 定义了 YAML 的版本。
- `$id`: 指定了设备树模式文件的唯一标识符。
- `$schema`: 指向定义 YAML 文件结构的模式文件。
- `title`: 设备名称。
- `maintainers`: 维护者的联系信息。
- `allOf`: 引用其他模式文件，以继承其属性。
- `properties`: 定义设备树节点的属性。
- `compatible`: 必须与指定字符串相匹配。
- `reg`: 表示 I²C 地址的属性，最多只能有一个条目。
- `interrupts`: 表示中断的属性，最多只能有一个条目。
- `required`: 列出必需的属性。
- `additionalProperties`: 是否允许额外的未定义属性。
- `examples`: 示例配置。

在示例中：
- `i2c` 节点表示一个 I²C 总线实例。
- `charger-detector@35` 是 MAX14656 充电器检测器的节点实例。
- `compatible` 属性指定了兼容性字符串。
- `reg` 属性指定了 I²C 地址。
- `interrupt-parent` 和 `interrupts` 属性指定了中断配置。
~~~~

## Documentation/devicetree/bindings/power/supply/maxim,max17040_cn.yaml
```yaml
# SPDX-许可证标识符: GPL-2.0
%YAML 1.2
---
$id: http://devicetree.org/schemas/power/supply/maxim,max17040.yaml#
$schema: http://devicetree.org/meta-schemas/core.yaml#

title: Maxim 17040 燃料表系列

maintainers:
  - Sebastian Reichel <sre@kernel.org>

allOf:
  - $ref: power-supply.yaml#

properties:
  compatible:
    enum:
      - maxim,max17040
      - maxim,max17041
      - maxim,max17043
      - maxim,max17044
      - maxim,max17048
      - maxim,max17049
      - maxim,max17058
      - maxim,max17059
      - maxim,max77836-battery

  reg:
    maxItems: 1

  maxim,alert-low-soc-level:
    $ref: /schemas/types.yaml#/definitions/uint32
    minimum: 1
    maximum: 32
    description: |
      设置产生中断的荷电状态（%）阈值。如果省略，则使用上电默认值 4（%）。
maxim,double-soc:
    类型: 布尔
    description: |
      某些设备返回的容量是实际的两倍。
      指定此属性以将报告的值除以 2，从而使其标准化。
      SoC == 荷电状态 == 容量
maxim,rcomp:
    $ref: /schemas/types.yaml#/definitions/uint8-array
    minItems: 1
    maxItems: 2
    description: |
      用于补偿不同电池化学成分和工作温度下的读数的值。
      max17040,41 的 rcomp 为两个字节，默认值为 0x97 0x00。
      所有其他设备的 rcomp 为一个字节，默认值为 0x97。
interrupts:
    maxItems: 1

  io-channels:
    items:
      - description: 电池温度

  io-channel-names:
    items:
      - const: temp

  wakeup-source:
    类型: 布尔
    description: |
      使用此属性将低荷电状态报警中断作为唤醒源。
required:
  - compatible
  - reg

unevaluatedProperties: false

examples:
  - |
    i2c {
      #address-cells = <1>;
      #size-cells = <0>;

      battery@36 {
        compatible = "maxim,max17048";
        reg = <0x36>;
        maxim,rcomp = /bits/ 8 <0x56>;
        maxim,alert-low-soc-level = <10>;
        maxim,double-soc;
      };
    };
  - |
    #include <dt-bindings/interrupt-controller/irq.h>
    i2c {
      #address-cells = <1>;
      #size-cells = <0>;

      battery@36 {
        compatible = "maxim,max77836-battery";
        reg = <0x36>;
        maxim,alert-low-soc-level = <10>;
        interrupt-parent = <&gpio7>;
        interrupts = <2 IRQ_TYPE_LEVEL_LOW>;
        wakeup-source;
      };
    };
  - |
    #include <dt-bindings/interrupt-controller/irq.h>
    i2c {
      #address-cells = <1>;
      #size-cells = <0>;

      fuel-gauge@36 {
        compatible = "maxim,max17043";
        reg = <0x36>;

        interrupt-parent = <&gpio>;
        interrupts = <144 IRQ_TYPE_EDGE_FALLING>;

        monitored-battery = <&battery>;
        power-supplies = <&charger>;

        io-channels = <&adc 8>;
        io-channel-names = "temp";

        maxim,alert-low-soc-level = <10>;
        wakeup-source;
      };
    };
```

## Documentation/devicetree/bindings/power/supply/maxim,max17042_cn.yaml
```yaml
# SPDX-许可证标识符: GPL-2.0
%YAML 1.2
---
$id: http://devicetree.org/schemas/power/supply/maxim,max17042.yaml#
$schema: http://devicetree.org/meta-schemas/core.yaml#

标题: Maxim 17042 燃料表系列

维护者:
  - Sebastian Reichel <sre@kernel.org>

allOf:
  - $ref: power-supply.yaml#

属性:
  compatible:
    枚举:
      - maxim,max17042
      - maxim,max17047
      - maxim,max17050
      - maxim,max17055
      - maxim,max77849-battery

  reg:
    最大项数: 1

  interrupts:
    最大项数: 1
    描述: |
      ALRT 引脚，一个开漏中断
maxim,rsns-microohm:
    $ref: /schemas/types.yaml#/definitions/uint32
    描述: |
      rsns 电阻器的电阻值（以微欧为单位）（数据手册推荐值为 10000）
定义此属性可启用电流感应功能
maxim,cold-temp:
    $ref: /schemas/types.yaml#/definitions/uint32
    描述: |
      报告电池温度过低的温度阈值（以十分之一摄氏度为单位）
默认情况下不报告低温事件
maxim,over-heat-temp:
    $ref: /schemas/types.yaml#/definitions/uint32
    描述: |
      报告电池过热的温度阈值（以十分之一摄氏度为单位）
默认情况下不报告过热事件
maxim,dead-volt:
    $ref: /schemas/types.yaml#/definitions/uint32
    描述: |
      报告电池失效的电压阈值（以毫伏为单位）
默认情况下不报告电池失效事件
maxim,over-volt:
    $ref: /schemas/types.yaml#/definitions/uint32
    描述: |
      报告电池过压的电压阈值（以毫伏为单位）
默认情况下不报告过压事件。
电源供应器：真

必需的：
  - 兼容性
  - 注册地址（`reg`）

额外属性：不允许

示例：
  - |
    i2c {
      #address-cells = <1>;
      #size-cells = <0>;

      battery@36 {  # 在I2C总线上地址为0x36的设备
        compatible = "maxim,max17042";  # 设备兼容性字符串
        reg = <0x36>;  # 设备注册地址
        maxim,rsns-microohm = <10000>;  # MAXIM IC的RSENSE电阻值（微欧）
        maxim,over-heat-temp = <600>;   # 过热温度阈值（10°C = 100，因此这里表示60°C）
        maxim,over-volt = <4300>;       # 过压电压阈值（毫伏，即4.3V）
      };
    };
```
