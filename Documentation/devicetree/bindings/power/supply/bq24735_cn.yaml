## Documentation/devicetree/bindings/power/supply/bq24735_cn.yaml
~~~~yaml
# SPDX-许可证标识符: GPL-2.0
# 版权所有 (C) 2021 Sebastian Reichel
%YAML 1.2
---
$id: http://devicetree.org/schemas/power/supply/bq24735.yaml#
$schema: http://devicetree.org/meta-schemas/core.yaml#

标题: TI BQ24735 锂离子电池充电器

维护者:
  - Sebastian Reichel <sre@kernel.org>

allOf:
  - $ref: power-supply.yaml#

属性:
  compatible:
    常量: ti,bq24735

  reg:
    最大项数: 1

  interrupts:
    描述: 交流适配器插拔事件中断
    最大项数: 1

  ti,ac-detect-gpios:
    最大项数: 1
    描述: |
      此 GPIO 可选地用于读取交流适配器的状态。这是一个主机 GPIO，配置为输入并连接到 bq24735 上的 ACOK 引脚。
注意：出于向后兼容性的原因，尽管 ACOK 在交流适配器插入时为激活（高）状态，但 GPIO 必须在交流适配器未插入时处于激活状态。
  ti,charge-current:
    $ref: /schemas/types.yaml#/definitions/uint32
    描述: |
      用于控制和设置充电电流
此值必须介于 128mA 和 8.128A 之间，步长分辨率为 64mA
上电复位 (POR) 值是 0x0000h。这个数字以毫安 (mA) 表示（例如，8192）
有关 ChargeCurrent (0x14h) 寄存器的更多信息，请参阅规格书。
  ti,charge-voltage:
    $ref: /schemas/types.yaml#/definitions/uint32
    描述: |
      用于控制和设置充电电压
此值必须介于 1.024V 和 19.2V 之间，步长分辨率为 16mV
上电复位 (POR) 值是 0x0000h。这个数字以毫伏 (mV) 表示（例如，19200）
有关 ChargeVoltage (0x15h) 寄存器的更多信息，请参阅规格书。
Here's the translation into Chinese:

```yaml
ti,input-current:
    $ref: /schemas/types.yaml#/definitions/uint32
    description: |
      用于控制和设置充电器的输入电流。
      此值必须在 128mA 和 8.064A 之间，步长分辨率为 128mA。
      上电复位（POR）值为 0x1000h。此数字以毫安（例如 8064）表示。
      有关 InputCurrent (0x3fh) 寄存器的更多信息，请参阅规格文档。
ti,external-control:
    type: 布尔值
    description: |
      指示充电器是否由外部配置，并且主机不应尝试启用/禁用充电或设置充电电压/电流。
poll-interval:
    $ref: /schemas/types.yaml#/definitions/uint32
    description: |
      如果未指定 'interrupts'，则使用此间隔（毫秒）轮询 AC 适配器的存在状态。
required:
  - compatible
  - reg

additionalProperties: false

examples:
  - |
    #include <dt-bindings/gpio/gpio.h>

    i2c {
      #address-cells = <1>;
      #size-cells = <0>;

      charger@9 {
        compatible = "ti,bq24735";
        reg = <0x9>;
        ti,ac-detect-gpios = <&gpio 72 0x1>;
      };
    };
```

说明：
- `ti,input-current`: 控制并设置充电器的输入电流。此值必须在 128mA 到 8.064A 之间，步长分辨率为 128mA。上电复位（POR）值为 0x1000h，这个数字以毫安表示（比如 8064）。更多关于 InputCurrent (0x3fh) 寄存器的信息，请参见规格文档。
- `ti,external-control`: 类型为布尔值。指示充电器是否由外部配置，以及主机不应尝试启用/禁用充电或设置充电电压/电流。
- `poll-interval`: 如果未指定 'interrupts'，则使用此间隔（毫秒）来轮询 AC 适配器的存在状态。
- `required` 和 `additionalProperties`: 分别指定了必需的属性和不允许有额外属性。
- 示例部分展示了如何在设备树中配置一个使用 TI bq24735 充电器的例子，包括地址、兼容性声明等。
~~~~

## Documentation/devicetree/bindings/power/supply/bq2515x_cn.yaml
~~~~yaml
下面是给定内容的中文翻译：

```yaml
# SPDX-文件许可标识: (GPL-2.0 或 BSD-2-Clause)
# 版权 (C) 2020 德州仪器公司
%YAML 1.2
---
$id: http://devicetree.org/schemas/power/supply/bq2515x.yaml#
$schema: http://devicetree.org/meta-schemas/core.yaml#

标题: 德州仪器 bq2515x 500mA 线性充电器系列

维护者:
  - 安德鲁·戴维斯 <afd@ti.com>

描述: |
  BQ2515x 系列是一款高度集成的电池充电管理 IC，集成了可穿戴设备中最常用的功能，包括充电器、输出电压轨、用于电池和系统监控的 ADC（模数转换器）以及推按钮控制器。
  关于充电器的详细规格可以参考：
    http://www.ti.com/lit/ds/symlink/bq25150.pdf
    http://www.ti.com/lit/ds/symlink/bq25155.pdf

属性:
  compatible:
    枚举:
      - ti,bq25150
      - ti,bq25155

  reg:
    最大项数: 1
    描述: 充电器的 I2C 地址
ac-detect-gpios:
    描述: |
       用于连接 bq2515x 设备 PG (AC 检测) 引脚的 GPIO
最大项数: 1

  reset-gpios:
    描述: 用于硬件复位的 GPIO
最大项数: 1

  powerdown-gpios:
    描述: 用于 IC 低功耗模式的 GPIO
最大项数: 1

  charge-enable-gpios:
    描述: 用于开启和关闭充电的 GPIO
最大项数: 1

  input-current-limit-microamp:
    描述: 最大输入电流（微安）
最小值: 50000
    最大值: 500000

  monitored-battery:
    $ref: /schemas/types.yaml#/definitions/phandle
    描述: 被监控的电池节点的 phandle

必需:
  - compatible
  - reg
  - monitored-battery

额外属性: false

示例:
  - |
    bat: 电池 {
      compatible = "simple-battery";
      constant-charge-current-max-microamp = <50000>;
      precharge-current-microamp = <2500>;
      constant-charge-voltage-max-microvolt = <4000000>;
    };
    #include <dt-bindings/gpio/gpio.h>
    i2c {
      #address-cells = <1>;
      #size-cells = <0>;

      bq25150: charger@6b {
        compatible = "ti,bq25150";
        reg = <0x6b>;
        monitored-battery = <&bat>;
        input-current-limit-microamp = <100000>;

        ac-detect-gpios = <&gpio1 28 GPIO_ACTIVE_HIGH>;
        reset-gpios = <&gpio0 14 GPIO_ACTIVE_HIGH>;
        powerdown-gpios = <&gpio0 15 GPIO_ACTIVE_HIGH>;
        charge-enable-gpios = <&gpio0 13 GPIO_ACTIVE_LOW>;
      };
    };
```
```
~~~~

## Documentation/devicetree/bindings/power/supply/bq256xx_cn.yaml
```yaml
以下是提供的 YAML 文档的中文翻译：

# SPDX-许可证标识符: (GPL-2.0-only 或 BSD-2-Clause)
# 版权所有 (C) 2020 德州仪器公司
%YAML 1.2
---
$id: http://devicetree.org/schemas/power/supply/bq256xx.yaml#
$schema: http://devicetree.org/meta-schemas/core.yaml#

标题: 德州仪器 bq256xx 开关模式降压充电器

维护者:
  - Andrew Davis <afd@ti.com>

描述: |
  bq256xx 系列器件是一组高度集成的电池充电管理和系统电源管理集成电路，适用于单节锂离子和锂聚合物电池。
数据手册:
    - https://www.ti.com/lit/ds/symlink/bq25600.pdf
    - https://www.ti.com/lit/ds/symlink/bq25601.pdf
    - https://www.ti.com/lit/ds/symlink/bq25600d.pdf
    - https://www.ti.com/lit/ds/symlink/bq25601d.pdf
    - https://www.ti.com/lit/ds/symlink/bq25611d.pdf
    - https://www.ti.com/lit/ds/symlink/bq25618.pdf
    - https://www.ti.com/lit/ds/symlink/bq25619.pdf

属性:
  compatible:
    枚举:
      - ti,bq25600
      - ti,bq25601
      - ti,bq25600d
      - ti,bq25601d
      - ti,bq25611d
      - ti,bq25618
      - ti,bq25619

  reg:
    最大项数: 1

  ti,watchdog-timeout-ms:
    默认值: 0
    描述: |
      以毫秒为单位的看门狗定时器。0（默认）禁用看门狗
    最小值: 0
    最大值: 160000
    枚举: [ 0, 40000, 80000, 160000]

  input-voltage-limit-microvolt:
    描述: |
       最小输入电压限制（以微伏为单位），步长为 100000 微伏
    最小值: 3900000
    最大值: 5400000

  input-current-limit-microamp:
    描述: |
       最大输入电流限制（以微安为单位），步长为 100000 微安
    最小值: 100000
    最大值: 3200000

  monitored-battery:
    $ref: /schemas/types.yaml#/definitions/phandle
    描述: 被监控电池节点的 phandle

  interrupts:
    最大项数: 1
    描述: |
      中断向主机发送一个低电平、256 微秒脉冲以报告充电设备状态和故障
ti,no-thermistor:
    类型: 布尔值
    描述: 表示未连接热敏电阻到 TS 引脚

必需:
  - compatible
  - reg
  - monitored-battery

allOf:
  - 如果:
      属性:
        compatible:
          包含:
            枚举:
              - ti,bq25600
              - ti,bq25601
              - ti,bq25600d
              - ti,bq25601d
    那么:
      属性:
        ti,no-thermistor: false

additionalProperties: false

示例:
  - |
    bat: 电池 {
      compatible = "simple-battery";
      constant-charge-current-max-microamp = <2040000>;
      constant-charge-voltage-max-microvolt = <4352000>;
      precharge-current-microamp = <180000>;
      charge-term-current-microamp = <180000>;
    };
    #include <dt-bindings/gpio/gpio.h>
    #include <dt-bindings/interrupt-controller/irq.h>
    i2c {

      clock-frequency = <400000>;

      #address-cells = <1>;
      #size-cells = <0>;

      charger@6b {
        compatible = "ti,bq25601";
        reg = <0x6b>;
        monitored-battery = <&bat>;

        interrupt-parent = <&gpio1>;
        interrupts = <16 IRQ_TYPE_EDGE_FALLING>;
        ti,watchdog-timeout-ms = <40000>;

        input-voltage-limit-microvolt = <4500000>;
        input-current-limit-microamp = <2400000>;
       };
    };
```

## Documentation/devicetree/bindings/power/supply/bq25890_cn.yaml
```yaml
# SPDX-许可证标识符: GPL-2.0
# 版权 (C) 2021 Sebastian Reichel
%YAML 1.2
---
$id: http://devicetree.org/schemas/power/supply/bq25890.yaml#
$schema: http://devicetree.org/meta-schemas/core.yaml#

title: Bq25890、bq25892、bq25895 和 bq25896 锂离子充电器

maintainers:
  - Sebastian Reichel <sre@kernel.org>

allOf:
  - $ref: power-supply.yaml#

properties:
  compatible:
    oneOf:
      - enum:
          - ti,bq25890
      - items:
          - enum:
              - ti,bq25892
              - ti,bq25895
              - ti,bq25896
          - const: ti,bq25890

  reg:
    maxItems: 1

  interrupts:
    maxItems: 1

  ti,battery-regulation-voltage:
    $ref: /schemas/types.yaml#/definitions/uint32
    description: 最大充电电压（以微伏为单位）

  ti,charge-current:
    $ref: /schemas/types.yaml#/definitions/uint32
    description: 最大充电电流（以微安为单位）

  ti,termination-current:
    $ref: /schemas/types.yaml#/definitions/uint32
    description: |
      当恒压阶段的电流降至此值以下时，充电将终止（以微安为单位）

  ti,precharge-current:
    $ref: /schemas/types.yaml#/definitions/uint32
    description: 预充阶段的最大充电电流（以微安为单位）

  ti,minimum-sys-voltage:
    $ref: /schemas/types.yaml#/definitions/uint32
    description: |
      当电池正在充电且低于最小系统电压时，
      系统将被调节至高于最小-sys-voltage 设置（以微伏为单位）

  ti,boost-voltage:
    $ref: /schemas/types.yaml#/definitions/uint32
    description: 提升模式下的 VBUS 电压水平（以微伏为单位）

  ti,boost-max-current:
    $ref: /schemas/types.yaml#/definitions/uint32
    description: 提升模式下允许的最大电流（以微安为单位）

  ti,boost-low-freq:
    description: 提升模式频率将为 500kHz，否则为 1.5MHz
    type: 布尔值

  ti,use-ilim-pin:
    description: |
      将使用 ILIM 电阻器，并且输入电流将是电阻器设置和 IINLIM 寄存器设置中较低的一个
    type: 布尔值

  ti,thermal-regulation-threshold:
    $ref: /schemas/types.yaml#/definitions/uint32
    description: |
      充电电流降低以避免过热的温度阈值（以摄氏度为单位）。
      如果省略，则使用默认设置（120 度）

  ti,ibatcomp-micro-ohms:
    description: 与电池串联的电阻器的值（以微欧姆为单位）

  ti,ibatcomp-clamp-microvolt:
    description: 由于预期在串联电阻器上的电压降而产生的最大充电电压调整

required:
  - compatible
  - reg
  - interrupts
  - ti,battery-regulation-voltage
  - ti,charge-current
  - ti,termination-current
  - ti,precharge-current
  - ti,minimum-sys-voltage
  - ti,boost-voltage
  - ti,boost-max-current

unevaluatedProperties: false

examples:
  - |
    #include <dt-bindings/interrupt-controller/irq.h>
    i2c {
      #address-cells = <1>;
      #size-cells = <0>;

      charger@6a {
        compatible = "ti,bq25890";
        reg = <0x6a>;

        interrupt-parent = <&gpio1>;
        interrupts = <16 IRQ_TYPE_EDGE_FALLING>;

        ti,battery-regulation-voltage = <4200000>;
        ti,charge-current = <1000000>;
        ti,termination-current = <50000>;
        ti,precharge-current = <128000>;
        ti,minimum-sys-voltage = <3600000>;
        ti,boost-voltage = <5000000>;
        ti,boost-max-current = <1000000>;

        ti,use-ilim-pin;
        ti,thermal-regulation-threshold = <120>;
      };
    };
```

## Documentation/devicetree/bindings/power/supply/bq25980_cn.yaml
```yaml
下面是给定内容的中文翻译：

# SPDX-文件许可人: (GPL-2.0-only 或 BSD-2-Clause)
# 版权 (C) 2020 德州仪器公司
%YAML 1.2
---
$id: http://devicetree.org/schemas/power/supply/bq25980.yaml#
$schema: http://devicetree.org/meta-schemas/core.yaml#

标题: 德州仪器 BQ25980 快速充电器

维护者:
  - Andrew Davis <afd@ti.com>

描述: |
  BQ25980、BQ25975 和 BQ25960 是一系列用于高功率密度便携式电子设备的快速充电器。这些无电感的开关充电器通过使用开关电容架构可以提供超过97%的效率。
allOf:
  - $ref: power-supply.yaml#

属性:
  compatible:
    枚举:
      - ti,bq25980
      - ti,bq25975
      - ti,bq25960

  reg:
    最大项数: 1

  ti,watchdog-timeout-ms:
    描述: |
      以毫秒为单位的看门狗定时器。0表示禁用看门狗
    默认值: 0
    最小值: 0
    最大值: 300000
    枚举: [ 0, 5000, 10000, 50000, 300000]

  ti,sc-ovp-limit-microvolt:
    描述: |
      当充电器处于开关电容模式时，输入电压的最小限制（微伏）。步长为100000微伏
    默认值: 17800000
    最小值: 14000000
    最大值: 22000000

  ti,sc-ocp-limit-microamp:
    描述: |
      当充电器处于开关电容模式时，输入电流的最大限制（微安）。步长为100000微安
    最小值: 100000
    最大值: 3300000

  ti,bypass-ovp-limit-microvolt:
    描述: |
      当充电器处于旁路模式时，输入电压的最小限制（微伏）。步长为50000微伏
    最小值: 7000000
    最大值: 12750000

  ti,bypass-ocp-limit-microamp:
    描述: |
      当充电器处于旁路模式时，输入电流的最大限制（微安）。步长为100000微安
    最小值: 100000
    最大值: 3300000

  ti,bypass-enable:
    类型: 布尔值
    描述: 启用启动时的旁路模式

  interrupts:
    最大项数: 1
    描述: |
      表示设备状态发生变化
被监控电池:
    $ref: /schemas/types.yaml#/definitions/phandle
    描述: 被监控电池节点的phandle

必需:
  - compatible
  - reg
  - 被监控电池

未评估属性: false

示例:
  - |
    bat: 电池 {
      compatible = "simple-battery";
      constant-charge-current-max-microamp = <4000000>;
      constant-charge-voltage-max-microvolt = <8400000>;
      precharge-current-microamp = <160000>;
      charge-term-current-microamp = <160000>;
    };
    #include <dt-bindings/gpio/gpio.h>
    #include <dt-bindings/interrupt-controller/irq.h>
    i2c {
      #address-cells = <1>;
      #size-cells = <0>;

      bq25980: charger@65 {
          compatible = "ti,bq25980";
          reg = <0x65>;
          interrupt-parent = <&gpio1>;
          interrupts = <16 IRQ_TYPE_EDGE_FALLING>;
          ti,watchdog-timeout-ms = <0>;
          ti,sc-ocp-limit-microamp = <2000000>;
          ti,sc-ovp-limit-microvolt = <17800000>;
          被监控电池 = <&bat>;
      };
    };
```

## Documentation/devicetree/bindings/power/supply/bq27xxx_cn.yaml
~~~~yaml
```yaml
# SPDX-许可证标识符: GPL-2.0
# 版权 (C) 2020 德州仪器公司
%YAML 1.2
---
$id: 'http://devicetree.org/schemas/power/supply/bq27xxx.yaml#'
$schema: 'http://devicetree.org/meta-schemas/core.yaml#'

title: 德州仪器 BQ27XXX 燃料计系列

maintainers:
  - Pali Rohár <pali@kernel.org>
  - Andrew F. Davis <afd@ti.com>
  - Sebastian Reichel <sre@kernel.org>

description: |
  支持各种德州仪器燃料计设备，这些设备具有相似的寄存器映射和电源供应特性。

allOf:
  - $ref: 'power-supply.yaml#'

properties:
  compatible:
    enum:
      - ti,bq27200
      - ti,bq27210
      - ti,bq27500 # 过时，请使用下面特定于版本的属性
      - ti,bq27510 # 过时，请使用下面特定于版本的属性
      - ti,bq27520 # 过时，请使用下面特定于版本的属性
      - ti,bq27500-1
      - ti,bq27510g1
      - ti,bq27510g2
      - ti,bq27510g3
      - ti,bq27520g1
      - ti,bq27520g2
      - ti,bq27520g3
      - ti,bq27520g4
      - ti,bq27521
      - ti,bq27530
      - ti,bq27531
      - ti,bq27541
      - ti,bq27542
      - ti,bq27546
      - ti,bq27742
      - ti,bq27545
      - ti,bq27411
      - ti,bq27421
      - ti,bq27425
      - ti,bq27426
      - ti,bq27441
      - ti,bq27621
      - ti,bq27z561
      - ti,bq28z610
      - ti,bq34z100
      - ti,bq78z100

  reg:
    maxItems: 1
    description: 整数，燃料计的 I2C 地址。
monitored-battery:
    description: |
       燃料计使用以下电池属性：
       - energy-full-design-microwatt-hours
       - charge-full-design-microamp-hours
       - voltage-min-design-microvolt
       必须同时设置或不设置 *-full-design-*-hours 属性
power-supplies: true

required:
  - compatible
  - reg
additionalProperties: false

examples:
  - |
    bat: battery {
      compatible = "simple-battery";
      voltage-min-design-microvolt = <3200000>;
      energy-full-design-microwatt-hours = <5290000>;
      charge-full-design-microamp-hours = <1430000>;
    };

    i2c {
      #address-cells = <1>;
      #size-cells = <0>;

      bq27510g3: fuel-gauge@55 {
        compatible = "ti,bq27510g3";
        reg = <0x55>;
        monitored-battery = <&bat>;
      };
    };
```
以上是将提供的 YAML 文件翻译成中文版本。请注意，某些术语和技术描述可能有多种中文表达方式，这里尽量采用了最合适的翻译。
~~~~
