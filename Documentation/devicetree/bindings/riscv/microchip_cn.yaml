## Documentation/devicetree/bindings/rng/mtk-rng_cn.yaml
~~~~yaml
```yaml
# SPDX-许可证标识符: (GPL-2.0 或 BSD-2-Clause)
%YAML 1.2
---
$id: http://devicetree.org/schemas/rng/mtk-rng.yaml#
$schema: http://devicetree.org/meta-schemas/core.yaml#

title: MediaTek 随机数生成器

maintainers:
  - Sean Wang <sean.wang@mediatek.com>

properties:
  $nodename:
    pattern: "^rng@[0-9a-f]+$"

  compatible:
    oneOf:
      - enum:
          - mediatek,mt7623-rng
      - items:
          - enum:
              - mediatek,mt7622-rng
              - mediatek,mt7629-rng
              - mediatek,mt7986-rng
              - mediatek,mt8365-rng
              - mediatek,mt8516-rng
          - const: mediatek,mt7623-rng

  reg:
    maxItems: 1

  clocks:
    maxItems: 1

  clock-names:
    items:
      - const: rng

required:
  - compatible
  - reg
  - clocks
  - clock-names

additionalProperties: false

examples:
  - |
    #include <dt-bindings/clock/mt2701-clk.h>
    rng: rng@1020f000 {
            compatible = "mediatek,mt7623-rng";
            reg = <0x1020f000 0x1000>;
            clocks = <&infracfg CLK_INFRA_TRNG>;
            clock-names = "rng";
    };
```

这段 YAML 文件描述了 Device Tree 中关于 MediaTek 随机数生成器的配置信息。它定义了如何在设备树中表示 MediaTek 的随机数生成器，包括必要的属性、兼容性声明和示例。
~~~~

## Documentation/devicetree/bindings/rng/nuvoton,npcm-rng_cn.yaml
~~~~yaml
```yaml
# SPDX-许可证标识符: GPL-2.0-only 或 BSD-2-Clause
%YAML 1.2
---
$id: http://devicetree.org/schemas/rng/nuvoton,npcm-rng.yaml#
$schema: http://devicetree.org/meta-schemas/core.yaml#

title: Nuvoton NPCM SoC 随机数生成器

maintainers:
  - Avi Fishman <avifishman70@gmail.com>
  - Tomer Maimon <tmaimon77@gmail.com>
  - Tali Perry <tali.perry1@gmail.com>
  - Patrick Venture <venture@google.com>
  - Nancy Yuen <yuenn@google.com>
  - Benjamin Fair <benjaminfair@google.com>

properties:
  compatible:
    enum:
      - nuvoton,npcm750-rng
      - nuvoton,npcm845-rng

  reg:
    maxItems: 1

required:
  - compatible
  - reg

additionalProperties: false

examples:
  - |
    rng@f000b000 {
        compatible = "nuvoton,npcm750-rng";
        reg = <0xf000b000 0x8>;
    };
```

说明：这段 YAML 文件定义了一个设备树规范，用于描述 Nuvoton NPCM 系列系统芯片中的随机数生成器（RNG）。该文件指定了兼容性、寄存器地址范围等属性，并给出了一个示例配置。
~~~~

## Documentation/devicetree/bindings/rng/omap_rng_cn.yaml
```yaml
# SPDX-许可证标识符: (GPL-2.0-only 或 BSD-2-Clause)
%YAML 1.2
---
$id: http://devicetree.org/schemas/rng/omap_rng.yaml#
$schema: http://devicetree.org/meta-schemas/core.yaml#

标题: OMAP SoC 和 Inside-Secure HWRNG 模块

维护者:
  - Jayesh Choudhary <j-choudhary@ti.com>

属性:
  compatible:
    枚举:
      - ti,omap2-rng
      - ti,omap4-rng
      - inside-secure,safexcel-eip76

  ti,hwmods:
    常量: rng
    过时: true
    描述: 与随机数生成器（RNG）模块相关的硬件模块名称

  reg:
    最大项目数: 1

  interrupts:
    最大项目数: 1

  clocks:
    最小项目数: 1
    项目:
      - 描述: EIP150 可关断时钟
      - 描述: 主可关断时钟

  clock-names:
    最小项目数: 1
    项目:
      - 常量: core
      - 常量: reg


allOf:
  - 如果:
      属性:
        compatible:
          包含:
            枚举:
              - ti,omap4-rng
              - inside-secure,safexcel-eip76

    那么:
      必需:
        - interrupts


必需:
  - compatible
  - reg

附加属性: false

示例:
  - |
    /* AM335x */
    rng: rng@48310000 {
            compatible = "ti,omap4-rng";
            ti,hwmods = "rng";
            reg = <0x48310000 0x2000>;
            interrupts = <111>;
    };
  - |
    /* SafeXcel IP-76 */
    trng: rng@f2760000 {
            compatible = "inside-secure,safexcel-eip76";
            reg = <0xf2760000 0x7d>;
            interrupts = <0 59 4>;
            clocks = <&cpm_syscon0 1 25>;
    };
```

## Documentation/devicetree/bindings/rng/samsung,exynos4-rng_cn.yaml
~~~~yaml
```yaml
# SPDX-许可证标识符: GPL-2.0
%YAML 1.2
---
$id: http://devicetree.org/schemas/rng/samsung,exynos4-rng.yaml#
$schema: http://devicetree.org/meta-schemas/core.yaml#

title: 三星 Exynos 系统级芯片 伪随机数生成器

维护者:
  - Krzysztof Kozlowski <krzk@kernel.org>

属性:
  compatible:
    枚举:
      - samsung,exynos4-rng                   # 对于 Exynos4210 和 Exynos4412
      - samsung,exynos5250-prng               # 对于 Exynos5250+

  reg:
    最大项数: 1

  clocks:
    最大项数: 1

  clock-names:
    项:
      - 常量: secss

必需:
  - compatible
  - reg
  - clock-names
  - clocks

额外属性: false

示例:
  - |
    #include <dt-bindings/clock/exynos4.h>

    rng@10830400 {
        compatible = "samsung,exynos4-rng";
        reg = <0x10830400 0x200>;
        clocks = <&clock CLK_SSS>;
        clock-names = "secss";
    };
```

请注意，上述翻译将英文原文转换成了中文，并保持了 YAML 结构的格式。不过在某些技术术语方面（例如 YAML 的关键字和一些专有名词），我保留了它们的英文形式以避免歧义或不准确的翻译。
~~~~

## Documentation/devicetree/bindings/rng/samsung,exynos5250-trng_cn.yaml
~~~~yaml
```yaml
# SPDX-许可证标识符: (GPL-2.0 或 BSD-2-Clause)
%YAML 1.2
---
$id: http://devicetree.org/schemas/rng/samsung,exynos5250-trng.yaml#
$schema: http://devicetree.org/meta-schemas/core.yaml#

title: Samsung Exynos 系统级芯片 真随机数生成器

维护者:
  - Krzysztof Kozlowski <krzk@kernel.org>
  - Łukasz Stelmach <l.stelmach@samsung.com>

属性:
  compatible:
    常量: samsung,exynos5250-trng

  clocks:
    最大项目数: 1

  clock-names:
    项目:
      - 常量: secss

  reg:
    最大项目数: 1

必需:
  - compatible
  - clocks
  - clock-names
  - reg

额外属性: false

示例:
  - |
    #include <dt-bindings/clock/exynos5250.h>

    rng@10830600 {
        compatible = "samsung,exynos5250-trng";
        reg = <0x10830600 0x100>;
        clocks = <&clock CLK_SSS>;
        clock-names = "secss";
    };
```

此文档描述了用于Samsung Exynos系统级芯片的真随机数生成器设备树规范，并提供了示例配置。
~~~~

## Documentation/devicetree/bindings/rng/silex-insight,ba431-rng_cn.yaml
```yaml
# SPDX-许可证标识符: (GPL-2.0-only 或 BSD-2-Clause)
%YAML 1.2
---
$id: http://devicetree.org/schemas/rng/silex-insight,ba431-rng.yaml#
$schema: http://devicetree.org/meta-schemas/core.yaml#

title: Silex Insight BA431 随机数生成器

description: |
  BA431 硬件随机数生成器是一个通过 FIPS-140-2/3 认证的知识产权(IP)。
maintainers:
  - Olivier Sobrie <olivier.sobrie@silexinsight.com>

properties:
  compatible:
    const: silex-insight,ba431-rng

  reg:
    maxItems: 1

required:
  - compatible
  - reg

additionalProperties: false

examples:
  - |
    rng@42800000 {
      compatible = "silex-insight,ba431-rng";
      reg = <0x42800000 0x1000>;
    };
```

## Documentation/devicetree/bindings/rng/sparc_sun_oracle_rng_cn.txt
```
针对n2_rng驱动的硬件随机数生成器（HWRNG）支持。

必需属性：
- `reg`         : 用于采样的基地址。
- `compatible`  : 应包含以下随机数生成器版本之一：
   - 对于Niagara 2 平台 (SUN UltraSPARC T2 CPU)，使用 `'SUNW,n2-rng'`
   - 对于Victoria Falls平台 (SUN UltraSPARC T2 Plus CPU)，使用 `'SUNW,vf-rng'`
   - 对于Rainbow/Yosemite Falls平台 (SUN SPARC T3/T4) 或 UltraSPARC KT/Niagara 3 (开发代号)，使用 `'SUNW,kt-rng'`
   - 对于Oracle收购SUN后更近期的系统，具体如下：
     - 对于SPARC T5/M5，使用 `'ORCL,m4-rng'`
     - 对于SPARC T7/M7，使用 `'ORCL,m7-rng'`

示例：
/* Linux LDOM 在 SPARC T5-2 上 */
节点 0xf029a4f4
	.node:  f029a4f4
	rng-#units:  00000002
	compatible: 'ORCL,m4-rng'
	reg:  0000000e
	name: 'random-number-generator'

/* Solaris 在 SPARC M7-8 上 */
节点 0xf028c08c
	rng-#units:  00000003
	compatible: 'ORCL,m7-rng'
	reg:  0000000e
	name:  'random-number-generator'

附注：也可参考DaveM的prtconfs.git。
```
