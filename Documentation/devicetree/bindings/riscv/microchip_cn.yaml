## Documentation/devicetree/bindings/riscv/microchip_cn.yaml
```yaml
# SPDX-许可证标识符: (GPL-2.0-only 或 BSD-2-Clause)
%YAML 1.2
---
$id: http://devicetree.org/schemas/riscv/microchip.yaml#
$schema: http://devicetree.org/meta-schemas/core.yaml#

标题: 基于 Microchip PolarFire SoC 的开发板

维护者:
  - Conor Dooley <conor.dooley@microchip.com>
  - Daire McNamara <daire.mcnamara@microchip.com>

描述:
  基于 Microchip PolarFire SoC 的开发板

属性:
  $nodename:
    常量: '/'
  compatible:
    oneOf:
      - items:
          - enum:
              - microchip,mpfs-icicle-reference-rtlv2203
              - microchip,mpfs-icicle-reference-rtlv2210
          - 常量: microchip,mpfs-icicle-kit
          - 常量: microchip,mpfs

      - items:
          - enum:
              - aldec,tysom-m-mpfs250t-rev2
              - aries,m100pfsevp
              - beagle,beaglev-fire
              - microchip,mpfs-sev-kit
              - sundance,polarberry
          - 常量: microchip,mpfs

附加属性: 真

..
```

## Documentation/devicetree/bindings/riscv/sifive_cn.yaml
```yaml
# SPDX-许可证标识符: (GPL-2.0 或 MIT)
%YAML 1.2
---
$id: http://devicetree.org/schemas/riscv/sifive.yaml#
$schema: http://devicetree.org/meta-schemas/core.yaml#

标题: 基于 SiFive SoC 的开发板

维护者:
  - Paul Walmsley <paul.walmsley@sifive.com>
  - Palmer Dabbelt <palmer@sifive.com>

描述:
  基于 SiFive SoC 的开发板

属性:
  $nodename:
    常量: '/'
  compatible:
    oneOf:
      - items:
          - enum:
              - sifive,hifive-unleashed-a00
          - 常量: sifive,fu540-c000
          - 常量: sifive,fu540

      - items:
          - enum:
              - sifive,hifive-unmatched-a00
          - 常量: sifive,fu740-c000
          - 常量: sifive,fu740

附加属性: 真

..
```

## Documentation/devicetree/bindings/riscv/sophgo_cn.yaml
```yaml
# SPDX-许可证标识符: (GPL-2.0-only 或 BSD-2-Clause)
%YAML 1.2
---
$id: http://devicetree.org/schemas/riscv/sophgo.yaml#
$schema: http://devicetree.org/meta-schemas/core.yaml#

标题: 基于 Sophgo SoC 的板卡

维护者:
  - 魏超 <chao.wei@sophgo.com>
  - 王晨 <unicorn_wang@outlook.com>

描述:
  基于 Sophgo SoC 的板卡

属性:
  $nodename:
    恒定值: '/'
  compatible:
    oneOf:
      - items:
          - 枚举:
              - milkv,duo
          - 恒定值: sophgo,cv1800b
      - items:
          - 枚举:
              - sophgo,huashan-pi
          - 恒定值: sophgo,cv1812h
      - items:
          - 枚举:
              - milkv,pioneer
          - 恒定值: sophgo,sg2042

其他属性: true

..
```

## Documentation/devicetree/bindings/riscv/starfive_cn.yaml
```yaml
# SPDX-许可证标识符: (GPL-2.0-only 或 BSD-2-Clause)
%YAML 1.2
---
$id: http://devicetree.org/schemas/riscv/starfive.yaml#
$schema: http://devicetree.org/meta-schemas/core.yaml#

标题: 基于StarFive系统级芯片(SoC)的开发板

维护者:
  - Michael Zhu <michael.zhu@starfivetech.com>
  - Drew Fustini <drew@beagleboard.org>

描述:
  基于StarFive系统级芯片(SoC)的开发板

属性:
  $nodename:
    常量: '/'
  compatible:
    oneOf:
      - items:
          - 枚举:
              - beagle,beaglev-starlight-jh7100-r0
              - starfive,visionfive-v1
          - 常量: starfive,jh7100

      - items:
          - 枚举:
              - milkv,mars
              - pine64,star64
              - starfive,visionfive-2-v1.2a
              - starfive,visionfive-2-v1.3b
          - 常量: starfive,jh7110

其他属性: true

..
```

## Documentation/devicetree/bindings/riscv/sunxi_cn.yaml
```yaml
# SPDX-许可证标识符: (GPL-2.0-only 或 BSD-2-Clause)
%YAML 1.2
---
$id: http://devicetree.org/schemas/riscv/sunxi.yaml#
$schema: http://devicetree.org/meta-schemas/core.yaml#

标题: 基于Allwinner RISC-V 系统芯片的开发板

维护者:
  - 陈宇 蔡 <wens@csie.org>
  - Jernej Skrabec <jernej.skrabec@gmail.com>
  - Samuel Holland <samuel@sholland.org>

描述:
  基于Allwinner RISC-V 系统芯片的开发板

属性:
  $nodename:
    常量: '/'
  compatible:
    oneOf:
      - 描述: Dongshan Nezha STU 模块系统
        items:
          - 常量: 100ask,dongshan-nezha-stu
          - 常量: allwinner,sun20i-d1

      - 描述: D1 Nezha 开发板
        items:
          - 常量: allwinner,d1-nezha
          - 常量: allwinner,sun20i-d1

      - 描述: ClockworkPi R-01 模块系统 和 v3.14 开发板
        items:
          - 常量: clockwork,r-01-clockworkpi-v3.14
          - 常量: allwinner,sun20i-d1

      - 描述: ClockworkPi R-01 模块系统, v3.14 开发板, 和 DevTerm 扩展
        items:
          - 常量: clockwork,r-01-devterm-v3.14
          - 常量: clockwork,r-01-clockworkpi-v3.14
          - 常量: allwinner,sun20i-d1

      - 描述: Lichee RV 模块系统
        items:
          - 常量: sipeed,lichee-rv
          - 常量: allwinner,sun20i-d1

      - 描述: 用于 Lichee RV 模块系统的载体开发板
        items:
          - 枚举:
              - sipeed,lichee-rv-86-panel-480p
              - sipeed,lichee-rv-86-panel-720p
              - sipeed,lichee-rv-dock
          - 常量: sipeed,lichee-rv
          - 常量: allwinner,sun20i-d1

      - 描述: MangoPi MQ 开发板
        items:
          - 常量: widora,mangopi-mq
          - 常量: allwinner,sun20i-d1s

      - 描述: MangoPi MQ Pro 开发板
        items:
          - 常量: widora,mangopi-mq-pro
          - 常量: allwinner,sun20i-d1

      - 描述: MangoPi MQ-R 开发板
        items:
          - 常量: widora,mangopi-mq-r-f133
          - 常量: allwinner,sun20i-d1s

其他属性: true

..
```

## Documentation/devicetree/bindings/riscv/thead_cn.yaml
```yaml
# SPDX-许可证标识符: (GPL-2.0-only 或 BSD-2-Clause)
%YAML 1.2
---
$id: http://devicetree.org/schemas/riscv/thead.yaml#
$schema: http://devicetree.org/meta-schemas/core.yaml#

标题: 基于T-HEAD SoC的开发板

维护者:
  - 张继生 <jszhang@kernel.org>

描述:
  基于T-HEAD SoC的开发板

属性:
  $nodename:
    常量: '/'
  compatible:
    oneOf:
      - 描述: BeagleV Ahead 单板计算机
        items:
          - 常量: beagle,beaglev-ahead
          - 常量: thead,th1520
      - 描述: Sipeed Lichee Pi 4A 开发板，适用于 Sipeed Lichee 模块 4A
        items:
          - 枚举:
              - sipeed,lichee-pi-4a
          - 常量: sipeed,lichee-module-4a
          - 常量: thead,th1520

其他属性: 真

..
```

## Documentation/devicetree/bindings/rng/amlogic,meson-rng_cn.yaml
~~~~yaml
```yaml
# SPDX-许可证标识符: (GPL-2.0 或 BSD-2-Clause)
# 版权所有 2019 BayLibre, SAS
%YAML 1.2
---
$id: http://devicetree.org/schemas/rng/amlogic,meson-rng.yaml#
$schema: http://devicetree.org/meta-schemas/core.yaml#

标题: Amlogic Meson 随机数生成器

维护者:
  - 尼尔·阿姆斯特朗 <neil.armstrong@linaro.org>

属性:
  compatible:
    枚举:
      - amlogic,meson-rng
      - amlogic,meson-s4-rng

  reg:
    最大项数: 1

  clocks:
    最大项数: 1

  clock-names:
    项:
      - 常量: core

必需:
  - compatible
  - reg

额外属性: false

示例:
  - |
    rng@c8834000 {
          compatible = "amlogic,meson-rng";
          reg = <0xc8834000 0x4>;
    };
```

请注意，这里的翻译尽量保持了原文的结构和格式，并将英文关键词翻译成了中文。但需要注意的是，在实际使用中，Device Tree 的 YAML 文件通常会使用英文关键字。
~~~~

## Documentation/devicetree/bindings/rng/apm,x-gene-rng_cn.yaml
~~~~yaml
```yaml
# SPDX-许可证标识符: GPL-2.0-only 或 BSD-2-Clause
%YAML 1.2
---
$id: http://devicetree.org/schemas/rng/apm,x-gene-rng.yaml#
$schema: http://devicetree.org/meta-schemas/core.yaml#

title: APM X-Gene 系统级芯片 随机数生成器

maintainers:
  - Khuong Dinh <khuong@os.amperecomputing.com>

properties:
  compatible:
    const: apm,xgene-rng

  clocks:
    maxItems: 1

  interrupts:
    maxItems: 1

  reg:
    maxItems: 1

required:
  - compatible
  - clocks
  - interrupts
  - reg

additionalProperties: false

examples:
  - |
    #include <dt-bindings/interrupt-controller/arm-gic.h>

    soc {
        #address-cells = <2>;
        #size-cells = <2>;

        rng@10520000 {
            compatible = "apm,xgene-rng";
            reg = <0x0 0x10520000 0x0 0x100>;
            interrupts = <GIC_SPI 65 IRQ_TYPE_LEVEL_HIGH>;
            clocks = <&rngpkaclk 0>;
        };
    };
```

这段代码定义了一个 Device Tree 的 YAML 描述格式，用于描述 APM X-Gene SoC 中的随机数生成器。其中包含了兼容性声明、时钟配置、中断配置和寄存器地址配置等信息，并提供了一个具体的示例。
~~~~

## Documentation/devicetree/bindings/rng/arm-cctrng_cn.yaml
```yaml
# SPDX-许可证标识符: (GPL-2.0 或 BSD-2-Clause)
%YAML 1.2
---
$id: http://devicetree.org/schemas/rng/arm-cctrng.yaml#
$schema: http://devicetree.org/meta-schemas/core.yaml#

标题: Arm 信任区域 CryptoCell TRNG 引擎

维护者:
  - Hadar Gat <hadar.gat@arm.com>

描述: |+
  Arm 信任区域 CryptoCell TRNG（真随机数生成器）引擎
属性:
  compatible:
    枚举:
      - arm,cryptocell-713-trng
      - arm,cryptocell-703-trng

  interrupts:
    最大项目数量: 1

  reg:
    最大项目数量: 1

  arm,rosc-ratio:
    描述:
      Arm 信任区域 CryptoCell TRNG 引擎有 4 个环形振荡器。
      这 4 个环形振荡器的采样比值。（来自校准）
    $ref: /schemas/types.yaml#/definitions/uint32-array
    最大项目数量: 4

  clocks:
    最大项目数量: 1

必需:
  - compatible
  - interrupts
  - reg
  - arm,rosc-ratio

额外属性: false

示例:
  - |
    arm_cctrng: rng@60000000 {
        compatible = "arm,cryptocell-713-trng";
        interrupts = <0 29 4>;
        reg = <0x60000000 0x10000>;
        arm,rosc-ratio = <5000 1000 500 0>;
    };
```

## Documentation/devicetree/bindings/rng/atmel,at91-trng_cn.yaml
```yaml
# SPDX-许可证标识符: GPL-2.0-only 或 BSD-2-Clause
%YAML 1.2
---
$id: http://devicetree.org/schemas/rng/atmel,at91-trng.yaml#
$schema: http://devicetree.org/meta-schemas/core.yaml#

标题: Atmel AT91 真随机数生成器

维护者:
  - Nicolas Ferre <nicolas.ferre@microchip.com>
  - Alexandre Belloni <alexandre.belloni@bootlin.com>
  - Claudiu Beznea <claudiu.beznea@microchip.com>

属性:
  compatible:
    oneOf:
      - 枚举:
          - atmel,at91sam9g45-trng
          - microchip,sam9x60-trng
      - 项:
          - 枚举:
              - microchip,sama7g5-trng
          - 常量: atmel,at91sam9g45-trng
      - 项:
          - 枚举:
              - microchip,sam9x7-trng
          - 常量: microchip,sam9x60-trng

  clocks:
    最大项数: 1

  interrupts:
    最大项数: 1

  reg:
    最大项数: 1

必需:
  - compatible
  - clocks
  - interrupts
  - reg

额外属性: false

示例:
  - |
    #include <dt-bindings/interrupt-controller/irq.h>

    rng@fffcc000 {
        compatible = "atmel,at91sam9g45-trng";
        reg = <0xfffcc000 0x4000>;
        interrupts = <6 IRQ_TYPE_LEVEL_HIGH 0>;
        clocks = <&trng_clk>;
    };
```

## Documentation/devicetree/bindings/rng/brcm,iproc-rng200_cn.yaml
~~~~yaml
```yaml
# SPDX-许可证标识符: (GPL-2.0 或 BSD-2-Clause)
%YAML 1.2
---
$id: http://devicetree.org/schemas/rng/brcm,iproc-rng200.yaml#
$schema: http://devicetree.org/meta-schemas/core.yaml#

title: 对于 iproc-rng200 驱动的支持硬件随机数生成器 (HWRNG)

维护者:
  - Florian Fainelli <f.fainelli@gmail.com>

属性:
  compatible:
    枚举:
      - brcm,bcm2711-rng200
      - brcm,bcm7211-rng200
      - brcm,bcm7278-rng200
      - brcm,iproc-rng200

  reg:
    maxItems: 1

其他属性: false

示例:
  - |
    rng@18032000 {
        compatible = "brcm,iproc-rng200";
        reg = <0x18032000 0x28>;
    };
```

此文档定义了一个设备树（Device Tree）模式，用于描述支持硬件随机数生成器 (HWRNG) 的 `iproc-rng200` 驱动。它包含了兼容性声明、寄存器地址配置等信息，并提供了一个具体的示例来展示如何在设备树中使用这些模式。
~~~~

## Documentation/devicetree/bindings/rng/hisi-rng_cn.txt
```
海思随机数生成器

所需属性：
- compatible（兼容性）: 应该是 "hisilicon,hip04-rng" 或者 "hisilicon,hip05-rng"
- reg（寄存器区域）: 此块的寄存器集的偏移量和长度

示例：

rng@d1010000 {
	compatible = "hisilicon,hip05-rng";  // 兼容 "hisilicon,hip05-rng"
	reg = <0xd1010000 0x100>;  // 寄存器区域偏移量为 0xd1010000，长度为 0x100
};
```

## Documentation/devicetree/bindings/rng/imx-rng_cn.yaml
```yaml
# SPDX-许可证标识符: (GPL-2.0-only 或 BSD-2-Clause)
%YAML 1.2
---
$id: http://devicetree.org/schemas/rng/imx-rng.yaml#
$schema: http://devicetree.org/meta-schemas/core.yaml#

title: Freescale RNGA/RNGB/RNGC (随机数生成器版本 A、B 和 C)

maintainers:
  - Vladimir Zapolskiy <vz@mleia.com>

properties:
  compatible:
    oneOf:
      - const: fsl,imx21-rnga
      - const: fsl,imx25-rngb
      - items:
          - const: fsl,imx31-rnga
          - const: fsl,imx21-rnga
      - items:
          - enum:
              - fsl,imx6sl-rngb
              - fsl,imx6sll-rngb
              - fsl,imx6ull-rngb
          - const: fsl,imx25-rngb
      - const: fsl,imx35-rngc

  reg:
    maxItems: 1

  interrupts:
    maxItems: 1

  clocks:
    maxItems: 1

required:
  - compatible
  - reg
  - interrupts
  - clocks

additionalProperties: false

examples:
  - |
    rngb@53fb0000 {
        compatible = "fsl,imx25-rngb";
        reg = <0x53fb0000 0x4000>;
        clocks = <&clks 109>;
        interrupts = <22>;
    };
```

## Documentation/devicetree/bindings/rng/ingenic,rng_cn.yaml
```yaml
# SPDX-文件许可人: (GPL-2.0-only 或 BSD-2-Clause)
%YAML 1.2
---
$id: http://devicetree.org/schemas/rng/ingenic,rng.yaml#
$schema: http://devicetree.org/meta-schemas/core.yaml#

标题: Ingenic SoCs 中的随机数生成器 (RNG)

维护者:
  - 周琰杰 (Zhou Yanjie) <zhouyanjie@wanyeetech.com>

描述:
  Ingenic SoCs 中的随机数生成器 (RNG)

属性:
  compatible:
    枚举:
      - ingenic,jz4780-rng
      - ingenic,x1000-rng

  reg:
    最大项目数: 1

必需:
  - compatible
  - reg

额外属性: false

示例:
  - |
    rng: rng@d8 {
        compatible = "ingenic,jz4780-rng";
        reg = <0xd8 0x8>;
    };
```

## Documentation/devicetree/bindings/rng/ingenic,trng_cn.yaml
```yaml
# SPDX-许可证标识符: (GPL-2.0-only 或 BSD-2-Clause)
%YAML 1.2
---
$id: http://devicetree.org/schemas/rng/ingenic,trng.yaml#
$schema: http://devicetree.org/meta-schemas/core.yaml#

标题: Ingenic SoCs 中的 DTRNG

维护者:
  - 周琰杰 (Zhou Yanjie) <zhouyanjie@wanyeetech.com>

描述:
  Ingenic SoCs 中的真随机数生成器

属性:
  compatible:
    枚举:
      - ingenic,x1830-dtrng

  reg:
    最大项目数: 1

  clocks:
    最大项目数: 1

必需项:
  - compatible
  - reg
  - clocks

额外属性: false

示例:
  - |
    #include <dt-bindings/clock/ingenic,x1830-cgu.h>

    dtrng: trng@10072000 {
        compatible = "ingenic,x1830-dtrng";
        reg = <0x10072000 0xc>;

        clocks = <&cgu X1830_CLK_DTRNG>;
    };
```

## Documentation/devicetree/bindings/rng/intel,ixp46x-rng_cn.yaml
~~~~yaml
```yaml
# SPDX-许可证标识符: (GPL-2.0-only 或 BSD-2-Clause)
%YAML 1.2
---
$id: http://devicetree.org/schemas/rng/intel,ixp46x-rng.yaml#
$schema: http://devicetree.org/meta-schemas/core.yaml#

title: Intel IXP46x 随机数生成器

description: |
  Intel IXP46x 在内存中的固定物理位置有一个随机数生成器。
  每次读取都保证提供一个唯一的 32 位随机数。
maintainers:
  - Linus Walleij <linus.walleij@linaro.org>

properties:
  compatible:
    const: intel,ixp46x-rng

  reg:
    maxItems: 1

required:
  - compatible
  - reg

additionalProperties: false

examples:
  - |
    rng@70002100 {
      compatible = "intel,ixp46x-rng";
      reg = <0x70002100 4>;
    };
```
此段代码描述了Intel IXP46x随机数生成器在设备树中的表示方式，并提供了示例。
~~~~

## Documentation/devicetree/bindings/rng/microchip,pic32-rng_cn.txt
```
* Microchip PIC32 随机数生成器

PIC32 RNG 提供了一个伪随机数生成器，它可以由另一个真正的随机数生成器进行初始化。
所需属性：
- compatible（兼容性）: 应该是 "microchip,pic32mzda-rng"
- reg（寄存器）: 指定寄存器的基本物理地址和大小
- clocks（时钟）: 时钟的句柄
示例：

	rng: rng@1f8e6000 { 
		compatible = "microchip,pic32mzda-rng"; 
		reg = <0x1f8e6000 0x1000>; 
		clocks = <&PBCLK5>; 
	};
```

## Documentation/devicetree/bindings/rng/microsoft,vmgenid_cn.yaml
```yaml
# SPDX-许可证标识符: (GPL-2.0-only 或 BSD-2-Clause)
%YAML 1.2
---
$id: http://devicetree.org/schemas/rng/microsoft,vmgenid.yaml#
$schema: http://devicetree.org/meta-schemas/core.yaml#

标题: 虚拟机生成ID

维护者:
  - Jason A. Donenfeld <Jason@zx2c4.com>

描述:
  固件或虚拟机监视程序可以使用此设备树来描述一个中断和一个共享资源，以注入虚拟机生成ID。虚拟机生成ID是一个全局唯一标识符（GUID），设备树绑定遵循在http://go.microsoft.com/fwlink/?LinkId=260709中定义的VMGenID规范。
属性:
  compatible:
    常量: microsoft,vmgenid

  reg:
    描述:
      指定一个16字节的VMGenID，采用与字节顺序无关的十六进制格式。
最大项数: 1

  interrupts:
    描述:
      用于通知新VMGenID可用的中断
最大项数: 1

必需:
  - compatible
  - reg
  - interrupts

额外属性: false

示例:
  - |
    #include <dt-bindings/interrupt-controller/arm-gic.h>
    rng@80000000 {
      compatible = "microsoft,vmgenid";
      reg = <0x80000000 0x1000>;
      interrupts = <GIC_SPI 35 IRQ_TYPE_EDGE_RISING>;
    };
```
