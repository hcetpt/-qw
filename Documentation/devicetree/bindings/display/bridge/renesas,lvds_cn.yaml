## Documentation/devicetree/bindings/display/bridge/sil,sii9022_cn.yaml
```yaml
以下是提供的 YAML 文件的中文翻译：

---

SPDX 许可证标识符: (GPL-2.0-only 或 BSD-2-Clause)

YAML 1.2
---
$id: http://devicetree.org/schemas/display/bridge/sil,sii9022.yaml#
$schema: http://devicetree.org/meta-schemas/core.yaml#

标题: Silicon Image sii902x HDMI 桥接器

维护者:
  - Boris Brezillon <bbrezillon@kernel.org>

属性:
  compatible:
    oneOf:
      - items:
          - enum:
              - sil,sii9022-cpi # CEC 编程接口
              - sil,sii9022-tpi # 发送器编程接口
          - const: sil,sii9022
      - const: sil,sii9022

  reg:
    maxItems: 1

  interrupts:
    maxItems: 1
    描述: 用于通知主机热插拔事件的中断线
  reset-gpios:
    maxItems: 1

  iovcc-supply:
    描述: I/O 供电电压（1.8V 或 3.3V）

  cvcc12-supply:
    描述: 数字核心供电电压（1.2V）

  '#sound-dai-cells':
    enum: [ 0, 1 ]
    描述: |
      <0> 如果仅连接了 I2S 或 S/PDIF 引脚，
      <1> 如果两者都已连接
只有当找到此属性时才配置 HDMI 音频
如果配置了 HDMI 音频，sii902x 设备将成为 I2S 和/或
      S/PDIF 音频编解码器组件（例如数字音频接收器），可用于
      使用 simple-card 或 audio-graph-card 绑定配置完整的音频设备。参阅它们的绑定文档以了解如何描述
      sii902x 设备与音频系统其余部分的连接方式：
      文档/devicetree/bindings/sound/simple-card.yaml
      文档/devicetree/bindings/sound/audio-graph-card.yaml
      注意：在使用 audio-graph-card 绑定时，使用的端口索引应为 3
  sil,i2s-data-lanes:
    $ref: /schemas/types.yaml#/definitions/uint32-array
    minItems: 1
    maxItems: 4
    uniqueItems: true
    items:
      enum: [ 0, 1, 2, 3 ]
    描述:
      每个整数表示哪个 I2S 引脚连接到哪个音频 FIFO
第一个整数选择第一个音频 FIFO#0 的 I2S 音频引脚
      （HDMI 通道 1&2），第二个选择 FIFO#1（HDMI 通道 3&4），依此类推。共有 4 个 FIFO 和 4 个 I2S 引脚（SD0 - SD3）。任何 I2S 引脚都可以
      连接到任何 FIFO，但不能有空缺。例如，在将一个通道映射到 FIFO#2 之前，必须先将 I2S 引脚映射到 FIFO#0 和 FIFO#1。默认值为 <0>，表示 SD0 引脚被路由到 HDMI 音频 FIFO#0
  clocks:
    maxItems: 1
    描述: MCLK 输入。MCLK 可用于生成 HDMI 音频 CTS 值
  clock-names:
    const: mclk

  ports:
    $ref: /schemas/graph.yaml#/properties/ports

    属性:
      port@0:
        $ref: /schemas/graph.yaml#/properties/port
        描述: 并行 RGB 输入端口

      port@1:
        $ref: /schemas/graph.yaml#/properties/port
        描述: HDMI 输出端口

      port@3:
        $ref: /schemas/graph.yaml#/properties/port
        描述: 音频输入端口

必需:
  - compatible
  - reg

附加属性: false

示例:
  - |
    i2c {
        #address-cells = <1>;
        #size-cells = <0>;

        hdmi-bridge@39 {
            compatible = "sil,sii9022";
            reg = <0x39>;
            reset-gpios = <&pioA 1 0>;
            iovcc-supply = <&v3v3_hdmi>;
            cvcc12-supply = <&v1v2_hdmi>;

            #sound-dai-cells = <0>;
            sil,i2s-data-lanes = < 0 1 2 >;
            clocks = <&mclk>;
            clock-names = "mclk";

            ports {
                #address-cells = <1>;
                #size-cells = <0>;

                port@0 {
                    reg = <0>;
                    bridge_in: endpoint {
                        remote-endpoint = <&dc_out>;
                    };
                };
            };
        };
    };
```

## Documentation/devicetree/bindings/display/bridge/sil,sii9234_cn.yaml
~~~~yaml
下面是给定内容的中文翻译：

```yaml
# SPDX-文件许可标识符: (GPL-2.0-only 或 BSD-2-Clause)
%YAML 1.2
---
$id: http://devicetree.org/schemas/display/bridge/sil,sii9234.yaml#
$schema: http://devicetree.org/meta-schemas/core.yaml#

标题: Silicon Image SiI9234 HDMI/MHL 桥接器

维护者:
  - Maciej Purski <m.purski@samsung.com>

属性:
  compatible:
    常量: sil,sii9234

  reg:
    描述: TPI接口的I2C地址
    最大项数: 1

  avcc12-supply:
    描述: TMDS模拟供电电压，1.2V

  avcc33-supply:
    描述: MHL/USB开关供电电压，3.3V

  cvcc12-supply:
    描述: 数字核心供电电压，1.2V

  iovcc18-supply:
    描述: I/O供电电压，1.8V

  interrupts:
    最大项数: 1

  reset-gpios:
    描述: 连接到复位引脚的GPIO
    最大项数: 1

  ports:
    $ref: /schemas/graph.yaml#/properties/ports

    属性:
      port@0:
        $ref: /schemas/graph.yaml#/properties/port
        描述:
          HDMI（编码器）输入的视频端口

      port@1:
        $ref: /schemas/graph.yaml#/properties/port
        描述:
          MHL到连接器端口

    必须包含:
      - port@0

必须包含:
  - compatible
  - reg
  - avcc12-supply
  - avcc33-supply
  - cvcc12-supply
  - iovcc18-supply
  - interrupts
  - reset-gpios
  - ports

不允许额外属性: false

示例:
  - |
    #include <dt-bindings/gpio/gpio.h>
    #include <dt-bindings/interrupt-controller/irq.h>

    i2c {
      #address-cells = <1>;
      #size-cells = <0>;

      bridge@39 {
        compatible = "sil,sii9234";
        reg = <0x39>;
        avcc12-supply = <&vsil12>;
        avcc33-supply = <&vcc33mhl>;
        cvcc12-supply = <&vsil12>;
        iovcc18-supply = <&vcc18mhl>;
        interrupt-parent = <&gpf3>;
        interrupts = <5 IRQ_TYPE_LEVEL_HIGH>;
        reset-gpios = <&gpf3 4 GPIO_ACTIVE_LOW>;

        ports {
          #address-cells = <1>;
          #size-cells = <0>;

          port@0 {
            reg = <0>;
            mhl_to_hdmi: endpoint {
              remote-endpoint = <&hdmi_to_mhl>;
            };
          };

          port@1 {
            reg = <1>;
            mhl_to_connector: endpoint {
              remote-endpoint = <&connector_to_mhl>;
            };
          };
        };
      };
    };
```

请注意，代码块中的注释和格式已尽量保持原样以确保语义的一致性。
~~~~

## Documentation/devicetree/bindings/display/bridge/simple-bridge_cn.yaml
```yaml
# SPDX-文件许可人: (GPL-2.0-only 或 BSD-2-Clause)
%YAML 1.2
---
$id: http://devicetree.org/schemas/display/bridge/simple-bridge.yaml#
$schema: http://devicetree.org/meta-schemas/core.yaml#

标题: 透明的非可编程 DRM 桥接器

维护者:
  - Laurent Pinchart <laurent.pinchart+renesas@ideasonboard.com>
  - Maxime Ripard <mripard@kernel.org>

描述: |
  此绑定支持透明的非可编程桥接器，这些桥接器不需要任何配置，并且只有一个输入和一个输出。

属性:
  compatible:
    oneOf:
      - items:
          - enum:
              - ti,ths8134a
              - ti,ths8134b
          - const: ti,ths8134
      - items:
          - const: corpro,gm7123
          - const: adi,adv7123
      - enum:
          - adi,adv7123
          - dumb-vga-dac
          - ti,opa362
          - ti,ths8134
          - ti,ths8135

  ports:
    $ref: /schemas/graph.yaml#/properties/ports

    属性:
      port@0:
        $ref: /schemas/graph.yaml#/properties/port
        描述: 桥接器的输入端口

      port@1:
        $ref: /schemas/graph.yaml#/properties/port
        描述: 桥接器的输出端口

    必需:
      - port@0
      - port@1

  enable-gpios:
    maxItems: 1
    描述: 控制桥接器使能的 GPIO

  vdd-supply:
    描述: 桥接器的电源供应

必需:
  - compatible
  - ports

附加属性: false

示例:
  - |
    bridge {
        compatible = "ti,ths8134a", "ti,ths8134";

        ports {
            #address-cells = <1>;
            #size-cells = <0>;

            port@0 {
                reg = <0>;

                vga_bridge_in: endpoint {
                    remote-endpoint = <&tcon0_out_vga>;
                };
            };

            port@1 {
                reg = <1>;

                vga_bridge_out: endpoint {
                    remote-endpoint = <&vga_con_in>;
                };
            };
        };
    };

..
```

## Documentation/devicetree/bindings/display/bridge/snps,dw-mipi-dsi_cn.yaml
```yaml
下面是给定内容的中文翻译：

# SPDX-License-Identifier: (GPL-2.0-only OR BSD-2-Clause)
%YAML 1.2
---
$id: http://devicetree.org/schemas/display/bridge/snps,dw-mipi-dsi.yaml#
$schema: http://devicetree.org/meta-schemas/core.yaml#

title: Synopsys DesignWare MIPI DSI 主控制器

maintainers:
  - Philippe CORNU <philippe.cornu@foss.st.com>

description: |
  本文件定义了适用于Synopsys DesignWare MIPI DSI主控制器的设备树属性。它本身并不构成一个设备树绑定规范，而是旨在被特定平台的设备树绑定引用。
  当从平台设备树绑定中引用时，本文件中定义的属性如下。平台设备树绑定负责定义每个属性是必需还是可选。
allOf:
  - $ref: ../dsi-controller.yaml#

properties:
  reg:
    maxItems: 1

  clocks: true

  clock-names: true

  resets:
    maxItems: 1

  reset-names:
    const: apb

  ports:
    $ref: /schemas/graph.yaml#/properties/ports

    properties:
      port@0:
        $ref: /schemas/graph.yaml#/properties/port
        description: 接收像素数据的输入节点
      port@1:
        $ref: /schemas/graph.yaml#/properties/port
        description: DSI输出节点至面板
required:
  - port@0
  - port@1

required:
  - clock-names
  - clocks
  - ports
  - reg

additionalProperties: true
```

## Documentation/devicetree/bindings/display/bridge/thine,thc63lvd1024_cn.yaml
```yaml
# SPDX-许可证标识符: (GPL-2.0-only 或 BSD-2-Clause)
%YAML 1.2
---
$id: http://devicetree.org/schemas/display/bridge/thine,thc63lvd1024.yaml#
$schema: http://devicetree.org/meta-schemas/core.yaml#

标题: Thine Electronics THC63LVD1024 LVDS 解码器

维护者:
  - Jacopo Mondi <jacopo+renesas@jmondi.org>
  - Laurent Pinchart <laurent.pinchart+renesas@ideasonboard.com>

描述: |
  THC63LVD1024 是一款双链路 LVDS 接收器，设计用于将 LVDS 流转换为并行数据输出。该芯片支持单输入/输出模式和双输入/输出模式，最多可处理两个 LVDS 输入流和两个数字 CMOS/TTL 输出。
单模式或双模式操作、输出数据映射以及 DDR 输出模式通过输入信号进行配置，芯片不暴露任何控制总线。
属性:
  compatible:
    常量: thine,thc63lvd1024

  ports:
    $ref: /schemas/graph.yaml#/properties/ports
    描述: |
      设备可以在单输入或双输入以及单输出或双输出模式下运行。
当在单输入模式下运行时，所有像素都从端口 @0 接收，端口 @1 不应包含任何端点。在双输入模式下，
偶数编号的像素从端口 @0 接收，奇数编号的像素从端口 @1 接收，端口 @0 和端口 @1 都应包含端点。
当在单输出模式下运行时，所有像素都从第一个 CMOS/TTL 端口输出，端口 @3 不应包含任何端点。在双输出
模式下，像素从两个 CMOS/TTL 端口输出，端口 @2 和端口 @3 都应包含端点。

属性:
      port@0:
        $ref: /schemas/graph.yaml#/properties/port
        描述: 第一个 LVDS 输入端口

      port@1:
        $ref: /schemas/graph.yaml#/properties/port
        描述: 第二个 LVDS 输入端口

      port@2:
        $ref: /schemas/graph.yaml#/properties/port
        描述: 第一个数字 CMOS/TTL 并行输出

      port@3:
        $ref: /schemas/graph.yaml#/properties/port
        描述: 第二个数字 CMOS/TTL 并行输出

    必需:
      - port@0
      - port@2

  oe-gpios:
    最大项数: 1
    描述: 输出使能 GPIO 信号，引脚名称 "OE"，高电平有效
powerdown-gpios:
    最大项数: 1
    描述: 功率下降 GPIO 信号，引脚名称 "/PDWN"，低电平有效
vcc-supply:
    描述:
      为 TTL 输出、TTL CLOCKOUT 信号、LVDS 输入、PLL 和数字电路提供电源
必需:
  - compatible
  - ports
  - vcc-supply

额外属性: false

示例:
  - |
    #include <dt-bindings/gpio/gpio.h>

    lvds-decoder {
        compatible = "thine,thc63lvd1024";

        vcc-supply = <&reg_lvds_vcc>;
        powerdown-gpios = <&gpio4 15 GPIO_ACTIVE_LOW>;

        ports {
            #address-cells = <1>;
            #size-cells = <0>;

            port@0 {
                reg = <0>;

                lvds_dec_in_0: endpoint {
                    remote-endpoint = <&lvds_out>;
                };
            };

            port@2 {
                reg = <2>;

                lvds_dec_out_2: endpoint {
                    remote-endpoint = <&adv7511_in>;
                };
            };
        };
    };
```

## Documentation/devicetree/bindings/display/bridge/ti,dlpc3433_cn.yaml
~~~~yaml
下面是给定内容的中文翻译：

```yaml
# SPDX-文件许可标识符: (GPL-2.0-only 或 BSD-2-Clause)
%YAML 1.2
---
$id: http://devicetree.org/schemas/display/bridge/ti,dlpc3433.yaml#
$schema: http://devicetree.org/meta-schemas/core.yaml#

标题: TI DLPC3433 MIPI DSI 至 DMD 桥接器

维护者:
  - Jagan Teki <jagan@amarulasolutions.com>
  - Christopher Vollo <chris@renewoutreach.org>

描述: |
  TI DLPC3433 是一种基于 MIPI DSI 的显示控制器桥接器，用于处理高分辨率 DMD 基础投影仪。
  它具有灵活配置的 MIPI DSI 和 DPI 信号输入，产生格式为 RGB565、RGB666、RGB888 的 DMD 输出。
  支持高达 720p 分辨率，并支持 60Hz 和 120Hz 刷新率。

属性:
  compatible:
    常量: ti,dlpc3433

  reg:
    枚举:
      - 0x1b
      - 0x1d

  enable-gpios:
    描述: PROJ_ON 引脚，芯片在 PROJ_ON 高电平时上电

vcc_intf-supply:
    描述: 用于为主机 I/O 供电的 1.8V/3.3V 电源

vcc_flsh-supply:
    描述: 用于为闪存 I/O 供电的 1.8V/3.3V 电源

端口:
    $ref: /schemas/graph.yaml#/properties/ports

    属性:
      端口@0:
        $ref: /schemas/graph.yaml#/$defs/port-base
        不评估的属性: false
        描述: 用于 MIPI DSI 输入的视频端口
属性:
          终端:
            $ref: /schemas/media/video-interfaces.yaml#
            不评估的属性: false

            属性:
              数据通道:
                描述: 物理 DSI 数据通道索引数组
最小项: 1
                项:
                  - 常量: 1
                  - 常量: 2
                  - 常量: 3
                  - 常量: 4

      端口@1:
        $ref: /schemas/graph.yaml#/properties/port
        描述: 用于 DMD 输出的视频端口

必需:
      - 端口@0
      - 端口@1

必需:
  - compatible
  - reg
  - enable-gpios
  - 端口

额外属性: false

示例:
  - |
    #include <dt-bindings/gpio/gpio.h>

    i2c {
        #地址单元格 = <1>;
        #大小单元格 = <0>;

        桥接器@1b {
            compatible = "ti,dlpc3433";
            reg = <0x1b>;
            enable-gpios = <&gpio2 1 GPIO_ACTIVE_HIGH>;

            端口 {
                #地址单元格 = <1>;
                #大小单元格 = <0>;

                端口@0 {
                    reg = <0>;

                    桥接器_in_dsi: 终端 {
                        远程终端 = <&dsi_out_bridge>;
                        数据通道 = <1 2 3 4>;
                    };
                };

                端口@1 {
                    reg = <1>;

                    桥接器_out_panel: 终端 {
                        远程终端 = <&panel_out_bridge>;
                    };
                };
            };
        };
    };
```

请注意，部分 YAML 结构中的关键字和语法可能没有直接对应的中文术语，因此在翻译时尽量保持了原文的形式。
~~~~

## Documentation/devicetree/bindings/display/bridge/ti,sn65dsi83_cn.yaml
~~~~yaml
下面是给定内容的中文翻译：

```yaml
# SPDX-文件许可标识符: (GPL-2.0-only 或 BSD-2-Clause)
%YAML 1.2
---
$id: http://devicetree.org/schemas/display/bridge/ti,sn65dsi83.yaml#
$schema: http://devicetree.org/meta-schemas/core.yaml#

标题: SN65DSI83 和 SN65DSI84 DSI 到 LVDS 桥接芯片

维护者:
  - Marek Vasut <marex@denx.de>

描述: |
  德州仪器 SN65DSI83 1x 单链路 MIPI DSI
  到 1x 单链路 LVDS
  https://www.ti.com/lit/gpn/sn65dsi83
  德州仪器 SN65DSI84 1x 单链路 MIPI DSI
  到 1x 双链路或 2x 单链路 LVDS
  https://www.ti.com/lit/gpn/sn65dsi84

属性:
  compatible:
    枚举:
      - ti,sn65dsi83
      - ti,sn65dsi84

  reg:
    枚举:
      - 0x2c
      - 0x2d

  enable-gpios:
    最大项数: 1
    描述: 桥接器使能引脚 (高电平有效) 的 GPIO 规定

vcc-supply:
    描述: 一个 1.8V 电源供应 (参见 regulator/regulator.yaml)

端口:
    $ref: /schemas/graph.yaml#/properties/ports

    属性:
      port@0:
        $ref: /schemas/graph.yaml#/$defs/port-base
        不评估属性: false
        描述: 用于 MIPI DSI 通道-A 输入的视频端口

        属性:
          endpoint:
            $ref: /schemas/media/video-interfaces.yaml#
            不评估属性: false

            属性:
              data-lanes:
                描述: 物理 DSI 数据通道索引数组
minItems: 1
                项:
                  - 常量: 1
                  - 常量: 2
                  - 常量: 3
                  - 常量: 4

      port@1:
        $ref: /schemas/graph.yaml#/$defs/port-base
        不评估属性: false
        描述: 用于 MIPI DSI 通道-B 输入的视频端口

        属性:
          endpoint:
            $ref: /schemas/media/video-interfaces.yaml#
            不评估属性: false

            属性:
              data-lanes:
                描述: 物理 DSI 数据通道索引数组
minItems: 1
                项:
                  - 常量: 1
                  - 常量: 2
                  - 常量: 3
                  - 常量: 4

      port@2:
        $ref: /schemas/graph.yaml#/properties/port
        描述: 用于 LVDS 通道-A 输出 (面板或桥接器) 的视频端口
port@3:
        $ref: /schemas/graph.yaml#/properties/port
        描述: 用于 LVDS 通道-B 输出 (面板或桥接器) 的视频端口
必需:
      - port@0
      - port@2

必需:
  - compatible
  - reg
  - 端口

allOf:
  - 如果:
      属性:
        compatible:
          包含:
            常量: ti,sn65dsi83
    那么:
      属性:
        端口:
          属性:
            port@1: false
            port@3: false

  - 如果:
      属性:
        compatible:
          包含:
            常量: ti,sn65dsi84
    那么:
      属性:
        端口:
          属性:
            port@1: false

额外属性: false

示例:
  - |
    #include <dt-bindings/gpio/gpio.h>

    i2c {
        #address-cells = <1>;
        #size-cells = <0>;

        bridge@2d {
            compatible = "ti,sn65dsi83";
            reg = <0x2d>;

            enable-gpios = <&gpio2 1 GPIO_ACTIVE_HIGH>;
            vcc-supply = <&reg_sn65dsi83_1v8>;

            端口 {
                #address-cells = <1>;
                #size-cells = <0>;

                port@0 {
                    reg = <0>;

                    endpoint {
                        remote-endpoint = <&dsi0_out>;
                        data-lanes = <1 2 3 4>;
                    };
                };

                port@2 {
                    reg = <2>;

                    endpoint {
                        remote-endpoint = <&panel_in_lvds>;
                    };
                };
            };
        };
    };
```
```
~~~~
