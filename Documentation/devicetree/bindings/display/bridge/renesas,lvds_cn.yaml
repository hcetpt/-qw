## Documentation/devicetree/bindings/display/bridge/toshiba,tc358768_cn.yaml
~~~~yaml
下面是给定内容的中文翻译：

```yaml
# SPDX-文件许可标识符: (GPL-2.0-only 或 BSD-2-Clause)
%YAML 1.2
---
$id: http://devicetree.org/schemas/display/bridge/toshiba,tc358768.yaml#
$schema: http://devicetree.org/meta-schemas/core.yaml#

标题: 东芝 TC358768/TC358778 平行RGB到MIPI DSI桥接器

维护者:
  - 彼得·乌约法卢西 <peter.ujfalusi@ti.com>

描述: |
  TC358768/TC358778 是一种桥接设备，可以将RGB信号转换为DSI信号。

属性:
  compatible:
    枚举:
      - toshiba,tc358768
      - toshiba,tc358778

  reg:
    最大项数: 1
    描述: 设备的基本I2C地址

  reset-gpios:
    最大项数: 1
    描述: 连接到低电平有效的RESX引脚的GPIO

  vddc-supply:
    描述: 用于1.2V内部核心电源的稳压器
  vddmipi-supply:
    描述: 用于MIPI的1.2V稳压器
  vddio-supply:
    描述: 用于1.8V - 3.3V IO电源的稳压器
  clocks:
    最大项数: 1

  clock-names:
    常量: refclk

  ports:
    $ref: /schemas/graph.yaml#/properties/ports

    属性:
      port@0:
        $ref: /schemas/graph.yaml#/$defs/port-base
        不评估的属性: false
        描述: |
          用于RGB输入的视频端口

        属性:
          endpoint:
            $ref: /schemas/graph.yaml#/$defs/endpoint-base
            不评估的属性: false

            属性:
              data-lines:
                $ref: /schemas/types.yaml#/definitions/uint32
                枚举: [ 16, 18, 24 ]

      port@1:
        $ref: /schemas/graph.yaml#/properties/port
        描述: |
          用于DSI输出（面板或连接器）的视频端口
必需:
      - port@0
      - port@1

必需:
  - compatible
  - reg
  - vddc-supply
  - vddmipi-supply
  - vddio-supply
  - ports

allOf:
  - $ref: ../dsi-controller.yaml#

不评估的属性: false

示例:
  - |
    #include <dt-bindings/gpio/gpio.h>

    i2c {
      #address-cells = <1>;
      #size-cells = <0>;

      dsi_bridge: dsi@e {
        compatible = "toshiba,tc358768";
        reg = <0xe>;

        clocks = <&tc358768_refclk>;
        clock-names = "refclk";

        reset-gpios = <&pcf_display_board 0 GPIO_ACTIVE_LOW>;

        vddc-supply = <&v1_2d>;
        vddmipi-supply = <&v1_2d>;
        vddio-supply = <&v3_3d>;

        dsi_bridge_ports: ports {
          #address-cells = <1>;
          #size-cells = <0>;

          port@0 {
            reg = <0>;
            rgb_in: endpoint {
              remote-endpoint = <&dpi_out>;
              data-lines = <24>;
            };
          };

          port@1 {
            reg = <1>;
            dsi_out: endpoint {
              remote-endpoint = <&lcd_in>;
            };
          };
        };
      };
    };
```
```
~~~~

## Documentation/devicetree/bindings/display/bridge/toshiba,tc358775_cn.yaml
~~~~yaml
```yaml
# SPDX-License-Identifier: (GPL-2.0-only OR BSD-2-Clause)
%YAML 1.2
---
$id: http://devicetree.org/schemas/display/bridge/toshiba,tc358775.yaml#
$schema: http://devicetree.org/meta-schemas/core.yaml#

title: 东芝 TC358775 DSI 至 LVDS 桥接器

maintainers:
  - Vinay Simha BN <simhavcs@gmail.com>

description: |
  本绑定支持 DSI 至 LVDS 桥接器 TC358765 和 TC358775

  MIPI DSI-RX 数据 4 路，时钟 1 路，数据速率高达每路 800 Mbps
视频帧大小：
  单链路 LVDS 显示面板最高可达 1600x1200 24 位/像素分辨率
  受限于 135 MHz 的 LVDS 速度
  对于双链路 LVDS 显示面板，最高可达 WUXGA（1920x1200 24 位像素）分辨率
  受限于 270 MHz 的 LVDS 速度
properties:
  compatible:
    enum:
      - toshiba,tc358765
      - toshiba,tc358775

  reg:
    maxItems: 1
    description: 桥接器的 I2C 地址，0x0f

  vdd-supply:
    description: 1.2V LVDS 电源供应

  vddio-supply:
    description: 1.8V IO 电源供应

  stby-gpios:
    maxItems: 1
    description: 待机引脚，低电平有效

  reset-gpios:
    maxItems: 1
    description: 硬件复位，低电平有效

  ports:
    $ref: /schemas/graph.yaml#/properties/ports

    properties:
      port@0:
        $ref: /schemas/graph.yaml#/$defs/port-base
        unevaluatedProperties: false
        description: |
          DSI 输入。远程端点 phandle 应该指向一个
          合法的 mipi_dsi_host 设备节点
properties:
          endpoint:
            $ref: /schemas/media/video-interfaces.yaml#
            unevaluatedProperties: false

            properties:
              data-lanes:
                description: 物理 DSI 数据通道索引数组
minItems: 1
                items:
                  - const: 1
                  - const: 2
                  - const: 3
                  - const: 4

      port@1:
        $ref: /schemas/graph.yaml#/properties/port
        description: |
          LVDS 输出的视频端口（面板或连接器）
port@2:
        $ref: /schemas/graph.yaml#/properties/port
        description: |
          双链路 LVDS 输出的视频端口（面板或连接器）
required:
      - port@0
      - port@1

required:
  - compatible
  - reg
  - vdd-supply
  - vddio-supply
  - reset-gpios
  - ports

allOf:
  - if:
      properties:
        compatible:
          contains:
            const: toshiba,tc358765
    then:
      properties:
        stby-gpios: false

additionalProperties: false

examples:
  - |
    #include <dt-bindings/gpio/gpio.h>

    /* 对于单链路 LVDS 显示面板 */

    i2c@78b8000 {
        /* 在高速扩展上 */
        label = "HS-I2C2";
        reg = <0x078b8000 0x500>;
        clock-frequency = <400000>; /* 快速模式操作 */
        #address-cells = <1>;
        #size-cells = <0>;

        tc_bridge: bridge@f {
            compatible = "toshiba,tc358775";
            reg = <0x0f>;

            vdd-supply = <&pm8916_l2>;
            vddio-supply = <&pm8916_l6>;

            stby-gpios = <&msmgpio 99 GPIO_ACTIVE_LOW>;
            reset-gpios = <&msmgpio 72 GPIO_ACTIVE_LOW>;

            ports {
                #address-cells = <1>;
                #size-cells = <0>;

                port@0 {
                    reg = <0>;
                    d2l_in_test: endpoint {
                        remote-endpoint = <&dsi0_out>;
                        data-lanes = <1 2 3 4>;
                    };
                };

                port@1 {
                    reg = <1>;
                    lvds_out: endpoint {
                        remote-endpoint = <&panel_in>;
                    };
                };
            };
        };
    };

    dsi@1a98000 {
        reg = <0x1a98000 0x25c>;
        reg-names = "dsi_ctrl";

        ports {
            #address-cells = <1>;
            #size-cells = <0>;
            port@1 {
                reg = <1>;
                dsi0_out: endpoint {
                    remote-endpoint = <&d2l_in_test>;
                };
             };
         };
     };

  - |
    /* 对于双链路 LVDS 显示面板 */

    i2c@78b8000 {
        /* 在高速扩展上 */
        label = "HS-I2C2";
        reg = <0x078b8000 0x500>;
        clock-frequency = <400000>; /* 快速模式操作 */
        #address-cells = <1>;
        #size-cells = <0>;

        tc_bridge_dual: bridge@f {
            compatible = "toshiba,tc358775";
            reg = <0x0f>;

            vdd-supply = <&pm8916_l2>;
            vddio-supply = <&pm8916_l6>;

            stby-gpios = <&msmgpio 99 GPIO_ACTIVE_LOW>;
            reset-gpios = <&msmgpio 72 GPIO_ACTIVE_LOW>;

            ports {
                #address-cells = <1>;
                #size-cells = <0>;

                port@0 {
                    reg = <0>;
                    d2l_in_dual: endpoint {
                        remote-endpoint = <&dsi0_out_dual>;
                        data-lanes = <1 2 3 4>;
                    };
                };

                port@1 {
                    reg = <1>;
                    lvds0_out: endpoint {
                        remote-endpoint = <&panel_in0>;
                    };
                };

                port@2 {
                    reg = <2>;
                    lvds1_out: endpoint {
                        remote-endpoint = <&panel_in1>;
                    };
                };
            };
        };
    };

    dsi@1a98000 {
        reg = <0x1a98000 0x25c>;
        reg-names = "dsi_ctrl";

        ports {
            #address-cells = <1>;
            #size-cells = <0>;
            port@1 {
                reg = <1>;
                dsi0_out_dual: endpoint {
                    remote-endpoint = <&d2l_in_dual>;
                };
             };
         };
     };
..
```
以上是将提供的 YAML 文件翻译为中文版本的内容。请注意，某些技术术语和专有名词保持了英文原样，以避免可能的误解。
~~~~

## Documentation/devicetree/bindings/display/cirrus,clps711x-fb_cn.txt
~~~~
* Cirrus Logic CLPS711X 帧缓冲器

必需属性：
- compatible: 必须包含 "cirrus,ep7209-fb"
- reg       : 控制器寄存器的物理基地址和长度 + 帧缓冲器内存的位置和大小
- clocks    : 帧缓冲参考时钟的设备句柄和时钟指定对
- display   : 指向显示节点的设备句柄，该节点描述在文档 `Documentation/devicetree/bindings/display/panel/display-timing.txt` 中
此外，显示节点必须定义以下属性：
  - bits-per-pixel: 每像素位数
- ac-prescale   : LCD 的 AC 偏置频率。此频率是给定制造商的 LCD 面板所需的 AC 偏置频率
- cmap-invert   : 反转颜色级别（可选）

可选属性：
- lcd-supply: 用于 LCD 供电电压的稳压器

示例：

```dt
fb: fb@800002c0 {
	compatible = "cirrus,ep7312-fb", "cirrus,ep7209-fb";
	reg = <0x800002c0 0xd44>, <0x60000000 0xc000>;
	clocks = <&clks 2>;
	lcd-supply = <&reg5v0>;
	display = <&display>;
};

display: display {
	model = "320x240x4";
	bits-per-pixel = <4>;
	ac-prescale = <17>;

	display-timings {
		native-mode = <&timing0>;
		timing0: 320x240 {
			hactive = <320>;
			hback-porch = <0>;
			hfront-porch = <0>;
			hsync-len = <0>;
			vactive = <240>;
			vback-porch = <0>;
			vfront-porch = <0>;
			vsync-len = <0>;
			clock-frequency = <6500000>;
		};
	};
};
```
以上是Cirrus Logic CLPS711X帧缓冲器在设备树中的配置示例。
~~~~

## Documentation/devicetree/bindings/display/connector/analog-tv-connector_cn.yaml
```yaml
# SPDX-许可证标识符: GPL-2.0-only
%YAML 1.2
---
$id: http://devicetree.org/schemas/display/connector/analog-tv-connector.yaml#
$schema: http://devicetree.org/meta-schemas/core.yaml#

标题: 模拟电视连接器

维护者:
  - Laurent Pinchart <Laurent.pinchart@ideasonboard.com>

属性:
  compatible:
    枚举:
      - composite-video-connector
      - svideo-connector

  label: 真

  sdtv-standards:
    描述:
      限制连接器上支持的电视标准为指定的那些。如果没有指定，则允许所有电视标准。可能的电视标准定义在 include/dt-bindings/display/sdtv-standards.h 中。
$ref: /schemas/types.yaml#/definitions/uint32

  port:
    $ref: /schemas/graph.yaml#/properties/port
    描述: 连接到提供模拟电视信号的控制器

必需:
  - compatible
  - port

附加属性: 错误

示例:
  - |
    #include <dt-bindings/display/sdtv-standards.h>

    connector {
        compatible = "composite-video-connector";
        label = "tv";
        sdtv-standards = <(SDTV_STD_PAL | SDTV_STD_NTSC)>;

        port {
            tv_connector_in: endpoint {
                remote-endpoint = <&venc_out>;
            };
        };
    };
```

## Documentation/devicetree/bindings/display/connector/dp-connector_cn.yaml
```yaml
# SPDX-许可证标识符: (GPL-2.0-only 或 BSD-2-Clause)
%YAML 1.2
---
$id: http://devicetree.org/schemas/display/connector/dp-connector.yaml#
$schema: http://devicetree.org/meta-schemas/core.yaml#

标题: DisplayPort 连接器

维护者:
  - Tomi Valkeinen <tomi.valkeinen@ti.com>

属性:
  compatible:
    常量: dp-connector

  label: 真

  type:
    枚举:
      - full-size
      - mini

  hpd-gpios:
    描述: 连接到 HPD 的 GPIO 线
    最大项数: 1

  dp-pwr-supply:
    描述: DP_PWR 引脚的电源供应

  port:
    $ref: /schemas/graph.yaml#/properties/port
    描述: 与提供 DP 信号的控制器的连接

必需:
  - compatible
  - type
  - port

额外属性: 错误

示例:
  - |
    connector {
        compatible = "dp-connector";
        label = "dp0";
        type = "full-size";

        port {
            dp_connector_in: endpoint {
                remote-endpoint = <&dp_out>;
            };
        };
    };

..
```

## Documentation/devicetree/bindings/display/connector/dvi-connector_cn.yaml
```yaml
# SPDX-许可证标识符: GPL-2.0-only
%YAML 1.2
---
$id: http://devicetree.org/schemas/display/connector/dvi-connector.yaml#
$schema: http://devicetree.org/meta-schemas/core.yaml#

标题: DVI 连接器

维护者:
  - Laurent Pinchart <Laurent.pinchart@ideasonboard.com>

属性:
  compatible:
    常量: dvi-connector

  label: 真

  hpd-gpios:
    描述: 连接到HPD的GPIO线
    最大项数: 1

  ddc-i2c-bus:
    描述: 指向用于DDC EDID探测的I2C控制器的phandle链接
    $ref: /schemas/types.yaml#/definitions/phandle

  analog:
    类型: 布尔值
    描述: 连接器具有DVI模拟引脚

  digital:
    类型: 布尔值
    描述: 连接器具有DVI数字引脚

  dual-link:
    类型: 布尔值
    描述: 连接器具有DVI双链路引脚

  port:
    $ref: /schemas/graph.yaml#/properties/port
    描述: 与提供DVI信号的控制器的连接

必需:
  - compatible
  - port

anyOf:
  - 必需:
      - analog
  - 必需:
      - digital

附加属性: 错误

示例:
  - |
    connector {
        compatible = "dvi-connector";
        label = "dvi";

        digital;

        ddc-i2c-bus = <&i2c3>;

        port {
            dvi_connector_in: endpoint {
                remote-endpoint = <&tfp410_out>;
            };
        };
    };
```

## Documentation/devicetree/bindings/display/connector/hdmi-connector_cn.yaml
```yaml
# SPDX-许可证标识符: GPL-2.0-only
%YAML 1.2
---
$id: http://devicetree.org/schemas/display/connector/hdmi-connector.yaml#
$schema: http://devicetree.org/meta-schemas/core.yaml#

标题: HDMI 连接器

维护者:
  - Laurent Pinchart <Laurent.pinchart@ideasonboard.com>

属性:
  compatible:
    常量: hdmi-connector

  type:
    描述: HDMI 连接器类型
    枚举:
      - a   # 标准全尺寸
      - b   # 从未部署？
      - c   # 迷你
      - d   # 微型
      - e   # 汽车用途

  label: 真

  hpd-gpios:
    描述: 连接到HPD的GPIO线
    最大项数: 1

  ddc-i2c-bus:
    描述: 指向用于DDC EDID探测的I2C控制器的phandle链接
    $ref: /schemas/types.yaml#/definitions/phandle

  ddc-en-gpios:
    描述: 用于启用DDC总线的GPIO信号
    最大项数: 1

  hdmi-pwr-supply:
    描述: HDMI +5V电源引脚的电源供应

  port:
    $ref: /schemas/graph.yaml#/properties/port
    描述: 连接到提供HDMI信号的控制器

必需:
  - compatible
  - port
  - type

额外属性: 假

示例:
  - |
    connector {
        compatible = "hdmi-connector";
        label = "hdmi";

        type = "a";

        port {
            hdmi_connector_in: endpoint {
                remote-endpoint = <&tpd12s015_out>;
            };
        };
    };
```

## Documentation/devicetree/bindings/display/connector/vga-connector_cn.yaml
```yaml
# SPDX-许可证标识符: GPL-2.0-only
%YAML 1.2
---
$id: http://devicetree.org/schemas/display/connector/vga-connector.yaml#
$schema: http://devicetree.org/meta-schemas/core.yaml#

标题: VGA 连接器

维护者:
  - Laurent Pinchart <Laurent.pinchart@ideasonboard.com>

属性:
  compatible:
    常量: vga-connector

  label: 真

  ddc-i2c-bus:
    描述: 指向用于DDC EDID探测的I2C控制器的phandle链接
    $ref: /schemas/types.yaml#/definitions/phandle

  port:
    $ref: /schemas/graph.yaml#/properties/port
    描述: 与提供VGA信号的控制器的连接

必需:
  - compatible
  - port

额外属性: 错误

示例:
  - |
    connector {
        compatible = "vga-connector";
        label = "vga";

        ddc-i2c-bus = <&i2c3>;

        port {
            vga_connector_in: 终端 {
                远程终端 = <&adv7123_out>;
            };
        };
    };
```
