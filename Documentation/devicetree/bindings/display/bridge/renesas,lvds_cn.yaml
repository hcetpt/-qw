## Documentation/devicetree/bindings/display/bridge/renesas,lvds_cn.yaml
~~~~yaml
以下是提供的 YAML 文件翻译成中文：

```yaml
# SPDX 许可证标识符: (GPL-2.0-only 或 BSD-2-Clause)
%YAML 1.2
---
$id: http://devicetree.org/schemas/display/bridge/renesas,lvds.yaml#
$schema: http://devicetree.org/meta-schemas/core.yaml#

title: Renesas R-Car LVDS 编码器

maintainers:
  - Laurent Pinchart <laurent.pinchart+renesas@ideasonboard.com>

description: |
  这些设备树绑定描述了嵌入在 Renesas R-Car Gen2、R-Car Gen3、RZ/G1 和 RZ/G2 系统级芯片 (SoC) 中的 LVDS 编码器。

properties:
  compatible:
    enum:
      - renesas,r8a7742-lvds # 对于 RZ/G1H 兼容的 LVDS 编码器
      - renesas,r8a7743-lvds # 对于 RZ/G1M 兼容的 LVDS 编码器
      - renesas,r8a7744-lvds # 对于 RZ/G1N 兼容的 LVDS 编码器
      - renesas,r8a774a1-lvds # 对于 RZ/G2M 兼容的 LVDS 编码器
      - renesas,r8a774b1-lvds # 对于 RZ/G2N 兼容的 LVDS 编码器
      - renesas,r8a774c0-lvds # 对于 RZ/G2E 兼容的 LVDS 编码器
      - renesas,r8a774e1-lvds # 对于 RZ/G2H 兼容的 LVDS 编码器
      - renesas,r8a7790-lvds # 对于 R-Car H2 兼容的 LVDS 编码器
      - renesas,r8a7791-lvds # 对于 R-Car M2-W 兼容的 LVDS 编码器
      - renesas,r8a7793-lvds # 对于 R-Car M2-N 兼容的 LVDS 编码器
      - renesas,r8a7795-lvds # 对于 R-Car H3 兼容的 LVDS 编码器
      - renesas,r8a7796-lvds # 对于 R-Car M3-W 兼容的 LVDS 编码器
      - renesas,r8a77961-lvds # 对于 R-Car M3-W+ 兼容的 LVDS 编码器
      - renesas,r8a77965-lvds # 对于 R-Car M3-N 兼容的 LVDS 编码器
      - renesas,r8a77970-lvds # 对于 R-Car V3M 兼容的 LVDS 编码器
      - renesas,r8a77980-lvds # 对于 R-Car V3H 兼容的 LVDS 编码器
      - renesas,r8a77990-lvds # 对于 R-Car E3 兼容的 LVDS 编码器
      - renesas,r8a77995-lvds # 对于 R-Car D3 兼容的 LVDS 编码器

  reg:
    maxItems: 1

  clocks:
    minItems: 1
    maxItems: 4

  clock-names:
    minItems: 1
    maxItems: 4

  resets:
    maxItems: 1

  ports:
    $ref: /schemas/graph.yaml#/properties/ports

    properties:
      port@0:
        $ref: /schemas/graph.yaml#/properties/port
        description: 并行 RGB 输入端口

      port@1:
        $ref: /schemas/graph.yaml#/properties/port
        description: LVDS 输出端口

    required:
      - port@0
      - port@1

  power-domains:
    maxItems: 1

  renesas,companion:
    $ref: /schemas/types.yaml#/definitions/phandle
    description: 
      指向配套 LVDS 编码器的 phandle。此属性对于 R-Car D3 和 E3，以及 RZ/G2E SoC 上的第一个 LVDS 编码器是必需的，并且应指向要作为双链路模式下的伴侣使用的第二个编码器。
      对于其他任何 LVDS 编码器，不应设置此属性。

required:
  - compatible
  - reg
  - clocks
  - power-domains
  - resets
  - ports

if:
  properties:
    compatible:
      enum:
        - renesas,r8a774c0-lvds
        - renesas,r8a77990-lvds
        - renesas,r8a77995-lvds
then:
  properties:
    clocks:
      minItems: 1
      items:
        - description: 功能时钟
        - description: EXTAL 输入时钟
        - description: DU_DOTCLKIN0 输入时钟
        - description: DU_DOTCLKIN1 输入时钟

    clock-names:
      minItems: 1
      items:
        - const: fck
        # LVDS 编码器可以使用 EXTAL 或 DU_DOTCLKINx 时钟
        # 这些时钟是可选的
        - enum:
            - extal
            - dclkin.0
            - dclkin.1
        - enum:
            - extal
            - dclkin.0
            - dclkin.1
        - enum:
            - extal
            - dclkin.0
            - dclkin.1

  required:
    - clock-names

else:
  properties:
    clocks:
      items:
        - description: 功能时钟

    clock-names:
      items:
        - const: fck

    renesas,companion: false

additionalProperties: false

examples:
  - |
    #include <dt-bindings/clock/renesas-cpg-mssr.h>
    #include <dt-bindings/power/r8a7795-sysc.h>

    lvds@feb90000 {
        compatible = "renesas,r8a7795-lvds";
        reg = <0xfeb90000 0x14>;
        clocks = <&cpg CPG_MOD 727>;
        power-domains = <&sysc R8A7795_PD_ALWAYS_ON>;
        resets = <&cpg 727>;

        ports {
            #address-cells = <1>;
            #size-cells = <0>;

            port@0 {
                reg = <0>;
                lvds_in: endpoint {
                    remote-endpoint = <&du_out_lvds0>;
                };
            };
            port@1 {
                reg = <1>;
                lvds_out: endpoint {
                    remote-endpoint = <&panel_in>;
                };
            };
        };
    };

  - |
    #include <dt-bindings/clock/renesas-cpg-mssr.h>
    #include <dt-bindings/power/r8a77990-sysc.h>

    lvds0: lvds@feb90000 {
        compatible = "renesas,r8a77990-lvds";
        reg = <0xfeb90000 0x20>;
        clocks = <&cpg CPG_MOD 727>,
                 <&x13_clk>,
                 <&extal_clk>;
        clock-names = "fck", "dclkin.0", "extal";
        power-domains = <&sysc R8A77990_PD_ALWAYS_ON>;
        resets = <&cpg 727>;

        renesas,companion = <&lvds1>;

        ports {
            #address-cells = <1>;
            #size-cells = <0>;

            port@0 {
                reg = <0>;
                lvds0_in: endpoint {
                    remote-endpoint = <&du_out_lvds0>;
                };
            };
            port@1 {
                reg = <1>;
                lvds0_out: endpoint {
                    remote-endpoint = <&panel_in1>;
                };
            };
        };
    };

    lvds1: lvds@feb90100 {
        compatible = "renesas,r8a77990-lvds";
        reg = <0xfeb90100 0x20>;
        clocks = <&cpg CPG_MOD 727>,
                 <&x13_clk>,
                 <&extal_clk>;
        clock-names = "fck", "dclkin.0", "extal";
        power-domains = <&sysc R8A77990_PD_ALWAYS_ON>;
        resets = <&cpg 726>;

        ports {
            #address-cells = <1>;
            #size-cells = <0>;

            port@0 {
                reg = <0>;
                lvds1_in: endpoint {
                    remote-endpoint = <&du_out_lvds1>;
                };
            };
            port@1 {
                reg = <1>;
                lvds1_out: endpoint {
                    remote-endpoint = <&panel_in2>;
                };
            };
        };
    };
```
请注意，上述 YAML 文件的翻译保持了原有的格式和语法结构，以便能被相应的解析器正确解析。
~~~~

## Documentation/devicetree/bindings/display/bridge/samsung,mipi-dsim_cn.yaml
```yaml
以下是提供的 YAML 文件的中文翻译：

---

SPDX 许可证标识符: (GPL-2.0-only 或 BSD-2-Clause)

%YAML 1.2
---
$id: http://devicetree.org/schemas/display/bridge/samsung,mipi-dsim.yaml#
$schema: http://devicetree.org/meta-schemas/core.yaml#

标题: Samsung MIPI DSIM 桥控制器

维护者:
  - Inki Dae <inki.dae@samsung.com>
  - Jagan Teki <jagan@amarulasolutions.com>
  - Marek Szyprowski <m.szyprowski@samsung.com>

描述: |
  Samsung MIPI DSIM 桥控制器可在 Exynos 和 i.MX8M Mini/Nano/Plus 系统芯片中找到。
属性:
  compatible:
    oneOf:
      - 枚举:
          - samsung,exynos3250-mipi-dsi
          - samsung,exynos4210-mipi-dsi
          - samsung,exynos5410-mipi-dsi
          - samsung,exynos5422-mipi-dsi
          - samsung,exynos5433-mipi-dsi
          - fsl,imx8mm-mipi-dsim
          - fsl,imx8mp-mipi-dsim
      - items:
          - 常量: fsl,imx8mn-mipi-dsim
          - 常量: fsl,imx8mm-mipi-dsim

  reg:
    最大项数: 1

  interrupts:
    最大项数: 1

  '#address-cells':
    常量: 1

  '#size-cells':
    常量: 0

  clocks:
    最小项数: 2
    最大项数: 5

  clock-names:
    最小项数: 2
    最大项数: 5

  samsung,phy-type:
    $ref: /schemas/types.yaml#/definitions/uint32
    描述: 对应于三星 PHY 类型的句柄

  power-domains:
    最大项数: 1

  samsung,power-domain:
    $ref: /schemas/types.yaml#/definitions/phandle
    描述: 对应于相关联的三星电源域的句柄

  vddcore-supply:
    描述: MIPI DSIM 核心电压供应（例如 1.1V）

  vddio-supply:
    描述: MIPI DSIM I/O 和 PLL 电压供应（例如 1.8V）

  samsung,burst-clock-frequency:
    $ref: /schemas/types.yaml#/definitions/uint32
    描述:
      DSIM 高速突发模式频率。如果未指定，
      将使用连接设备或桥接器提供的像素时钟。

  samsung,esc-clock-frequency:
    $ref: /schemas/types.yaml#/definitions/uint32
    描述:
      DSIM 逃逸模式频率

  samsung,pll-clock-frequency:
    $ref: /schemas/types.yaml#/definitions/uint32
    描述:
      DSIM 振荡器时钟频率。如果未指定，将使用 sclk_mipi 的时钟频率。

  phys:
    最大项数: 1

  phy-names:
    常量: dsim

  ports:
    $ref: /schemas/graph.yaml#/properties/ports

    属性:
      port@0:
        $ref: /schemas/graph.yaml#/properties/port
        描述:
          输入端口节点用于从显示控制器接收像素数据。必须精确指定一个终端节点。
      port@1:
        $ref: /schemas/graph.yaml#/$defs/port-base
        未评估属性: false
        描述:
          DSI 输出端口节点到面板或链中的下一个桥接器
        属性:
          终端:
            $ref: /schemas/media/video-interfaces.yaml#
            未评估属性: false

            属性:
              data-lanes:
                最小项数: 1
                最大项数: 4
                独特项: true
                项:
                  枚举: [1, 2, 3, 4]

              lane-polarities:
                最小项数: 1
                最大项数: 5
                描述:
                  Samsung MIPI DSI IP 要求所有数据通道具有相同的极性
          依赖:
              lane-polarities: [data-lanes]

所需属性:
  - clock-names
  - clocks
  - compatible
  - interrupts
  - reg
  - samsung,esc-clock-frequency

全部包含:
  - $ref: ../dsi-controller.yaml#
  - 如果:
      属性:
        compatible:
          包含:
            常量: samsung,exynos5433-mipi-dsi

    则:
      属性:
        clocks:
          最小项数: 5

        clock-names:
          项:
            - 常量: bus_clk
            - 常量: phyclk_mipidphy0_bitclkdiv8
            - 常量: phyclk_mipidphy0_rxclkesc0
            - 常量: sclk_rgb_vclk_to_dsim0
            - 常量: sclk_mipi

        ports:
          必需:
            - port@0

      所需属性:
        - ports
        - vddcore-supply
        - vddio-supply

  - 如果:
      属性:
        compatible:
          包含:
            常量: samsung,exynos5410-mipi-dsi

    则:
      属性:
        clocks:
          最小项数: 2

        clock-names:
          项:
            - 常量: bus_clk
            - 常量: pll_clk

      所需属性:
        - vddcore-supply
        - vddio-supply

  - 如果:
      属性:
        compatible:
          包含:
            常量: samsung,exynos4210-mipi-dsi

    则:
      属性:
        clocks:
          最小项数: 2

        clock-names:
          项:
            - 常量: bus_clk
            - 常量: sclk_mipi

      所需属性:
        - vddcore-supply
        - vddio-supply

  - 如果:
      属性:
        compatible:
          包含:
            常量: samsung,exynos3250-mipi-dsi

    则:
      属性:
        clocks:
          最小项数: 2

        clock-names:
          项:
            - 常量: bus_clk
            - 常量: pll_clk

      所需属性:
        - vddcore-supply
        - vddio-supply
        - samsung,phy-type

其他属性:
  类型: 对象

示例:
  - |
    #include <dt-bindings/clock/exynos5433.h>
    #include <dt-bindings/gpio/gpio.h>
    #include <dt-bindings/interrupt-controller/arm-gic.h>

    dsi@13900000 {
       compatible = "samsung,exynos5433-mipi-dsi";
       reg = <0x13900000 0xC0>;
       interrupts = <GIC_SPI 205 IRQ_TYPE_LEVEL_HIGH>;
       phys = <&mipi_phy 1>;
       phy-names = "dsim";
       clocks = <&cmu_disp CLK_PCLK_DSIM0>,
                <&cmu_disp CLK_PHYCLK_MIPIDPHY0_BITCLKDIV8>,
                <&cmu_disp CLK_PHYCLK_MIPIDPHY0_RXCLKESC0>,
                <&cmu_disp CLK_SCLK_RGB_VCLK_TO_DSIM0>,
                <&cmu_disp CLK_SCLK_DSIM0>;
       clock-names = "bus_clk",
                     "phyclk_mipidphy0_bitclkdiv8",
                     "phyclk_mipidphy0_rxclkesc0",
                     "sclk_rgb_vclk_to_dsim0",
                     "sclk_mipi";
       power-domains = <&pd_disp>;
       vddcore-supply = <&ldo6_reg>;
       vddio-supply = <&ldo7_reg>;
       samsung,burst-clock-frequency = <512000000>;
       samsung,esc-clock-frequency = <16000000>;
       samsung,pll-clock-frequency = <24000000>;
       pinctrl-names = "default";
       pinctrl-0 = <&te_irq>;

       ports {
          #address-cells = <1>;
          #size-cells = <0>;

          port@0 {
             reg = <0>;

             dsi_to_mic: endpoint {
                remote-endpoint = <&mic_to_dsi>;
             };
          };
       };
    };
```

## Documentation/devicetree/bindings/display/bridge/sil,sii8620_cn.yaml
```yaml
# SPDX-许可证标识符: GPL-2.0-only 或 BSD-2-Clause
%YAML 1.2
---
$id: http://devicetree.org/schemas/display/bridge/sil,sii8620.yaml#
$schema: http://devicetree.org/meta-schemas/core.yaml#

title: Silicon Image SiI8620 HDMI/MHL 桥接器

maintainers:
  - Krzysztof Kozlowski <krzysztof.kozlowski@linaro.org>

properties:
  compatible:
    const: sil,sii8620

  reg:
    maxItems: 1

  clocks:
    maxItems: 1

  clock-names:
    items:
      - const: xtal

  cvcc10-supply:
    description: 数字核心供电电压 (1.0V)

  interrupts:
    maxItems: 1

  iovcc18-supply:
    description: I/O 供电电压 (1.8V)

  reset-gpios:
    maxItems: 1

  ports:
    $ref: /schemas/graph.yaml#/properties/ports
    unevaluatedProperties: false

    properties:
      port@0:
        $ref: /schemas/graph.yaml#/properties/port
        description:
          视频端口用于 HDMI (编码器) 输入

      port@1:
        $ref: /schemas/graph.yaml#/properties/port
        description:
          MHL 到连接器端口

    required:
      - port@0
      - port@1

required:
  - compatible
  - reg
  - clocks
  - cvcc10-supply
  - interrupts
  - iovcc18-supply
  - reset-gpios
  - ports

additionalProperties: false

examples:
  - |
    #include <dt-bindings/gpio/gpio.h>
    #include <dt-bindings/interrupt-controller/irq.h>

    i2c {
        #address-cells = <1>;
        #size-cells = <0>;

        bridge@39 {
            reg = <0x39>;
            compatible = "sil,sii8620";
            cvcc10-supply = <&ldo36_reg>;
            iovcc18-supply = <&ldo34_reg>;
            interrupt-parent = <&gpf0>;
            interrupts = <2 IRQ_TYPE_LEVEL_HIGH>;
            reset-gpios = <&gpv7 0 GPIO_ACTIVE_LOW>;
            clocks = <&pmu_system_controller 0>;
            clock-names = "xtal";

            ports {
                #address-cells = <1>;
                #size-cells = <0>;

                port@0 {
                    reg = <0>;
                    mhl_to_hdmi: endpoint {
                        remote-endpoint = <&hdmi_to_mhl>;
                    };
                };

                port@1 {
                    reg = <1>;
                    mhl_to_musb_con: endpoint {
                        remote-endpoint = <&musb_con_to_mhl>;
                    };
                };
            };
        };
    };
```
