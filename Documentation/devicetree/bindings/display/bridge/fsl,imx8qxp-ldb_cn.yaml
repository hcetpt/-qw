## Documentation/devicetree/bindings/display/bridge/renesas,dsi-csi2-tx_cn.yaml
```yaml
这段 Device Tree 绑定描述了瑞萨 R-Car 第四代系统芯片 (SoC) 中嵌入的 MIPI DSI/CSI-2 编码器。

维护者:
  - Laurent Pinchart <laurent.pinchart+renesas@ideasonboard.com>

描述: 
  此绑定描述了瑞萨 R-Car 第四代系统芯片 (SoC) 中嵌入的 MIPI DSI/CSI-2 编码器。该编码器可以在 DSI 或 CSI-2 模式下工作，并且最多可以使用四个数据通道。

属性:
  compatible:
    枚举:
      - renesas,r8a779a0-dsi-csi2-tx    # 对于 V3U
      - renesas,r8a779g0-dsi-csi2-tx    # 对于 V4H

  reg:
    最大项数: 1

  clocks:
    项:
      - 描述: 功能时钟
      - 描述: DSI (和 CSI-2) 功能时钟
      - 描述: PLL 参考时钟

  clock-names:
    项:
      - 常量: fck
      - 常量: dsi
      - 常量: pll

  power-domains:
    最大项数: 1

  resets:
    最大项数: 1

  ports:
    $ref: /schemas/graph.yaml#/properties/ports

    属性:
      port@0:
        $ref: /schemas/graph.yaml#/properties/port
        描述: 并行输入端口

      port@1:
        $ref: /schemas/graph.yaml#/$defs/port-base
        不评估的属性: false
        描述: DSI/CSI-2 输出端口

        属性:
          endpoint:
            $ref: /schemas/media/video-interfaces.yaml#
            不评估的属性: false

            属性:
              data-lanes:
                最少项数: 1
                最大项数: 4

            必须包含:
              - data-lanes

    必须包含:
      - port@0
      - port@1

必须包含:
  - compatible
  - reg
  - clocks
  - power-domains
  - resets
  - ports

额外属性: false

示例:
  - |
    #include <dt-bindings/clock/r8a779a0-cpg-mssr.h>
    #include <dt-bindings/power/r8a779a0-sysc.h>

    dsi0: dsi-encoder@fed80000 {
        compatible = "renesas,r8a779a0-dsi-csi2-tx";
        reg = <0xfed80000 0x10000>;
        power-domains = <&sysc R8A779A0_PD_ALWAYS_ON>;
        clocks = <&cpg CPG_MOD 415>,
                 <&cpg CPG_CORE R8A779A0_CLK_DSI>,
                 <&cpg CPG_CORE R8A779A0_CLK_CP>;
        clock-names = "fck", "dsi", "pll";
        resets = <&cpg 415>;

        ports {
            #address-cells = <1>;
            #size-cells = <0>;

            port@0 {
                reg = <0>;
                dsi0_in: endpoint {
                    remote-endpoint = <&du_out_dsi0>;
                };
            };

            port@1 {
                reg = <1>;
                dsi0_out: endpoint {
                    data-lanes = <1 2>;
                    remote-endpoint = <&sn65dsi86_in>;
                };
            };
        };
    };
```

## Documentation/devicetree/bindings/display/bridge/renesas,dsi_cn.yaml
```yaml
此文档定义了适用于Renesas RZ/G2L系列SoC中嵌入的MIPI DSI编码器的设备树绑定。

# 许可证
SPDX-License-Identifier: (GPL-2.0-only OR BSD-2-Clause)

%YAML 1.2
---
$id: http://devicetree.org/schemas/display/bridge/renesas,dsi.yaml#
$schema: http://devicetree.org/meta-schemas/core.yaml#

# 标题
title: Renesas RZ/G2L MIPI DSI 编码器

# 维护者
maintainers:
  - Biju Das <biju.das.jz@bp.renesas.com>

# 描述
description: |
  本绑定描述了嵌入在Renesas RZ/G2L系列SoC中的MIPI DSI编码器。该编码器可以在DSI模式下工作，支持最多四条数据通道。
allOf:
  - $ref: /schemas/display/dsi-controller.yaml#

# 属性
properties:
  compatible:
    items:
      - enum:
          - renesas,r9a07g044-mipi-dsi # RZ/G2{L,LC}
          - renesas,r9a07g054-mipi-dsi # RZ/V2L
      - const: renesas,rzg2l-mipi-dsi

  reg:
    maxItems: 1

  interrupts:
    items:
      - description: 序列操作通道0中断
      - description: 序列操作通道1中断
      - description: 视频输入操作通道1中断
      - description: DSI包接收中断
      - description: DSI致命错误中断
      - description: DSI D-PHY PPI中断
      - description: 调试中断

  interrupt-names:
    items:
      - const: seq0
      - const: seq1
      - const: vin1
      - const: rcv
      - const: ferr
      - const: ppi
      - const: debug

  clocks:
    items:
      - description: DSI D-PHY PLL倍频时钟
      - description: DSI D-PHY系统时钟
      - description: DSI AXI总线时钟
      - description: DSI寄存器访问时钟
      - description: DSI视频时钟
      - description: DSI D-PHY逃逸模式传输时钟

  clock-names:
    items:
      - const: pllclk
      - const: sysclk
      - const: aclk
      - const: pclk
      - const: vclk
      - const: lpclk

  resets:
    items:
      - description: MIPI_DSI_CMN_RSTB
      - description: MIPI_DSI_ARESET_N
      - description: MIPI_DSI_PRESET_N

  reset-names:
    items:
      - const: rst
      - const: arst
      - const: prst

  power-domains:
    maxItems: 1

  ports:
    $ref: /schemas/graph.yaml#/properties/ports

    properties:
      port@0:
        $ref: /schemas/graph.yaml#/properties/port
        description: 并行输入端口

      port@1:
        $ref: /schemas/graph.yaml#/$defs/port-base
        unevaluatedProperties: false
        description: DSI输出端口

        properties:
          endpoint:
            $ref: /schemas/media/video-interfaces.yaml#
            unevaluatedProperties: false

            properties:
              data-lanes:
                description: 物理DSI数据通道索引数组
minItems: 1
                items:
                  - const: 1
                  - const: 2
                  - const: 3
                  - const: 4

            required:
              - data-lanes

    required:
      - port@0
      - port@1

# 必须包含的属性
required:
  - compatible
  - reg
  - interrupts
  - interrupt-names
  - clocks
  - clock-names
  - resets
  - reset-names
  - power-domains
  - ports

# 不允许额外属性
additionalProperties: false

# 示例
examples:
  - |
    #include <dt-bindings/clock/r9a07g044-cpg.h>
    #include <dt-bindings/interrupt-controller/arm-gic.h>

    dsi0: dsi@10850000 {
        compatible = "renesas,r9a07g044-mipi-dsi", "renesas,rzg2l-mipi-dsi";
        reg = <0x10850000 0x20000>;
        interrupts = <GIC_SPI 142 IRQ_TYPE_LEVEL_HIGH>,
                     <GIC_SPI 143 IRQ_TYPE_LEVEL_HIGH>,
                     <GIC_SPI 144 IRQ_TYPE_LEVEL_HIGH>,
                     <GIC_SPI 145 IRQ_TYPE_LEVEL_HIGH>,
                     <GIC_SPI 146 IRQ_TYPE_LEVEL_HIGH>,
                     <GIC_SPI 147 IRQ_TYPE_LEVEL_HIGH>,
                     <GIC_SPI 148 IRQ_TYPE_LEVEL_HIGH>;
        interrupt-names = "seq0", "seq1", "vin1", "rcv",
                          "ferr", "ppi", "debug";
        clocks = <&cpg CPG_MOD R9A07G044_MIPI_DSI_PLLCLK>,
                 <&cpg CPG_MOD R9A07G044_MIPI_DSI_SYSCLK>,
                 <&cpg CPG_MOD R9A07G044_MIPI_DSI_ACLK>,
                 <&cpg CPG_MOD R9A07G044_MIPI_DSI_PCLK>,
                 <&cpg CPG_MOD R9A07G044_MIPI_DSI_VCLK>,
                 <&cpg CPG_MOD R9A07G044_MIPI_DSI_LPCLK>;
        clock-names = "pllclk", "sysclk", "aclk", "pclk", "vclk", "lpclk";
        resets = <&cpg R9A07G044_MIPI_DSI_CMN_RSTB>,
                 <&cpg R9A07G044_MIPI_DSI_ARESET_N>,
                 <&cpg R9A07G044_MIPI_DSI_PRESET_N>;
        reset-names = "rst", "arst", "prst";
        power-domains = <&cpg>;

        ports {
            #address-cells = <1>;
            #size-cells = <0>;

            port@0 {
                reg = <0>;
                dsi0_in: endpoint {
                    remote-endpoint = <&du_out_dsi0>;
                };
            };

            port@1 {
                reg = <1>;
                dsi0_out: endpoint {
                    data-lanes = <1 2 3 4>;
                    remote-endpoint = <&adv7535_in>;
                };
            };
        };
    };
```

## Documentation/devicetree/bindings/display/bridge/renesas,dw-hdmi_cn.yaml
```yaml
下面是给定内容的中文翻译：

# SPDX-许可证标识符: (GPL-2.0-only 或 BSD-2-Clause)
%YAML 1.2
---
$id: http://devicetree.org/schemas/display/bridge/renesas,dw-hdmi.yaml#
$schema: http://devicetree.org/meta-schemas/core.yaml#

标题: Renesas R-Car DWC HDMI 发射器编码器

维护者:
  - Laurent Pinchart <laurent.pinchart+renesas@ideasonboard.com>

描述: |
  HDMI 发射器是一个 Synopsys DesignWare HDMI 1.4 TX 控制器 IP，配有一个辅助 PHY IP。
allOf:
  - $ref: synopsys,dw-hdmi.yaml#

属性:
  compatible:
    items:
      - enum:
          - renesas,r8a774a1-hdmi # 对于 RZ/G2M 兼容 HDMI TX
          - renesas,r8a774b1-hdmi # 对于 RZ/G2N 兼容 HDMI TX
          - renesas,r8a774e1-hdmi # 对于 RZ/G2H 兼容 HDMI TX
          - renesas,r8a7795-hdmi # 对于 R-Car H3 兼容 HDMI TX
          - renesas,r8a7796-hdmi # 对于 R-Car M3-W 兼容 HDMI TX
          - renesas,r8a77961-hdmi # 对于 R-Car M3-W+ 兼容 HDMI TX
          - renesas,r8a77965-hdmi # 对于 R-Car M3-N 兼容 HDMI TX
      - const: renesas,rcar-gen3-hdmi

  reg-io-width:
    const: 1

  clocks:
    maxItems: 2

  clock-names:
    maxItems: 2

  resets:
    maxItems: 1

  ports:
    $ref: /schemas/graph.yaml#/properties/ports

    属性:
      port@0:
        $ref: /schemas/graph.yaml#/properties/port
        描述: 并行 RGB 输入端口

      port@1:
        $ref: /schemas/graph.yaml#/properties/port
        描述: HDMI 输出端口

      port@2:
        $ref: /schemas/graph.yaml#/properties/port
        描述: 音频输入端口

    必需:
      - port@0
      - port@1
      - port@2

  power-domains:
    maxItems: 1

必需:
  - compatible
  - reg
  - clocks
  - clock-names
  - resets
  - interrupts
  - ports

未评估属性: false

示例:
  - |
    #include <dt-bindings/clock/r8a7795-cpg-mssr.h>
    #include <dt-bindings/interrupt-controller/irq.h>
    #include <dt-bindings/power/r8a7795-sysc.h>

    hdmi@fead0000 {
        compatible = "renesas,r8a7795-hdmi", "renesas,rcar-gen3-hdmi";
        reg = <0xfead0000 0x10000>;
        interrupts = <0 389 IRQ_TYPE_LEVEL_HIGH>;
        clocks = <&cpg CPG_CORE R8A7795_CLK_S0D4>, <&cpg CPG_MOD 729>;
        clock-names = "iahb", "isfr";
        power-domains = <&sysc R8A7795_PD_ALWAYS_ON>;
        resets = <&cpg 729>;

        ports {
            #address-cells = <1>;
            #size-cells = <0>;
            port@0 {
                reg = <0>;
                dw_hdmi0_in: endpoint {
                    remote-endpoint = <&du_out_hdmi0>;
                };
            };
            port@1 {
                reg = <1>;
                rcar_dw_hdmi0_out: endpoint {
                    remote-endpoint = <&hdmi0_con>;
                };
            };
            port@2 {
                reg = <2>;
                rcar_dw_hdmi0_sound_in: endpoint {
                    remote-endpoint = <&hdmi_sound_out>;
                };
            };
        };
    };

    hdmi0-out {
        compatible = "hdmi-connector";
        label = "HDMI0 OUT";
        type = "a";

        port {
            hdmi0_con: endpoint {
                remote-endpoint = <&rcar_dw_hdmi0_out>;
            };
        };
    };
```
