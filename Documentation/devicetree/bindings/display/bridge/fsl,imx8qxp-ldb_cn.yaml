## Documentation/devicetree/bindings/display/bridge/lontium,lt8912b_cn.yaml
~~~~yaml
下面是给定内容的中文翻译：

```yaml
# SPDX-文件许可标识符: (GPL-2.0-only 或 BSD-2-Clause)
%YAML 1.2
---
$id: http://devicetree.org/schemas/display/bridge/lontium,lt8912b.yaml#
$schema: http://devicetree.org/meta-schemas/core.yaml#

标题: Lontium LT8912B MIPI 到 HDMI 桥接器

维护者:
  - Adrien Grassein <adrien.grassein@gmail.com>

描述: |
  LT8912B 是一款桥接设备，可以将 DSI 转换为 HDMI。

属性:
  compatible:
    枚举:
      - lontium,lt8912b

  reg:
    最大项数: 1

  reset-gpios:
    最大项数: 1
    描述: 连接到激活高电平复位引脚的 GPIO

端口:
    $ref: /schemas/graph.yaml#/properties/ports

    属性:
      port@0:
        $ref: /schemas/graph.yaml#/$defs/port-base
        不评估属性: false
        描述:
          主要 MIPI 端口用于 MIPI 输入

        属性:
          endpoint:
            $ref: /schemas/media/video-interfaces.yaml#
            不评估属性: false

            属性:
              data-lanes: true

            必需:
              - data-lanes

      port@1:
        $ref: /schemas/graph.yaml#/properties/port
        描述: |
          HDMI 端口，应连接到与 HDMI 连接器绑定兼容的节点
必需:
      - port@0
      - port@1

  vcchdmipll-supply:
    描述: 一个 1.8V 的供电，用于为 HDMI PLL 供电
vcchdmitx-supply:
    描述: 一个 1.8V 的供电，用于为 HDMI TX 部分供电
vcclvdspll-supply:
    描述: 一个 1.8V 的供电，用于为 LVDS PLL 供电
vcclvdstx-supply:
    描述: 一个 1.8V 的供电，用于为 LVDS TX 部分供电
vccmipirx-supply:
    描述: 一个 1.8V 的供电，用于为 MIPI RX 部分供电
vccsysclk-supply:
    描述: 一个 1.8V 的供电，用于为 SYSCLK 供电
vdd-supply:
    描述: 一个 1.8V 的供电，用于为数字部分供电
必需:
  - compatible
  - reg
  - reset-gpios
  - ports

额外属性: false

示例:
  - |
    #include <dt-bindings/gpio/gpio.h>

    i2c {
      #address-cells = <1>;
      #size-cells = <0>;

      hdmi-bridge@48 {
        compatible = "lontium,lt8912b";
        reg = <0x48>;
        reset-gpios = <&max7323 0 GPIO_ACTIVE_LOW>;

        ports {
          #address-cells = <1>;
          #size-cells = <0>;

          port@0 {
            reg = <0>;

            hdmi_out_in: endpoint {
              data-lanes = <0 1 2 3>;
              remote-endpoint = <&mipi_dsi_out>;
            };
          };

          port@1 {
              reg = <1>;

              endpoint {
                  remote-endpoint = <&hdmi_in>;
              };
          };
        };
      };
    };
```

请注意，上述翻译保留了 YAML 格式和原有的结构。
您没有提供需要翻译的文本。请提供需要翻译成中文的英文或其他语言的文本。
~~~~

## Documentation/devicetree/bindings/display/bridge/lontium,lt9211_cn.yaml
```yaml
下面是给定内容的中文翻译：

# SPDX-许可证标识符: (GPL-2.0-only 或 BSD-2-Clause)
%YAML 1.2
---
$id: http://devicetree.org/schemas/display/bridge/lontium,lt9211.yaml#
$schema: http://devicetree.org/meta-schemas/core.yaml#

标题: Lontium LT9211 DSI/LVDS/DPI 到 DSI/LVDS/DPI 桥接器
维护者:
  - Marek Vasut <marex@denx.de>

描述: |
  LT9211 是桥接设备，能够将单/双链路 DSI/LVDS 或单 DPI 转换为单/双链路 DSI/LVDS 或单 DPI。
属性:
  compatible:
    枚举:
      - lontium,lt9211

  reg:
    最大项数: 1

  interrupts:
    最大项数: 1

  reset-gpios:
    最大项数: 1
    描述: 连接到高电平有效的重置引脚的 GPIO
vccio-supply:
    描述: 用于 1.8V IO 电源的稳压器
端口:
    $ref: /schemas/graph.yaml#/properties/ports

    属性:
      port@0:
        $ref: /schemas/graph.yaml#/properties/port
        描述:
          主要的 MIPI DSI 端口-1 用于 MIPI 输入或
          LVDS 端口-1 用于 LVDS 输入或 DPI 输入
port@1:
        $ref: /schemas/graph.yaml#/properties/port
        描述:
          额外的 MIPI 端口-2 用于 MIPI 输入或 LVDS 端口-2
          用于 LVDS 输入。与主要端口-1 结合使用以驱动更高分辨率的显示器

      port@2:
        $ref: /schemas/graph.yaml#/properties/port
        描述:
          主要的 MIPI DSI 端口-1 用于 MIPI 输出或
          LVDS 端口-1 用于 LVDS 输出或 DPI 输出
port@3:
        $ref: /schemas/graph.yaml#/properties/port
        描述:
          额外的 MIPI 端口-2 用于 MIPI 输出或 LVDS 端口-2
          用于 LVDS 输出。与主要端口-1 结合使用以驱动更高分辨率的显示器
必需:
      - port@0
      - port@2

必需:
  - compatible
  - reg
  - vccio-supply
  - 端口

附加属性: false

示例:
  - |
    #include <dt-bindings/gpio/gpio.h>
    #include <dt-bindings/interrupt-controller/irq.h>

    i2c {
      #address-cells = <1>;
      #size-cells = <0>;

      hdmi-bridge@3b {
        compatible = "lontium,lt9211";
        reg = <0x3b>;

        reset-gpios = <&tlmm 128 GPIO_ACTIVE_HIGH>;
        interrupts-extended = <&tlmm 84 IRQ_TYPE_EDGE_FALLING>;

        vccio-supply = <&lt9211_1v8>;

        端口 {
          #address-cells = <1>;
          #size-cells = <0>;

          port@0 {
            reg = <0>;

            终端点 {
              远程终端点 = <&dsi0_out>;
            };
          };

          port@2 {
            reg = <2>;

            终端点 {
              远程终端点 = <&panel_in_lvds>;
            };
          };
        };
      };
    };

..
```

## Documentation/devicetree/bindings/display/bridge/lontium,lt9611_cn.yaml
```yaml
下面是给定内容的中文翻译：

# SPDX-许可证标识符: (GPL-2.0-only 或 BSD-2-Clause)
%YAML 1.2
---
$id: http://devicetree.org/schemas/display/bridge/lontium,lt9611.yaml#
$schema: http://devicetree.org/meta-schemas/core.yaml#

标题: Lontium LT9611(UXC) 2端口MIPI到HDMI桥接器

维护者:
  - Vinod Koul <vkoul@kernel.org>

描述: |
  LT9611 和 LT9611UXC 是桥接设备，用于将DSI转换为HDMI。

属性:
  compatible:
    枚举:
      - lontium,lt9611
      - lontium,lt9611uxc

  reg:
    最大项目数: 1

  "#sound-dai-cells":
    常量: 1

  interrupts:
    最大项目数: 1

  reset-gpios:
    最大项目数: 1
    描述: 连接到激活高电平的RESET引脚的GPIO

vdd-supply:
    描述: 1.8V MIPI PHY电源的稳压器
vcc-supply:
    描述: 3.3V I/O电源的稳压器
ports:
    $ref: /schemas/graph.yaml#/properties/ports

    属性:
      port@0:
        $ref: /schemas/graph.yaml#/properties/port
        描述:
          主MIPI端口1，用于MIPI输入

      port@1:
        $ref: /schemas/graph.yaml#/properties/port
        描述:
          额外的MIPI端口2，用于MIPI输入，在与主MIPI端口1结合使用时驱动更高分辨率的显示器

      port@2:
        $ref: /schemas/graph.yaml#/properties/port
        描述:
          HDMI端口，用于HDMI输出

    必需:
      - port@0
      - port@2

必需:
  - compatible
  - reg
  - interrupts
  - vdd-supply
  - vcc-supply
  - ports

额外属性: false

示例:
  - |
    #include <dt-bindings/gpio/gpio.h>
    #include <dt-bindings/interrupt-controller/irq.h>

    i2c10 {
      #address-cells = <1>;
      #size-cells = <0>;

      hdmi-bridge@3b {
        compatible = "lontium,lt9611";
        reg = <0x3b>;

        reset-gpios = <&tlmm 128 GPIO_ACTIVE_HIGH>;
        interrupts-extended = <&tlmm 84 IRQ_TYPE_EDGE_FALLING>;

        vdd-supply = <&lt9611_1v8>;
        vcc-supply = <&lt9611_3v3>;

        ports {
          #address-cells = <1>;
          #size-cells = <0>;

          port@0 {
            reg = <0>;
            lt9611_a: endpoint {
              remote-endpoint = <&dsi0_out>;
            };
          };

          port@1 {
            reg = <1>;
            lt9611_b: endpoint {
              remote-endpoint = <&dsi1_out>;
            };
          };

          port@2 {
            reg = <2>;
            lt9611_out: endpoint {
              remote-endpoint = <&hdmi_con>;
            };
          };
        };
      };
    };

..
```

## Documentation/devicetree/bindings/display/bridge/lvds-codec_cn.yaml
```yaml
# SPDX-许可证标识符: GPL-2.0
%YAML 1.2
---
$id: http://devicetree.org/schemas/display/bridge/lvds-codec.yaml#
$schema: http://devicetree.org/meta-schemas/core.yaml#

标题: 透明的 LVDS 编码器和解码器

维护者:
  - Laurent Pinchart <laurent.pinchart+renesas@ideasonboard.com>

描述: |
  此绑定支持那些不需要任何配置的透明 LVDS 编码器和解码器。
LVDS 是在 ANSI/TIA/EIA-644-A 中定义的一种物理层规范。随着时间推移，已经使用了多种不兼容的数据链路层来向 LVDS 面板传输图像数据。此绑定仅针对以下规范兼容的设备：
[JEIDA] "显示器数字接口标准", JEIDA-59-1999, 1999 年 2 月 (版本 1.0), 日本电子工业发展协会 (JEIDA)
[LDI] "开放 LVDS 显示接口", 1999 年 5 月 (版本 0.95), 国家半导体
[VESA] "VESA 笔记本面板标准", 2007 年 10 月 (版本 1.0), 视频电子标准协会 (VESA)

  这些设备通常以 FPD-Link 和 FlatLink 等品牌名称销售。
属性:
  compatible:
    oneOf:
      - items:
          - enum:
              - ti,ds90c185   # 对于 TI DS90C185 FPD-Link 序列化器
              - ti,ds90c187   # 对于 TI DS90C187 FPD-Link 序列化器
              - ti,sn75lvds83 # 对于 TI SN75LVDS83 FlatLink 发射器
          - const: lvds-encoder # 通用 LVDS 编码器兼容回退
      - items:
          - enum:
              - ti,ds90cf364a # 对于 DS90CF364A FPD-Link LVDS 接收器
              - ti,ds90cf384a # 对于 DS90CF384A FPD-Link LVDS 接收器
              - ti,sn65lvds94 # 对于 SN65DS94 LVDS 串并转换器
          - const: lvds-decoder # 通用 LVDS 解码器兼容回退
      - enum:
          - thine,thc63lvdm83d # 对于 THC63LVDM83D LVDS 序列化器

  ports:
    $ref: /schemas/graph.yaml#/properties/ports

    properties:
      port@0:
        $ref: /schemas/graph.yaml#/$defs/port-base
        unevaluatedProperties: false
        description: |
          对于 LVDS 编码器，端口 0 是并行输入
          对于 LVDS 解码器，端口 0 是 LVDS 输入

        properties:
          endpoint:
            $ref: /schemas/media/video-interfaces.yaml#
            unevaluatedProperties: false

            properties:
              data-mapping:
                enum:
                  - jeida-18
                  - jeida-24
                  - vesa-24
                description: |
                  颜色信号映射顺序。详情见
                  文档/devicetree/bindings/display/lvds.yaml

      port@1:
        $ref: /schemas/graph.yaml#/properties/port
        description: |
          对于 LVDS 编码器，端口 1 是 LVDS 输出
          对于 LVDS 解码器，端口 1 是并行输出

    required:
      - port@0
      - port@1

  pclk-sample:
    description:
      在上升沿或下降沿进行数据采样
enum:
      - 0  # 下降沿
      - 1  # 上升沿
    default: 0

  powerdown-gpios:
    description:
      用于控制该设备电源线的 GPIO
maxItems: 1

  power-supply: true

allOf:
  - if:
      not:
        properties:
          compatible:
            contains:
              const: lvds-decoder
    then:
      properties:
        ports:
          properties:
            port@0:
              properties:
                endpoint:
                  properties:
                    data-mapping: false

  - if:
      not:
        properties:
          compatible:
            contains:
              const: lvds-encoder
    then:
      properties:
        pclk-sample: false

required:
  - compatible
  - ports

additionalProperties: false


示例:
  - |
    lvds-encoder {
      compatible = "ti,ds90c185", "lvds-encoder";

      ports {
        #address-cells = <1>;
        #size-cells = <0>;

        port@0 {
          reg = <0>;

          lvds_enc_in: endpoint {
            remote-endpoint = <&display_out_rgb>;
          };
        };

        port@1 {
          reg = <1>;

          lvds_enc_out: endpoint {
            remote-endpoint = <&lvds_panel_in>;
          };
        };
      };
    };

  - |
    lvds-decoder {
      compatible = "ti,ds90cf384a", "lvds-decoder";

      ports {
        #address-cells = <1>;
        #size-cells = <0>;

        port@0 {
          reg = <0>;

          lvds_dec_in: endpoint {
            remote-endpoint = <&display_out_lvds>;
          };
        };

        port@1 {
          reg = <1>;

          lvds_dec_out: endpoint {
            remote-endpoint = <&rgb_panel_in>;
          };
        };
      };
    };
```

## Documentation/devicetree/bindings/display/bridge/megachips-stdpxxxx-ge-b850v3-fw_cn.txt
~~~~
GE B850v3 的第二个视频输出的驱动程序：
- STDP4028-ge-b850v3-fw 桥接器（LVDS-DP）
- STDP2690-ge-b850v3-fw 桥接器（DP-DP++）

GE B850v3 上第二个输出的视频处理管线如下：

   主机 -> LVDS|--(STDP4028)--|DP -> DP|--(STDP2690)--|DP++ -> 视频输出

每个桥接器都包含一个专门的闪存，用于支持定制设计。其结果是，在这个设计中，STDP4028 和 STDP2690 的行为与标准桥接器不同。兼容字符串包括后缀 "-ge-b850v3-fw"，以明确指出该驱动程序适用于具有特定于 GE B850v3 固件的桥接器。
硬件并不提供对视频处理管线的控制，因为这两个桥接器表现得像一个整体。硬件暴露的唯一接口是 EDID、HPD 和中断。

**stdp4028-ge-b850v3-fw 必需属性：**
  - compatible : "megachips,stdp4028-ge-b850v3-fw"
  - reg : I2C 总线地址
  - interrupts : 应在此处描述一个中断，如
    <0 IRQ_TYPE_LEVEL_HIGH>
  - ports : 一个输入端口（reg = <0>）和一个输出端口（reg = <1>）

**stdp2690-ge-b850v3-fw 必需属性：**
  - compatible : "megachips,stdp2690-ge-b850v3-fw"
  - reg : I2C 总线地址
  - ports : 一个输入端口（reg = <0>）和一个输出端口（reg = <1>）

**示例：**

```device-tree
&mux2_i2c2 {
	clock-frequency = <100000>;

	stdp4028@73 {
		compatible = "megachips,stdp4028-ge-b850v3-fw";
		#address-cells = <1>;
		#size-cells = <0>;

		reg = <0x73>;

		interrupt-parent = <&gpio2>;
		interrupts = <0 IRQ_TYPE_LEVEL_HIGH>;

		ports {
			#address-cells = <1>;
			#size-cells = <0>;

			port@0 {
				reg = <0>;
				stdp4028_in: endpoint {
					remote-endpoint = <&lvds0_out>;
				};
			};
			port@1 {
				reg = <1>;
				stdp4028_out: endpoint {
					remote-endpoint = <&stdp2690_in>;
				};
			};
		};
	};

	stdp2690@72 {
		compatible = "megachips,stdp2690-ge-b850v3-fw";
		#address-cells = <1>;
		#size-cells = <0>;

		reg = <0x72>;

		ports {
			#address-cells = <1>;
			#size-cells = <0>;

			port@0 {
				reg = <0>;
				stdp2690_in: endpoint {
					remote-endpoint = <&stdp4028_out>;
				};
			};

			port@1 {
				reg = <1>;
				stdp2690_out: endpoint {
					/* 连接外部显示器的接口 */
				};
			};
		};
	};
};
```
以上示例展示了如何在 Device Tree 中定义这些桥接器及其配置。
~~~~

## Documentation/devicetree/bindings/display/bridge/microchip,sam9x75-lvds_cn.yaml
```yaml
# SPDX-许可证标识符: (GPL-2.0-only 或 BSD-2-Clause)
%YAML 1.2
---
$id: http://devicetree.org/schemas/display/bridge/microchip,sam9x75-lvds.yaml#
$schema: http://devicetree.org/meta-schemas/core.yaml#

标题: Microchip SAM9X75 LVDS 控制器

维护者:
  - Dharma Balasubiramani <dharma.b@microchip.com>

描述:
  低压差分信号控制器（LVDSC）管理从LCD控制器内部DPI总线到OpenLDI LVDS输出信号的数据格式转换。LVDSC的功能包括位映射、平衡模式管理和序列化。

属性:
  compatible:
    常量: microchip,sam9x75-lvds

  reg:
    最大项目数: 1

  interrupts:
    最大项目数: 1

  clocks:
    项目:
      - 描述: 外设总线时钟

  clock-names:
    项目:
      - 常量: pclk

必需:
  - compatible
  - reg
  - interrupts
  - clocks
  - clock-names

额外属性: false

示例:
  - |
    #include <dt-bindings/interrupt-controller/irq.h>
    #include <dt-bindings/clock/at91.h>
    lvds-controller@f8060000 {
      compatible = "microchip,sam9x75-lvds";
      reg = <0xf8060000 0x100>;
      interrupts = <56 IRQ_TYPE_LEVEL_HIGH 0>;
      clocks = <&pmc PMC_TYPE_PERIPHERAL 56>;
      clock-names = "pclk";
    };
```
