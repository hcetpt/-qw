## Documentation/devicetree/bindings/display/bridge/fsl,imx8qxp-ldb_cn.yaml
~~~~yaml
下面是提供的 YAML 文件的中文翻译：

```yaml
# SPDX 许可证标识符: (GPL-2.0-only 或 BSD-2-Clause)
%YAML 1.2
---
$id: http://devicetree.org/schemas/display/bridge/fsl,imx8qxp-ldb.yaml#
$schema: http://devicetree.org/meta-schemas/core.yaml#

title: Freescale i.MX8qm/qxp LVDS 显示桥接器

maintainers:
  - Liu Ying <victor.liu@nxp.com>

description: |
  Freescale i.MX8qm/qxp LVDS 显示桥接器(LDB)有两个通道。
  i.MX8qm/qxp LDB 由控制与状态寄存器(CSR)模块控制。
  CSR 模块作为系统控制器，包含 LDB 的配置寄存器。
  对于 i.MX8qxp LDB，每个通道支持最高 24bpp 的并行输入颜色格式，并且可以将输入映射到 VESA 或 JEIDA 标准。两个通道不能同时使用，也就是说，用户需要选择其中一个来使用。来自两个 LDB 实例的两个 LDB 通道可以在 LDB 分割模式下协同工作以支持双链路 LVDS 显示器。通道索引必须不同。通道0输出奇数像素，而通道1输出偶数像素。
  对于 i.MX8qm LDB，每个通道还支持最高 30bpp 的并行输入颜色格式。两个通道可以同时使用，既可以是双模式也可以是分割模式。在双模式下，两个通道输出相同的数据。在分割模式下，通道0输出奇数像素，通道1输出偶数像素。
  需要说明的是，i.MX8qm/qxp LDB 在 SoC 参考手册中正式称为像素映射器。像素映射器使用嵌入在 i.MX6qdl/sx SoC 中的 LDB 逻辑，即本质上基于它们。为了保持命名一致性，此绑定将其称为 LDB。

properties:
  compatible:
    enum:
      - fsl,imx8qm-ldb
      - fsl,imx8qxp-ldb

  "#address-cells":
    const: 1

  "#size-cells":
    const: 0

  clocks:
    items:
      - description: 像素时钟
      - description: 旁路时钟

  clock-names:
    items:
      - const: pixel
      - const: bypass

  power-domains:
    maxItems: 1

  fsl,companion-ldb:
    $ref: /schemas/types.yaml#/definitions/phandle
    description: |
      一个指向在 LDB 分割模式中使用的配套 LDB 的 phandle

patternProperties:
  "^channel@[0-1]$":
    type: object
    description: 表示 LDB 的一个通道
properties:
      "#address-cells":
        const: 1

      "#size-cells":
        const: 0

      reg:
        description: 通道索引
enum: [ 0, 1 ]

      phys:
        description: 指向表示 LVDS PHY 的 PHY 模块的 phandle
```

请注意，某些 YAML 元素和结构可能没有直接的中文等价物，因此这些部分保留了英文原样。
这段文本是 Device Tree (设备树) 的描述，用于定义硬件组件及其配置。下面是该文本的中文翻译：

```yaml
# 最大项目数: 1

phy-names:
  # 常量: lvds_phy

port@0:
  $ref: /schemas/graph.yaml#/properties/port
  description: 通道的输入端口
port@1:
  $ref: /schemas/graph.yaml#/properties/port
  description: 通道的输出端口
required:
  - "#address-cells"
  - "#size-cells"
  - reg
  - phys
  - phy-names

additionalProperties: false

required:
  - compatible
  - "#address-cells"
  - "#size-cells"
  - clocks
  - clock-names
  - power-domains
  - channel@0
  - channel@1

allOf:
  - if:
      properties:
        compatible:
          contains:
            const: fsl,imx8qm-ldb
    then:
      properties:
        fsl,companion-ldb: false

additionalProperties: false

examples:
  - |
    #include <dt-bindings/firmware/imx/rsrc.h>
    ldb {
        #address-cells = <1>;
        #size-cells = <0>;
        compatible = "fsl,imx8qxp-ldb";
        clocks = <&clk IMX_SC_R_LVDS_0 IMX_SC_PM_CLK_MISC2>,
                 <&clk IMX_SC_R_LVDS_0 IMX_SC_PM_CLK_BYPASS>;
        clock-names = "pixel", "bypass";
        power-domains = <&pd IMX_SC_R_LVDS_0>;

        channel@0 {
            #address-cells = <1>;
            #size-cells = <0>;
            reg = <0>;
            phys = <&mipi_lvds_0_phy>;
            phy-names = "lvds_phy";

            port@0 {
                reg = <0>;

                mipi_lvds_0_ldb_ch0_mipi_lvds_0_pxl2dpi: endpoint {
                    remote-endpoint = <&mipi_lvds_0_pxl2dpi_mipi_lvds_0_ldb_ch0>;
                };
            };
        };

        channel@1 {
            #address-cells = <1>;
            #size-cells = <0>;
            reg = <1>;
            phys = <&mipi_lvds_0_phy>;
            phy-names = "lvds_phy";

            port@0 {
                reg = <0>;

                mipi_lvds_0_ldb_ch1_mipi_lvds_0_pxl2dpi: endpoint {
                    remote-endpoint = <&mipi_lvds_0_pxl2dpi_mipi_lvds_0_ldb_ch1>;
                };
            };
        };
    };
```

请注意，由于 Device Tree 的特殊格式，其中包含了很多特定的符号和语法（如 `$ref`、`contains` 等），这些在翻译时保持不变。此外，示例中的代码部分也直接保留了英文原文。
~~~~

## Documentation/devicetree/bindings/display/bridge/fsl,imx8qxp-pixel-combiner_cn.yaml
~~~~yaml
下面是给定内容的中文翻译：

```yaml
# SPDX-文件许可标识: (GPL-2.0-only 或 BSD-2-Clause)
%YAML 1.2
---
$id: http://devicetree.org/schemas/display/bridge/fsl,imx8qxp-pixel-combiner.yaml#
$schema: http://devicetree.org/meta-schemas/core.yaml#

标题: Freescale i.MX8qm/qxp 像素组合器

维护者:
  - Liu Ying <victor.liu@nxp.com>

描述: |
  Freescale i.MX8qm/qxp 像素组合器从单个显示控制器接收两个输出流，并对这两个流进行操作以支持多种模式（旁路、像素组合、YUV444转YUV422、分立RGB），这些模式可以配置为一个屏幕、两个屏幕或虚拟屏幕。像素组合器还负责生成像素链路输出通道的一些控制信号。

属性:
  compatible:
    枚举:
      - fsl,imx8qm-pixel-combiner
      - fsl,imx8qxp-pixel-combiner

  "#address-cells":
    常量: 1

  "#size-cells":
    常量: 0

  reg:
    最大项数: 1

  clocks:
    最大项数: 1

  clock-names:
    常量: apb

  power-domains:
    最大项数: 1

模式属性:
  "^channel@[0-1]$":
    类型: 对象
    描述: 表示像素组合器的一个显示流
属性:
      "#address-cells":
        常量: 1

      "#size-cells":
        常量: 0

      reg:
        描述: 显示流索引
枚举: [ 0, 1 ]

      port@0:
        $ref: /schemas/graph.yaml#/properties/port
        描述: 显示流的输入端点
port@1:
        $ref: /schemas/graph.yaml#/properties/port
        描述: 显示流的输出端点
所需:
      - "#address-cells"
      - "#size-cells"
      - reg
      - port@0
      - port@1

    其他属性: false

所需:
  - compatible
  - "#address-cells"
  - "#size-cells"
  - reg
  - clocks
  - clock-names
  - power-domains

其他属性: false

示例:
  - |
    #include <dt-bindings/clock/imx8-lpcg.h>
    #include <dt-bindings/firmware/imx/rsrc.h>
    pixel-combiner@56020000 {
        compatible = "fsl,imx8qxp-pixel-combiner";
        #address-cells = <1>;
        #size-cells = <0>;
        reg = <0x56020000 0x10000>;
        clocks = <&dc0_pixel_combiner_lpcg IMX_LPCG_CLK_4>;
        clock-names = "apb";
        power-domains = <&pd IMX_SC_R_DC_0>;

        channel@0 {
            #address-cells = <1>;
            #size-cells = <0>;
            reg = <0>;

            port@0 {
                reg = <0>;

                dc0_pixel_combiner_ch0_dc0_dpu_disp0: endpoint {
                    remote-endpoint = <&dc0_dpu_disp0_dc0_pixel_combiner_ch0>;
                };
            };

            port@1 {
                reg = <1>;

                dc0_pixel_combiner_ch0_dc0_pixel_link0: endpoint {
                    remote-endpoint = <&dc0_pixel_link0_dc0_pixel_combiner_ch0>;
                };
            };
        };

        channel@1 {
            #address-cells = <1>;
            #size-cells = <0>;
            reg = <1>;

            port@0 {
                reg = <0>;

                dc0_pixel_combiner_ch1_dc0_dpu_disp1: endpoint {
                    remote-endpoint = <&dc0_dpu_disp1_dc0_pixel_combiner_ch1>;
                };
            };

            port@1 {
                reg = <1>;

                dc0_pixel_combiner_ch1_dc0_pixel_link1: endpoint {
                    remote-endpoint = <&dc0_pixel_link1_dc0_pixel_combiner_ch1>;
                };
            };
        };
    };
```
```
~~~~

## Documentation/devicetree/bindings/display/bridge/fsl,imx8qxp-pixel-link_cn.yaml
```yaml
下面是给定内容的中文翻译：

# SPDX-许可证标识符: (GPL-2.0-only 或 BSD-2-Clause)
%YAML 1.2
---
$id: http://devicetree.org/schemas/display/bridge/fsl,imx8qxp-pixel-link.yaml#
$schema: http://devicetree.org/meta-schemas/core.yaml#

标题: Freescale i.MX8qm/qxp 显示像素链接

维护者:
  - 刘颖 <victor.liu@nxp.com>

描述: |
  Freescale i.MX8qm/qxp 显示像素链接（DPL）在像素源（显示控制器或摄像头模块）和像素消费者（图像处理或显示器）之间形成了一个标准的异步连接。它由两个独立的功能组成：像素传输功能和控制接口。每个控制通道下可以存在多个像素通道。此绑定文档仅适用于像素源为显示控制器的像素链接。
  i.MX8qm/qxp 显示像素链接通过系统控制器单元（SCU）固件进行访问。

属性:
  compatible:
    枚举:
      - fsl,imx8qm-dc-pixel-link
      - fsl,imx8qxp-dc-pixel-link

  fsl,dc-id:
    $ref: /schemas/types.yaml#/definitions/uint8
    描述: |
      表示与像素链接相连的显示控制器索引的 u8 值
  fsl,dc-stream-id:
    $ref: /schemas/types.yaml#/definitions/uint8
    描述: |
      表示与像素链接相连的显示控制器流索引的 u8 值
    枚举: [0, 1]

  ports:
    $ref: /schemas/graph.yaml#/properties/ports

    属性:
      port@0:
        $ref: /schemas/graph.yaml#/properties/port
        描述: 来自上游视频源的像素链接输入端口节点
patternProperties:
      "^port@[1-4]$":
        $ref: /schemas/graph.yaml#/properties/port
        描述: 连接到下游桥接器的像素链接输出端口节点

所需属性:
  - port@0
  - port@1
  - port@2
  - port@3
  - port@4

allOf:
  - 如果:
      属性:
        compatible:
          包含:
            常量: fsl,imx8qxp-dc-pixel-link
    那么:
      属性:
        fsl,dc-id:
          常量: 0

  - 如果:
      属性:
        compatible:
          包含:
            常量: fsl,imx8qm-dc-pixel-link
    那么:
      属性:
        fsl,dc-id:
          枚举: [0, 1]

所需属性:
  - compatible
  - fsl,dc-id
  - fsl,dc-stream-id
  - ports

其他属性: false

示例:
  - |
    dc0-pixel-link0 {
        compatible = "fsl,imx8qxp-dc-pixel-link";
        fsl,dc-id = /bits/ 8 <0>;
        fsl,dc-stream-id = /bits/ 8 <0>;

        ports {
            #address-cells = <1>;
            #size-cells = <0>;

            /* 来自 dc0 的像素组合器通道0 */
            port@0 {
                reg = <0>;

                dc0_pixel_link0_dc0_pixel_combiner_ch0: endpoint {
                    remote-endpoint = <&dc0_pixel_combiner_ch0_dc0_pixel_link0>;
                };
            };

            /* 到 MIPI/LVDS 组合子系统的 PXL2DPIs */
            port@1 {
                #address-cells = <1>;
                #size-cells = <0>;
                reg = <1>;

                dc0_pixel_link0_mipi_lvds_0_pxl2dpi: endpoint@0 {
                    reg = <0>;
                    remote-endpoint = <&mipi_lvds_0_pxl2dpi_dc0_pixel_link0>;
                };

                dc0_pixel_link0_mipi_lvds_1_pxl2dpi: endpoint@1 {
                    reg = <1>;
                    remote-endpoint = <&mipi_lvds_1_pxl2dpi_dc0_pixel_link0>;
                };
            };

            /* 未使用 */
            port@2 {
                reg = <2>;
            };

            /* 未使用 */
            port@3 {
                reg = <3>;
            };

            /* 到图像处理子系统 */
            port@4 {
                reg = <4>;
            };
        };
    };
```

## Documentation/devicetree/bindings/display/bridge/fsl,imx8qxp-pxl2dpi_cn.yaml
```yaml
下面是给定内容的中文翻译：

# SPDX-文件许可标识符: (GPL-2.0-only 或 BSD-2-Clause)
%YAML 1.2
---
$id: http://devicetree.org/schemas/display/bridge/fsl,imx8qxp-pxl2dpi.yaml#
$schema: http://devicetree.org/meta-schemas/core.yaml#

标题: NXP i.MX8qxp 像素链路到显示像素接口

维护者:
  - Liu Ying <victor.liu@nxp.com>

描述: |
  NXP i.MX8qxp 像素链路到显示像素接口 (PXL2DPI) 将像素链路的 36 位数据输出与 DSI 控制器的 MIPI-DPI 24 位数据输入以及用于 LVDS 模式的 LVDS 显示桥接 (LDB) 模块的输入相连接，以重新映射这些模块之间的像素颜色编码。
  此模块完全由组合逻辑构成。
  i.MX8qxp PXL2DPI 通过控制和状态寄存器 (CSR) 模块进行控制。
  作为系统控制器的 CSR 模块包含 PXL2DPI 的配置寄存器。

属性:
  compatible:
    常量: fsl,imx8qxp-pxl2dpi

  fsl,sc-resource:
    $ref: /schemas/types.yaml#/definitions/uint32
    描述: 与此 PXL2DPI 实例关联的 SCU 资源 ID
电源域:
    最大项数: 1

  fsl,companion-pxl2dpi:
    $ref: /schemas/types.yaml#/definitions/phandle
    描述: |
      一个指向下游 LVDS 显示桥接 (LDB) 在拆分模式下使用的配套 PXL2DPI 的 phandle
端口:
    $ref: /schemas/graph.yaml#/properties/ports

    属性:
      port@0:
        $ref: /schemas/graph.yaml#/properties/port
        描述: 从像素链路到 PXL2DPI 的输入端口节点
port@1:
        $ref: /schemas/graph.yaml#/properties/port
        描述: 从 PXL2DPI 到下游桥接的输出端口节点
必需:
      - port@0
      - port@1

必需:
  - compatible
  - fsl,sc-resource
  - 电源域
  - 端口

其他属性: false

示例:
  - |
    #include <dt-bindings/firmware/imx/rsrc.h>
    pxl2dpi {
        compatible = "fsl,imx8qxp-pxl2dpi";
        fsl,sc-resource = <IMX_SC_R_MIPI_0>;
        电源域 = <&pd IMX_SC_R_MIPI_0>;

        端口 {
            #address-cells = <1>;
            #size-cells = <0>;

            port@0 {
                #address-cells = <1>;
                #size-cells = <0>;
                reg = <0>;

                mipi_lvds_0_pxl2dpi_dc_pixel_link0: endpoint@0 {
                    reg = <0>;
                    远程端点 = <&dc_pixel_link0_mipi_lvds_0_pxl2dpi>;
                };

                mipi_lvds_0_pxl2dpi_dc_pixel_link1: endpoint@1 {
                     reg = <1>;
                     远程端点 = <&dc_pixel_link1_mipi_lvds_0_pxl2dpi>;
                };
            };

            port@1 {
                #address-cells = <1>;
                #size-cells = <0>;
                reg = <1>;

                mipi_lvds_0_pxl2dpi_mipi_lvds_0_ldb_ch0: endpoint@0 {
                    reg = <0>;
                    远程端点 = <&mipi_lvds_0_ldb_ch0_mipi_lvds_0_pxl2dpi>;
                };

                mipi_lvds_0_pxl2dpi_mipi_lvds_0_ldb_ch1: endpoint@1 {
                    reg = <1>;
                    远程端点 = <&mipi_lvds_0_ldb_ch1_mipi_lvds_0_pxl2dpi>;
                };
            };
        };
    };
```

## Documentation/devicetree/bindings/display/bridge/fsl,imx93-mipi-dsi_cn.yaml
~~~~yaml
下面是给定内容的中文翻译：

```yaml
# SPDX-文件许可标识符: (GPL-2.0-only 或 BSD-2-Clause)
%YAML 1.2
---
$id: http://devicetree.org/schemas/display/bridge/fsl,imx93-mipi-dsi.yaml#
$schema: http://devicetree.org/meta-schemas/core.yaml#

标题: Freescale i.MX93 对 Synopsys Designware MIPI DSI 的特定扩展

维护者:
  - 刘颖 <victor.liu@nxp.com>

描述: |
  在 Freescale i.MX93 SoC 中嵌入了一个 Synopsys Designware MIPI DSI 主控制器和一个 Synopsys Designware MIPI DPHY。一些配置和扩展由 i.MX93 多媒体块控制器控制。
allOf:
  - $ref: snps,dw-mipi-dsi.yaml#

属性:
  compatible:
    常量: fsl,imx93-mipi-dsi

  clocks:
    items:
      - 描述: APB 时钟
      - 描述: 像素时钟
      - 描述: PHY 配置时钟
      - 描述: PHY 参考时钟

  clock-names:
    items:
      - 常量: pclk
      - 常量: pix
      - 常量: phy_cfg
      - 常量: phy_ref

  interrupts:
    最大项数: 1

  fsl,media-blk-ctrl:
    $ref: /schemas/types.yaml#/definitions/phandle
    描述:
      i.MX93 多媒体块控制器作为系统控制器，通过 PLL SoC 接口控制从 LCDIF 显示控制器到 MIPI DSI 主控制器的像素组件位图配置以及与 MIPI DPHY PLL 相关的配置
电源域:
    最大项数: 1

必需:
  - compatible
  - interrupts
  - fsl,media-blk-ctrl
  - 电源域

未评估属性: false

示例:
  - |
    #include <dt-bindings/clock/imx93-clock.h>
    #include <dt-bindings/gpio/gpio.h>
    #include <dt-bindings/interrupt-controller/arm-gic.h>
    #include <dt-bindings/power/fsl,imx93-power.h>

    dsi@4ae10000 {
        compatible = "fsl,imx93-mipi-dsi";
        reg = <0x4ae10000 0x10000>;
        interrupts = <GIC_SPI 177 IRQ_TYPE_LEVEL_HIGH>;
        clocks = <&clk IMX93_CLK_MIPI_DSI_GATE>,
                 <&clk IMX93_CLK_MEDIA_DISP_PIX>,
                 <&clk IMX93_CLK_MIPI_PHY_CFG>,
                 <&clk IMX93_CLK_24M>;
        clock-names = "pclk", "pix", "phy_cfg", "phy_ref";
        fsl,media-blk-ctrl = <&media_blk_ctrl>;
        power-domains = <&media_blk_ctrl IMX93_MEDIABLK_PD_MIPI_DSI>;
        #address-cells = <1>;
        #size-cells = <0>;

        panel@0 {
            compatible = "raydium,rm67191";
            reg = <0>;
            reset-gpios = <&adp5585gpio 6 GPIO_ACTIVE_LOW>;
            dsi-lanes = <4>;
            video-mode = <2>;

            port {
                panel_in: endpoint {
                    remote-endpoint = <&dsi_out>;
                };
            };
        };

        ports {
            #address-cells = <1>;
            #size-cells = <0>;

            port@0 {
                reg = <0>;

                dsi_to_lcdif: endpoint {
                    remote-endpoint = <&lcdif_to_dsi>;
                };
            };

            port@1 {
                reg = <1>;

                dsi_out: endpoint {
                    remote-endpoint = <&panel_in>;
                };
            };
        };
    };
```
```
~~~~
