## Documentation/devicetree/bindings/display/panel/samsung,lms380kf01_cn.yaml
~~~~yaml
下面是给定文档的中文翻译：

```yaml
# SPDX-License-Identifier: (GPL-2.0-only OR BSD-2-Clause)
%YAML 1.2
---
$id: http://devicetree.org/schemas/display/panel/samsung,lms380kf01.yaml#
$schema: http://devicetree.org/meta-schemas/core.yaml#

title: 三星 LMS380KF01 显示屏面板

description: LMS380KF01 是三星移动显示（SMD）生产的一款分辨率为 480x800 DPI 的显示屏面板，采用 WideChips WS2401 显示控制器。它支持内部或外部背光控制。
maintainers:
  - Linus Walleij <linus.walleij@linaro.org>

allOf:
  - $ref: panel-common.yaml#
  - $ref: /schemas/spi/spi-peripheral-props.yaml#

properties:
  compatible:
    const: samsung,lms380kf01

  reg:
    maxItems: 1

  interrupts:
    description: 提供一个可选的静电放电 (ESD) 中断，用于指示显示屏硬件出现异常。此中断也可能因其他原因（如配置错误）而触发。
    maxItems: 1

  reset-gpios: true

  vci-supply:
    description: 为 VCI 模拟电压供电的稳压器，通常电压约为 3.0 V。

  vccio-supply:
    description: 为 VCCIO 电压供电的稳压器，通常电压约为 1.8 V。

  backlight: true

  spi-cpha: true

  spi-cpol: true

  spi-max-frequency:
    maximum: 1200000

  port: true

required:
  - compatible
  - reg
  - spi-cpha
  - spi-cpol
  - port

unevaluatedProperties: false

examples:
  - |
    #include <dt-bindings/gpio/gpio.h>
    #include <dt-bindings/interrupt-controller/irq.h>

    spi {
        compatible = "spi-gpio";
        sck-gpios = <&gpio 0 GPIO_ACTIVE_HIGH>;
        miso-gpios = <&gpio 1 GPIO_ACTIVE_HIGH>;
        mosi-gpios = <&gpio 2 GPIO_ACTIVE_HIGH>;
        cs-gpios = <&gpio 3 GPIO_ACTIVE_HIGH>;
        num-chipselects = <1>;
        #address-cells = <1>;
        #size-cells = <0>;

        panel@0 {
            compatible = "samsung,lms380kf01";
            spi-max-frequency = <1200000>;
            spi-cpha;
            spi-cpol;
            reg = <0>;
            vci-supply = <&lcd_3v0_reg>;
            vccio-supply = <&lcd_1v8_reg>;
            reset-gpios = <&gpio 4 GPIO_ACTIVE_LOW>;
            interrupt-parent = <&gpio>;
            interrupts = <5 IRQ_TYPE_EDGE_RISING>;

            port {
                panel_in: endpoint {
                    remote-endpoint = <&display_out>;
                };
            };
        };
    };
```

这段 YAML 文件描述了三星 LMS380KF01 显示屏面板在设备树中的配置细节。
~~~~

## Documentation/devicetree/bindings/display/panel/samsung,lms397kf04_cn.yaml
```yaml
# SPDX-文件许可人: (GPL-2.0-only 或 BSD-2-Clause)
%YAML 1.2
---
$id: http://devicetree.org/schemas/display/panel/samsung,lms397kf04.yaml#
$schema: http://devicetree.org/meta-schemas/core.yaml#

title: 三星 LMS397KF04 显示屏面板

description: 数据手册声称这是基于一个名为 DB7430 的显示屏控制器，并且有一个独立的背光控制器
maintainers:
  - Linus Walleij <linus.walleij@linaro.org>

allOf:
  - $ref: panel-common.yaml#
  - $ref: /schemas/spi/spi-peripheral-props.yaml#

properties:
  compatible:
    const: samsung,lms397kf04

  reg:
    maxItems: 1

  reset-gpios: true

  vci-supply:
    description: 提供 VCI 模拟电压（通常约为 3.0 V）的调节器

  vccio-supply:
    description: 提供 VCCIO 电压（通常约为 1.8 V）的调节器

  backlight: true

  spi-cpha: true

  spi-cpol: true

  spi-max-frequency:
    description: 作为 SPI 客户节点继承，数据手册规定了最小周期为最大 300 ns，这给出了大约 3 MHz 的最大频率
    maximum: 3000000

  port: true

required:
  - compatible
  - reg
  - spi-cpha
  - spi-cpol
  - port

unevaluatedProperties: false

examples:
  - |
    #include <dt-bindings/gpio/gpio.h>

    spi {
      compatible = "spi-gpio";
      sck-gpios = <&gpio 0 GPIO_ACTIVE_HIGH>;
      miso-gpios = <&gpio 1 GPIO_ACTIVE_HIGH>;
      mosi-gpios = <&gpio 2 GPIO_ACTIVE_HIGH>;
      cs-gpios = <&gpio 3 GPIO_ACTIVE_HIGH>;
      num-chipselects = <1>;
      #address-cells = <1>;
      #size-cells = <0>;
      panel@0 {
        compatible = "samsung,lms397kf04";
        spi-max-frequency = <3000000>;
        spi-cpha;
        spi-cpol;
        reg = <0>;
        vci-supply = <&lcd_3v0_reg>;
        vccio-supply = <&lcd_1v8_reg>;
        reset-gpios = <&gpio 4 GPIO_ACTIVE_LOW>;
        backlight = <&ktd259>;

        port {
          panel_in: endpoint {
            remote-endpoint = <&display_out>;
          };
        };
      };
    };
```

## Documentation/devicetree/bindings/display/panel/samsung,s6d16d0_cn.yaml
```yaml
# SPDX-许可证标识符: GPL-2.0
%YAML 1.2
---
$id: http://devicetree.org/schemas/display/panel/samsung,s6d16d0.yaml#
$schema: http://devicetree.org/meta-schemas/core.yaml#

title: 三星 S6D16D0 4英寸 864x480 AMOLED 显示屏

维护者:
  - Linus Walleij <linus.walleij@linaro.org>

allOf:
  - $ref: panel-common.yaml#

属性:
  compatible:
    常量: samsung,s6d16d0

  reg:
    最大项数: 1

  port: true
  reset-gpios: true

  vdd1-supply:
    描述: 输入/输出电压供应

必需:
  - compatible
  - reg
  - vdd1-supply
  - reset-gpios

额外属性: false

示例:
  - |
    #include <dt-bindings/gpio/gpio.h>

    dsi {
        #address-cells = <1>;
        #size-cells = <0>;

        panel@0 {
            compatible = "samsung,s6d16d0";
            reg = <0>;
            vdd1-supply = <&foo>;
            reset-gpios = <&foo_gpio 0 GPIO_ACTIVE_LOW>;

            port {
                panel_in: endpoint {
                    remote-endpoint = <&dsi_out>;
                };
            };
        };
    };

..
```

## Documentation/devicetree/bindings/display/panel/samsung,s6d27a1_cn.yaml
~~~~yaml
下面是给定内容的中文翻译：

```yaml
# SPDX-文件许可标识符: (GPL-2.0-only 或 BSD-2-Clause)
%YAML 1.2
---
$id: http://devicetree.org/schemas/display/panel/samsung,s6d27a1.yaml#
$schema: http://devicetree.org/meta-schemas/core.yaml#

标题: 三星 S6D27A1 显示面板

描述: S6D27A1 是三星移动显示（SMD）生产的一款分辨率为 480x800 DPI 的显示面板
维护者:
  - Markuss Broks <markuss.broks@gmail.com>

allOf:
  - $ref: panel-common.yaml#
  - $ref: /schemas/spi/spi-peripheral-props.yaml#

属性:
  compatible:
    常量: samsung,s6d27a1

  reg:
    最大项数: 1

  interrupts:
    描述: 提供一个可选的静电放电（ESD）中断，用于指示显示硬件出现异常
      此中断也可能因其他原因被触发，例如配置错误
    最大项数: 1

  reset-gpios: true

  vci-supply:
    描述: 为 VCI 模拟电压供电的稳压器
      通常电压约为 3.0V

  vccio-supply:
    描述: 为 VCCIO 电压供电的稳压器
      通常电压约为 1.8V

  backlight: true

  spi-cpha: true

  spi-cpol: true

  spi-max-frequency:
    最大值: 1200000

  port: true

必需:
  - compatible
  - reg
  - vci-supply
  - vccio-supply
  - spi-cpha
  - spi-cpol
  - port

未评估属性: false

示例:
  - |
    #include <dt-bindings/gpio/gpio.h>
    #include <dt-bindings/interrupt-controller/irq.h>

    spi {
        compatible = "spi-gpio";
        sck-gpios = <&gpio 0 GPIO_ACTIVE_HIGH>;
        miso-gpios = <&gpio 1 GPIO_ACTIVE_HIGH>;
        mosi-gpios = <&gpio 2 GPIO_ACTIVE_HIGH>;
        cs-gpios = <&gpio 3 GPIO_ACTIVE_HIGH>;
        num-chipselects = <1>;
        #address-cells = <1>;
        #size-cells = <0>;
        panel@0 {
            compatible = "samsung,s6d27a1";
            spi-max-frequency = <1200000>;
            spi-cpha;
            spi-cpol;
            reg = <0>;
            vci-supply = <&lcd_3v0_reg>;
            vccio-supply = <&lcd_1v8_reg>;
            reset-gpios = <&gpio 4 GPIO_ACTIVE_LOW>;
            interrupt-parent = <&gpio>;
            interrupts = <5 IRQ_TYPE_EDGE_RISING>;

            port {
                panel_in: endpoint {
                    remote-endpoint = <&display_out>;
                };
            };
        };
    };
..
```

请注意，上述翻译保持了 YAML 格式和示例代码中的语法不变。
~~~~

## Documentation/devicetree/bindings/display/panel/samsung,s6d7aa0_cn.yaml
```yaml
# SPDX-文件许可人: (GPL-2.0-only 或 BSD-2-Clause)
%YAML 1.2
---
$id: http://devicetree.org/schemas/display/panel/samsung,s6d7aa0.yaml#
$schema: http://devicetree.org/meta-schemas/core.yaml#

title: 三星 S6D7AA0 MIPI-DSI LCD 面板控制器

maintainers:
  - Artur Weber <aweber.kernel@gmail.com>

allOf:
  - $ref: panel-common.yaml#

properties:
  compatible:
    items:
      - enum:
          # 1280x800 LSL080AL02 面板
          - samsung,lsl080al02
          # 1024x768 LSL080AL03 面板
          - samsung,lsl080al03
          # 1024x768 LTL101AT01 面板
          - samsung,ltl101at01
      - const: samsung,s6d7aa0

  reg:
    maxItems: 1

  backlight:
    description:
      用于面板的背光。如果此属性设置在具有基于 DSI 的背光控制的面板上（LSL080AL03 和 LTL101AT01），
      它将覆盖基于 DSI 的背光。

  reset-gpios:
    description: 重置 GPIO 引脚，通常为 GPIO_ACTIVE_LOW
  power-supply:
    description:
      面板的主要电源供应；不同面板的具体电压各不相同，
      并且通常大约在 3.3-5V 左右。
  vmipi-supply:
    description: VMIPI 供电，通常为 1.8V

required:
  - compatible
  - reg
  - reset-gpios

additionalProperties: false

examples:
  - |
    #include <dt-bindings/gpio/gpio.h>

    dsi {
        #address-cells = <1>;
        #size-cells = <0>;

        panel@0 {
            compatible = "samsung,lsl080al02", "samsung,s6d7aa0";
            reg = <0>;
            power-supply = <&display_3v3_supply>;
            reset-gpios = <&gpf0 4 GPIO_ACTIVE_LOW>;
            backlight = <&backlight>;
        };
    };

..
```

## Documentation/devicetree/bindings/display/panel/samsung,s6e63m0_cn.yaml
```yaml
# SPDX-许可证标识符: GPL-2.0
%YAML 1.2
---
$id: http://devicetree.org/schemas/display/panel/samsung,s6e63m0.yaml#
$schema: http://devicetree.org/meta-schemas/core.yaml#

标题: Samsung s6e63m0 AMOLED 液晶面板

维护者:
  - Jonathan Bakker <xc-racer2@live.ca>

allOf:
  - $ref: panel-common.yaml#
  - $ref: /schemas/leds/backlight/common.yaml#
  - $ref: /schemas/spi/spi-peripheral-props.yaml#

属性:
  compatible:
    常量: samsung,s6e63m0

  reg:
    最大项数: 1

  reset-gpios: 真
  port: 真
  default-brightness: 真
  max-brightness: 真

  spi-3wire: 真
  spi-cpha: 真
  spi-cpol: 真

  vdd3-supply:
    描述: VDD 调节器

  vci-supply:
    描述: VCI 调节器

必需:
  - compatible
  - reset-gpios
  - vdd3-supply
  - vci-supply

未评估属性: 假

示例:
  - |
    spi {
        #address-cells = <1>;
        #size-cells = <0>;

        display@0 {
            compatible = "samsung,s6e63m0";
            reg = <0>;
            reset-gpios = <&mp05 5 1>;
            vdd3-supply = <&ldo12_reg>;
            vci-supply = <&ldo11_reg>;
            spi-max-frequency = <1200000>;

            port {
                lcd_ep: endpoint {
                    remote-endpoint = <&fimd_ep>;
                };
            };
        };
    };
```

## Documentation/devicetree/bindings/display/panel/samsung,s6e88a0-ams452ef01_cn.yaml
~~~~yaml
```yaml
# SPDX-许可证标识符: (GPL-2.0-only 或 BSD-2-Clause)
%YAML 1.2
---
$id: http://devicetree.org/schemas/display/panel/samsung,s6e88a0-ams452ef01.yaml#
$schema: http://devicetree.org/meta-schemas/core.yaml#

title: 三星 AMS452EF01 AMOLED 显示屏与 S6E88A0 视频模式 DSI 控制器

maintainers:
  - Michael Srba <Michael.Srba@seznam.cz>

allOf:
  - $ref: panel-common.yaml#

properties:
  compatible:
    const: samsung,s6e88a0-ams452ef01

  reg:
    maxItems: 1

  port: true
  reset-gpios: true
  vdd3-supply:
    description: 核心电压供电
  vci-supply:
    description: 模拟电路的电压供电

required:
  - compatible
  - reg
  - port
  - vdd3-supply
  - vci-supply
  - reset-gpios

additionalProperties: false

examples:
  - |
    #include <dt-bindings/gpio/gpio.h>

    dsi {
            #address-cells = <1>;
            #size-cells = <0>;
            panel@0 {
                    reg = <0>;

                    compatible = "samsung,s6e88a0-ams452ef01";

                    vdd3-supply = <&pm8916_l17>;
                    vci-supply = <&reg_vlcd_vci>;
                    reset-gpios = <&msmgpio 25 GPIO_ACTIVE_HIGH>;

                    port {
                            panel_in: endpoint {
                                    remote-endpoint = <&dsi0_out>;
                            };
                    };
            };
    };
```

这段 YAML 文件定义了一个设备树片段，描述了三星 AMS452EF01 AMOLED 显示屏和 S6E88A0 视频模式 DSI 控制器的配置。其中包含了兼容性声明、必需的属性以及示例配置。
~~~~

## Documentation/devicetree/bindings/display/panel/samsung,s6e8aa0_cn.yaml
```yaml
# SPDX-许可证标识符: GPL-2.0
%YAML 1.2
---
$id: http://devicetree.org/schemas/display/panel/samsung,s6e8aa0.yaml#
$schema: http://devicetree.org/meta-schemas/core.yaml#

标题: Samsung S6E8AA0 AMOLED 液晶显示屏 5.3 英寸面板

维护者:
  - Andrzej Hajda <a.hajda@samsung.com>

allOf:
  - $ref: panel-common.yaml#

属性:
  compatible:
    常量: samsung,s6e8aa0

  reg:
    最大项数: 1

  reset-gpios: 真
  display-timings: 真

  vdd3-supply:
    描述: 核心电压供电

  vci-supply:
    描述: 模拟电路的电压供电

  power-on-delay:
    描述: 在开启稳压器后的延迟 [毫秒]
    $ref: /schemas/types.yaml#/definitions/uint32

  reset-delay:
    描述: 复位序列后的延迟 [毫秒]
    $ref: /schemas/types.yaml#/definitions/uint32

  init-delay:
    描述: 初始化序列后的延迟 [毫秒]
    $ref: /schemas/types.yaml#/definitions/uint32

  panel-width-mm:
    描述: 面板物理宽度 [毫米]

  panel-height-mm:
    描述: 面板物理高度 [毫米]

  flip-horizontal:
    描述: 是否水平翻转图像的布尔值
    类型: 布尔

  flip-vertical:
    描述: 是否垂直翻转图像的布尔值
    类型: 布尔

必需:
  - compatible
  - reg
  - vdd3-supply
  - vci-supply
  - reset-gpios
  - display-timings

额外属性: 错误

示例:
  - |
    dsi {
        #address-cells = <1>;
        #size-cells = <0>;

        panel@0 {
            compatible = "samsung,s6e8aa0";
            reg = <0>;
            vdd3-supply = <&vcclcd_reg>;
            vci-supply = <&vlcd_reg>;
            reset-gpios = <&gpy4 5 0>;
            power-on-delay = <50>;
            reset-delay = <100>;
            init-delay = <100>;
            panel-width-mm = <58>;
            panel-height-mm = <103>;
            flip-horizontal;
            flip-vertical;

            display-timings {
                timing0: timing-0 {
                    clock-frequency = <57153600>;
                    hactive = <720>;
                    vactive = <1280>;
                    hfront-porch = <5>;
                    hback-porch = <5>;
                    hsync-len = <5>;
                    vfront-porch = <13>;
                    vback-porch = <1>;
                    vsync-len = <2>;
                };
            };
        };
    };
```
