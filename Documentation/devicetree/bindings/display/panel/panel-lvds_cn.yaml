## Documentation/devicetree/bindings/display/panel/pda,91-00156-a0_cn.yaml
```yaml
# SPDX-许可证标识符: GPL-2.0
%YAML 1.2
---
$id: http://devicetree.org/schemas/display/panel/pda,91-00156-a0.yaml#
$schema: http://devicetree.org/meta-schemas/core.yaml#

标题: PDA 91-00156-A0 5.0英寸WVGA TFT LCD显示屏

维护者:
  - Cristian Birsan <cristian.birsan@microchip.com>
  - Thierry Reding <thierry.reding@gmail.com>

全部包括:
  - $ref: panel-common.yaml#

属性:
  compatible:
    常量: pda,91-00156-a0

  power-supply: 真
  backlight: 真
  port: 真

额外属性: 假

必需:
  - compatible
  - power-supply
  - backlight

..
```

## Documentation/devicetree/bindings/display/panel/raspberrypi,7inch-touchscreen_cn.yaml
```yaml
# SPDX-文件许可人: GPL-2.0
%YAML 1.2
---
$id: http://devicetree.org/schemas/display/panel/raspberrypi,7inch-touchscreen.yaml#
$schema: http://devicetree.org/meta-schemas/core.yaml#

标题: 官方的7英寸(800x480)树莓派触摸屏

维护者:
  - Eric Anholt <eric@anholt.net>
  - Thierry Reding <thierry.reding@gmail.com>

描述: |+
  此DSI面板包含:

  - TC358762 DSI->DPI桥接器
  - 在I2C上的Atmel微控制器，用于为DSI桥接器供电序列和
    控制背光
  - 在I2C上的触摸屏控制器，用于触摸输入

  本绑定涵盖了DSI显示部分，但不包括其触摸输入
属性:
  compatible:
    常量: raspberrypi,7inch-touchscreen-panel

  reg:
    常量: 0x45

  port: 真

必需:
  - compatible
  - reg
  - port

额外属性: 假

示例:
  - |+
    dsi1: dsi {
      #address-cells = <1>;
      #size-cells = <0>;

      port {
        dsi_out_port: endpoint {
          remote-endpoint = <&panel_dsi_port>;
        };
      };
    };

    i2c_dsi: i2c {
      compatible = "i2c-gpio";
      #address-cells = <1>;
      #size-cells = <0>;
      scl-gpios = <&gpio 28 0>;
      sda-gpios = <&gpio 29 0>;

      lcd@45 {
        compatible = "raspberrypi,7inch-touchscreen-panel";
        reg = <0x45>;

        port {
          panel_dsi_port: endpoint {
            remote-endpoint = <&dsi_out_port>;
          };
        };
      };
    };
```

## Documentation/devicetree/bindings/display/panel/raydium,rm67191_cn.yaml
```yaml
# SPDX-文件许可人: GPL-2.0
%YAML 1.2
---
$id: http://devicetree.org/schemas/display/panel/raydium,rm67191.yaml#
$schema: http://devicetree.org/meta-schemas/core.yaml#

title: 使用MIPI-DSI协议的Raydium RM67171 OLED LCD面板

维护者:
  - Robert Chiras <robert.chiras@nxp.com>

allOf:
  - $ref: panel-common.yaml#

属性:
  compatible:
    常量: raydium,rm67191

  reg:
    maxItems: 1

  port: true
  reset-gpios: true
  width-mm: true
  height-mm: true

  dsi-lanes:
    描述: 要使用的DSI通道数量必须是<3>或<4>
    $ref: /schemas/types.yaml#/definitions/uint32
    枚举: [3, 4]

  v3p3-supply:
    描述: 对3.3V调节器的phandle，该调节器为VDD_3V3引脚供电

  v1p8-supply:
    描述: 对1.8V调节器的phandle，该调节器为VDD_1V8引脚供电

  video-mode:
    描述: |
      0 - 爆发模式
      1 - 非爆发模式，带同步事件
      2 - 非爆发模式，带同步脉冲
    $ref: /schemas/types.yaml#/definitions/uint32
    枚举: [0, 1, 2]

必需:
  - compatible
  - reg
  - dsi-lanes
  - port

additionalProperties: false

示例:
  - |
    #include <dt-bindings/gpio/gpio.h>

    dsi {
        #address-cells = <1>;
        #size-cells = <0>;

        panel@0 {
            compatible = "raydium,rm67191";
            reg = <0>;
            reset-gpios = <&gpio1 7 GPIO_ACTIVE_LOW>;
            dsi-lanes = <4>;
            width-mm = <68>;
            height-mm = <121>;
            video-mode = <1>;

            port {
                panel_in: endpoint {
                    remote-endpoint = <&mipi_out>;
                };
            };
        };
    };

..
```

## Documentation/devicetree/bindings/display/panel/raydium,rm68200_cn.yaml
~~~~yaml
```yaml
# SPDX-许可证标识符: (GPL-2.0-only 或 BSD-2-Clause)
%YAML 1.2
---
$id: http://devicetree.org/schemas/display/panel/raydium,rm68200.yaml#
$schema: http://devicetree.org/meta-schemas/core.yaml#

title: Raydium 半导体公司 RM68200 5.5英寸 720p MIPI-DSI TFT 液晶屏

maintainers:
  - Philippe CORNU <philippe.cornu@foss.st.com>

description: |
  Raydium 半导体公司的 RM68200 是一个使用 MIPI-DSI 视频接口连接的 5.5英寸 720x1280 TFT 液晶屏
allOf:
  - $ref: panel-common.yaml#

properties:

  compatible:
    const: raydium,rm68200

  reg:
    maxItems: 1
    description: DSI 虚拟通道

  backlight: true
  enable-gpios: true
  port: true
  power-supply: true

  reset-gpios:
    maxItems: 1

additionalProperties: false

required:
  - compatible
  - power-supply
  - reg

examples:
  - |
    dsi {
      #address-cells = <1>;
      #size-cells = <0>;
      panel@0 {
        compatible = "raydium,rm68200";
        reg = <0>;
        reset-gpios = <&gpiof 15 0>;
        power-supply = <&v1v8>;
        backlight = <&pwm_backlight>;
      };
    };
..
```
~~~~

## Documentation/devicetree/bindings/display/panel/raydium,rm692e5_cn.yaml
```yaml
# SPDX-许可证标识符: GPL-2.0-only 或 BSD-2-Clause
%YAML 1.2
---
$id: http://devicetree.org/schemas/display/panel/raydium,rm692e5.yaml#
$schema: http://devicetree.org/meta-schemas/core.yaml#

标题: 基于 Raydium RM692E5 的 DSI 显示屏面板

维护者:
  - Konrad Dybcio <konradybcio@kernel.org>

描述:
  Raydium RM692E5 是一种通用的 DSI 面板 IC，用于控制
  AMOLED 面板
allOf:
  - $ref: panel-common.yaml#

属性:
  compatible:
    items:
      - const: fairphone,fp5-rm692e5-boe
      - const: raydium,rm692e5

  reg:
    maxItems: 1

  dvdd-supply:
    描述: 数字电压轨

  vci-supply:
    描述: 模拟电压轨

  vddio-supply:
    描述: I/O 电压轨

  port: true

必需:
  - compatible
  - reg
  - reset-gpios
  - dvdd-supply
  - vci-supply
  - vddio-supply
  - port

未评估属性: false

示例:
  - |
    #include <dt-bindings/gpio/gpio.h>

    dsi {
        #address-cells = <1>;
        #size-cells = <0>;

        panel@0 {
            compatible = "fairphone,fp5-rm692e5-boe", "raydium,rm692e5";
            reg = <0>;

            reset-gpios = <&tlmm 44 GPIO_ACTIVE_LOW>;
            dvdd-supply = <&vreg_oled_vci>;
            vci-supply = <&vreg_l12c>;
            vddio-supply = <&vreg_oled_dvdd>;

            port {
                panel_in_0: endpoint {
                    remote-endpoint = <&dsi0_out>;
                };
            };
        };
    };

..
```

## Documentation/devicetree/bindings/display/panel/raydium,rm69380_cn.yaml
```yaml
# SPDX-文件许可人: GPL-2.0-only 或 BSD-2-Clause
%YAML 1.2
---
$id: http://devicetree.org/schemas/display/panel/raydium,rm69380.yaml#
$schema: http://devicetree.org/meta-schemas/core.yaml#

标题: 基于 Raydium RM69380 的 DSI 显示屏面板

维护者:
  - David Wronek <david@mainlining.org>

描述:
  Raydium RM69380 是一个通用的 DSI 面板控制芯片，用于控制 OLED 面板。
allOf:
  - $ref: panel-common-dual.yaml#

属性:
  compatible:
    items:
      - enum:
          - lenovo,j716f-edo-rm69380
      - const: raydium,rm69380
    描述: 这个字段指示了使用 RM69380 面板驱动程序的面板制造商。compatible 字符串确定了 RM69380 面板驱动程序应如何配置以与指定的面板一起工作。raydium,rm69380 compatible 字符串应该始终作为回退选项提供。
reg:
    maxItems: 1

  avdd-supply:
    描述: 模拟电压轨

  vddio-supply:
    描述: I/O 电压轨

  reset-gpios:
    maxItems: 1
    描述: 重置线的 GPIO 的 phandle - 这应该是低电平有效

必需:
  - compatible
  - reg
  - avdd-supply
  - vddio-supply
  - reset-gpios

未评估属性: false

示例:
  - |
    #include <dt-bindings/gpio/gpio.h>

    dsi {
        #address-cells = <1>;
        #size-cells = <0>;

        panel@0 {
            compatible = "lenovo,j716f-edo-rm69380", "raydium,rm69380";
            reg = <0>;

            avdd-supply = <&panel_avdd_regulator>;
            vddio-supply = <&vreg_l14a>;
            reset-gpios = <&tlmm 75 GPIO_ACTIVE_LOW>;

            ports {
                #address-cells = <1>;
                #size-cells = <0>;

                port@0 {
                    reg = <0>;
                    panel_in_0: endpoint {
                        remote-endpoint = <&mdss_dsi0_out>;
                    };
                };

                port@1 {
                    reg = <1>;
                    panel_in_1: endpoint {
                        remote-endpoint = <&mdss_dsi1_out>;
                    };
                };
            };
        };
    };
```

## Documentation/devicetree/bindings/display/panel/rocktech,jh057n00900_cn.yaml
~~~~yaml
```yaml
# SPDX-License-Identifier: (GPL-2.0-only OR BSD-2-Clause)
%YAML 1.2
---
$id: 'http://devicetree.org/schemas/display/panel/rocktech,jh057n00900.yaml#'
$schema: 'http://devicetree.org/meta-schemas/core.yaml#'

title: Rocktech JH057N00900 5.5" 720x1440 TFT LCD 面板

maintainers:
  - Ondrej Jirman <megi@xff.cz>
  - Guido Gŭnther <agx@sigxcpu.org>

description:
  Rocktech JH057N00900 是一个通过 MIPI-DSI 视频接口连接的 720x1440 TFT LCD 面板。
allOf:
  - $ref: 'panel-common.yaml#'

properties:
  compatible:
    enum:
      # Anberic RG353V-V2 5.0" 640x480 TFT LCD 面板
      - anbernic,rg353v-panel-v2
      # GameForce Chi 3.5" 640x480 TFT LCD 面板
      - gameforce,chi-panel
      # Powkiddy RGB10MAX3 5.0" 720x1280 TFT LCD 面板
      - powkiddy,rgb10max3-panel
      # Powkiddy RGB30 3.0" 720x720 TFT LCD 面板
      - powkiddy,rgb30-panel
      # Rocktech JH057N00900 5.5" 720x1440 TFT LCD 面板
      - rocktech,jh057n00900
      # Xingbangda XBD599 5.99" 720x1440 TFT LCD 面板
      - xingbangda,xbd599

  port: true
  reg:
    maxItems: 1
    description: DSI 虚拟通道

  vcc-supply:
    description: 面板电源供应

  iovcc-supply:
    description: I/O 电压供应

  reset-gpios: true

  backlight: true
  rotation: true

required:
  - compatible
  - reg
  - vcc-supply
  - iovcc-supply
  - reset-gpios

additionalProperties: false

examples:
  - |
    #include <dt-bindings/gpio/gpio.h>

    dsi {
        #address-cells = <1>;
        #size-cells = <0>;
        panel@0 {
            compatible = "rocktech,jh057n00900";
            reg = <0>;
            vcc-supply = <&reg_2v8_p>;
            iovcc-supply = <&reg_1v8_p>;
            reset-gpios = <&gpio3 13 GPIO_ACTIVE_LOW>;
            backlight = <&backlight>;
        };
    };
```
以上是您提供的 YAML 文件的中文翻译。请注意，某些关键字和属性名称保持原样，因为它们通常是固定的术语或标识符。
~~~~

## Documentation/devicetree/bindings/display/panel/ronbo,rb070d30_cn.yaml
```yaml
# SPDX-许可证标识符: (GPL-2.0+ 或 X11)
%YAML 1.2
---
$id: http://devicetree.org/schemas/display/panel/ronbo,rb070d30.yaml#
$schema: http://devicetree.org/meta-schemas/core.yaml#

title: Ronbo RB070D30 DSI 显示屏面板

maintainers:
  - Maxime Ripard <mripard@kernel.org>

properties:
  compatible:
    const: ronbo,rb070d30

  reg:
    maxItems: 1

  power-gpios:
    description: 用于电源引脚的 GPIO
    maxItems: 1

  reset-gpios:
    description: 用于复位引脚的 GPIO
    maxItems: 1

  shlr-gpios:
    description: 用于 shlr 引脚（水平翻转）的 GPIO
    maxItems: 1

  updn-gpios:
    description: 用于 updn 引脚（垂直翻转）的 GPIO
    maxItems: 1

  vcc-lcd-supply:
    description: 电源稳压器

  backlight:
    description: 面板使用的背光
    $ref: /schemas/types.yaml#/definitions/phandle

required:
  - compatible
  - power-gpios
  - reg
  - reset-gpios
  - shlr-gpios
  - updn-gpios
  - vcc-lcd-supply

additionalProperties: false
```

## Documentation/devicetree/bindings/display/panel/samsung,amoled-mipi-dsi_cn.yaml
```yaml
# SPDX-许可证标识符: GPL-2.0
%YAML 1.2
---
$id: http://devicetree.org/schemas/display/panel/samsung,amoled-mipi-dsi.yaml#
$schema: http://devicetree.org/meta-schemas/core.yaml#

标题: Samsung AMOLED MIPI-DSI 显示屏

维护者:
  - Hoegeun Kwon <hoegeun.kwon@samsung.com>

allOf:
  - $ref: panel-common.yaml#

  - if:
      properties:
        compatible:
          contains:
            enum:
              - samsung,s6e3ha2
              - samsung,s6e3hf2
    then:
      required:
        - enable-gpios

属性:
  compatible:
    枚举:
        # Samsung S6E63J0X03 1.63" 320x320 AMOLED 显示屏
      - samsung,s6e63j0x03
        # Samsung S6E3HA2 5.7" 1440x2560 AMOLED 显示屏
      - samsung,s6e3ha2
        # Samsung S6E3HF2 5.65" 1600x2560 AMOLED 显示屏
      - samsung,s6e3hf2

  reg:
    最大项目数: 1

  reset-gpios: 真
  enable-gpios: 真
  te-gpios: 真

  vdd3-supply:
    描述: 输入输出电压供应

  vci-supply:
    描述: 模拟电路的电压供应

必需:
  - compatible
  - reg
  - vdd3-supply
  - vci-supply
  - reset-gpios

额外属性: 假

示例:
  - |
    #include <dt-bindings/gpio/gpio.h>

    dsi {
        #address-cells = <1>;
        #size-cells = <0>;

        panel@0 {
            compatible = "samsung,s6e3ha2";
            reg = <0>;
            vdd3-supply = <&ldo27_reg>;
            vci-supply = <&ldo28_reg>;
            reset-gpios = <&gpg0 0 GPIO_ACTIVE_LOW>;
            enable-gpios = <&gpf1 5 GPIO_ACTIVE_HIGH>;
            te-gpios = <&gpf1 3 GPIO_ACTIVE_HIGH>;
        };
    };
```

## Documentation/devicetree/bindings/display/panel/samsung,ams495qa01_cn.yaml
```yaml
# SPDX-文件许可人: (GPL-2.0-only 或 BSD-2-Clause)
%YAML 1.2
---
$id: http://devicetree.org/schemas/display/panel/samsung,ams495qa01.yaml#
$schema: http://devicetree.org/meta-schemas/core.yaml#

title: 三星 AMS495QA01 显示屏，带有 Magnachip D53E6EA8966 控制器

maintainers:
  - Chris Morgan <macromorgan@hotmail.com>

allOf:
  - $ref: panel-common.yaml#
  - $ref: /schemas/spi/spi-peripheral-props.yaml#

properties:
  compatible:
    const: samsung,ams495qa01

  reg:
    maxItems: 1

  reset-gpios:
    description: 复位 GPIO，必须为 GPIO_ACTIVE_LOW
  elvdd-supply:
    description: 为显示屏供电的调节器
  enable-gpios: true
  port: true
  vdd-supply:
    description: 为显示屏逻辑部分供电的调节器

required:
  - compatible
  - reg
  - reset-gpios
  - vdd-supply

additionalProperties: false

examples:
  - |
    #include <dt-bindings/gpio/gpio.h>
    spi {
        #address-cells = <1>;
        #size-cells = <0>;
        panel@0 {
            compatible = "samsung,ams495qa01";
            reg = <0>;
            reset-gpios = <&gpio4 0 GPIO_ACTIVE_LOW>;
            vdd-supply = <&vcc_3v3>;

            port {
                mipi_in_panel: endpoint {
                  remote-endpoint = <&mipi_out_panel>;
                };
            };
        };
    };
```

## Documentation/devicetree/bindings/display/panel/samsung,atna33xc20_cn.yaml
~~~~yaml
```yaml
# SPDX-文件许可标识符: (GPL-2.0-only 或 BSD-2-Clause)
%YAML 1.2
---
$id: http://devicetree.org/schemas/display/panel/samsung,atna33xc20.yaml#
$schema: http://devicetree.org/meta-schemas/core.yaml#

title: 三星 13.3 英寸 FHD (1920x1080 像素) eDP AMOLED 显示屏

maintainers:
  - Douglas Anderson <dianders@chromium.org>

allOf:
  - $ref: panel-common.yaml#

properties:
  compatible:
    const: samsung,atna33xc20

  enable-gpios: true
  port: true
  power-supply: true
  no-hpd: true
  hpd-gpios: true

additionalProperties: false

required:
  - compatible
  - enable-gpios
  - power-supply

examples:
  - |
    #include <dt-bindings/clock/qcom,rpmh.h>
    #include <dt-bindings/gpio/gpio.h>
    #include <dt-bindings/interrupt-controller/irq.h>

    i2c {
      #address-cells = <1>;
      #size-cells = <0>;

      bridge@2d {
        compatible = "ti,sn65dsi86";
        reg = <0x2d>;

        interrupt-parent = <&tlmm>;
        interrupts = <10 IRQ_TYPE_LEVEL_HIGH>;

        enable-gpios = <&tlmm 102 GPIO_ACTIVE_HIGH>;

        vpll-supply = <&src_pp1800_s4a>;
        vccio-supply = <&src_pp1800_s4a>;
        vcca-supply = <&src_pp1200_l2a>;
        vcc-supply = <&src_pp1200_l2a>;

        clocks = <&rpmhcc RPMH_LN_BB_CLK2>;
        clock-names = "refclk";

        no-hpd;

        ports {
          #address-cells = <1>;
          #size-cells = <0>;

          port@0 {
            reg = <0>;
            endpoint {
              remote-endpoint = <&dsi0_out>;
            };
          };

          port@1 {
            reg = <1>;
            sn65dsi86_out: endpoint {
              remote-endpoint = <&panel_in_edp>;
            };
          };
        };

        aux-bus {
          panel {
            compatible = "samsung,atna33xc20";
            enable-gpios = <&tlmm 12 GPIO_ACTIVE_HIGH>;
            power-supply = <&pp3300_dx_edp>;
            hpd-gpios = <&sn65dsi86_bridge 2 GPIO_ACTIVE_HIGH>;

            port {
              panel_in_edp: endpoint {
                remote-endpoint = <&sn65dsi86_out>;
              };
            };
          };
        };
      };
    };
```

请注意，上述翻译尽可能保持了原文件的结构和内容不变。某些特定于设备树的标记（例如 `#address-cells`）以及变量（如 `&tlmm`）并未进行翻译，因为它们是特定上下文中的标识符或配置指令。
~~~~
