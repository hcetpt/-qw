## Documentation/devicetree/bindings/display/renesas,cmm_cn.yaml
```yaml
# SPDX-许可证标识符: GPL-2.0-only
%YAML 1.2
---
$id: http://devicetree.org/schemas/display/renesas,cmm.yaml#
$schema: http://devicetree.org/meta-schemas/core.yaml#

标题: Renesas R-Car 颜色管理模块 (CMM)

维护者:
  - Laurent Pinchart <laurent.pinchart@ideasonboard.com>
  - Kieran Bingham <kieran.bingham+renesas@ideasonboard.com>
  - Jacopo Mondi <jacopo+renesas@jmondi.org>

描述: |+
  连接到R-Car DU视频通道的Renesas R-Car颜色管理模块
  它提供了图像增强功能，如一维查找表 (LUT)、三维查找表 (CLU)、一维直方图生成 (HGO) 和颜色空间转换 (CSC)。

属性:
  compatible:
    oneOf:
      - items:
          - enum:
              - renesas,r8a7795-cmm
              - renesas,r8a7796-cmm
              - renesas,r8a77965-cmm
              - renesas,r8a77990-cmm
              - renesas,r8a77995-cmm
          - const: renesas,rcar-gen3-cmm
      - items:
          - const: renesas,rcar-gen2-cmm

  reg:
    maxItems: 1

  clocks:
    maxItems: 1

  resets:
    maxItems: 1

  power-domains:
    maxItems: 1

必需:
  - compatible
  - reg
  - clocks
  - resets
  - power-domains

额外属性: false

示例:
  - |
    #include <dt-bindings/clock/r8a7796-cpg-mssr.h>
    #include <dt-bindings/power/r8a7796-sysc.h>

    cmm0: cmm@fea40000 {
         compatible = "renesas,r8a7796-cmm",
                      "renesas,rcar-gen3-cmm";
         reg = <0xfea40000 0x1000>;
         power-domains = <&sysc R8A7796_PD_ALWAYS_ON>;
         clocks = <&cpg CPG_MOD 711>;
         resets = <&cpg 711>;
    };
```
