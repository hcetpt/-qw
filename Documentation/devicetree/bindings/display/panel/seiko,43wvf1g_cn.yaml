## Documentation/devicetree/bindings/display/panel/sony,tulip-truly-nt35521_cn.yaml
~~~~yaml
```yaml
# SPDX-文件许可标识: (GPL-2.0-only 或 BSD-2-Clause)
%YAML 1.2
---
$id: http://devicetree.org/schemas/display/panel/sony,tulip-truly-nt35521.yaml#
$schema: http://devicetree.org/meta-schemas/core.yaml#

title: 索尼 Tulip Truly NT35521 5.24英寸 1280x720 MIPI-DSI 显示屏

maintainers:
  - Shawn Guo <shawn.guo@linaro.org>

description: |
  索尼 Tulip Truly NT35521 是一款 5.24英寸 1280x720 的 MIPI-DSI 显示屏，可以在索尼 Xperia M4 手机中找到。该显示屏的背光是通过 DSI 链路管理的。
allOf:
  - $ref: panel-common.yaml#

properties:
  compatible:
    const: sony,tulip-truly-nt35521

  reg:
    maxItems: 1

  positive5-supply:
    description: 正5伏供电

  negative5-supply:
    description: 负5伏供电

  reset-gpios: true

  enable-gpios: true

  port: true

required:
  - compatible
  - reg
  - positive5-supply
  - negative5-supply
  - reset-gpios
  - enable-gpios
  - port

additionalProperties: false

examples:
  - |
    #include <dt-bindings/gpio/gpio.h>

    dsi {
        #address-cells = <1>;
        #size-cells = <0>;

        panel@0 {
            compatible = "sony,tulip-truly-nt35521";
            reg = <0>;
            positive5-supply = <&positive5_reg>;
            negative5-supply = <&negative5_reg>;
            reset-gpios = <&msmgpio 25 GPIO_ACTIVE_LOW>;
            enable-gpios = <&msmgpio 10 GPIO_ACTIVE_HIGH>;

            port {
                panel_in: endpoint {
                    remote-endpoint = <&dsi0_out>;
                };
            };
        };
    };
```
以上内容是对原始 YAML 文件的中文翻译。请注意，由于 YAML 格式不支持中文字符作为键（如 `compatible`），因此这部分内容未直接翻译为中文。实际使用时，应保持这些键为英文。
~~~~

## Documentation/devicetree/bindings/display/panel/startek,kd070fhfid015_cn.yaml
~~~~yaml
```yaml
# SPDX-许可证标识符: GPL-2.0-only 或 BSD-2-Clause
%YAML 1.2
---
$id: http://devicetree.org/schemas/display/panel/startek,kd070fhfid015.yaml#
$schema: http://devicetree.org/meta-schemas/core.yaml#

title: StarTek 电子技术公司的 kd070fhfid015 7 英寸 TFT LCD 面板

maintainers:
  - Alexandre Mergnat <amergnat@baylibre.com>

allOf:
  - $ref: panel-common.yaml#

properties:
  compatible:
    const: startek,kd070fhfid015

  enable-gpios: true

  iovcc-supply:
    description: 引用给面板 I/O 引脚供电的稳压器
reg:
    maxItems: 1
    description: DSI 虚拟通道

  reset-gpios: true

  port: true

  power-supply: true

additionalProperties: false

required:
  - compatible
  - enable-gpios
  - iovcc-supply
  - reg
  - reset-gpios
  - port
  - power-supply

examples:
  - |
    #include <dt-bindings/gpio/gpio.h>

    dsi0 {
        #address-cells = <1>;
        #size-cells = <0>;

        panel@0 {
            compatible = "startek,kd070fhfid015";
            reg = <0>;
            enable-gpios = <&pio 67 GPIO_ACTIVE_HIGH>;
            reset-gpios = <&pio 20 GPIO_ACTIVE_HIGH>;
            iovcc-supply = <&mt6357_vsim1_reg>;
            power-supply = <&vsys_lcm_reg>;

            port {
                panel_in: endpoint {
                    remote-endpoint = <&dsi_out>;
                };
            };
        };
    };
..
```

请注意，部分 YAML 结构无法直接翻译为中文，例如键名和值。在上述代码中，我将描述性和注释性内容翻译成了中文，而保留了 YAML 的结构不变。
~~~~

## Documentation/devicetree/bindings/display/panel/startek,startek-kd050c_cn.yaml
```yaml
# SPDX-许可证标识符: GPL-2.0
%YAML 1.2
---
$id: http://devicetree.org/schemas/display/panel/startek,startek-kd050c.yaml#
$schema: http://devicetree.org/meta-schemas/core.yaml#

标题: Startek 电子科技公司的 KD050C 5.0" WVGA TFT 液晶显示屏

维护者:
  - 尼基塔·基里亚诺夫 <nikita@compulab.co.il>

allOf:
  - $ref: panel-dpi.yaml#

属性:
  compatible:
    项目:
      - 常量: startek,startek-kd050c
      - {} # panel-dpi，但为了避免错误选择此处未列出

  backlight: 真
  enable-gpios: 真
  height-mm: 真
  label: 真
  panel-timing: 真
  port: 真
  power-supply: 真
  reset-gpios: 真
  width-mm: 真

额外属性: 错误

..
```

## Documentation/devicetree/bindings/display/panel/synaptics,r63353_cn.yaml
```yaml
# SPDX-许可证标识符: (GPL-2.0-only 或 BSD-2-Clause)
%YAML 1.2
---
$id: http://devicetree.org/schemas/display/panel/synaptics,r63353.yaml#
$schema: http://devicetree.org/meta-schemas/core.yaml#

标题: 基于 Synaptics R63353 的 MIPI-DSI 显示屏

维护者:
  - Michael Trimarchi <michael@amarulasolutions.com>

allOf:
  - $ref: panel-common.yaml#

属性:
  compatible:
    items:
      - 枚举:
          - sharp,ls068b3sx02
      - 常量: syna,r63353

  reg:
    最大项数: 1

  avdd-supply: 真
  dvdd-supply: 真

必需:
  - compatible
  - reg
  - avdd-supply
  - dvdd-supply
  - reset-gpios
  - port
  - backlight

未评估的属性: 假

示例:
  - |
    #include <dt-bindings/gpio/gpio.h>

    dsi {
        #address-cells = <1>;
        #size-cells = <0>;

        panel@0 {
            compatible = "sharp,ls068b3sx02", "syna,r63353";
            reg = <0>;
            avdd-supply = <&avdd_display>;
            dvdd-supply = <&dvdd_display>;
            reset-gpios = <&r_pio 0 5 GPIO_ACTIVE_LOW>; /* PL05 */
            backlight = <&backlight>;

            port {
                panel_in: endpoint {
                    remote-endpoint = <&mipi_dsi_out>;
                };
            };
        };
    };
```

## Documentation/devicetree/bindings/display/panel/tfc,s9700rtwv43tr-01b_cn.yaml
```yaml
# SPDX-文件许可人: GPL-2.0
%YAML 1.2
---
$id: http://devicetree.org/schemas/display/panel/tfc,s9700rtwv43tr-01b.yaml#
$schema: http://devicetree.org/meta-schemas/core.yaml#

标题: TFC S9700RTWV43TR-01B 7" 三五公司 800x480 LCD 显示屏带电阻式触摸屏

维护者:
  - Jyri Sarha <jsarha@ti.com>
  - Thierry Reding <thierry.reding@gmail.com>

描述: |+
  此显示屏在 TI AM335x-evm 上可以找到。
allOf:
  - $ref: panel-common.yaml#

属性:
  compatible:
    常量: tfc,s9700rtwv43tr-01b

  enable-gpios: 真
  backlight: 真
  port: 真

附加属性: 假

必需:
  - compatible
  - power-supply

..
```

## Documentation/devicetree/bindings/display/panel/ti,nspire_cn.yaml
~~~~yaml
```yaml
# SPDX-许可证标识符: (GPL-2.0-only 或 BSD-2-Clause)
%YAML 1.2
---
$id: http://devicetree.org/schemas/display/panel/ti,nspire.yaml#
$schema: http://devicetree.org/meta-schemas/core.yaml#

title: 德州仪器 NSPIRE 显示屏面板

maintainers:
  - Linus Walleij <linus.walleij@linaro.org>

allOf:
  - $ref: panel-common.yaml#

properties:
  compatible:
    enum:
      - ti,nspire-cx-lcd-panel
      - ti,nspire-classic-lcd-panel
  port: true

required:
  - compatible

additionalProperties: false

examples:
  - |
    panel {
        compatible = "ti,nspire-cx-lcd-panel";
        port {
            panel_in: endpoint {
                remote-endpoint = <&pads>;
            };
        };
    };
```

这段 YAML 代码描述了一个针对德州仪器 NSPIRE 设备的显示面板配置文件。它定义了两种类型的面板：`ti,nspire-cx-lcd-panel` 和 `ti,nspire-classic-lcd-panel`，并提供了一个示例来展示如何在设备树中使用这些配置。
~~~~

## Documentation/devicetree/bindings/display/panel/tpo,td_cn.yaml
~~~~yaml
```yaml
# SPDX-许可证标识符: GPL-2.0
%YAML 1.2
---
$id: 'http://devicetree.org/schemas/display/panel/tpo,td.yaml'
$schema: 'http://devicetree.org/meta-schemas/core.yaml'

标题: Toppoly TD 显示屏面板

维护者:
  - Marek Belisko <marek@goldelico.com>
  - H. Nikolaus Schaller <hns@goldelico.com>

allOf:
  - $ref: 'panel-common.yaml'
  - $ref: '/schemas/spi/spi-peripheral-props.yaml'

属性:
  compatible:
    枚举:
      # Toppoly TD028TTEC1 面板
      - tpo,td028ttec1
      # Toppoly TD043MTEA1 面板
      - tpo,td043mtea1

  reg:
    maxItems: 1

  label: 真
  reset-gpios: 真
  backlight: 真
  port: 真

  spi-cpha: 真
  spi-cpol: 真

必需:
  - compatible
  - port

未评估属性: 假

示例:
  - |
    spi {
        #address-cells = <1>;
        #size-cells = <0>;

        panel: panel@0 {
            compatible = "tpo,td043mtea1";
            reg = <0>;
            spi-max-frequency = <100000>;
            spi-cpol;
            spi-cpha;

            label = "lcd";

            reset-gpios = <&gpio7 7 0>;

            port {
                lcd_in: endpoint {
                    remote-endpoint = <&dpi_out>;
                };
            };
        };
    };
```

请注意，某些关键字如 `true` 和 `false` 已根据中文习惯被翻译为 “真” 和 “假”，但实际 YAML 文件中应使用英文关键字。此外，注释和描述部分进行了适当的翻译。
~~~~

## Documentation/devicetree/bindings/display/panel/tpo,tpg110_cn.yaml
```yaml
# SPDX-许可证标识符: GPL-2.0
%YAML 1.2
---
$id: http://devicetree.org/schemas/display/panel/tpo,tpg110.yaml#
$schema: http://devicetree.org/meta-schemas/core.yaml#

标题: TPO TPG110 面板

维护者:
  - Linus Walleij <linus.walleij@linaro.org>
  - Thierry Reding <thierry.reding@gmail.com>

描述: |+
  此面板驱动程序是一个组件，它充当RGB输出和各种面板之间的中介。
  面板驱动程序在电子上被配置为所需的分辨率和其他属性，并且通过3线SPI接口进行控制。通过SPI与TPG110通信，
  可以发现配置的属性，因此硬件在很大程度上是自我描述的。
+--------+
  SPI -> |  TPO   | -> 物理显示器
  RGB -> | TPG110 |
         +--------+

  如果需要某些电气配置或替代分辨率，可以通过软件控制显示器并通过SPI接口设置。
  该接口还可以调整显示属性，例如伽马校正和某些电气驱动电平。
TPG110 不知道连接的面板的实际尺寸，因此这需要在设备树中指定。
它需要一个GPIO线路来控制其复位线路。
串行协议的线路名称类似于I2C，但该协议不是I2C而是3线SPI。
allOf:
  - $ref: panel-common.yaml#
  - $ref: /schemas/spi/spi-peripheral-props.yaml#

属性:
  compatible:
    oneOf:
      - items:
          - enum:
              - ste,nomadik-nhk15-display
          - const: tpo,tpg110
      - const: tpo,tpg110

  reg:
    maxItems: 1

  grestb-gpios:
    maxItems: 1
    描述: 面板复位GPIO

  spi-3wire: true

  spi-max-frequency:
    const: 3000000

必需:
  - compatible
  - reg
  - grestb-gpios
  - width-mm
  - height-mm
  - spi-3wire
  - spi-max-frequency
  - port

未评估的属性: false

示例:
  - |+
    spi {
      #address-cells = <1>;
      #size-cells = <0>;

      panel: display@0 {
        compatible = "tpo,tpg110";
        reg = <0>;
        spi-3wire;
        /* 最小周期320纳秒 ≒ 3 MHz */
        spi-max-frequency = <3000000>;
        /* 来自数据手册的宽度和高度 */
        width-mm = <116>;
        height-mm = <87>;
        grestb-gpios = <&foo_gpio 5 1>;
        backlight = <&bl>;

        port {
          nomadik_clcd_panel: endpoint {
            remote-endpoint = <&foo>;
          };
        };
      };
    };
```

## Documentation/devicetree/bindings/display/panel/visionox,rm69299_cn.yaml
~~~~yaml
```yaml
# SPDX-文件许可标识符: GPL-2.0-only 或 BSD-2-Clause
%YAML 1.2
---
$id: 'http://devicetree.org/schemas/display/panel/visionox,rm69299.yaml'
$schema: 'http://devicetree.org/meta-schemas/core.yaml'

title: Visionox 型号 RM69299 显示屏

maintainers:
  - Abhinav Kumar <quic_abhinavk@quicinc.com>
  - Jessica Zhang <quic_jesszhan@quicinc.com>

description: |
  此绑定适用于使用 Visionox RM692999 面板的显示屏
allOf:
  - $ref: 'panel-common.yaml'

properties:
  compatible:
    const: 'visionox,rm69299-1080p-display'

  reg:
    maxItems: 1

  vdda-supply:
    description: |
      提供 vdda 供电电压的调节器的 phandle
  vdd3p3-supply:
    description: |
      提供 vdd3p3 供电电压的调节器的 phandle
  port: true
  reset-gpios: true

additionalProperties: false

required:
  - compatible
  - reg
  - vdda-supply
  - vdd3p3-supply
  - reset-gpios
  - port

examples:
  - |
    dsi {
        #address-cells = <1>;
        #size-cells = <0>;

        panel@0 {
            compatible = "visionox,rm69299-1080p-display";
            reg = <0>;

            vdda-supply = <&src_pp1800_l8c>;
            vdd3p3-supply = <&src_pp2800_l18a>;

            reset-gpios = <&pm6150l_gpio 3 0>;
            port {
                panel0_in: endpoint {
                    remote-endpoint = <&dsi0_out>;
                };
            };
        };
    };
```

这段 YAML 文件描述了一个名为 Visionox RM69299 的显示面板的 Device Tree Binding，它规定了如何在设备树中定义该面板的配置。此外，还给出了一个示例来说明如何根据此绑定在设备树中配置 Visionox RM69299 显示面板。
~~~~

## Documentation/devicetree/bindings/display/panel/visionox,vtdr6130_cn.yaml
~~~~yaml
```yaml
# SPDX-许可证标识符: GPL-2.0-only 或 BSD-2-Clause
%YAML 1.2
---
$id: http://devicetree.org/schemas/display/panel/visionox,vtdr6130.yaml#
$schema: http://devicetree.org/meta-schemas/core.yaml#

title: Visionox VTDR6130 AMOLED DSI 面板

maintainers:
  - Neil Armstrong <neil.armstrong@linaro.org>

allOf:
  - $ref: panel-common.yaml#

properties:
  compatible:
    const: visionox,vtdr6130

  reg:
    maxItems: 1
    description: DSI 虚拟通道

  vddio-supply: true
  vci-supply: true
  vdd-supply: true
  port: true
  reset-gpios: true

additionalProperties: false

required:
  - compatible
  - reg
  - vddio-supply
  - vci-supply
  - vdd-supply
  - reset-gpios
  - port

examples:
  - |
    #include <dt-bindings/gpio/gpio.h>
    dsi {
        #address-cells = <1>;
        #size-cells = <0>;
        panel@0 {
            compatible = "visionox,vtdr6130";
            reg = <0>;

            vddio-supply = <&vreg_l12b_1p8>;
            vci-supply = <&vreg_l13b_3p0>;
            vdd-supply = <&vreg_l11b_1p2>;

            reset-gpios = <&tlmm 133 GPIO_ACTIVE_LOW>;

            port {
                panel0_in: endpoint {
                    remote-endpoint = <&dsi0_out>;
                };
            };
        };
    };
..
```

这段 YAML 文件定义了一个设备树片段，用于描述 Visionox VTDR6130 AMOLED DSI 面板的配置。它包括了面板所需的电源供应、GPIO 重置信号以及与显示子系统连接的相关信息。
~~~~

## Documentation/devicetree/bindings/display/panel/wl-355608-a8_cn.yaml
~~~~yaml
```yaml
# SPDX-许可证标识符: (GPL-2.0-only 或 BSD-2-Clause)
%YAML 1.2
---
$id: http://devicetree.org/schemas/display/panel/wl-355608-a8.yaml#
$schema: http://devicetree.org/meta-schemas/core.yaml#

title: WL-355608-A8 3.5" (640x480 像素) 24位 IPS 液晶屏

maintainers:
  - Ryan Walklin <ryan@testtoast.com>

allOf:
  - $ref: panel-common.yaml#
  - $ref: /schemas/spi/spi-peripheral-props.yaml#

properties:
  compatible:
    const: wl-355608-a8

  reg:
    maxItems: 1

  spi-3wire: true

required:
  - compatible
  - reg
  - port
  - power-supply
  - reset-gpios

unevaluatedProperties: false

examples:
  - |
    #include <dt-bindings/gpio/gpio.h>

    spi {
        #address-cells = <1>;
        #size-cells = <0>;

        panel@0 {
            compatible = "wl-355608-a8";
            reg = <0>;

            spi-3wire;
            spi-max-frequency = <3125000>;

            reset-gpios = <&pio 8 14 GPIO_ACTIVE_LOW>; // PI14

            backlight = <&backlight>;
            power-supply = <&reg_lcd>;

            port {
                endpoint {
                    remote-endpoint = <&tcon_lcd0_out_lcd>;
                };
            };
        };
    };
```

请注意，此翻译保持了 YAML 格式的原始结构，并尽可能保留了技术术语的英文形式以确保准确性和清晰度。对于 `compatible` 和其他类似字段中的字符串值，它们在设备树中通常是固定的，并且不需要翻译。
~~~~

## Documentation/devicetree/bindings/display/panel/xinpeng,xpp055c272_cn.yaml
```yaml
# SPDX-文件许可人: (GPL-2.0-only 或 BSD-2-Clause)
%YAML 1.2
---
$id: http://devicetree.org/schemas/display/panel/xinpeng,xpp055c272.yaml#
$schema: http://devicetree.org/meta-schemas/core.yaml#

标题: Xinpeng XPP055C272 5.5英寸 720x1280 DSI 显示屏

维护者:
  - Heiko Stuebner <heiko.stuebner@theobroma-systems.com>

allOf:
  - $ref: panel-common.yaml#

属性:
  compatible:
    常量: xinpeng,xpp055c272

  reg:
    最大项数: 1

  backlight: 真
  port: 真
  reset-gpios: 真
  iovcc-supply:
    描述: 提供电压iovcc的调节器
  vci-supply:
    描述: 提供电压vci的调节器

必需:
  - compatible
  - reg
  - backlight
  - port
  - iovcc-supply
  - vci-supply

额外属性: 错误

示例:
  - |
    dsi {
        #address-cells = <1>;
        #size-cells = <0>;

        panel@0 {
            compatible = "xinpeng,xpp055c272";
            reg = <0>;
            backlight = <&backlight>;
            iovcc-supply = <&vcc_1v8>;
            vci-supply = <&vcc3v3_lcd>;

            port {
                mipi_in_panel: endpoint {
                    remote-endpoint = <&mipi_out_panel>;
                };
            };
        };
    };

..
```
