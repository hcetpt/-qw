## Documentation/devicetree/bindings/display/panel/seiko,43wvf1g_cn.yaml
```yaml
# SPDX-许可证标识符: GPL-2.0
%YAML 1.2
---
$id: http://devicetree.org/schemas/display/panel/seiko,43wvf1g.yaml#
$schema: http://devicetree.org/meta-schemas/core.yaml#

title: 精工爱普生公司 4.3" WVGA (800 x RGB x 480) 带触摸屏的TFT显示屏

维护者:
  - Fabio Estevam <festevam@gmail.com>

allOf:
  - $ref: panel-common.yaml#

属性:
  compatible:
    常量: sii,43wvf1g

  backlight: 真
  port: 真

  dvdd-supply:
    描述: 3v3 数字稳压器

  avdd-supply:
    描述: 5v 模拟稳压器

  enable-gpios: 真

必需:
  - compatible
  - dvdd-supply
  - avdd-supply

额外属性: 假

示例:
  - |
    panel {
        compatible = "sii,43wvf1g";

        backlight = <&backlight_display>;
        dvdd-supply = <&reg_lcd_3v3>;
        avdd-supply = <&reg_lcd_5v>;
        port {
            panel_in: endpoint {
                remote-endpoint = <&display_out>;
            };
        };
    };
```

## Documentation/devicetree/bindings/display/panel/sharp,lq101r1sx01_cn.yaml
```yaml
# SPDX-许可证标识符: GPL-2.0
%YAML 1.2
---
$id: http://devicetree.org/schemas/display/panel/sharp,lq101r1sx01.yaml#
$schema: http://devicetree.org/meta-schemas/core.yaml#

标题: Sharp 微电子 10.1" WQXGA TFT LCD 面板

维护者:
  - Thierry Reding <treding@nvidia.com>

描述: |
  此面板需要一个双通道 DSI 主机才能运行。它支持两种模式：
  - 左右：每个通道驱动屏幕的左半部或右半部
  - 偶奇：每个通道驱动屏幕的偶数行或奇数行

  每个 DSI 通道控制一个独立的 DSI 外设。由第一个链路（DSI-LINK1）驱动的外设，无论是左边还是偶数行，被视为主要外设并控制设备。'link2' 属性包含指向由第二个链路（DSI-LINK2，右边或奇数行）驱动的外设的 phandle。
  请注意，在视频模式下，DSI-LINK1 接口始终提供左边/偶数像素，而 DSI-LINK2 始终提供右边/奇数像素。在命令模式下，可以编程任一链路来驱动左边/偶数或右边/奇数像素，
  但为了保持一致性，此绑定假设选择了与视频模式相同的分配方式。
allOf:
  - $ref: panel-common.yaml#

属性:
  compatible:
    oneOf:
      - items:
          - const: sharp,lq101r1sx03
          - const: sharp,lq101r1sx01
      - enum:
          - sharp,lq101r1sx01

  reg:
    maxItems: 1

  power-supply: true
  backlight: true

  link2:
    $ref: /schemas/types.yaml#/definitions/phandle
    description: |
      指向次级链路上 DSI 外设的 phandle。注意该属性的存在标志着包含节点为 DSI-LINK1。

必需:
  - compatible
  - reg

如果:
  必需:
    - link2
然后:
  必需:
    - power-supply

其他属性: false

示例:
  - |
    dsi0: dsi@fd922800 {
        #address-cells = <1>;
        #size-cells = <0>;
        reg = <0xfd922800 0x200>;

        panel: panel@0 {
            compatible = "sharp,lq101r1sx01";
            reg = <0>;

            link2 = <&secondary>;

            power-supply = <&power>;
            backlight = <&backlight>;
        };
    };

    dsi1: dsi@fd922a00 {
        #address-cells = <1>;
        #size-cells = <0>;
        reg = <0xfd922a00 0x200>;

        secondary: panel@0 {
            compatible = "sharp,lq101r1sx01";
            reg = <0>;
        };
    };

..
```

## Documentation/devicetree/bindings/display/panel/sharp,lq150x1lg11_cn.yaml
```yaml
# SPDX-文件许可人: GPL-2.0
%YAML 1.2
---
$id: http://devicetree.org/schemas/display/panel/sharp,lq150x1lg11.yaml#
$schema: http://devicetree.org/meta-schemas/core.yaml#

title: Sharp 15" LQ150X1LG11 XGA TFT LCD 面板

maintainers:
  - Peter Rosin <peda@axentia.se>

allOf:
  - $ref: panel-common.yaml#

properties:
  compatible:
    const: sharp,lq150x1lg11

  power-supply: true
  backlight: true

  rlud-gpios:
    maxItems: 1
    description: |
      RL/UD（旋转180度）引脚的GPIO
如果未指定rlud-gpios和/或sellvds-gpios，
      则假定RL/UD和/或SELLVDS引脚由硬件适当地处理
sellvds-gpios:
    maxItems: 1
    description: |
      SELLVDS引脚的GPIO
如果未指定rlud-gpios和/或sellvds-gpios，
      则假定RL/UD和/或SELLVDS引脚由硬件适当地处理
required:
  - compatible
  - power-supply

additionalProperties: false

examples:
  - |
    #include <dt-bindings/gpio/gpio.h>

    panel {
        compatible = "sharp,lq150x1lg11";

        power-supply = <&vcc_3v3_reg>;               /* VCC */

        backlight = <&backlight>;
        rlud-gpios = <&gpio 17 GPIO_ACTIVE_HIGH>;    /* RL/UD */
        sellvds-gpios = <&gpio 18 GPIO_ACTIVE_HIGH>; /* SELLVDS */
    };
```

## Documentation/devicetree/bindings/display/panel/sharp,ls037v7dw01_cn.yaml
~~~~yaml
```yaml
# SPDX-文件许可人: GPL-2.0
%YAML 1.2
---
$id: http://devicetree.org/schemas/display/panel/sharp,ls037v7dw01.yaml#
$schema: http://devicetree.org/meta-schemas/core.yaml#

title: SHARP LS037V7DW01 TFT-LCD 面板

description: |
  此面板可以有零到五个 GPIO 来配置以在 QVGA 和 VGA 模式以及扫描方向之间切换配置。
  由于这些引脚也可以通过外部拉高/拉低电阻进行配置，所有 GPIO 均被视为可选的，并且数组中可能存在空位。
maintainers:
  - Tony Lindgren <tony@atomide.com>

allOf:
  - $ref: panel-common.yaml#

properties:
  compatible:
    const: sharp,ls037v7dw01

  label: true
  enable-gpios: true
  reset-gpios: true
  port: true
  power-supply: true

  mode-gpios:
    minItems: 1
    maxItems: 3
    description: |
      按照 LS037V7DW01.pdf 中指定的顺序排列的 GPIO：MO、LR 和 UD。
      此面板可以有零到三个 GPIO 来配置以在 QVGA 和 VGA 模式以及
      扫描方向之间切换配置。由于这些引脚也可以通过外部拉高/拉低电阻进行配置，
      所有 GPIO 均被视为可选的，并且数组中可能存在空位。
required:
  - compatible
  - port

additionalProperties: false

examples:
  - |
    #include <dt-bindings/gpio/gpio.h>

    lcd0: display {
        compatible = "sharp,ls037v7dw01";
        power-supply = <&lcd_3v3>;
        enable-gpios = <&gpio5 24 GPIO_ACTIVE_HIGH>;    /* gpio152, lcd INI */
        reset-gpios = <&gpio5 27 GPIO_ACTIVE_HIGH>;     /* gpio155, lcd RESB */
        mode-gpios = <&gpio5 26 GPIO_ACTIVE_HIGH        /* gpio154, lcd MO */
                      &gpio1 2 GPIO_ACTIVE_HIGH         /* gpio2, lcd LR */
                      &gpio1 3 GPIO_ACTIVE_HIGH>;       /* gpio3, lcd UD */

        port {
            lcd_in: endpoint {
                remote-endpoint = <&dpi_out>;
            };
        };
    };
```

以上是将英文 YAML 文件翻译为中文版本的内容。注意，某些技术术语和专有名词没有翻译，因为它们本身就是国际通用的技术词汇或专有名词。
~~~~

## Documentation/devicetree/bindings/display/panel/sharp,ls043t1le01_cn.yaml
~~~~yaml
```yaml
# SPDX-文件许可人: GPL-2.0
%YAML 1.2
---
$id: http://devicetree.org/schemas/display/panel/sharp,ls043t1le01.yaml#
$schema: http://devicetree.org/meta-schemas/core.yaml#

title: Sharp 微电子 4.3" qHD TFT LCD 显示屏

maintainers:
  - Werner Johansson <werner.johansson@sonymobile.com>

allOf:
  - $ref: panel-common.yaml#

properties:
  compatible:
    const: sharp,ls043t1le01-qhd

  reg:
    maxItems: 1

  backlight: true
  reset-gpios: true
  port: true

  avdd-supply:
    description: 提供电源电压的稳压器的句柄

required:
  - compatible
  - reg
  - avdd-supply

additionalProperties: false

examples:
  - |
    #include <dt-bindings/gpio/gpio.h>

    dsi {
        #address-cells = <1>;
        #size-cells = <0>;

        panel@0 {
            compatible = "sharp,ls043t1le01-qhd";
            reg = <0>;
            avdd-supply = <&pm8941_l22>;
            backlight = <&pm8941_wled>;
            reset-gpios = <&pm8941_gpios 19 GPIO_ACTIVE_HIGH>;
        };
    };
```

请注意，`SPDX-文件许可人:` 在中文环境中可能不会被广泛使用，这里我将其翻译为“SPDX-文件许可人:”，但实际标准术语应为 “SPDX-License-Identifier:”。此外，某些技术术语和语法结构在中文环境中可能不常用，因此保持了原文的形式。
~~~~

## Documentation/devicetree/bindings/display/panel/sharp,ls060t1sx01_cn.yaml
~~~~yaml
```yaml
# SPDX-文件许可标识: (GPL-2.0-only 或 BSD-2-Clause)
%YAML 1.2
---
$id: http://devicetree.org/schemas/display/panel/sharp,ls060t1sx01.yaml#
$schema: http://devicetree.org/meta-schemas/core.yaml#

title: Sharp 微电子 6.0英寸 全高清 TFT LCD 显示屏

maintainers:
  - Dmitry Baryskov <dmitry.baryshkov@linaro.org>

allOf:
  - $ref: panel-common.yaml#

properties:
  compatible:
    const: sharp,ls060t1sx01

  reg:
    maxItems: 1

  backlight: true
  reset-gpios: true
  port: true

  avdd-supply:
    description: 提供正向供电电压的稳压器的句柄
  avee-supply:
    description: 提供负向供电电压的稳压器的句柄
  vddi-supply:
    description: 提供I/O供电电压的稳压器的句柄
  vddh-supply:
    description: 提供模拟供电电压的稳压器的句柄

required:
  - compatible
  - reg

additionalProperties: false

examples:
  - |
    #include <dt-bindings/gpio/gpio.h>

    dsi {
        #address-cells = <1>;
        #size-cells = <0>;

        panel@0 {
            compatible = "sharp,ls060t1sx01";
            reg = <0>;
            avdd-supply = <&pm8941_l22>;
            backlight = <&backlight>;
            reset-gpios = <&pm8916_gpios 25 GPIO_ACTIVE_LOW>;
        };
    };
```

请注意，这个翻译尽可能地保留了原有的 YAML 结构和内容。一些字段如 `allOf` 和 `properties` 下的内容在中文语境中可能显得不太自然，这是因为这些是 YAML 格式特有的语法，并不直接对应于中文表达习惯。
~~~~

## Documentation/devicetree/bindings/display/panel/sitronix,st7701_cn.yaml
~~~~yaml
```yaml
# SPDX-许可证标识符: (GPL-2.0-only 或 BSD-2-Clause)
%YAML 1.2
---
$id: http://devicetree.org/schemas/display/panel/sitronix,st7701.yaml#
$schema: http://devicetree.org/meta-schemas/core.yaml#

title: 基于 Sitronix ST7701 的 LCD 面板

maintainers:
  - Jagan Teki <jagan@amarulasolutions.com>

description: |
  ST7701 专为小型和中型 TFT LCD 显示屏设计，能够支持最高 480RGBx864 的分辨率。它提供了多种系统接口，如 MIPI/RGB/SPI。
  Techstar TS8550B 是一个分辨率为 480x854、2-lane MIPI DSI 的 LCD 面板，内部集成了 ST7701 芯片。
  Densitron DMT028VGHMCMI-1A 是一个分辨率为 480x640、2-lane MIPI DSI 的 LCD 面板，内部集成了 ST7701 芯片。
allOf:
  - $ref: panel-common.yaml#

properties:
  compatible:
    items:
      - enum:
          - anbernic,rg-arc-panel
          - densitron,dmt028vghmcmi-1a
          - elida,kd50t048a
          - techstar,ts8550b
      - const: sitronix,st7701

  reg:
    description: 该屏幕使用的 DSI 虚拟通道
    maxItems: 1

  VCC-supply:
    description: MIPI 电路的模拟稳压器

  IOVCC-supply:
    description: I/O 系统稳压器

  port: true
  reset-gpios: true
  rotation: true

  backlight: true

required:
  - compatible
  - reg
  - VCC-supply
  - IOVCC-supply
  - port
  - reset-gpios

additionalProperties: false

examples:
  - |
    #include <dt-bindings/gpio/gpio.h>

    dsi {
        #address-cells = <1>;
        #size-cells = <0>;

        panel@0 {
            compatible = "techstar,ts8550b", "sitronix,st7701";
            reg = <0>;
            VCC-supply = <&reg_dldo2>;
            IOVCC-supply = <&reg_dldo2>;
            reset-gpios = <&pio 3 24 GPIO_ACTIVE_HIGH>; /* LCD-RST: PD24 */
            backlight = <&backlight>;

            port {
                mipi_in_panel: endpoint {
                    remote-endpoint = <&mipi_out_panel>;
                };
            };
        };
    };
```

这段 YAML 文件定义了一个基于 Sitronix ST7701 的 LCD 面板的设备树规范，并给出了一个示例。
~~~~

## Documentation/devicetree/bindings/display/panel/sitronix,st7789v_cn.yaml
```yaml
# SPDX-许可证标识符: GPL-2.0
%YAML 1.2
---
$id: http://devicetree.org/schemas/display/panel/sitronix,st7789v.yaml#
$schema: http://devicetree.org/meta-schemas/core.yaml#

标题: 通过SPI控制总线操作的Sitronix ST7789V RGB显示屏

维护者:
  - Maxime Ripard <mripard@kernel.org>

allOf:
  - $ref: panel-common.yaml#
  - $ref: /schemas/spi/spi-peripheral-props.yaml#

属性:
  compatible:
    枚举:
      - edt,et028013dma
      - inanbo,t28cp45tn89-v17
      - jasonic,jt240mhqs-hwt-ek-e3
      - sitronix,st7789v

  reg:
    最大项数: 1

  reset-gpios: 真
  power-supply: 真
  backlight: 真
  port: 真
  rotation: 真

  spi-cpha: 真
  spi-cpol: 真

  spi-rx-bus-width:
    最小值: 0
    最大值: 1

  dc-gpios:
    最大项数: 1
    描述: DCX引脚, 并行接口中的显示数据/命令选择引脚

必需:
  - compatible
  - reg
  - power-supply

未评估属性: 假

示例:
  - |
    #include <dt-bindings/gpio/gpio.h>

    spi {
        #address-cells = <1>;
        #size-cells = <0>;

        panel@0 {
            compatible = "sitronix,st7789v";
            reg = <0>;
            reset-gpios = <&pio 6 11 GPIO_ACTIVE_LOW>;
            backlight = <&pwm_bl>;
            power-supply = <&power>;
            rotation = <180>;
            spi-max-frequency = <100000>;
            spi-cpol;
            spi-cpha;

            port {
                panel_input: endpoint {
                    remote-endpoint = <&tcon0_out_panel>;
                };
            };
        };
    };

..
```

## Documentation/devicetree/bindings/display/panel/sony,acx424akp_cn.yaml
~~~~yaml
```yaml
# SPDX-文件许可标识: (GPL-2.0-only 或 BSD-2-Clause)
%YAML 1.2
---
$id: http://devicetree.org/schemas/display/panel/sony,acx424akp.yaml#
$schema: http://devicetree.org/meta-schemas/core.yaml#

title: 索尼 ACX424AKP/ACX424AKM 4" 480x864/480x854 AMOLED 显示屏

description: 索尼 ACX424AKP 和 ACX424AKM 是基于 Novatek NT35560 显示控制器构建的显示屏。两者唯一的区别在于 AKM 在 Y 轴上配置为比 AKP 少使用 10 个像素。
maintainers:
  - Linus Walleij <linus.walleij@linaro.org>

allOf:
  - $ref: panel-common.yaml#

properties:
  compatible:
    enum:
      - sony,acx424akp
      - sony,acx424akm

  reg:
    maxItems: 1

  reset-gpios: true
  vddi-supply:
    description: 提供电压 vddi 的稳压器
  enforce-video-mode: true

required:
  - compatible
  - reg
  - reset-gpios

additionalProperties: false

examples:
  - |
    #include <dt-bindings/gpio/gpio.h>

    dsi-controller@a0351000 {
        compatible = "ste,mcde-dsi";
        reg = <0xa0351000 0x1000>;
        #address-cells = <1>;
        #size-cells = <0>;

        panel@0 {
            compatible = "sony,acx424akp";
            reg = <0>;
            vddi-supply = <&foo>;
            reset-gpios = <&foo_gpio 0 GPIO_ACTIVE_LOW>;
        };
    };
```
此文档定义了一个设备树配置文件，用于描述索尼 ACX424AKP 和 ACX424AKM 显示屏。这两个显示屏都是基于 Novatek NT35560 控制器，并且在 Y 轴方向上具有微小差异。文档还包含了一个示例，展示了如何在设备树中定义这个显示屏的配置。
~~~~

## Documentation/devicetree/bindings/display/panel/sony,acx565akm_cn.yaml
```yaml
下面是给定内容的中文翻译：

# SPDX-文件许可人: GPL-2.0
%YAML 1.2
---
$id: http://devicetree.org/schemas/display/panel/sony,acx565akm.yaml#
$schema: http://devicetree.org/meta-schemas/core.yaml#

标题: 索尼 ACX565AKM SDI 显示屏

维护者:
  - Tomi Valkeinen <tomi.valkeinen@ti.com>

allOf:
  - $ref: panel-common.yaml#
  - $ref: /schemas/spi/spi-peripheral-props.yaml#

属性:
  compatible:
    常量: sony,acx565akm

  reg:
    最大项数: 1

  label: 真
  reset-gpios: 真
  port: 真

必需:
  - compatible
  - port

未评估属性: 假

示例:
  - |
    #include <dt-bindings/gpio/gpio.h>

    spi {
        #address-cells = <1>;
        #size-cells = <0>;

        panel@2 {
            compatible = "sony,acx565akm";
            spi-max-frequency = <6000000>;
            reg = <2>;

            label = "lcd";
            reset-gpios = <&gpio3 26 GPIO_ACTIVE_HIGH>; /* 90 */

            port {
                lcd_in: endpoint {
                    remote-endpoint = <&sdi_out>;
                };
            };
        };
    };

..
```

## Documentation/devicetree/bindings/display/panel/sony,td4353-jdi_cn.yaml
~~~~yaml
```yaml
# SPDX-文件许可标识: (GPL-2.0-only 或 BSD-2-Clause)
%YAML 1.2
---
$id: http://devicetree.org/schemas/display/panel/sony,td4353-jdi.yaml#
$schema: http://devicetree.org/meta-schemas/core.yaml#

title: 索尼 TD4353 JDI 5 / 5.7 英寸 2160x1080 MIPI-DSI 显示屏面板

maintainers:
  - Konrad Dybcio <konrad.dybcio@somainline.org>

description: |
  索尼 TD4353 JDI 是一款用于 Xperia XZ2 和 XZ2 Compact 智能手机的 5 (XZ2c) / 5.7 (XZ2) 英寸 2160x1080
  MIPI-DSI 面板
allOf:
  - $ref: panel-common.yaml#

properties:
  compatible:
    const: sony,td4353-jdi-tama

  reg:
    maxItems: 1

  backlight: true
  width-mm: true
  height-mm: true

  vddio-supply:
    description: VDDIO 1.8V 供电

  vsp-supply:
    description: 正向 5.5V 供电

  vsn-supply:
    description: 负向 5.5V 供电

  panel-reset-gpios:
    description: 显示面板复位引脚

  touch-reset-gpios:
    description: 触摸面板复位引脚

  port: true

required:
  - compatible
  - reg
  - vddio-supply
  - vsp-supply
  - vsn-supply
  - panel-reset-gpios
  - touch-reset-gpios
  - port

additionalProperties: false

examples:
  - |
    #include <dt-bindings/gpio/gpio.h>

    dsi {
        #address-cells = <1>;
        #size-cells = <0>;

        panel: panel@0 {
            compatible = "sony,td4353-jdi-tama";
            reg = <0>;

            backlight = <&pmi8998_wled>;
            vddio-supply = <&vreg_l14a_1p8>;
            vsp-supply = <&lab>;
            vsn-supply = <&ibb>;
            panel-reset-gpios = <&tlmm 6 GPIO_ACTIVE_HIGH>;
            touch-reset-gpios = <&tlmm 99 GPIO_ACTIVE_HIGH>;

            port {
                panel_in: endpoint {
                    remote-endpoint = <&dsi0_out>;
                };
            };
        };
    };
..
```
~~~~
