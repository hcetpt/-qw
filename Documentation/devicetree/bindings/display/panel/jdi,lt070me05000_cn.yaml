## Documentation/devicetree/bindings/display/panel/novatek,nt35950_cn.yaml
```yaml
下面是给定文档的中文翻译：

# SPDX-License-Identifier: (GPL-2.0-only OR BSD-2-Clause)
%YAML 1.2
---
$id: http://devicetree.org/schemas/display/panel/novatek,nt35950.yaml#
$schema: http://devicetree.org/meta-schemas/core.yaml#

title: 基于Novatek NT35950 的显示面板

maintainers:
  - AngeloGioacchino Del Regno <angelogioacchino.delregno@somainline.org>

description: |
  Novatek 的 nt35950 IC 是一种驱动 IC，用于驱动 MIPI-DSI 面板，
  具有静态 RAM 以在命令模式下保留内容，并且还支持视频模式，
  可使用 VESA 帧缓冲压缩或显示流压缩在单个或双 DSI 端口上。
  此 DDIC 还能够将输入图像放大到面板的原生分辨率，
  例如，它可以将 1920x1080 输入放大到 3840x2160，
  使用双线性插值或像素复制。
allOf:
  - $ref: panel-common-dual.yaml#

properties:
  compatible:
    items:
      - enum:
          - sharp,ls055d1sx04
      - const: novatek,nt35950
    description: 指示使用 NT35950 面板驱动程序的面板制造商。
      兼容字符串决定了如何配置 NT35950 面板驱动程序以与指示的面板一起工作。
      novatek,nt35950 兼容字符串应始终作为备选提供。
reg:
    maxItems: 1

  reset-gpios:
    maxItems: 1
    description: 重置信号线的 GPIO phandle —— 这应该是 8mA 的 GPIO，
      可以通过多路复用器、引脚控制器和引脚控制器名称进行配置（高电平有效）。

  avdd-supply:
    description: 正向升压电源调节器
  avee-supply:
    description: 负向升压电源调节器
  dvdd-supply:
    description: 提供数字电压的调节器
  vddio-supply:
    description: 提供电压 I/O 的调节器

  backlight: true
  ports: true

required:
  - compatible
  - reg
  - reset-gpios
  - avdd-supply
  - avee-supply
  - dvdd-supply
  - vddio-supply
  - ports

additionalProperties: false

examples:
  - |
    #include <dt-bindings/gpio/gpio.h>

    dsi0 {
        #address-cells = <1>;
        #size-cells = <0>;

        panel@0 {
            compatible = "sharp,ls055d1sx04", "novatek,nt35950";
            reg = <0>;

            backlight = <&pmi8998_wled>;
            reset-gpios = <&tlmm 94 GPIO_ACTIVE_HIGH>;

            avdd-supply = <&lab>;
            avee-supply = <&ibb>;
            dvdd-supply = <&disp_dvdd_vreg>;
            vddio-supply = <&vreg_l14a_1p85>;

            ports {
                #address-cells = <1>;
                #size-cells = <0>;

                port@0 {
                    reg = <0>;
                    panel_in0: endpoint {
                        remote-endpoint = <&dsi0_out>;
                    };
                };

                port@1 {
                    reg = <1>;
                    panel_in1: endpoint {
                        remote-endpoint = <&dsi1_out>;
                    };
                };
            };
        };
    };
```

## Documentation/devicetree/bindings/display/panel/novatek,nt36523_cn.yaml
```yaml
下面是给定内容的中文翻译：

# SPDX-文件许可标识符: GPL-2.0-only 或 BSD-2-Clause
%YAML 1.2
---
$id: http://devicetree.org/schemas/display/panel/novatek,nt36523.yaml#
$schema: http://devicetree.org/meta-schemas/core.yaml#

标题: 基于Novatek NT36523的DSI显示面板

维护者:
  - 建华 卢 <lujianhua000@gmail.com>

描述: |
  Novatek NT36523 是一种通用的DSI面板控制IC，用于驱动DSI面板。支持来自中国星光电科技（CSOT）和京东方科技的视频模式面板。

属性:
  compatible:
    oneOf:
      - items:
          - enum:
              - xiaomi,elish-boe-nt36523
              - xiaomi,elish-csot-nt36523
          - const: novatek,nt36523
      - items:
          - enum:
              - lenovo,j606f-boe-nt36523w
          - const: novatek,nt36523w

  reg:
    maxItems: 1

  reset-gpios:
    maxItems: 1
    描述: 重置线的GPIO phandle - 这应该为8mA

  vddio-supply:
    描述: 提供电压I/O电压的调节器

  rotation: true
  backlight: true

必需:
  - compatible
  - reg
  - vddio-supply
  - reset-gpios

allOf:
  - $ref: panel-common-dual.yaml#
  - if:
      properties:
        compatible:
          contains:
            enum:
              - novatek,nt36523w
    then:
      properties:
        ports:
          properties:
            port@1: false
    else:
      properties:
        port: false
        ports:
          required:
            - port@1

未评估的属性: false

示例:
  - |
    #include <dt-bindings/gpio/gpio.h>

    dsi {
        #address-cells = <1>;
        #size-cells = <0>;

        panel@0 {
            compatible = "xiaomi,elish-csot-nt36523", "novatek,nt36523";
            reg = <0>;

            vddio-supply = <&vreg_l14a_1p88>;
            reset-gpios = <&tlmm 75 GPIO_ACTIVE_LOW>;
            backlight = <&backlight>;

            ports {
                #address-cells = <1>;
                #size-cells = <0>;

                port@0 {
                    reg = <0>;
                    panel_in_0: endpoint {
                        remote-endpoint = <&dsi0_out>;
                    };
                };

                port@1{
                    reg = <1>;
                    panel_in_1: endpoint {
                        remote-endpoint = <&dsi1_out>;
                    };
                };
            };
        };
    };
```

## Documentation/devicetree/bindings/display/panel/novatek,nt36672a_cn.yaml
```yaml
下面是给定内容的中文翻译：

# SPDX-文件许可标识符: GPL-2.0-only 或 BSD-2-Clause
%YAML 1.2
---
$id: http://devicetree.org/schemas/display/panel/novatek,nt36672a.yaml#
$schema: http://devicetree.org/meta-schemas/core.yaml#

标题: 基于 Novatek NT36672A 的 DSI 显示面板

维护者:
  - Sumit Semwal <sumit.semwal@linaro.org>

描述: |
  来自 Novatek 的 nt36672a 芯片是一种通用的 DSI 面板驱动芯片，用于驱动 DSI 面板。
  目前仅支持分辨率 1080x2246 的天马 FHD+ 液晶显示面板。这是一个视频模式的 DSI 面板。
全部包含:
  - $ref: panel-common.yaml#

属性:
  compatible:
    项目:
      - 枚举:
          - tianma,fhd-video
      - 常量: novatek,nt36672a
    描述: 这表示使用 NT36672A 面板驱动程序的面板制造商。这个兼容字符串决定了如何为指定的面板配置 NT36672A 面板驱动程序。novatek,nt36672a 兼容项应始终作为回退选项提供。
  reg:
    最大项目数: 1

  reset-gpios:
    最大项目数: 1
    描述: 重置线的 GPIO 的 phandle —— 这应该是 8mA，GPIO 可以通过复用器、引脚控制器和引脚控制器名称（高电平有效）进行配置。

  vddio-supply:
    描述: 提供电压的调节器的 phandle
      电源 IC 供电

  vddpos-supply:
    描述: 正向升压供电调节器的 phandle

  vddneg-supply:
    描述: 负向升压供电调节器的 phandle

  port: true
  backlight: true

必需:
  - compatible
  - reg
  - vddio-supply
  - vddpos-supply
  - vddneg-supply
  - reset-gpios
  - port

未评估属性: false

示例:
  - |+
    #include <dt-bindings/gpio/gpio.h>

    dsi0 {
        #address-cells = <1>;
        #size-cells = <0>;

        panel@0 {
            compatible = "tianma,fhd-video", "novatek,nt36672a";
            reg = <0>;
            vddio-supply = <&vreg_l14a_1p88>;
            vddpos-supply = <&lab>;
            vddneg-supply = <&ibb>;

            backlight = <&pmi8998_wled>;
            reset-gpios = <&tlmm 6 GPIO_ACTIVE_HIGH>;

            port {
                tianma_nt36672a_in_0: endpoint {
                    remote-endpoint = <&dsi0_out>;
                };
            };
        };
    };
```

## Documentation/devicetree/bindings/display/panel/novatek,nt36672e_cn.yaml
~~~~yaml
```yaml
# SPDX-许可证标识符: GPL-2.0-only 或 BSD-2-Clause
%YAML 1.2
---
$id: http://devicetree.org/schemas/display/panel/novatek,nt36672e.yaml#
$schema: http://devicetree.org/meta-schemas/core.yaml#

title: Novatek NT36672E LCD DSI 面板

maintainers:
  - Ritesh Kumar <quic_riteshk@quicinc.com>

allOf:
  - $ref: panel-common.yaml#

properties:
  compatible:
    const: novatek,nt36672e

  reg:
    maxItems: 1
    description: DSI 虚拟通道

  vddi-supply: true
  avdd-supply: true
  avee-supply: true
  port: true
  reset-gpios: true
  backlight: true

required:
  - compatible
  - reg
  - vddi-supply
  - avdd-supply
  - avee-supply
  - reset-gpios
  - port

additionalProperties: false

examples:
  - |
    #include <dt-bindings/gpio/gpio.h>
    dsi {
        #address-cells = <1>;
        #size-cells = <0>;
        panel@0 {
            compatible = "novatek,nt36672e";
            reg = <0>;

            reset-gpios = <&tlmm 44 GPIO_ACTIVE_HIGH>;

            vddi-supply = <&vreg_l8c_1p8>;
            avdd-supply = <&disp_avdd>;
            avee-supply = <&disp_avee>;

            backlight = <&pwm_backlight>;

            port {
                panel0_in: endpoint {
                    remote-endpoint = <&dsi0_out>;
                };
            };
        };
    };
```

请注意，上述内容是将原始 YAML 文件中的英文描述和注释翻译成了中文。代码本身没有变化，因为 YAML 格式本身就是一种国际化的数据交换格式，不需要进行本地化处理。
~~~~

## Documentation/devicetree/bindings/display/panel/olimex,lcd-olinuxino_cn.yaml
```yaml
# SPDX-许可证标识符: GPL-2.0
%YAML 1.2
---
$id: http://devicetree.org/schemas/display/panel/olimex,lcd-olinuxino.yaml#
$schema: http://devicetree.org/meta-schemas/core.yaml#

标题: Olimex有限公司的LCD-OLinuXino桥接面板
维护者:
  - Stefan Mavrodiev <stefan@olimex.com>

描述: |
  此设备可用作主机控制器和LCD面板之间的桥梁。
  目前支持的LCD包括：
    - LCD-OLinuXino-4.3TS
    - LCD-OLinuXino-5
    - LCD-OLinuXino-7
    - LCD-OLinuXino-10

  面板本身包含：
    - AT24C16C EEPROM，用于存储面板识别信息和时序要求
    - AR1021电阻式触摸屏控制器（可选）
    - FT5x6电容式触摸屏控制器（可选）
    - GT911/GT928电容式触摸屏控制器（可选）

  上述芯片共享同一个I2C总线。EEPROM在出厂时已预先编程有设备信息（ID、序列号等）和时序要求。
  触摸屏绑定可以在以下文件中找到：
    - input/touchscreen/goodix.yaml
    - input/touchscreen/edt-ft5x06.txt
    - input/touchscreen/ar1021.txt

allOf:
  - $ref: panel-common.yaml#

属性:
  compatible:
    常量: olimex,lcd-olinuxino

  reg:
    最大项目数: 1

  backlight: true
  enable-gpios: true
  power-supply: true

必需:
  - compatible
  - reg
  - power-supply

附加属性: false

示例:
  - |
    #include <dt-bindings/gpio/gpio.h>

    i2c {
        #address-cells = <1>;
        #size-cells = <0>;

        panel@50 {
            compatible = "olimex,lcd-olinuxino";
            reg = <0x50>;
            power-supply = <&reg_vcc5v0>;
            enable-gpios = <&pio 7 8 GPIO_ACTIVE_HIGH>;
            backlight = <&backlight>;
        };
    };

..
```

## Documentation/devicetree/bindings/display/panel/orisetech,otm8009a_cn.yaml
```yaml
# SPDX-文件许可人: (GPL-2.0-only 或 BSD-2-Clause)
%YAML 1.2
---
$id: http://devicetree.org/schemas/display/panel/orisetech,otm8009a.yaml#
$schema: http://devicetree.org/meta-schemas/core.yaml#

title: Orise Tech OTM8009A 3.97" 480x800 TFT LCD 面板 (MIPI-DSI 视频模式)

maintainers:
  - Philippe CORNU <philippe.cornu@foss.st.com>

description: |
             Orise Tech OTM8009A 是一个通过 MIPI-DSI 视频接口连接的 3.97" 480x800 TFT LCD 面板。其背光是通过 DSI 链路进行管理。
allOf:
  - $ref: panel-common.yaml#

properties:

  compatible:
    const: orisetech,otm8009a

  reg:
    maxItems: 1
    description: DSI 虚拟通道

  enable-gpios: true
  port: true
  power-supply: true

  reset-gpios:
    maxItems: 1

additionalProperties: false

required:
  - compatible
  - reg

examples:
  - |
    dsi {
      #address-cells = <1>;
      #size-cells = <0>;
      panel@0 {
        compatible = "orisetech,otm8009a";
        reg = <0>;
        reset-gpios = <&gpiof 15 0>;
        power-supply = <&v1v8>;
      };
    };
..
```

## Documentation/devicetree/bindings/display/panel/panel-common-dual_cn.yaml
~~~~yaml
```yaml
# SPDX-许可证标识符: GPL-2.0-only 或 BSD-2-Clause
%YAML 1.2
---
$id: http://devicetree.org/schemas/display/panel/panel-common-dual.yaml#
$schema: http://devicetree.org/meta-schemas/core.yaml#

title: 双链路显示面板的通用属性

maintainers:
  - Thierry Reding <thierry.reding@gmail.com>
  - Laurent Pinchart <laurent.pinchart+renesas@ideasonboard.com>

description:
  支持双链路面板的面板IC通用属性。设备也可能支持单链路。
allOf:
  - $ref: panel-common.yaml#

properties:
  ports:
    $ref: /schemas/graph.yaml#/properties/ports
    additionalProperties: false

    properties:
      port@0:
        $ref: /schemas/graph.yaml#/properties/port
        description: 第一链路

      port@1:
        $ref: /schemas/graph.yaml#/properties/port
        description: 第二链路

      "#address-cells": true
      "#size-cells": true

    required:
      - port@0

# 单面板设置仍然被允许
oneOf:
  - required:
      - ports
  - required:
      - port

additionalProperties: true
```

这段 YAML 代码定义了双链路显示面板的通用属性，适用于 Device Tree 配置文件，并且兼容单链路和单面板的配置。
~~~~

## Documentation/devicetree/bindings/display/panel/panel-common_cn.yaml
```yaml
# SPDX-许可证标识符: GPL-2.0
%YAML 1.2
---
$id: http://devicetree.org/schemas/display/panel/panel-common.yaml#
$schema: http://devicetree.org/meta-schemas/core.yaml#

标题: 显示面板的通用属性

维护者:
  - Thierry Reding <thierry.reding@gmail.com>
  - Laurent Pinchart <laurent.pinchart+renesas@ideasonboard.com>

描述: |
  本文件定义了几类显示面板在设备树中通用的属性。它本身并不构成一个设备树绑定规范，而是旨在被设备树绑定引用。
当从面板设备树绑定中引用时，本文件中定义的属性如下所述。面板设备树绑定负责定义每个属性是必需的还是可选的。
属性:
  # 描述性属性
  width-mm:
    描述:
      指定图像显示物理区域的宽度。此属性以毫米为单位并四舍五入到最接近的整数。
  height-mm:
    描述:
      指定图像显示物理区域的高度。此属性以毫米为单位并四舍五入到最接近的整数。
  label:
    描述: |
      标签属性通过适合人类使用的字符串来指定面板的一个象征性的名称。通常包含系统上（例如，作为粘贴标签）或系统文档中（例如，在用户手册中）所指定的名称。
如果不存在这样的名称，并且根据设备树绑定该属性不是必须的，则应省略而不是使用非描述性信息构造。例如，在仅包含单个面板的系统中的LCD面板不应标记为“LCD”，除非该名称在系统上标示或在系统文档中描述性地使用。
  rotation:
    描述:
      显示旋转角度，逆时针方向（0、90、180、270度）
    $ref: /schemas/types.yaml#/definitions/uint32
    枚举: [0, 90, 180, 270]

  # 显示定时
  panel-timing:
    描述:
      大多数显示面板仅支持单一分辨率，并需要特定的显示定时。`panel-timing` 子节点表示这些定时。
    $ref: panel-timing.yaml#

  display-timings:
    描述:
      一些显示面板支持多种分辨率及其不同的定时。
`display-timings` 绑定支持指定多种定时，并可选择性地指定哪一种是原生模式。
    $ref: display-timings.yaml#

  # 连接性
  port:
    $ref: /schemas/graph.yaml#/properties/port

  ddc-i2c-bus:
    $ref: /schemas/types.yaml#/definitions/phandle
    描述:
      有些面板通过I2C兼容总线（如DDC2或E-DDC）暴露EDID信息。对于这类面板，`ddc-i2c-bus` 包含指向连接到该总线的系统I2C控制器的phandle。
无HPD（热插拔检测）:
    类型: 布尔值
    描述:
      本面板应通过HPD（热插拔检测）信号来表明其已准备就绪，但由于该信号未被连接，因此在启动面板时应根据面板规格硬编码最大延迟时间。

HPD-GPIOs:
    最大项目数: 1
    描述:
      如果热插拔检测（HPD）是连接到系统中的GPIO而非专用的HPD引脚，则可以在此处指定该引脚。

# 控制I/O

  # 许多显示面板可通过由GPIO驱动的引脚进行控制。这些控制信号的特性和定时取决于具体设备，并留给面板设备树绑定来指定。然而对于实现了兼容控制信号的面板，以下的GPIO标识符可以使用。
enable-gpios:
    最大项目数: 1
    描述: |
      用于连接至面板使能控制信号的GPIO标识符。使能信号为高电平有效，用于启用面板操作。此属性也可用于实现了低电平有效的电源关闭信号的面板，该信号是使能信号的反相版本。对于低电平有效的使能信号（或高电平有效的电源关闭信号），可以通过反转GPIO标识符的极性标志来支持。
请注意，使能信号仅控制面板的操作，不应与背光使能信号混淆。
reset-gpios:
    最大项目数: 1
    描述:
      用于连接至面板复位控制信号的GPIO标识符
复位信号为低电平有效，在激活期间复位面板内部逻辑。高电平有效的复位信号可以通过反转GPIO标识符的极性标志来支持。
te-gpios:
    最大项目数: 1
    描述:
      用于撕裂效果同步信号的GPIO标识符
撕裂效果信号为高电平有效。低电平有效的信号可以通过反转GPIO标识符的极性标志来支持。

# 电源
  power-supply:
    描述:
      显示面板需要供电。虽然一些面板需要多个电源供应，且面板特定的约束条件规定了电源供应的顺序和定时，但在许多情况下单个电源就足够了，这可能是因为面板只有一个电源轨，或者是因为所有电源轨都可以由同一电源供应。在这种情况下，`power-supply`属性通过一个指向调节器的phandle来指定为面板供电的电源。
### 背光

### 大多数显示面板包含背光。其中一些还通过诸如I2C或DSI等控制总线暴露背光控制器。其他则通过连接到外部背光控制器的GPIO、PWM或其他信号来暴露背光控制。

**backlight:**
    $ref: /schemas/types.yaml#/definitions/phandle
    description:
      对于由外部背光控制器控制背光的面板，此属性包含一个phandle，用于引用该控制器。
      
**dependencies:**
  width-mm: [ height-mm ]
  height-mm: [ width-mm ]

**additionalProperties:** true

..
```

## Documentation/devicetree/bindings/display/panel/panel-dpi_cn.yaml
```yaml
# SPDX-文件许可人: (GPL-2.0-only 或 BSD-2-Clause)
%YAML 1.2
---
$id: http://devicetree.org/schemas/display/panel/panel-dpi.yaml#
$schema: http://devicetree.org/meta-schemas/core.yaml#

标题: 通用 MIPI DPI 面板

维护者:
  - Sam Ravnborg <sam@ravnborg.org>

allOf:
  - $ref: panel-common.yaml#

属性:
  compatible:
    描述:
      必须包含特定于面板的兼容字符串和 "panel-dpi"，顺序如此
      - {}
      - 常量: panel-dpi

  backlight: true
  enable-gpios: true
  height-mm: true
  label: true
  panel-timing: true
  port: true
  power-supply: true
  reset-gpios: true
  width-mm: true

必需:
  - panel-timing
  - power-supply

不允许额外属性。

示例:
  - |
    panel {
        compatible = "startek,startek-kd050c", "panel-dpi";
        label = "osddisplay";
        power-supply = <&vcc_supply>;
        backlight = <&backlight>;

        port {
            lcd_in: endpoint {
                remote-endpoint = <&dpi_out>;
            };
        };
        panel-timing {
            clock-frequency = <9200000>;
            hactive = <800>;
            vactive = <480>;
            hfront-porch = <8>;
            hback-porch = <4>;
            hsync-len = <41>;
            vback-porch = <2>;
            vfront-porch = <4>;
            vsync-len = <10>;

            hsync-active = <0>;
            vsync-active = <0>;
            de-active = <1>;
            pixelclk-active = <1>;
        };
    };
```
