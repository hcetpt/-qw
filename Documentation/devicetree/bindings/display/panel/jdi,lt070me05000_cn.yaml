## Documentation/devicetree/bindings/display/panel/jdi,lt070me05000_cn.yaml
```yaml
# SPDX-文件许可人: GPL-2.0
%YAML 1.2
---
$id: http://devicetree.org/schemas/display/panel/jdi,lt070me05000.yaml#
$schema: http://devicetree.org/meta-schemas/core.yaml#

title: JDI 型号 LT070ME05000 1200x1920 7" DSI 显示屏面板

维护者:
  - Vinay Simha BN <simhavcs@gmail.com>

allOf:
  - $ref: panel-common.yaml#

属性:
  compatible:
    常量: jdi,lt070me05000

  reg:
    最大项数: 1

  enable-gpios: 真
  reset-gpios: 真

  vddp-supply:
    描述: |
      提供电压给电源IC供电(3-5V)的稳压器。

  iovcc-supply:
    描述: |
      提供电压给IOVCC，即LCD模块供电(1.8V)的稳压器。

  dcdc-en-gpios:
    最大项数: 1
    描述: |
      电源IC线路的GPIO的phandle
      电源IC供电使能, 高电平有效

  port: 真

必需:
  - compatible
  - reg
  - vddp-supply
  - iovcc-supply
  - enable-gpios
  - reset-gpios
  - dcdc-en-gpios

额外属性: 假

示例:
  - |
    #include <dt-bindings/gpio/gpio.h>

    dsi {
        #address-cells = <1>;
        #size-cells = <0>;

        panel@0 {
            compatible = "jdi,lt070me05000";
            reg = <0>;

            vddp-supply = <&pm8921_l17>;
            iovcc-supply = <&pm8921_lvs7>;

            enable-gpios = <&pm8921_gpio 36 GPIO_ACTIVE_HIGH>;
            reset-gpios = <&tlmm_pinmux 54 GPIO_ACTIVE_LOW>;
            dcdc-en-gpios = <&pm8921_gpio 23 GPIO_ACTIVE_HIGH>;
        };
    };
```

## Documentation/devicetree/bindings/display/panel/kingdisplay,kd035g6-54nt_cn.yaml
~~~~yaml
```yaml
# SPDX-文件许可标识: GPL-2.0
%YAML 1.2
---
$id: http://devicetree.org/schemas/display/panel/kingdisplay,kd035g6-54nt.yaml#
$schema: http://devicetree.org/meta-schemas/core.yaml#

title: King Display KD035G6-54NT 3.5" (320x240 像素) 24位 TFT LCD 显示屏

maintainers:
  - Paul Cercueil <paul@crapouillou.net>

allOf:
  - $ref: panel-common.yaml#
  - $ref: /schemas/spi/spi-peripheral-props.yaml#

properties:
  compatible:
    const: kingdisplay,kd035g6-54nt

  reg:
    maxItems: 1

  backlight: true
  port: true
  power-supply: true
  reset-gpios: true

  spi-3wire: true

required:
  - compatible
  - power-supply
  - reset-gpios

unevaluatedProperties: false

examples:
  - |
    #include <dt-bindings/gpio/gpio.h>

    spi {
        #address-cells = <1>;
        #size-cells = <0>;

        panel@0 {
            compatible = "kingdisplay,kd035g6-54nt";
            reg = <0>;

            spi-max-frequency = <3125000>;
            spi-3wire;

            reset-gpios = <&gpe 2 GPIO_ACTIVE_LOW>;

            backlight = <&backlight>;
            power-supply = <&ldo6>;

            port {
                panel_input: endpoint {
                    remote-endpoint = <&panel_output>;
                };
            };
        };
    };
..
```

这段 YAML 文件描述了 King Display KD035G6-54NT 3.5 英寸（320x240 像素）24 位 TFT LCD 面板的设备树规范。维护者为 Paul Cercueil，并定义了一些必要的属性和要求，以及示例配置。
~~~~

## Documentation/devicetree/bindings/display/panel/leadtek,ltk035c5444t_cn.yaml
~~~~yaml
```yaml
# SPDX-许可证标识符: (GPL-2.0-only 或 BSD-2-Clause)
%YAML 1.2
---
$id: http://devicetree.org/schemas/display/panel/leadtek,ltk035c5444t.yaml#
$schema: http://devicetree.org/meta-schemas/core.yaml#

title: Leadtek ltk035c5444t 3.5" (640x480 像素) 24位 IPS 液晶面板

maintainers:
  - Paul Cercueil <paul@crapouillou.net>
  - Christophe Branchereau <cbranchereau@gmail.com>

allOf:
  - $ref: panel-common.yaml#
  - $ref: /schemas/spi/spi-peripheral-props.yaml#

properties:
  compatible:
    const: leadtek,ltk035c5444t

  reg:
    maxItems: 1

  spi-3wire: true

required:
  - compatible
  - reg
  - port
  - power-supply
  - reset-gpios

unevaluatedProperties: false

examples:
  - |
    #include <dt-bindings/gpio/gpio.h>

    spi {
        #address-cells = <1>;
        #size-cells = <0>;
        panel@0 {
            compatible = "leadtek,ltk035c5444t";
            reg = <0>;

            spi-3wire;
            spi-max-frequency = <3125000>;

            reset-gpios = <&gpe 2 GPIO_ACTIVE_LOW>;

            backlight = <&backlight>;
            power-supply = <&vcc>;

            port {
                panel_input: endpoint {
                    remote-endpoint = <&panel_output>;
                };
            };
        };
    };
```

此文档描述了如何在设备树中定义Leadtek ltk035c5444t 3.5英寸（640x480像素）24位IPS液晶面板。它指定了必要的属性，如兼容性、SPI配置、GPIO重置信号等，并给出了一个示例来展示如何在设备树中表示该面板。
~~~~

## Documentation/devicetree/bindings/display/panel/leadtek,ltk050h3146w_cn.yaml
```yaml
# SPDX-文件许可人: (GPL-2.0-only 或 BSD-2-Clause)
%YAML 1.2
---
$id: http://devicetree.org/schemas/display/panel/leadtek,ltk050h3146w.yaml#
$schema: http://devicetree.org/meta-schemas/core.yaml#

标题: Leadtek LTK050H3146W 5.0英寸 720x1280 DSI 显示屏

维护者:
  - Quentin Schulz <quentin.schulz@theobroma-systems.com>

allOf:
  - $ref: panel-common.yaml#

属性:
  compatible:
    枚举:
      - leadtek,ltk050h3146w
      - leadtek,ltk050h3146w-a2
      - leadtek,ltk050h3148w

  reg:
    最大项目数: 1

  backlight: 真
  reset-gpios: 真
  iovcc-supply:
    描述: 提供电压iovcc的调节器
  vci-supply:
    描述: 提供电压vci的调节器

必需:
  - compatible
  - reg
  - backlight
  - iovcc-supply
  - vci-supply

额外属性: 假

示例:
  - |
    dsi {
        #address-cells = <1>;
        #size-cells = <0>;
        panel@0 {
            compatible = "leadtek,ltk050h3146w";
            reg = <0>;
            backlight = <&backlight>;
            iovcc-supply = <&vcc_1v8>;
            vci-supply = <&vcc3v3_lcd>;
        };
    }; 

..
```

## Documentation/devicetree/bindings/display/panel/leadtek,ltk500hd1829_cn.yaml
```yaml
# SPDX-文件许可人: (GPL-2.0-only 或 BSD-2-Clause)
%YAML 1.2
---
$id: http://devicetree.org/schemas/display/panel/leadtek,ltk500hd1829.yaml#
$schema: http://devicetree.org/meta-schemas/core.yaml#

title: Leadtek LTK500HD1829 5.0英寸 720x1280 DSI 显示屏

维护者:
  - Heiko Stuebner <heiko.stuebner@theobroma-systems.com>

allOf:
  - $ref: panel-common.yaml#

属性:
  compatible:
    枚举:
      - leadtek,ltk101b4029w
      - leadtek,ltk500hd1829

  reg:
    maxItems: 1

  backlight: true
  reset-gpios: true
  iovcc-supply:
    描述: 提供电压iovcc的调节器
  vcc-supply:
    描述: 提供电压vcc的调节器

必需:
  - compatible
  - reg
  - backlight
  - iovcc-supply
  - vcc-supply

其他属性: false

示例:
  - |
    dsi {
        #address-cells = <1>;
        #size-cells = <0>;

        panel@0 {
            compatible = "leadtek,ltk500hd1829";
            reg = <0>;
            backlight = <&backlight>;
            iovcc-supply = <&vcc_1v8>;
            vcc-supply = <&vcc_2v8>;
        };
    };
```

## Documentation/devicetree/bindings/display/panel/lg,lg4573_cn.yaml
```yaml
# SPDX-许可证标识符: GPL-2.0
%YAML 1.2
---
$id: http://devicetree.org/schemas/display/panel/lg,lg4573.yaml#
$schema: http://devicetree.org/meta-schemas/core.yaml#

标题: LG LG4573 TFT液晶显示器与SPI控制总线

描述: |
  面板必须遵循在spi/spi-controller.yaml中指定的SPI从设备规则。

维护者:
  - Heiko Schocher <hs@denx.de>

allOf:
  - $ref: panel-common.yaml#
  - $ref: /schemas/spi/spi-peripheral-props.yaml#

属性:
  compatible:
    常量: lg,lg4573

  reg:
    最大项数: 1

必需:
  - compatible
  - reg

未评估属性: false

示例:
  - |
    spi {
        #address-cells = <1>;
        #size-cells = <0>;

        lcd_panel: display@0 {
            compatible = "lg,lg4573";
            spi-max-frequency = <10000000>;
            reg = <0>;
        };
    };
```

## Documentation/devicetree/bindings/display/panel/lgphilips,lb035q02_cn.yaml
```yaml
# SPDX-许可证标识符: GPL-2.0
%YAML 1.2
---
$id: http://devicetree.org/schemas/display/panel/lgphilips,lb035q02.yaml#
$schema: http://devicetree.org/meta-schemas/core.yaml#

标题: LG.Philips LB035Q02 显示屏

维护者:
  - Tomi Valkeinen <tomi.valkeinen@ti.com>

allOf:
  - $ref: panel-common.yaml#
  - $ref: /schemas/spi/spi-peripheral-props.yaml#

属性:
  compatible:
    常量: lgphilips,lb035q02

  reg:
    最大项目数: 1

  label: 真
  enable-gpios: 真
  port: 真

  spi-cpha: 真
  spi-cpol: 真

必需:
  - compatible
  - enable-gpios
  - port

未评估属性: 假

示例:
  - |
    spi {
        #address-cells = <1>;
        #size-cells = <0>;

        panel: panel@0 {
            compatible = "lgphilips,lb035q02";
            reg = <0>;
            spi-max-frequency = <100000>;
            spi-cpol;
            spi-cpha;

            label = "lcd";

            enable-gpios = <&gpio7 7 0>;

            port {
                lcd_in: endpoint {
                    remote-endpoint = <&dpi_out>;
                };
            };
        };
    };

..
```

## Documentation/devicetree/bindings/display/panel/logicpd,type28_cn.yaml
```yaml
# SPDX-许可证标识符: GPL-2.0
%YAML 1.2
---
$id: http://devicetree.org/schemas/display/panel/logicpd,type28.yaml#
$schema: http://devicetree.org/meta-schemas/core.yaml#

标题: Logic PD Type 28 4.3" WQVGA TFT LCD 显示屏

维护者:
  - Adam Ford <aford173@gmail.com>

allOf:
  - $ref: panel-common.yaml#

属性:
  compatible:
    常量: logicpd,type28

  power-supply: 真
  enable-gpios: 真
  backlight: 真
  port: 真

必需:
  - compatible

额外属性: 假

示例:
  - |
    lcd0: display {
      compatible = "logicpd,type28";
      enable-gpios = <&gpio5 27 0>;
      backlight = <&backlight>;
      port {
        lcd_in: endpoint {
          remote-endpoint = <&dpi_out>;
        };
      };
    };
```

## Documentation/devicetree/bindings/display/panel/mantix,mlaf057we51-x_cn.yaml
```yaml
# SPDX-文件许可人: (GPL-2.0-only 或 BSD-2-Clause)
%YAML 1.2
---
$id: http://devicetree.org/schemas/display/panel/mantix,mlaf057we51-x.yaml#
$schema: http://devicetree.org/meta-schemas/core.yaml#

title: Mantix MLAF057WE51-X 5.7" 720x1440 TFT LCD 面板

maintainers:
  - Guido Günther <agx@sigxcpu.org>

description:
  Mantix MLAF057WE51-X 是一个通过 MIPI-DSI 视频接口连接的 720x1440 TFT LCD 面板。
allOf:
  - $ref: panel-common.yaml#

properties:
  compatible:
    enum:
      - mantix,mlaf057we51-x
      - ys,ys57pss36bh5gq

  port: true
  reg:
    maxItems: 1
    description: DSI 虚拟通道

  avdd-supply:
    description: 正向模拟电源供应

  avee-supply:
    description: 负向模拟电源供应

  vddi-supply:
    description: 1.8V I/O 电压供应

  reset-gpios: true

  mantix,tp-rstn-gpios:
    maxItems: 1
    description: 触发 DSI 配置加载的第二条复位线

  backlight: true

required:
  - compatible
  - reg
  - avdd-supply
  - avee-supply
  - vddi-supply
  - reset-gpios

additionalProperties: false

examples:
  - |
    #include <dt-bindings/gpio/gpio.h>

    dsi {
        #address-cells = <1>;
        #size-cells = <0>;
        panel@0 {
            compatible = "mantix,mlaf057we51-x";
            reg = <0>;
            avdd-supply = <&reg_avdd>;
            avee-supply = <&reg_avee>;
            vddi-supply = <&reg_1v8_p>;
            reset-gpios = <&gpio1 29 GPIO_ACTIVE_LOW>;
            mantix,tp-rstn-gpios = <&gpio1 24 GPIO_ACTIVE_LOW>;
            backlight = <&backlight>;
        };
    };

..
```

## Documentation/devicetree/bindings/display/panel/nec,nl8048hl11_cn.yaml
```yaml
# SPDX-许可证标识符: GPL-2.0
%YAML 1.2
---
$id: http://devicetree.org/schemas/display/panel/nec,nl8048hl11.yaml#
$schema: http://devicetree.org/meta-schemas/core.yaml#

标题: NEC NL8048HL11 4.1" WVGA TFT LCD 面板

描述:
  NEC NL8048HL11 是一款 4.1" WVGA TFT LCD 面板，它具有一个 24 位 RGB 并行数据接口和一个 SPI 控制接口。
维护者:
  - Laurent Pinchart <laurent.pinchart@ideasonboard.com>

allOf:
  - $ref: panel-common.yaml#
  - $ref: /schemas/spi/spi-peripheral-props.yaml#

属性:
  compatible:
    常量: nec,nl8048hl11

  reg:
    最大项目数: 1

  label: 真
  port: 真
  reset-gpios: 真

  spi-max-frequency:
    最大值: 10000000

必需:
  - compatible
  - reg
  - reset-gpios
  - port

未评估的属性: 假

示例:
  - |
    #include <dt-bindings/gpio/gpio.h>

    spi {
      #address-cells = <1>;
      #size-cells = <0>;

      lcd_panel: panel@0 {
        compatible = "nec,nl8048hl11";
        reg = <0>;
        spi-max-frequency = <10000000>;

        reset-gpios = <&gpio7 7 GPIO_ACTIVE_LOW>;

        port {
          lcd_in: endpoint {
            remote-endpoint = <&dpi_out>;
          };
        };
      };
    };

..
```

## Documentation/devicetree/bindings/display/panel/newvision,nv3051d_cn.yaml
~~~~yaml
```yaml
# SPDX-许可证标识符: (GPL-2.0-only 或 BSD-2-Clause)
%YAML 1.2
---
$id: http://devicetree.org/schemas/display/panel/newvision,nv3051d.yaml#
$schema: http://devicetree.org/meta-schemas/core.yaml#

title: 基于 NewVision NV3051D 的 LCD 面板

description: |
  NewVision NV3051D 是一种用于驱动 DSI 面板的驱动芯片。
maintainers:
  - Chris Morgan <macromorgan@hotmail.com>

allOf:
  - $ref: panel-common.yaml#

properties:
  compatible:
    items:
      - enum:
          - anbernic,rg351v-panel
          - anbernic,rg353p-panel
          - powkiddy,rk2023-panel
      - const: newvision,nv3051d

  reg:
    maxItems: 1

  backlight: true
  port: true
  reset-gpios:
    description: 低电平有效的复位 GPIO
  vdd-supply: true

required:
  - compatible
  - reg
  - backlight

additionalProperties: false

examples:
  - |
    #include <dt-bindings/gpio/gpio.h>
    dsi {
        #address-cells = <1>;
        #size-cells = <0>;
        panel@0 {
            compatible = "anbernic,rg353p-panel", "newvision,nv3051d";
            reg = <0>;
            backlight = <&backlight>;
            reset-gpios = <&gpio4 0 GPIO_ACTIVE_LOW>;
            vdd-supply = <&vcc3v3_lcd>;

            port {
                mipi_in_panel: endpoint {
                    remote-endpoint = <&mipi_out_panel>;
                };
            };
        };
    };
..
```

这段 YAML 文件定义了基于 NewVision NV3051D 的 LCD 面板的设备树配置。它描述了如何配置与这种面板相关的属性和必要的绑定信息。
~~~~

## Documentation/devicetree/bindings/display/panel/novatek,nt35510_cn.yaml
```yaml
# SPDX-文件许可人: (GPL-2.0-only 或 BSD-2-Clause)
%YAML 1.2
---
$id: http://devicetree.org/schemas/display/panel/novatek,nt35510.yaml#
$schema: http://devicetree.org/meta-schemas/core.yaml#

title: 基于Novatek NT35510的显示面板

maintainers:
  - Linus Walleij <linus.walleij@linaro.org>

allOf:
  - $ref: panel-common.yaml#

properties:
  compatible:
    items:
      - enum:
          - frida,frd400b25025
          - hydis,hva40wv1
      - const: novatek,nt35510
    description: 这表示使用NT35510面板驱动程序的面板制造商。兼容字符串确定了NT35510面板驱动程序如何配置以与指示的面板一起工作。novatek,nt35510 兼容性始终应作为备选方案提供。
reg:
    maxItems: 1

  reset-gpios: 真
  vdd-supply:
    description: 提供电压vdd的稳压器
  vddi-supply:
    description: 提供电压vddi的稳压器
  backlight: 真
  port: 真

required:
  - compatible
  - reg

additionalProperties: false

examples:
  - |
    #include <dt-bindings/gpio/gpio.h>

    dsi {
        #address-cells = <1>;
        #size-cells = <0>;
        panel@0 {
            compatible = "hydis,hva40wv1", "novatek,nt35510";
            reg = <0>;
            vdd-supply = <&ab8500_ldo_aux4_reg>;
            vddi-supply = <&ab8500_ldo_aux6_reg>;
            reset-gpios = <&gpio4 11 GPIO_ACTIVE_LOW>;
            backlight = <&gpio_bl>;
        };
    };

..
```
