## Documentation/devicetree/bindings/display/panel/boe,th101mb31ig002-28a_cn.yaml
~~~~yaml
下面是给定内容的中文翻译：

```yaml
# SPDX-License-Identifier: (GPL-2.0-only OR BSD-2-Clause)
%YAML 1.2
---
$id: http://devicetree.org/schemas/display/panel/boe,th101mb31ig002-28a.yaml#
$schema: http://devicetree.org/meta-schemas/core.yaml#

title: BOE TH101MB31IG002-28A WXGA DSI 显示屏面板

maintainers:
  - 曼努尔·特劳特 <manut@mecka.net>

allOf:
  - $ref: panel-common.yaml#

properties:
  compatible:
    enum:
        # BOE TH101MB31IG002-28A 10.1" WXGA TFT LCD 面板
      - boe,th101mb31ig002-28a

  reg:
    maxItems: 1

  backlight: true
  enable-gpios: true
  power-supply: true
  port: true
  rotation: true

required:
  - compatible
  - reg
  - enable-gpios
  - power-supply

additionalProperties: false

examples:
  - |
    #include <dt-bindings/gpio/gpio.h>

    dsi {
        #address-cells = <1>;
        #size-cells = <0>;
        panel@0 {
            compatible = "boe,th101mb31ig002-28a";
            reg = <0>;
            backlight = <&backlight_lcd0>;
            enable-gpios = <&gpio 45 GPIO_ACTIVE_HIGH>;
            rotation = <90>;
            power-supply = <&vcc_3v3>;
            port {
                panel_in_dsi: endpoint {
                    remote-endpoint = <&dsi_out_con>;
                };
            };
        };
    };
```

请注意，这里的翻译保持了 YAML 格式的规范性，并尽量保留了原文件的结构和格式。
~~~~

## Documentation/devicetree/bindings/display/panel/boe,tv101wum-nl6_cn.yaml
```yaml
下面是给定内容的中文翻译：

# SPDX-文件许可标识符: (GPL-2.0-only 或 BSD-2-Clause)
%YAML 1.2
---
$id: http://devicetree.org/schemas/display/panel/boe,tv101wum-nl6.yaml#
$schema: http://devicetree.org/meta-schemas/core.yaml#

标题: BOE TV101WUM-NL6 DSI 显示面板

维护者:
  - Thierry Reding <thierry.reding@gmail.com>
  - Sam Ravnborg <sam@ravnborg.org>

allOf:
  - $ref: panel-common.yaml#

属性:
  compatible:
    枚举:
      # BOE TV101WUM-NL6 10.1" WUXGA TFT LCD 面板
      - boe,tv101wum-nl6
      # AUO KD101N80-45NA 10.1" WUXGA TFT LCD 面板
      - auo,kd101n80-45na
      # BOE TV101WUM-N53 10.1" WUXGA TFT LCD 面板
      - boe,tv101wum-n53
      # AUO B101UAN08.3 10.1" WUXGA TFT LCD 面板
      - auo,b101uan08.3
      # BOE TV105WUM-NW0 10.5" WUXGA TFT LCD 面板
      - boe,tv105wum-nw0
      # BOE TV110C9M-LL3 10.95" WUXGA TFT LCD 面板
      - boe,tv110c9m-ll3
      # INX HJ110IZ-01A 10.95" WUXGA TFT LCD 面板
      - innolux,hj110iz-01a
      # STARRY 2081101QFH032011-53G 10.1" WUXGA TFT LCD 面板
      - starry,2081101qfh032011-53g
      # STARRY ili9882t 10.51" WUXGA TFT LCD 面板
      - starry,ili9882t

  reg:
    最大项目数: 1

  enable-gpios:
    描述: 用于使能引脚的GPIO规范

  pp1800-supply:
    描述: 核电压供电

  pp3300-supply:
    描述: 核电压供电

  avdd-supply:
    描述: 提供正向电压的稳压器的phandle

  avee-supply:
    描述: 提供负向电压的稳压器的phandle

  backlight:
    描述: 与面板相连的背光设备的phandle

  port: 真
  rotation: 真

必需项:
  - compatible
  - reg
  - enable-gpios
  - pp1800-supply
  - avdd-supply
  - avee-supply

额外属性: 假

示例:
  - |
    dsi {
        #address-cells = <1>;
        #size-cells = <0>;
        panel@0 {
            compatible = "boe,tv101wum-nl6";
            reg = <0>;
            enable-gpios = <&pio 45 0>;
            avdd-supply = <&ppvarn_lcd>;
            avee-supply = <&ppvarp_lcd>;
            pp1800-supply = <&pp1800_lcd>;
            backlight = <&backlight_lcd0>;
            port {
                panel_in: endpoint {
                    remote-endpoint = <&dsi_out>;
                };
            };
        };
    };
```

## Documentation/devicetree/bindings/display/panel/dlc,dlc0700yzg-1_cn.yaml
~~~~yaml
```yaml
# SPDX-文件许可标识: GPL-2.0
%YAML 1.2
---
$id: http://devicetree.org/schemas/display/panel/dlc,dlc0700yzg-1.yaml#
$schema: http://devicetree.org/meta-schemas/core.yaml#

title: DLC 显示公司 DLC0700YZG-1 7.0" WSVGA TFT LCD 面板

maintainers:
  - Philipp Zabel <p.zabel@pengutronix.de>
  - Thierry Reding <thierry.reding@gmail.com>

allOf:
  - $ref: panel-common.yaml#

properties:
  compatible:
    const: dlc,dlc0700yzg-1

  reset-gpios: true
  enable-gpios: true
  backlight: true
  port: true

additionalProperties: false

required:
  - compatible
  - power-supply

..
```

请注意，由于 YAML 格式中不支持注释形式的省略号（即 `..`），因此在实际 YAML 文件中应使用其他方式来表示或省略这部分内容。上述翻译尽可能地保持了原文件结构。
~~~~

## Documentation/devicetree/bindings/display/panel/ebbg,ft8719_cn.yaml
~~~~yaml
```yaml
# SPDX-许可证标识符: GPL-2.0-only 或 BSD-2-Clause
%YAML 1.2
---
$id: http://devicetree.org/schemas/display/panel/ebbg,ft8719.yaml#
$schema: http://devicetree.org/meta-schemas/core.yaml#

title: EBBG FT8719 MIPI-DSI LCD 面板

maintainers:
  - Joel Selvaraj <jo@jsfamily.in>

description: |
  来自 EBBG 的 FT8719 面板是一款 FHD+ LCD 显示面板，分辨率高达 1080x2246。
  它是一个视频模式的 DSI 面板。背光通过 QCOM WLED 驱动进行管理。
allOf:
  - $ref: panel-common.yaml#

properties:
  compatible:
    const: ebbg,ft8719

  reg:
    maxItems: 1
    description: 外设的 DSI 虚拟通道

  vddio-supply:
    description: 电源 IC 供电稳压器

  vddpos-supply:
    description: 正向升压供电稳压器

  vddneg-supply:
    description: 反向升压供电稳压器

required:
  - compatible
  - reg
  - vddio-supply
  - vddpos-supply
  - vddneg-supply
  - reset-gpios
  - port

unevaluatedProperties: false

examples:
  - |
    #include <dt-bindings/gpio/gpio.h>

    dsi {
      #address-cells = <1>;
      #size-cells = <0>;

      panel@0 {
        compatible = "ebbg,ft8719";
        reg = <0>;

        vddio-supply = <&vreg_l14a_1p88>;
        vddpos-supply = <&lab>;
        vddneg-supply = <&ibb>;

        reset-gpios = <&tlmm 6 GPIO_ACTIVE_LOW>;

        backlight = <&pmi8998_wled>;

        port {
          ebbg_ft8719_in_0: endpoint {
            remote-endpoint = <&dsi0_out>;
          };
        };
      };
    };
```

这段 YAML 文件描述了 EBBG FT8719 MIPI-DSI LCD 面板的设备树配置，包括必需的属性、兼容性声明以及示例配置。
~~~~

## Documentation/devicetree/bindings/display/panel/elida,kd35t133_cn.yaml
```yaml
下面是给定内容的中文翻译：

# SPDX-文件许可标识: (GPL-2.0-only 或 BSD-2-Clause)
%YAML 1.2
---
$id: http://devicetree.org/schemas/display/panel/elida,kd35t133.yaml#
$schema: http://devicetree.org/meta-schemas/core.yaml#

标题: Elida KD35T133 3.5英寸 320x480 DSI 显示屏面板

维护者:
  - Heiko Stuebner <heiko.stuebner@theobroma-systems.com>

allOf:
  - $ref: panel-common.yaml#

属性:
  compatible:
    常量: elida,kd35t133

  reg:
    最大项数: 1

  backlight: 真
  port: 真
  reset-gpios: 真
  rotation: 真
  iovcc-supply:
    描述: 提供 iovcc 电压的调节器
  vdd-supply:
    描述: 提供 vdd 电压的调节器

必需:
  - compatible
  - reg
  - backlight
  - port
  - iovcc-supply
  - vdd-supply

额外属性: 假

示例:
  - |
    dsi {
        #address-cells = <1>;
        #size-cells = <0>;
        panel@0 {
            compatible = "elida,kd35t133";
            reg = <0>;
            backlight = <&backlight>;
            iovcc-supply = <&vcc_1v8>;
            vdd-supply = <&vcc3v3_lcd>;

            port {
                mipi_in_panel: endpoint {
                    remote-endpoint = <&mipi_out_panel>;
                };
            };
        };
    };

..
```

## Documentation/devicetree/bindings/display/panel/fascontek,fs035vg158_cn.yaml
~~~~yaml
```yaml
# SPDX-许可证标识符: (GPL-2.0-only 或 BSD-2-Clause)
%YAML 1.2
---
$id: http://devicetree.org/schemas/display/panel/fascontek,fs035vg158.yaml#
$schema: http://devicetree.org/meta-schemas/core.yaml#

title: Fascontek FS035VG158 3.5" (640x480 像素) 24 位 IPS 液晶面板

maintainers:
  - John Watts <contact@jookia.org>

allOf:
  - $ref: panel-common.yaml#
  - $ref: /schemas/spi/spi-peripheral-props.yaml#

properties:
  compatible:
    const: fascontek,fs035vg158

  reg:
    maxItems: 1

  spi-3wire: true

required:
  - compatible
  - reg
  - port
  - power-supply
  - reset-gpios

unevaluatedProperties: false

examples:
  - |
    #include <dt-bindings/gpio/gpio.h>

    spi {
        #address-cells = <1>;
        #size-cells = <0>;
        panel@0 {
            compatible = "fascontek,fs035vg158";
            reg = <0>;

            spi-3wire;
            spi-max-frequency = <3125000>;

            reset-gpios = <&gpe 2 GPIO_ACTIVE_LOW>;

            backlight = <&backlight>;
            power-supply = <&vcc>;

            port {
                panel_input: endpoint {
                    remote-endpoint = <&panel_output>;
                };
            };
        };
    };
```

此文档描述了Fascontek FS035VG158 3.5英寸（640x480像素）24位IPS液晶面板的Device Tree规范。维护者为John Watts，并且该设备支持通过SPI接口进行配置。示例部分展示了如何在Device Tree中表示这个面板。
~~~~

## Documentation/devicetree/bindings/display/panel/feixin,k101-im2ba02_cn.yaml
```yaml
# SPDX-文件许可人: (GPL-2.0-only 或 BSD-2-Clause)
%YAML 1.2
---
$id: http://devicetree.org/schemas/display/panel/feixin,k101-im2ba02.yaml#
$schema: http://devicetree.org/meta-schemas/core.yaml#

标题: Feixin K101 IM2BA02 10.1" MIPI-DSI LCD 显示屏

维护者:
  - Icenowy Zheng <icenowy@aosc.io>

allOf:
  - $ref: panel-common.yaml#

属性:
  compatible:
    常量: feixin,k101-im2ba02

  reg:
    最大项目数: 1

  backlight: true
  reset-gpios: true
  avdd-supply:
    描述: 提供 AVDD 电压的稳压器
  dvdd-supply:
    描述: 提供 DVDD 电压的稳压器
  cvdd-supply:
    描述: 提供 CVDD 电压的稳压器

必需:
  - compatible
  - reg
  - avdd-supply
  - dvdd-supply
  - cvdd-supply

额外属性: false

示例:
  - |
    #include <dt-bindings/gpio/gpio.h>

    dsi {
        #address-cells = <1>;
        #size-cells = <0>;
        panel@0 {
            compatible = "feixin,k101-im2ba02";
            reg = <0>;
            avdd-supply = <&reg_dc1sw>;
            dvdd-supply = <&reg_dc1sw>;
            cvdd-supply = <&reg_ldo_io1>;
            reset-gpios = <&pio 3 24 GPIO_ACTIVE_HIGH>;
            backlight = <&backlight>;
        };
    };

..
```

## Documentation/devicetree/bindings/display/panel/feiyang,fy07024di26a30d_cn.yaml
~~~~yaml
```yaml
# SPDX-许可证标识符: (GPL-2.0-only 或 BSD-2-Clause)
%YAML 1.2
---
$id: http://devicetree.org/schemas/display/panel/feiyang,fy07024di26a30d.yaml#
$schema: http://devicetree.org/meta-schemas/core.yaml#

title: Feiyang FY07024DI26A30-D 7" MIPI-DSI LCD 面板

maintainers:
  - Jagan Teki <jagan@amarulasolutions.com>

allOf:
  - $ref: panel-common.yaml#

properties:
  compatible:
    const: feiyang,fy07024di26a30d

  reg:
    description: 该屏幕使用的 DSI 虚拟通道
    maxItems: 1

  avdd-supply:
    description: 模拟稳压器 dc1 开关

  dvdd-supply:
    description: 3v3 数字稳压器

  port: true
  reset-gpios: true

  backlight: true

required:
  - compatible
  - reg
  - avdd-supply
  - dvdd-supply
  - port

additionalProperties: false

examples:
  - |
    #include <dt-bindings/gpio/gpio.h>

    dsi {
        #address-cells = <1>;
        #size-cells = <0>;

        panel@0 {
            compatible = "feiyang,fy07024di26a30d";
            reg = <0>;
            avdd-supply = <&reg_dc1sw>;
            dvdd-supply = <&reg_dldo2>;
            reset-gpios = <&pio 3 24 GPIO_ACTIVE_HIGH>; /* LCD-RST: PD24 */
            backlight = <&backlight>;

            port {
                mipi_in_panel: endpoint {
                    remote-endpoint = <&mipi_out_panel>;
                };
            };
        };
    };
```

此文档描述了如何在 Device Tree 中配置 Feiyang FY07024DI26A30-D 7" MIPI-DSI LCD 面板。包括了必要的属性和示例配置，以确保正确地初始化和使用该 LCD 面板。
~~~~

## Documentation/devicetree/bindings/display/panel/focaltech,gpt3_cn.yaml
~~~~yaml
```yaml
# SPDX-许可证标识符: (GPL-2.0 或 BSD-2-Clause)
%YAML 1.2
---
$id: http://devicetree.org/schemas/display/panel/focaltech,gpt3.yaml#
$schema: http://devicetree.org/meta-schemas/core.yaml#

title: Focaltech GPT3 3.0" (640x480 像素) IPS LCD 面板

maintainers:
  - Christophe Branchereau <cbranchereau@gmail.com>

allOf:
  - $ref: panel-common.yaml#
  - $ref: /schemas/spi/spi-peripheral-props.yaml#

properties:
  compatible:
    const: focaltech,gpt3

  reg:
    maxItems: 1

required:
  - compatible
  - reg
  - power-supply
  - reset-gpios

unevaluatedProperties: false

examples:
  - |
    #include <dt-bindings/gpio/gpio.h>

    spi {
        #address-cells = <1>;
        #size-cells = <0>;

        panel@0 {
            compatible = "focaltech,gpt3";
            reg = <0>;

            spi-max-frequency = <3125000>;

            reset-gpios = <&gpe 2 GPIO_ACTIVE_LOW>;

            backlight = <&backlight>;
            power-supply = <&vcc>;

            port {
                panel_input: endpoint {
                    remote-endpoint = <&panel_output>;
                };
            };
        };
    };
```

请注意，此文档描述了一个设备树（Device Tree）配置文件，用于定义Focaltech GPT3 3.0英寸(640x480像素)IPS LCD面板的硬件接口和属性。这个配置文件遵循特定的模式，并指定了必要的属性以确保与系统的正确集成。
~~~~

## Documentation/devicetree/bindings/display/panel/himax,hx83102_cn.yaml
```yaml
# SPDX-文件许可人: (GPL-2.0-only 或 BSD-2-Clause)
%YAML 1.2
---
$id: http://devicetree.org/schemas/display/panel/himax,hx83102.yaml#
$schema: http://devicetree.org/meta-schemas/core.yaml#

title: Himax HX83102 MIPI-DSI LCD 面板控制器

maintainers:
  - Cong Yang <yangcong5@huaqin.corp-partner.google.com>

allOf:
  - $ref: panel-common.yaml#

properties:
  compatible:
    items:
      - enum:
          # Boe nv110wum-l60 11.0" WUXGA TFT LCD 面板
          - boe,nv110wum-l60
          # IVO t109nw41 11.0" WUXGA TFT LCD 面板
          - ivo,t109nw41
          # STARRY himax83102-j02 10.51" WUXGA TFT LCD 面板
          - starry,himax83102-j02
      - const: himax,hx83102

  reg:
    description: DSI 外设的虚拟通道编号

  enable-gpios:
    description: 启用引脚的 GPIO 规格

  pp1800-supply:
    description: 核心电压供应

  avdd-supply:
    description: 提供正向电压的稳压器的 phandle

  avee-supply:
    description: 提供负向电压的稳压器的 phandle

  backlight: true
  port: true
  rotation: true

required:
  - compatible
  - reg
  - enable-gpios
  - pp1800-supply
  - avdd-supply
  - avee-supply

additionalProperties: false

examples:
  - |
    dsi {
        #address-cells = <1>;
        #size-cells = <0>;
        panel@0 {
            compatible = "starry,himax83102-j02", "himax,hx83102";
            reg = <0>;
            enable-gpios = <&pio 45 0>;
            avdd-supply = <&ppvarn_lcd>;
            avee-supply = <&ppvarp_lcd>;
            pp1800-supply = <&pp1800_lcd>;
            backlight = <&backlight_lcd0>;
            port {
                panel_in: endpoint {
                    remote-endpoint = <&dsi_out>;
                };
            };
        };
    };
```

## Documentation/devicetree/bindings/display/panel/himax,hx83112a_cn.yaml
```yaml
# SPDX-文件许可人: GPL-2.0-only 或 BSD-2-Clause
%YAML 1.2
---
$id: http://devicetree.org/schemas/display/panel/himax,hx83112a.yaml#
$schema: http://devicetree.org/meta-schemas/core.yaml#

标题: 基于Himax HX83112A的DSI显示面板

维护者:
  - Luca Weiss <luca.weiss@fairphone.com>

描述:
  Himax HX83112A 是一种通用的DSI面板控制IC，用于控制LCD面板。
allOf:
  - $ref: panel-common.yaml#

属性:
  compatible:
    包含:
      常量: djn,9a-3r063-1102b

  reg:
    最大项数: 1

  vdd1-supply:
    描述: 数字电压轨

  vsn-supply:
    描述: 正向源电压轨

  vsp-supply:
    描述: 负向源电压轨

  port: 真

必需:
  - compatible
  - reg
  - reset-gpios
  - vdd1-supply
  - vsn-supply
  - vsp-supply
  - port

未评估属性: 假

示例:
  - |
    #include <dt-bindings/gpio/gpio.h>

    dsi {
        #address-cells = <1>;
        #size-cells = <0>;

        panel@0 {
            compatible = "djn,9a-3r063-1102b";
            reg = <0>;

            backlight = <&pm6150l_wled>;
            reset-gpios = <&pm6150l_gpios 9 GPIO_ACTIVE_LOW>;

            vdd1-supply = <&vreg_l1e>;
            vsn-supply = <&pm6150l_lcdb_ncp>;
            vsp-supply = <&pm6150l_lcdb_ldo>;

            port {
                panel_in_0: endpoint {
                    remote-endpoint = <&dsi0_out>;
                };
            };
        };
    };
```
