## Documentation/devicetree/bindings/display/panel/jdi,lpm102a188a_cn.yaml
```yaml
下面是给定内容的中文翻译：

# SPDX-文件许可标识符: GPL-2.0-only 或 BSD-2-Clause
%YAML 1.2
---
$id: http://devicetree.org/schemas/display/panel/jdi,lpm102a188a.yaml#
$schema: http://devicetree.org/meta-schemas/core.yaml#

标题: JDI LPM102A188A 2560x1800 10.2" DSI 面板

维护者:
  - 迪奥戈·伊沃 <diogo.ivo@tecnico.ulisboa.pt>

描述: |
  此面板需要双通道 DSI 主机才能运行。它支持两种模式：
  - 左右：每个通道驱动屏幕的左半部分或右半部分
  - 偶奇：每个通道驱动屏幕的偶数行或奇数行

  每个 DSI 通道控制一个独立的 DSI 外设。由第一个链路（DSI-LINK1）驱动的外设被视为主外设，并控制设备。'link2' 属性包含指向第二个链路（DSI-LINK2）所驱动的外设的 phandle。
allOf:
  - $ref: panel-common.yaml#

属性:
  compatible:
    常量: jdi,lpm102a188a

  reg:
    最大项数: 1

  enable-gpios: true
  reset-gpios: true
  power-supply: true
  backlight: true

  ddi-supply:
    描述: 提供电源 IOVCC（1.8V）的稳压器
link2:
    $ref: /schemas/types.yaml#/definitions/phandle
    描述: |
      指向次级链路上的 DSI 外设的 phandle。注意，此属性的存在标志着包含节点为 DSI-LINK1
required:
  - compatible
  - reg

if:
  required:
    - link2
then:
  required:
    - power-supply
    - ddi-supply
    - enable-gpios
    - reset-gpios

additionalProperties: false

示例:
  - |
    #include <dt-bindings/gpio/gpio.h>
    #include <dt-bindings/gpio/tegra-gpio.h>

    dsia: dsi@54300000 {
        #address-cells = <1>;
        #size-cells = <0>;
        reg = <0x0 0x54300000 0x0 0x00040000>;

        link2: panel@0 {
            compatible = "jdi,lpm102a188a";
            reg = <0>;
        };
    };

    dsib: dsi@54400000{
        #address-cells = <1>;
        #size-cells = <0>;
        reg = <0x0 0x54400000 0x0 0x00040000>;
        nvidia,ganged-mode = <&dsia>;

        link1: panel@0 {
            compatible = "jdi,lpm102a188a";
            reg = <0>;
            power-supply = <&pplcd_vdd>;
            ddi-supply = <&pp1800_lcdio>;
            enable-gpios = <&gpio TEGRA_GPIO(V, 1) GPIO_ACTIVE_HIGH>;
            reset-gpios = <&gpio TEGRA_GPIO(V, 2) GPIO_ACTIVE_LOW>;
            link2 = <&link2>;
            backlight = <&backlight>;
        };
    };

..
```
