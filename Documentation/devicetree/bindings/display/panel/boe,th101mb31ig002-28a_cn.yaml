## Documentation/devicetree/bindings/display/panel/himax,hx8394_cn.yaml
```yaml
# SPDX-文件许可人: (GPL-2.0-only 或 BSD-2-Clause)
%YAML 1.2
---
$id: http://devicetree.org/schemas/display/panel/himax,hx8394.yaml#
$schema: http://devicetree.org/meta-schemas/core.yaml#

title: Himax HX8394 MIPI-DSI LCD 面板控制器

maintainers:
  - Ondrej Jirman <megi@xff.cz>
  - Javier Martinez Canillas <javierm@redhat.com>

description:
  设备树绑定用于基于Himax HX8394控制器的面板，例如通过MIPI-DSI视频接口连接的HannStar HSD060BHW4 720x1440 TFT LCD面板
allOf:
  - $ref: panel-common.yaml#

properties:
  compatible:
    items:
      - enum:
          - hannstar,hsd060bhw4
          - powkiddy,x55-panel
      - const: himax,hx8394

  reg:
    maxItems: 1

  reset-gpios: true

  backlight: true

  rotation: true

  port: true

  vcc-supply:
    description: 面板电源供应

  iovcc-supply:
    description: I/O电压供应

required:
  - compatible
  - reg
  - reset-gpios
  - backlight
  - port
  - vcc-supply
  - iovcc-supply

additionalProperties: false

examples:
  - |
    #include <dt-bindings/gpio/gpio.h>

    dsi {
        #address-cells = <1>;
        #size-cells = <0>;
        panel@0 {
            compatible = "hannstar,hsd060bhw4", "himax,hx8394";
            reg = <0>;
            vcc-supply = <&reg_2v8_p>;
            iovcc-supply = <&reg_1v8_p>;
            reset-gpios = <&gpio3 13 GPIO_ACTIVE_LOW>;
            backlight = <&backlight>;

            port {
                mipi_in_panel: endpoint {
                    remote-endpoint = <&mipi_out_panel>;
                };
            };
        };
    };

..
```

## Documentation/devicetree/bindings/display/panel/ilitek,ili9163_cn.yaml
```yaml
# SPDX-License-Identifier: (GPL-2.0-only OR BSD-2-Clause)
%YAML 1.2
---
$id: http://devicetree.org/schemas/display/panel-ilitek,ili9163.yaml#
$schema: http://devicetree.org/meta-schemas/core.yaml#

标题: Ilitek ILI9163 显示屏面板

维护者:
  - Daniel Mack <daniel@zonque.org>

描述:
  此绑定适用于使用 Ilitek ILI9163 控制器的 SPI 模式显示屏面板
allOf:
  - $ref: panel-common.yaml#
  - $ref: /schemas/spi/spi-peripheral-props.yaml#

属性:
  compatible:
    items:
      - enum:
          - newhaven,1.8-128160EF
      - const: ilitek,ili9163

  reg:
    maxItems: 1

  spi-max-frequency:
    maximum: 32000000

  dc-gpios:
    maxItems: 1
    描述: 显示数据/命令选择 (D/CX)

  backlight: true
  reset-gpios: true
  rotation: true

必需:
  - compatible
  - reg
  - dc-gpios
  - reset-gpios

未评估属性: false

示例:
  - |
    #include <dt-bindings/gpio/gpio.h>

    spi {
            #address-cells = <1>;
            #size-cells = <0>;

            display@0 {
                    compatible = "newhaven,1.8-128160EF", "ilitek,ili9163";
                    reg = <0>;
                    spi-max-frequency = <32000000>;
                    dc-gpios = <&gpio0 24 GPIO_ACTIVE_HIGH>;
                    reset-gpios = <&gpio0 25 GPIO_ACTIVE_HIGH>;
                    rotation = <180>;
                    backlight = <&backlight>;
            };
    };

..
```

## Documentation/devicetree/bindings/display/panel/ilitek,ili9322_cn.yaml
```yaml
# SPDX-许可证标识符: GPL-2.0
%YAML 1.2
---
$id: http://devicetree.org/schemas/display/panel/ilitek,ili9322.yaml#
$schema: http://devicetree.org/meta-schemas/core.yaml#

标题: Ilitek ILI9322 TFT 面板驱动程序，带有 SPI 控制总线

维护者:
  - Linus Walleij <linus.walleij@linaro.org>

描述: |
  这是一个针对 320x240 TFT 面板的驱动程序，它支持多种输入流，并将其适配和缩放到面板上。该面板输出有 960 个 TFT 源驱动器引脚和 240 个 TFT 栅极驱动器引脚、VCOM、VCOML 和 VCOMH 输出。
allOf:
  - $ref: panel-common.yaml#
  - $ref: /schemas/spi/spi-peripheral-props.yaml#

属性:
  compatible:
    items:
      - enum:
          - dlink,dir-685-panel
      - const: ilitek,ili9322

  reg:
    maxItems: 1

  reset-gpios: true
  port: true

  vcc-supply:
    描述: 核心电压供应

  iovcc-supply:
    描述: 接口输入/输出信号的电压供应

  vci-supply:
    描述: 模拟部分的电压供应

必需:
  - compatible
  - reg

未评估的属性: false

示例:
  - |
    spi {
        #address-cells = <1>;
        #size-cells = <0>;

        panel: display@0 {
            compatible = "dlink,dir-685-panel", "ilitek,ili9322";
            reg = <0>;
            vcc-supply = <&vdisp>;
            iovcc-supply = <&vdisp>;
            vci-supply = <&vdisp>;

            port {
                panel_in: endpoint {
                    remote-endpoint = <&display_out>;
                };
            };
        };
    };

..
```

## Documentation/devicetree/bindings/display/panel/ilitek,ili9341_cn.yaml
```yaml
下面是给定内容的中文翻译：

# SPDX-许可证标识符: (GPL-2.0-only 或 BSD-2-Clause)
%YAML 1.2
---
$id: http://devicetree.org/schemas/display/panel/ilitek,ili9341.yaml#
$schema: http://devicetree.org/meta-schemas/core.yaml#

标题: Ilitek-9341 显示屏面板

维护者:
  - Dillon Min <dillon.minfei@gmail.com>

描述: |
  Ilitek ILI9341 TFT 面板驱动程序，带有 SPI 控制总线
  这是一个针对 320x240 TFT 面板的驱动程序，接受 16 位或 18 位的 RGB 输入流
allOf:
  - $ref: panel-common.yaml#
  - $ref: /schemas/spi/spi-peripheral-props.yaml#

属性:
  compatible:
    items:
      - enum:
          - adafruit,yx240qv29
          # 在 stm32f429-disco 板上使用 240*320 彩色的 ili9341
          - st,sf-tc240t-9370-t
          - canaan,kd233-tft
      - const: ilitek,ili9341

  reg:
    maxItems: 1

  dc-gpios:
    maxItems: 1
    描述: 此 DBI 面板的显示数据/命令选择 (D/CX)

  spi-3wire: true

  spi-max-frequency:
    const: 10000000

  port: true

  vci-supply:
    描述: 模拟电压供电 (2.5 .. 3.3V)

  vddi-supply:
    描述: 接口逻辑的电压供电 (1.65 .. 3.3 V)

  vddi-led-supply:
    描述: LED 驱动器的电压供电 (1.65 .. 3.3 V)

unevaluatedProperties: false

必需:
  - compatible
  - reg
  - dc-gpios

如果:
  属性:
    compatible:
      包含:
        enum:
          - st,sf-tc240t-9370-t
那么:
  必需:
    - port

示例:
  - |+
    #include <dt-bindings/gpio/gpio.h>
    spi {
        #address-cells = <1>;
        #size-cells = <0>;
        panel: display@0 {
            compatible = "st,sf-tc240t-9370-t",
                         "ilitek,ili9341";
            reg = <0>;
            spi-3wire;
            spi-max-frequency = <10000000>;
            dc-gpios = <&gpiod 13 0>;
            port {
                panel_in: endpoint {
                    remote-endpoint = <&display_out>;
                };
            };
        };
        display@1{
            compatible = "adafruit,yx240qv29", "ilitek,ili9341";
            reg = <1>;
            spi-max-frequency = <10000000>;
            dc-gpios = <&gpio0 9 GPIO_ACTIVE_HIGH>;
            reset-gpios = <&gpio0 8 GPIO_ACTIVE_HIGH>;
            rotation = <270>;
            backlight = <&backlight>;
        };
    };
```

## Documentation/devicetree/bindings/display/panel/ilitek,ili9805_cn.yaml
```yaml
# SPDX-文件许可人: (GPL-2.0-only 或 BSD-2-Clause)
%YAML 1.2
---
$id: http://devicetree.org/schemas/display/panel-ilitek,ili9805.yaml#
$schema: http://devicetree.org/meta-schemas/core.yaml#

title: 基于Ilitek ILI9805 的 MIPI-DSI 显示屏

维护者:
  - Michael Trimarchi <michael@amarulasolutions.com>

allOf:
  - $ref: panel-common.yaml#

属性:
  compatible:
    items:
      - 枚举:
          - giantplus,gpm1790a0
          - tianma,tm041xdhg01
      - 常量: ilitek,ili9805

  reg:
    maxItems: 1

  avdd-supply: true
  dvdd-supply: true

必需:
  - compatible
  - avdd-supply
  - dvdd-supply
  - reg
  - reset-gpios
  - port
  - backlight

未评估的属性: false

示例:
  - |
    #include <dt-bindings/gpio/gpio.h>

    dsi {
        #address-cells = <1>;
        #size-cells = <0>;

        panel@0 {
            compatible = "giantplus,gpm1790a0", "ilitek,ili9805";
            reg = <0>;
            avdd-supply = <&avdd_display>;
            dvdd-supply = <&dvdd_display>;
            reset-gpios = <&r_pio 0 5 GPIO_ACTIVE_LOW>; /* PL05 */
            backlight = <&backlight>;

            port {
                panel_in: endpoint {
                    remote-endpoint = <&mipi_dsi_out>;
                };
            };
        };
    };

..
```

## Documentation/devicetree/bindings/display/panel/ilitek,ili9806e_cn.yaml
~~~~yaml
下面是给定内容的中文翻译：

```yaml
# SPDX-文件许可标识: (GPL-2.0-only 或 BSD-2-Clause)
%YAML 1.2
---
$id: http://devicetree.org/schemas/display/panel/ilitek,ili9806e.yaml#
$schema: http://devicetree.org/meta-schemas/core.yaml#

title: 基于 Ilitek ILI9806E 的 MIPI-DSI 显示屏

maintainers:
  - Michael Walle <mwalle@kernel.org>

allOf:
  - $ref: panel-common.yaml#

properties:
  compatible:
    items:
      - enum:
          - ortustech,com35h3p70ulc
      - const: ilitek,ili9806e

  reg:
    maxItems: 1

  vdd-supply: true
  vccio-supply: true

required:
  - compatible
  - reg
  - vdd-supply
  - vccio-supply
  - reset-gpios
  - backlight
  - port

unevaluatedProperties: false

examples:
  - |
    #include <dt-bindings/gpio/gpio.h>

    dsi {
        #address-cells = <1>;
        #size-cells = <0>;

        panel@0 {
            compatible = "ortustech,com35h3p70ulc", "ilitek,ili9806e";
            reg = <0>;
            vdd-supply = <&reg_vdd_panel>;
            vccio-supply = <&reg_vccio_panel>;
            reset-gpios = <&gpio3 6 GPIO_ACTIVE_LOW>;
            backlight = <&backlight>;

            port {
                panel_in: endpoint {
                    remote-endpoint = <&dsi_out>;
                };
            };
        };
    };
```

说明：
此文档定义了基于 Ilitek ILI9806E 芯片组的 MIPI-DSI 显示屏的设备树配置。维护者为 Michael Walle。该配置要求指定与之兼容的设备型号、寄存器信息以及必要的电源和控制信号等。示例部分展示了一个具体的设备树片段，用于配置一个使用 Ilitek ILI9806E 的显示屏。
~~~~

## Documentation/devicetree/bindings/display/panel/ilitek,ili9881c_cn.yaml
```yaml
# SPDX-许可证标识符: GPL-2.0
%YAML 1.2
---
$id: http://devicetree.org/schemas/display/panel/ilitek,ili9881c.yaml#
$schema: http://devicetree.org/meta-schemas/core.yaml#

标题: 基于Ilitek ILI9881c 的MIPI-DSI显示面板

维护者:
  - Maxime Ripard <mripard@kernel.org>

allOf:
  - $ref: panel-common.yaml#

属性:
  compatible:
    items:
      - 枚举:
          - ampire,am8001280g
          - bananapi,lhr050h41
          - feixin,k101-im2byl02
          - startek,kd050hdfia020
          - tdo,tl050hdv35
          - wanchanglong,w552946aba
      - 常量: ilitek,ili9881c

  reg:
    最大项数: 1

  backlight: true
  power-supply: true
  reset-gpios: true
  rotation: true

必需:
  - compatible
  - power-supply
  - reg

额外属性: false

示例:
  - |
    #include <dt-bindings/gpio/gpio.h>

    dsi {
        #address-cells = <1>;
        #size-cells = <0>;

        panel@0 {
            compatible = "bananapi,lhr050h41", "ilitek,ili9881c";
            reg = <0>;
            power-supply = <&reg_display>;
            reset-gpios = <&r_pio 0 5 GPIO_ACTIVE_LOW>; /* PL05 */
            backlight = <&pwm_bl>;
        };
    };
```

## Documentation/devicetree/bindings/display/panel/innolux,ej030na_cn.yaml
~~~~yaml
```yaml
# SPDX-许可证标识符: (GPL-2.0 或 BSD-2-Clause)
%YAML 1.2
---
$id: http://devicetree.org/schemas/display/panel/innolux,ej030na.yaml#
$schema: http://devicetree.org/meta-schemas/core.yaml#

title: Innolux EJ030NA 3.0" (320x480 像素) 24位 TFT 液晶屏

maintainers:
  - Paul Cercueil <paul@crapouillou.net>

allOf:
  - $ref: panel-common.yaml#
  - $ref: /schemas/spi/spi-peripheral-props.yaml#

properties:
  compatible:
    const: innolux,ej030na

  reg:
    maxItems: 1

  backlight: true
  port: true
  power-supply: true
  reset-gpios: true

required:
  - compatible
  - reg
  - power-supply
  - reset-gpios

unevaluatedProperties: false

examples:
  - |
    #include <dt-bindings/gpio/gpio.h>

    spi {
        #address-cells = <1>;
        #size-cells = <0>;

        panel@0 {
            compatible = "innolux,ej030na";
            reg = <0>;

            spi-max-frequency = <10000000>;

            reset-gpios = <&gpe 4 GPIO_ACTIVE_LOW>;
            power-supply = <&lcd_power>;

            backlight = <&backlight>;

            port {
                panel_input: endpoint {
                    remote-endpoint = <&panel_output>;
                };
            };
        };
    };
```

请注意，此翻译保持了原有的 YAML 结构和语法，并将描述性文本翻译成了中文。此外，代码示例中的注释和绑定语法保持不变，因为它们是特定于硬件配置的，通常不会进行翻译。
~~~~

## Documentation/devicetree/bindings/display/panel/innolux,p097pfg_cn.yaml
```yaml
# SPDX-许可证标识符: GPL-2.0
%YAML 1.2
---
$id: http://devicetree.org/schemas/display/panel/innolux,p097pfg.yaml#
$schema: http://devicetree.org/meta-schemas/core.yaml#

标题: Innolux P097PFG 9.7" 1536x2048 TFT LCD 显示屏

维护者:
  - 林煌 <hl@rock-chips.com>

allOf:
  - $ref: panel-common.yaml#

属性:
  compatible:
    常量: innolux,p097pfg

  reg:
    最大项数: 1

  backlight: true
  enable-gpios: true

  avdd-supply:
    描述: 提供正电压的稳压器

  avee-supply:
    描述: 提供负电压的稳压器

必需:
  - compatible
  - reg
  - avdd-supply
  - avee-supply
  - enable-gpios

额外属性: false

示例:
  - |
    #include <dt-bindings/gpio/gpio.h>

    dsi {
        #address-cells = <1>;
        #size-cells = <0>;

        panel@0 {
            compatible = "innolux,p097pfg";
            reg = <0>;
            avdd-supply = <&avdd>;
            avee-supply = <&avee>;
            backlight = <&backlight>;
            enable-gpios = <&gpio1 13 GPIO_ACTIVE_HIGH>;
        };
    };
```

## Documentation/devicetree/bindings/display/panel/jadard,jd9365da-h3_cn.yaml
```yaml
# SPDX-文件许可人: (GPL-2.0-only 或 BSD-2-Clause)
%YAML 1.2
---
$id: http://devicetree.org/schemas/display/panel/jadard,jd9365da-h3.yaml#
$schema: http://devicetree.org/meta-schemas/core.yaml#

title: Jadard JD9365DA-HE WXGA DSI 显示屏

maintainers:
  - Jagan Teki <jagan@edgeble.ai>

allOf:
  - $ref: panel-common.yaml#

properties:
  compatible:
    items:
      - enum:
          - chongzhou,cz101b4001
          - kingdisplay,kd101ne3-40ti
          - radxa,display-10hd-ad001
          - radxa,display-8hd-ad002
      - const: jadard,jd9365da-h3

  reg:
    maxItems: 1

  vdd-supply:
    description: 为 VDD 提供电源的稳压器，通常是 3.3V

  vccio-supply:
    description: 为 VCCIO 提供电源的稳压器，通常是 1.8V

  reset-gpios: true

  backlight: true

  port: true

required:
  - compatible
  - reg
  - vdd-supply
  - vccio-supply
  - reset-gpios

additionalProperties: false

examples:
  - |
    #include <dt-bindings/gpio/gpio.h>
    #include <dt-bindings/pinctrl/rockchip.h>

    dsi {
        #address-cells = <1>;
        #size-cells = <0>;

        panel@0 {
            compatible = "chongzhou,cz101b4001", "jadard,jd9365da-h3";
            reg = <0>;
            vdd-supply = <&lcd_3v3>;
            vccio-supply = <&vcca_1v8>;
            reset-gpios = <&gpio1 RK_PC2 GPIO_ACTIVE_HIGH>;
            backlight = <&backlight>;

            port {
                mipi_in_panel: endpoint {
                    remote-endpoint = <&mipi_out_panel>;
                };
            };
        };
    };

..
```
