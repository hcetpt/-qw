## Documentation/devicetree/bindings/display/brcm,bcm2835-hvs_cn.yaml
```yaml
# SPDX-许可证标识符: GPL-2.0
%YAML 1.2
---
$id: http://devicetree.org/schemas/display/brcm,bcm2835-hvs.yaml#
$schema: http://devicetree.org/meta-schemas/core.yaml#

title: Broadcom VC4 (VideoCore4) 硬件视频缩放器

维护者:
  - Eric Anholt <eric@anholt.net>

属性:
  compatible:
    枚举:
      - brcm,bcm2711-hvs
      - brcm,bcm2835-hvs

  reg:
    最大项目数: 1

  interrupts:
    最大项目数: 1

  clocks:
    最大项目数: 1
    描述: 核心时钟

必需:
  - compatible
  - reg
  - interrupts

附加属性: false

如果:
  属性:
    compatible:
      包含:
        常量: brcm,bcm2711-hvs

那么:
  必需:
    - clocks

示例:
  - |
    hvs@7e400000 {
        compatible = "brcm,bcm2835-hvs";
        reg = <0x7e400000 0x6000>;
        interrupts = <2 1>;
    };

..
```

## Documentation/devicetree/bindings/display/brcm,bcm2835-pixelvalve0_cn.yaml
```yaml
# SPDX-License-Identifier: GPL-2.0
%YAML 1.2
---
$id: http://devicetree.org/schemas/display/brcm,bcm2835-pixelvalve0.yaml#
$schema: http://devicetree.org/meta-schemas/core.yaml#

标题: Broadcom VC4 (VideoCore4) PixelValve

维护者:
  - Eric Anholt <eric@anholt.net>

属性:
  compatible:
    枚举:
      - brcm,bcm2835-pixelvalve0
      - brcm,bcm2835-pixelvalve1
      - brcm,bcm2835-pixelvalve2
      - brcm,bcm2711-pixelvalve0
      - brcm,bcm2711-pixelvalve1
      - brcm,bcm2711-pixelvalve2
      - brcm,bcm2711-pixelvalve3
      - brcm,bcm2711-pixelvalve4

  reg:
    最大项数: 1

  interrupts:
    最大项数: 1

必需:
  - compatible
  - reg
  - interrupts

额外属性: false

示例:
  - |
    pixelvalve@7e807000 {
        compatible = "brcm,bcm2835-pixelvalve2";
        reg = <0x7e807000 0x100>;
        interrupts = <2 10>; /* pixelvalve */
    };
```

## Documentation/devicetree/bindings/display/brcm,bcm2835-txp_cn.yaml
```yaml
# SPDX-文件许可人: GPL-2.0
%YAML 1.2
---
$id: http://devicetree.org/schemas/display/brcm,bcm2835-txp.yaml#
$schema: http://devicetree.org/meta-schemas/core.yaml#

标题: Broadcom VC4 (VideoCore4) TXP (回写) 控制器

维护者:
  - Eric Anholt <eric@anholt.net>

属性:
  compatible:
    常量: brcm,bcm2835-txp

  reg:
    最大项数: 1

  interrupts:
    最大项数: 1

必需:
  - compatible
  - reg
  - interrupts

额外属性: false

示例:
  - |
    txp: txp@7e004000 {
        compatible = "brcm,bcm2835-txp";
        reg = <0x7e004000 0x20>;
        interrupts = <1 11>;
    };
```

## Documentation/devicetree/bindings/display/brcm,bcm2835-v3d_cn.yaml
```yaml
# SPDX-许可证标识符: GPL-2.0
%YAML 1.2
---
$id: http://devicetree.org/schemas/display/brcm,bcm2835-v3d.yaml#
$schema: http://devicetree.org/meta-schemas/core.yaml#

标题: Broadcom VC4 (VideoCore4) V3D 图形处理单元

维护者:
  - Eric Anholt <eric@anholt.net>

属性:
  compatible:
    枚举:
      - brcm,bcm2835-v3d
      - brcm,cygnus-v3d

  reg:
    最大项目数: 1

  clocks:
    最大项目数: 1

  interrupts:
    最大项目数: 1

  power-domains:
    最大项目数: 1

必需:
  - compatible
  - reg
  - interrupts

额外属性: false

示例:
  - |
    v3d: v3d@7ec00000 {
        compatible = "brcm,bcm2835-v3d";
        reg = <0x7ec00000 0x1000>;
        interrupts = <1 10>;
    };
```

## Documentation/devicetree/bindings/display/brcm,bcm2835-vc4_cn.yaml
```yaml
# SPDX-文件许可人: GPL-2.0
%YAML 1.2
---
$id: http://devicetree.org/schemas/display/brcm,bcm2835-vc4.yaml#
$schema: http://devicetree.org/meta-schemas/core.yaml#

标题: Broadcom VC4 (VideoCore4) 图形处理器

维护者:
  - Eric Anholt <eric@anholt.net>

描述: >
  在 Raspberry Pi 上的 VC4 设备包括一个带有 HDMI 输出和 HVS（硬件视频缩放器）的显示系统，用于合成显示平面。

属性:
  compatible:
    枚举:
      - brcm,bcm2711-vc5
      - brcm,bcm2835-vc4
      - brcm,cygnus-vc4

必需:
  - compatible

额外属性: false

示例:
  - |
    vc4: 图形处理器 {
        compatible = "brcm,bcm2835-vc4";
    };

..
```

## Documentation/devicetree/bindings/display/brcm,bcm2835-vec_cn.yaml
```yaml
# SPDX-许可证标识符: GPL-2.0
%YAML 1.2
---
$id: http://devicetree.org/schemas/display/brcm,bcm2835-vec.yaml#
$schema: http://devicetree.org/meta-schemas/core.yaml#

标题: Broadcom VC4（VideoCore4）VEC

维护者:
  - Eric Anholt <eric@anholt.net>

属性:
  compatible:
    枚举:
      - brcm,bcm2711-vec
      - brcm,bcm2835-vec

  reg:
    最大项数: 1

  clocks:
    最大项数: 1

  interrupts:
    最大项数: 1

  power-domains:
    最大项数: 1

必需:
  - compatible
  - reg
  - clocks
  - interrupts

额外属性: false

示例:
  - |
    #include <dt-bindings/clock/bcm2835.h>

    vec: vec@7e806000 {
        compatible = "brcm,bcm2835-vec";
        reg = <0x7e806000 0x1000>;
        clocks = <&clocks BCM2835_CLOCK_VEC>;
        interrupts = <2 27>;
    };
```

## Documentation/devicetree/bindings/display/bridge/adi,adv7511_cn.yaml
~~~~yaml
# SPDX-许可证标识符: (GPL-2.0 或 BSD-2-Clause)
%YAML 1.2
---
$id: http://devicetree.org/schemas/display/bridge/adi,adv7511.yaml#
$schema: http://devicetree.org/meta-schemas/core.yaml#

标题: Analog Devices ADV7511/11W/13 HDMI 编码器

维护者:
  - Laurent Pinchart <laurent.pinchart@ideasonboard.com>

描述: |
  ADV7511、ADV7511W 和 ADV7513 是与 HDMI 1.4 和 DVI 1.0 兼容的 HDMI 音频和视频
  发送器。它们支持颜色空间转换、S/PDIF、CEC 和 HDCP。发送器输入是
  并行 RGB 或 YUV 数据。
属性:
  compatible:
    枚举:
      - adi,adv7511
      - adi,adv7511w
      - adi,adv7513

  reg:
    描述: |
      I2C 从设备地址
ADV7511/11W/13 的内部寄存器被分为四页，
      通过不同的 I2C 地址暴露，创建了四个寄存器
      映射。每个映射都有其自己的 I2C 地址，并且作为 I2C 总线上的标准从设备运行。主地址是必需的，其他地址是可选的，如果未指定则恢复为默认值。
最小项数: 1
    最大项数: 4

  reg-names:
    描述:
      具有可编程地址的地图名称。它可以包含任何需要非默认地址的地图
最小项数: 1
    项:
      - 常量: main
      - 常量: edid
      - 常量: cec
      - 常量: packet

  clocks:
    描述: CEC 时钟的引用
最大项数: 1

  clock-names:
    常量: cec

  interrupts:
    最大项数: 1

  pd-gpios:
    描述: 连接到电源关闭信号的 GPIO
最大项数: 1

  avdd-supply:
    描述: 为 AVDD 引脚供电的 1.8V 电源
dvdd-supply:
    描述: 为 DVDD 引脚供电的 1.8V 电源
pvdd-supply:
    描述: 为 PVDD 引脚供电的 1.8V 电源
dvdd-3v-supply:
    描述: 为 DVDD_3V 引脚供电的 3.3V 电源
下面是提供的描述翻译成中文：

`bgvdd-supply`:
    描述: 为 BGVDD 引脚供电的 1.8V 电源

`adi,input-depth`:
    描述: 输入颜色分量每种颜色的位数
$ref: /schemas/types.yaml#/definitions/uint32
    枚举: [ 8, 10, 12 ]

`adi,input-colorspace`:
    描述: 输入颜色空间
枚举: [ RGB, YUV422, YUV444 ]

`adi,input-clock`:
    描述: |
      输入时钟类型
"1x": 每个像素一个时钟周期
        "2x": 每个像素两个时钟周期
        "dd": 每个像素一个时钟周期，数据在时钟的两个边沿驱动
    枚举: [ 1x, 2x, dd ]

`adi,clock-delay`:
    描述:
      视频数据时钟相对于像素时钟的延迟，以皮秒(ps)为单位（-1200ps 至 1600 ps）
$ref: /schemas/types.yaml#/definitions/uint32
    默认值: 0

`adi,embedded-sync`:
    描述:
      如果定义了此属性，则输入使用嵌入在数据流中的同步信号（类似于 BT.656 的方式）
类型: 布尔值

`adi,input-style`:
    描述:
      输入格式表中列出的输入组件排列变体
$ref: /schemas/types.yaml#/definitions/uint32
    枚举: [ 1, 2, 3 ]

`adi,input-justification`:
    描述: 输入位对齐方式
枚举: [ 左对齐, 平均分布, 右对齐 ]

`ports`:
    描述:
      ADV7511(W)/13 具有两个视频端口和一个音频端口
$ref: /schemas/graph.yaml#/properties/ports

    属性:
      `port@0`:
        描述: 用于 RGB 或 YUV 输入的视频端口
这段文本定义了一个设备树（Device Tree）片段，用于描述一个HDMI接收器的配置。下面是中文翻译：

```yaml
# 引用 graph.yaml 中定义的端口属性
$ref: /schemas/graph.yaml#/properties/port

      port@1:
        description: HDMI 输出的视频端口
$ref: /schemas/graph.yaml#/properties/port

      port@2:
        description: HDMI 输出的音频端口
$ref: /schemas/graph.yaml#/properties/port

# 除了在 "rgb 1x" 和 "yuv444 1x" 模式下，其他情况下 adi,input-colorspace 和 adi,input-clock 是必需的；在这两种模式下，它们不能被指定。
if:
  not:
    properties:
      adi,input-colorspace:
        contains:
          enum: [ rgb, yuv444 ]
      adi,input-clock:
        contains:
          const: 1x

then:
  required:
    - adi,input-style
    - adi,input-justification

else:
  properties:
    adi,input-style: false
    adi,input-justification: false


required:
  - compatible
  - reg
  - ports
  - adi,input-depth
  - adi,input-colorspace
  - adi,input-clock
  - avdd-supply
  - dvdd-supply
  - pvdd-supply
  - dvdd-3v-supply
  - bgvdd-supply

additionalProperties: false

examples:
  - |
    #include <dt-bindings/interrupt-controller/irq.h>

    i2c@e6500000 {
        #address-cells = <1>;
        #size-cells = <0>;

        reg = <0 0xe6500000>;

        adv7511w: hdmi@39 {
            compatible = "adi,adv7511w";
            /*
             * EDID 页面将在 I2C 总线地址 0x66 上可访问。所有其他映射继续使用它们的默认地址
*/
            reg = <0x39>, <0x66>;
            reg-names = "main", "edid";
            interrupt-parent = <&gpio3>;
            interrupts = <29 IRQ_TYPE_EDGE_FALLING>;
            clocks = <&cec_clock>;
            clock-names = "cec";
            avdd-supply = <&v1v8>;
            dvdd-supply = <&v1v8>;
            pvdd-supply = <&v1v8>;
            dvdd-3v-supply = <&v3v3>;
            bgvdd-supply = <&v1v8>;

            adi,input-depth = <8>;
            adi,input-colorspace = "yuv422";
            adi,input-clock = "1x";

            adi,input-style = <3>;
            adi,input-justification = "right";
            ports {
                #address-cells = <1>;
                #size-cells = <0>;

                port@0 {
                    reg = <0>;
                    adv7511w_in: endpoint {
                        remote-endpoint = <&dpi_out>;
                    };
                };

                port@1 {
                    reg = <1>;
                    adv7511_out: endpoint {
                        remote-endpoint = <&hdmi_connector_in>;
                    };
                };

                port@2 {
                    reg = <2>;
                    codec_endpoint: endpoint {
                        remote-endpoint = <&i2s0_cpu_endpoint>;
                    };
                };
            };
        };
    };
```

这段配置描述了 ADI ADV7511W HDMI 接收器的配置，并且包括了对不同端口的描述、中断控制器绑定、时钟、电源供应以及与之相关的端点连接等信息。
~~~~

## Documentation/devicetree/bindings/display/bridge/adi,adv7533_cn.yaml
~~~~yaml
```yaml
# SPDX-License-Identifier: (GPL-2.0 OR BSD-2-Clause)
%YAML 1.2
---
$id: http://devicetree.org/schemas/display/bridge/adi,adv7533.yaml#
$schema: http://devicetree.org/meta-schemas/core.yaml#

title: Analog Devices ADV7533/35 HDMI 编码器

maintainers:
  - Laurent Pinchart <laurent.pinchart@ideasonboard.com>

allOf:
  - $ref: /schemas/sound/dai-common.yaml#

description: |
  ADV7533 和 ADV7535 是与 HDMI 1.4 和 DVI 1.0 兼容的 HDMI 音频和视频发射器。
  它们支持颜色空间转换、S/PDIF、CEC 和 HDCP。发射器输入接口为 MIPI DSI。

properties:
  compatible:
    enum:
      - adi,adv7533
      - adi,adv7535

  reg:
    description: |
      I2C 从设备地址
      ADV7533/35 的内部寄存器被分割成四个页面，这些页面通过不同的 I2C 地址暴露出来，
      形成了四个寄存器映射。每个映射都有其自己的 I2C 地址，并且在 I2C 总线上作为标准从设备运行。
      主地址是必需的，其他地址是可选的，如果没有指定，则会回退到默认值。
minItems: 1
    maxItems: 4

  reg-names:
    description:
      可编程地址映射的名称。它可以包含任何需要非默认地址的映射。
minItems: 1
    items:
      - const: main
      - const: edid
      - const: cec
      - const: packet

  clocks:
    description: 对 CEC 时钟的引用
maxItems: 1

  clock-names:
    const: cec

  interrupts:
    maxItems: 1

  pd-gpios:
    description: 连接到电源关闭信号的 GPIO
maxItems: 1

  avdd-supply:
    description: 一个为 AVDD 引脚供电的 1.8V 电源
dvdd-supply:
    description: 一个为 DVDD 引脚供电的 1.8V 电源
pvdd-supply:
    description: 一个为 PVDD 引脚供电的 1.8V 电源
a2vdd-supply:
    description: 一个为 A2VDD 引脚供电的 1.8V 电源
```
Here is the provided content translated into Chinese:

`v3p3-supply`:
    描述: 一个3.3V的电源供应，为V3P3引脚供电。
`v1p2-supply`:
    描述:
      为V1P2引脚供电的电源供应。对于ADV7533可以是1.2V或1.8V，
      但对于ADV7535只能是1.8V。
`adi,disable-timing-generator`:
    描述:
      禁用内部定时生成器。芯片将依赖DSI数据通道中的同步信号，
      而不是为HDMI输出生成自己的时序。
类型: 布尔值

`adi,dsi-lanes`:
    描述: 连接到DSI主机的DSI数据通道的数量。
$ref: /schemas/types.yaml#/definitions/uint32
    枚举: [1, 2, 3, 4]

`#sound-dai-cells`:
    常量: 0

`ports`:
    描述:
      ADV7533/35有两个视频端口和一个音频端口。
$ref: /schemas/graph.yaml#/properties/ports

属性:
  `port@0`:
    描述:
      用于DSI输入的视频端口。远程终端节点句柄应引用有效的mipi_dsi_host_device。
$ref: /schemas/graph.yaml#/properties/port

  `port@1`:
    描述: 用于HDMI输出的视频端口。
$ref: /schemas/graph.yaml#/properties/port

  `port@2`:
    描述: 用于HDMI输出的音频端口。
$ref: /schemas/graph.yaml#/properties/port

必需项:
  - 兼容性
  - 寄存器
  - 端口
  - adi,dsi-lanes
  - avdd-supply
  - dvdd-supply
  - pvdd-supply
  - a2vdd-supply
  - v3p3-supply

不允许额外属性。

示例:
  - |
    #include <dt-bindings/interrupt-controller/irq.h>

    i2c@e6500000 {
        #address-cells = <1>;
        #size-cells = <0>;

        reg = <0 0xe6500000>;

        adv7533: hdmi@39 {
            compatible = "adi,adv7533";
            /*
             * EDID页面将在I2C总线地址0x66上可访问。所有其他映射继续使用其默认地址
*/
            reg = <0x39>, <0x66>;
            reg-names = "main", "edid";
            interrupt-parent = <&gpio3>;
            interrupts = <29 IRQ_TYPE_EDGE_FALLING>;
            clocks = <&cec_clock>;
            clock-names = "cec";
            adi,dsi-lanes = <4>;
            avdd-supply = <&v1v8>;
            dvdd-supply = <&v1v8>;
            pvdd-supply = <&v1v8>;
            a2vdd-supply = <&v1v8>;
            v3p3-supply = <&v3v3>;

            ports {
                #address-cells = <1>;
                #size-cells = <0>;

                port@0 {
                    reg = <0>;
                    adv7533_in: endpoint {
                        remote-endpoint = <&dsi_out>;
                    };
                };

                port@1 {
                    reg = <1>;
                    adv7533_out: endpoint {
                        remote-endpoint = <&hdmi_connector_in>;
                    };
                };

                port@2 {
                    reg = <2>;
                    codec_endpoint: endpoint {
                        remote-endpoint = <&i2s0_cpu_endpoint>;
                    };
                };
            };
        };
    };
您没有提供需要翻译的文本。请提供需要翻译成中文的英文或其他语言的文本。
~~~~
