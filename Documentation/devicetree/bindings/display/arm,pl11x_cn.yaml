## Documentation/devicetree/bindings/display/bridge/cdns,mhdp8546_cn.yaml
```yaml
# SPDX-License-Identifier: (GPL-2.0 OR BSD-2-Clause)
%YAML 1.2
---
$id: http://devicetree.org/schemas/display/bridge/cdns,mhdp8546.yaml#
$schema: http://devicetree.org/meta-schemas/core.yaml#

title: Cadence MHDP8546 桥接器

maintainers:
  - Swapnil Jakhade <sjakhade@cadence.com>
  - Yuti Amonkar <yamonkar@cadence.com>

properties:
  compatible:
    enum:
      - cdns,mhdp8546
      - ti,j721e-mhdp8546

  reg:
    minItems: 1
    items:
      - description:
          MHDPTX APB 寄存器块到 PHY 映射区域 (AUX_CONFIG_P) 的寄存器范围。
          AUX 和 PMA 寄存器不属于此范围，而是包含在关联的 PHY 中。
      - description:
          对于 TI J7 系统芯片 (SoC)，DSS_EDP0_INTG_CFG_VP 寄存器块的寄存器范围。
      - description:
          MHDPTX SAPB 寄存器块的寄存器范围。

  reg-names:
    minItems: 1
    items:
      - const: mhdptx
      - const: j721e-intg
      - const: mhdptx-sapb

  clocks:
    maxItems: 1
    description:
      DP 桥接时钟，用于 IP 了解如何将一定数量的时钟周期转换为时间（这用于符合 DP 标准定时和延迟）。

  phys:
    maxItems: 1
    description:
      显示端口 PHY 的 phandle。

  phy-names:
    items:
      - const: dpphy

  power-domains:
    maxItems: 1

  interrupts:
    maxItems: 1

  ports:
    $ref: /schemas/graph.yaml#/properties/ports

    properties:
      port@0:
        $ref: /schemas/graph.yaml#/properties/port
        description:
          第一个输入端口，代表 DP 桥接器的输入端。
      port@1:
        $ref: /schemas/graph.yaml#/properties/port
        description:
          第二个输入端口，代表 DP 桥接器的输入端。
      port@2:
        $ref: /schemas/graph.yaml#/properties/port
        description:
          第三个输入端口，代表 DP 桥接器的输入端。
      port@3:
        $ref: /schemas/graph.yaml#/properties/port
        description:
          第四个输入端口，代表 DP 桥接器的输入端。
这段内容描述了一个设备树(Device Tree)的配置片段，主要用于定义一个显示端口（DP）桥接器。下面是该配置的中文翻译：

`port@4:`  
   `$ref`: `/schemas/graph.yaml#//properties/port`  
   `description`:  
     输出端口表示DP桥接器的输出  

`required:`  
  `- port@0`  
  `- port@4`  

`allOf:`  
  `- 如果:`  
    `properties:`  
      `compatible:`  
        `contains:`  
          `const`: `ti,j721e-mhdp8546`  
    `则:`  
      `properties:`  
        `reg:`  
          `minItems`: `2`  
          `maxItems`: `3`  
        `reg-names:`  
          `minItems`: `2`  
          `maxItems`: `3`  
    `否则:`  
      `properties:`  
        `reg:`  
          `minItems`: `1`  
          `maxItems`: `2`  
        `reg-names:`  
          `minItems`: `1`  
          `maxItems`: `2`  

`required:`  
 `- compatible`  
 `- clocks`  
 `- reg`  
 `- reg-names`  
 `- phys`  
 `- phy-names`  
 `- interrupts`  
 `- ports`  

`additionalProperties`: `false`  

`examples:`  
 `- |`  
    `#include <dt-bindings/interrupt-controller/arm-gic.h>`  
    `bus {`  
        `#address-cells = <2>;`  
        `#size-cells = <2>;`  
  
        `mhdp: dp-bridge@f0fb000000 {`  
            `compatible = "cdns,mhdp8546";`  
            `reg = <0xf0 0xfb000000 0x0 0x1000000>;`  
            `reg-names = "mhdptx";`  
            `clocks = <&mhdp_clock>;`  
            `phys = <&dp_phy>;`  
            `phy-names = "dpphy";`  
            `interrupts = <GIC_SPI 614 IRQ_TYPE_LEVEL_HIGH>;`  
  
            `ports {`  
                `#address-cells = <1>;`  
                `#size-cells = <0>;`  
  
                `port@0 {`  
                    `reg = <0>;`  
                    `dp_bridge_input: endpoint {`  
                        `remote-endpoint = <&xxx_dpi_output>;`  
                    `};`  
                `};`  
  
                `port@4 {`  
                    `reg = <4>;`  
                    `dp_bridge_output: endpoint {`  
                        `remote-endpoint = <&xxx_dp_connector_input>;`  
                    `};`  
                `};`  
            `};`  
        `};`  
    `};`  
  `..`  

### 翻译说明：
- `port@4:` 表示端口号为4的配置。
- `description:` 描述了端口的功能。
- `required:` 列出了必需的字段。
- `allOf:` 定义了一组条件，根据不同的兼容性设置不同的属性要求。
- `additionalProperties:` 表示不允许有额外未定义的属性。
- `examples:` 给出了一个具体的例子，展示如何在设备树中定义DP桥接器。

这个配置用于详细描述DP桥接器的连接方式和必要的配置参数。
```

## Documentation/devicetree/bindings/display/bridge/chipone,icn6211_cn.yaml
~~~~yaml
```yaml
# SPDX-许可证标识符: (GPL-2.0-only 或 BSD-2-Clause)
%YAML 1.2
---
$id: http://devicetree.org/schemas/display/bridge/chipone,icn6211.yaml#
$schema: http://devicetree.org/meta-schemas/core.yaml#

title: Chipone ICN6211 MIPI-DSI 至 RGB 转换桥接器

maintainers:
  - Jagan Teki <jagan@amarulasolutions.com>

description: |
  ICN6211 是来自 Chipone 的 MIPI-DSI 至 RGB 转换桥接器
它具有灵活配置的 MIPI DSI 信号输入，并产生 RGB565、RGB666、RGB888 输出格式
properties:
  compatible:
    enum:
      - chipone,icn6211

  reg:
    maxItems: 1
    description: DSI 外设的虚拟通道编号

  clock-names:
    const: refclk

  clocks:
    maxItems: 1
    description: |
        可选的外部时钟连接到 REF_CLK 输入
时钟速率必须在 10..154 MHz 范围内
enable-gpios:
    description: 桥接器 EN 引脚，当 EN 为低电平时芯片复位
vdd1-supply:
    description: 为 MIPI RX 供电的 1.8V/2.5V/3.3V 电源
vdd2-supply:
    description: 为 PLL 供电的 1.8V/2.5V/3.3V 电源
vdd3-supply:
    description: 为 RGB 输出供电的 1.8V/2.5V/3.3V 电源
ports:
    $ref: /schemas/graph.yaml#/properties/ports

    properties:
      port@0:
        $ref: /schemas/graph.yaml#/$defs/port-base
        unevaluatedProperties: false
        description:
          用于 MIPI DSI 输入的视频端口

        properties:
          endpoint:
            $ref: /schemas/media/video-interfaces.yaml#
            unevaluatedProperties: false

            properties:
              data-lanes:
                description: 物理 DSI 数据通道索引数组
minItems: 1
                items:
                  - const: 1
                  - const: 2
                  - const: 3
                  - const: 4

      port@1:
        $ref: /schemas/graph.yaml#/properties/port
        description:
          用于 MIPI DPI 输出（面板或连接器）的视频端口
```

请注意，此翻译保留了原始 YAML 结构，并将注释和描述翻译成了中文。由于 YAML 中的 `$ref` 和 `unevaluatedProperties` 等字段依赖于特定的上下文和链接的 YAML 文件，这些部分保持原样。
这段文本是 Device Tree (设备树) 的描述片段，通常用于嵌入式系统中定义硬件配置。下面是该文本的中文翻译：

```yaml
# 必须字段
- port@1

必须:
  - 兼容性
  - 寄存器地址
  - 使能GPIOs
  - 端口

额外属性: false

示例:
  - |
    #include <dt-bindings/gpio/gpio.h>

    dsi {
      #address-cells = <1>;
      #size-cells = <0>;

      bridge@0 { 
        兼容性 = "chipone,icn6211";
        寄存器地址 = <0>;
        使能GPIOs = <&r_pio 0 5 GPIO_ACTIVE_HIGH>; /* LCD-RST: PL5 */

        端口 {
          #address-cells = <1>;
          #size-cells = <0>;

          port@0 {
            寄存器地址 = <0>;

            bridge_in_dsi: 终端 {
              远程终端 = <&dsi_out_bridge>;
            };
          };

          port@1 {
            寄存器地址 = <1>;

            bridge_out_panel: 终端 {
              远程终端 = <&panel_out_bridge>;
            };
          };
        };
      };
    };
```

这里解释一下几个关键部分：
- `port@1` 表示端口编号为 1 的端口是必需的。
- `compatible` 字段指定了与设备兼容的字符串。
- `reg` 是指寄存器地址。
- `enable-gpios` 指定用于使能某些功能的 GPIO 引脚。
- `ports` 表示端口配置。
- `additionalProperties: false` 表明不允许有额外的属性。
- `endpoint` 用来定义连接到另一个设备的端点。

希望这可以帮助你理解这段设备树描述的具体含义！
~~~~

## Documentation/devicetree/bindings/display/bridge/chrontel,ch7033_cn.yaml
~~~~yaml
```yaml
# SPDX-许可证标识符: (GPL-2.0-only 或 BSD-2-Clause)
# 版权所有 (C) 2019,2020 Lubomir Rintel <lkundrak@v3.sk>
%YAML 1.2
---
$id: 'http://devicetree.org/schemas/display/bridge/chrontel,ch7033.yaml#'
$schema: 'http://devicetree.org/meta-schemas/core.yaml#'

title: Chrontel CH7033 视频编码器

maintainers:
  - Lubomir Rintel <lkundrak@v3.sk>

properties:
  compatible:
    const: chrontel,ch7033

  reg:
    maxItems: 1
    description: 设备的 I2C 地址

  ports:
    $ref: '/schemas/graph.yaml#/properties/ports'

    properties:
      port@0:
        $ref: '/schemas/graph.yaml#/properties/port'
        description: |
          用于 RGB 输入的视频端口
      port@1:
        $ref: '/schemas/graph.yaml#/properties/port'
        description: |
          DVI 端口，应当连接到与 DVI 连接器绑定兼容的节点
required:
  - port@0
  - port@1

required:
  - compatible
  - reg
  - ports

additionalProperties: false

examples:
  - |
    i2c {
        #address-cells = <1>;
        #size-cells = <0>;

        vga-dvi-encoder@76 {
            compatible = "chrontel,ch7033";
            reg = <0x76>;

            ports {
                #address-cells = <1>;
                #size-cells = <0>;

                port@0 {
                    reg = <0>;
                    endpoint {
                        remote-endpoint = <&lcd0_rgb_out>;
                    };
                };

                port@1 {
                    reg = <1>;
                    endpoint {
                        remote-endpoint = <&dvi_in>;
                    };
                };

            };
        };
    };
```

以上是将给定的 YAML 文件翻译为中文版本。请注意，某些专有名词和技术术语保持英文原样以避免混淆。
~~~~

## Documentation/devicetree/bindings/display/bridge/fsl,imx8mp-hdmi-tx_cn.yaml
~~~~yaml
下面是给定内容的中文翻译：

```yaml
# SPDX-文件许可标识: (GPL-2.0-only 或 BSD-2-Clause)
%YAML 1.2
---
$id: http://devicetree.org/schemas/display/bridge/fsl,imx8mp-hdmi-tx.yaml#
$schema: http://devicetree.org/meta-schemas/core.yaml#

标题: Freescale i.MX8MP DWC HDMI TX 编码器

维护者:
  - Lucas Stach <l.stach@pengutronix.de>

描述:
  i.MX8MP HDMI 发射器是 Synopsys DesignWare
  HDMI 2.0a TX 控制器 IP。
allOf:
  - $ref: /schemas/display/bridge/synopsys,dw-hdmi.yaml#

属性:
  compatible:
    枚举:
      - fsl,imx8mp-hdmi-tx

  reg-io-width:
    常量: 1

  clocks:
    最大项数: 4

  clock-names:
    项:
      - 常量: iahb
      - 常量: isfr
      - 常量: cec
      - 常量: pix

  power-domains:
    最大项数: 1

  ports:
    $ref: /schemas/graph.yaml#/properties/ports

    属性:
      port@0:
        $ref: /schemas/graph.yaml#/properties/port
        描述: 并行RGB输入端口

      port@1:
        $ref: /schemas/graph.yaml#/properties/port
        描述: HDMI输出端口

    必须:
      - port@0
      - port@1

必须:
  - compatible
  - reg
  - clocks
  - clock-names
  - interrupts
  - power-domains
  - ports

未评估属性: false

示例:
  - |
    #include <dt-bindings/clock/imx8mp-clock.h>
    #include <dt-bindings/interrupt-controller/irq.h>
    #include <dt-bindings/power/imx8mp-power.h>

    hdmi@32fd8000 {
        compatible = "fsl,imx8mp-hdmi-tx";
        reg = <0x32fd8000 0x7eff>;
        interrupts = <0 IRQ_TYPE_LEVEL_HIGH>;
        clocks = <&clk IMX8MP_CLK_HDMI_APB>,
                 <&clk IMX8MP_CLK_HDMI_REF_266M>,
                 <&clk IMX8MP_CLK_32K>,
                 <&hdmi_tx_phy>;
        clock-names = "iahb", "isfr", "cec", "pix";
        power-domains = <&hdmi_blk_ctrl IMX8MP_HDMIBLK_PD_HDMI_TX>;
        reg-io-width = <1>;
        ports {
           #address-cells = <1>;
           #size-cells = <0>;
           port@0 {
             reg = <0>;

             hdmi_tx_from_pvi: endpoint {
               remote-endpoint = <&pvi_to_hdmi_tx>;
             };
          };

          port@1 {
            reg = <1>;
              hdmi_tx_out: endpoint {
                remote-endpoint = <&hdmi0_con>;
              };
          };
        };
    };
```
```
~~~~
