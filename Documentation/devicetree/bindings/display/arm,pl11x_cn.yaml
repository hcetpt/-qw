## Documentation/devicetree/bindings/display/arm,pl11x_cn.yaml
~~~~yaml
# SPDX-许可证标识符: (GPL-2.0-only 或 BSD-2-Clause)
%YAML 1.2
---
$id: http://devicetree.org/schemas/display/arm,pl11x.yaml#
$schema: http://devicetree.org/meta-schemas/core.yaml#

标题: Arm PrimeCell 彩色 LCD 控制器 PL110/PL111

维护者:
  - Liviu Dudau <Liviu.Dudau@arm.com>
  - Andre Przywara <andre.przywara@arm.com>

描述:
  Arm Primecell PL110/PL111 是一个 LCD 控制器 IP，它扫描系统内存中的帧缓冲区区域，并为各种 LCD 面板创建定时信号。
# 我们需要在这里使用选择条件以避免匹配所有包含 'arm,primecell' 的节点
选择:
  属性:
    兼容性:
      包含:
        枚举:
          - arm,pl110
          - arm,pl111
  必需:
    - 兼容性

属性:
  兼容性:
    项:
      - 枚举:
          - arm,pl110
          - arm,pl111
      - 常量: arm,primecell

  reg:
    最大项数: 1

  中断名称:
    任选其一:
      - 常量: combined
        描述:
          IP 提供了四条单独的中断线，同时也有一条组合线。如果集成只连接这条线到中断控制器，则这里只记录这一条中断。
      - 项:
          - 常量: mbe        # CLCDMBEINTR
          - 常量: vcomp      # CLCDVCOMPINTR
          - 常量: lnbu       # CLCDLNBUINTR
          - 常量: fuf        # CLCDFUFINTR

  中断:
    最小项数: 1
    最大项数: 4

  时钟名称:
    项:
      - 常量: clcdclk
      - 常量: apb_pclk

  时钟:
    项:
      - 描述: 控制器的 CLCDCLK 参考时钟
      - 描述: 寄存器访问的 HCLK AHB 从属时钟
内存区域:
    最大项数: 1
    描述:
      指向用于帧缓冲区的内存节点的句柄
如果没有提供，则帧缓冲区可以位于内存中的任何位置
最大内存带宽:
    $引用: /schemas/types.yaml#/definitions/uint32
    描述:
      细胞内存接口可以处理的最大带宽（每秒字节数）
如果没有提供，则内存接口足够快，可以处理所有可能的视频模式
端口:
    $引用: /schemas/graph.yaml#/$defs/port-base
    不允许额外属性

    描述:
      控制器的输出端点，连接 LCD 面板信号
属性:
      端点:
        $引用: /schemas/graph.yaml#/$defs/endpoint-base
        不允许未评估属性

        属性:
          arm,pl11x,tft-r0g0b0-pads:
            $引用: /schemas/types.yaml#/definitions/uint32-array
            项:
              - 描述: 用于第一个红色位 (R0) 的 CLD 垫的索引
              - 描述: 用于第一个绿色位 (G0) 的 CLD 垫的索引
              - 描述: 用于第一个蓝色位 (B0) 的 CLD 垫的索引
            过时: true
            描述: |
              已过时。一个包含三个 32 位值的数组，定义了 CLD[23:0] 垫的接线方式
第一个值包含了用于R0（红色分量的第一个比特）的“CLD”外部引脚（焊盘）的索引，第二个值对应绿色，第三个值对应蓝色。
请参见 PL110/PL111 技术参考手册中的 "LCD 面板信号复用细节" 段落。
这隐含地定义了可用的颜色模式，例如：
- PL111 TFT 4:4:4 面板:
    `arm,pl11x,tft-r0g0b0-pads = <4 15 20>;`
- PL110 TFT (1:)5:5:5 面板:
    `arm,pl11x,tft-r0g0b0-pads = <1 7 13>;`
- PL111 TFT (1:)5:5:5 面板:
    `arm,pl11x,tft-r0g0b0-pads = <3 11 19>;`
- PL111 TFT 5:6:5 面板:
    `arm,pl11x,tft-r0g0b0-pads = <3 10 19>;`
- PL110 和 PL111 TFT 8:8:8 面板:
    `arm,pl11x,tft-r0g0b0-pads = <0 8 16>;`
- PL110 和 PL111 TFT 8:8:8 面板，红蓝分量交换:
    `arm,pl11x,tft-r0g0b0-pads = <16 8 0>;`

additionalProperties: false

required:
  - compatible
  - reg
  - clock-names
  - clocks
  - port

allOf:
  - if:
      properties:
        interrupts:
          minItems: 2
      required:
        - interrupts
    then:
      required:
        - interrupt-names

示例:
```yaml
clcd@10020000 {
    compatible = "arm,pl111", "arm,primecell";
    reg = <0x10020000 0x1000>;
    interrupt-names = "combined";
    interrupts = <44>;
    clocks = <&oscclk1>, <&oscclk2>;
    clock-names = "clcdclk", "apb_pclk";
    max-memory-bandwidth = <94371840>; /* Bps, 1024x768@60 16bpp */

    port {
        clcd_pads: endpoint {
            remote-endpoint = <&clcd_panel>;
        };
    };
};

panel {
    compatible = "arm,rtsm-display";

    port {
        clcd_panel: endpoint {
            remote-endpoint = <&clcd_pads>;
        };
    };
};
```
...
~~~~

## Documentation/devicetree/bindings/display/armada/marvell,dove-lcd_cn.txt
~~~~
Armada DRM CRTC 驱动的设备树绑定

必需属性：
- `compatible`：值应为 "marvell,dove-lcd"
- `reg`：LCD 控制器的基本地址和大小
- `interrupts`：LCD 控制器的单个中断编号
- `port`：带有端点的视频输出端口，如 graph.txt 中所述

可选属性：

- `clocks`：如 clock-bindings.txt 中所述
- `clock-names`：如 clock-bindings.txt 中所述
   - `"axiclk"`：用于像素时钟的 AXI 总线时钟
   - `"plldivider"`：用于像素时钟的 PLL 分频时钟
   - `"ext_ref_clk0"`：用于像素时钟的外部时钟 0
   - `"ext_ref_clk1"`：用于像素时钟的外部时钟 1

注意：所有时钟都是可选的，但至少需要指定一个。未来可能会根据不同 SoC 的需求添加更多的时钟。
示例：

``` 
lcd0: lcd-controller@820000 {
	compatible = "marvell,dove-lcd";
	reg = <0x820000 0x1000>;
	interrupts = <47>;
	clocks = <&si5351 0>;
	clock-names = "ext_ref_clk_1";
};
```
在上述示例中，`lcd-controller@820000` 表示 LCD 控制器的基地址为 0x820000，其大小为 0x1000 字节。它使用了外部时钟 1 (`ext_ref_clk1`) 作为其像素时钟源，并且该控制器的中断号为 47。
~~~~

## Documentation/devicetree/bindings/display/atmel,lcdc-display_cn.yaml
~~~~yaml
```yaml
# SPDX-许可证标识符: (GPL-2.0 或 BSD-2-Clause)
%YAML 1.2
---
$id: http://devicetree.org/schemas/display/atmel,lcdc-display.yaml#
$schema: http://devicetree.org/meta-schemas/core.yaml#

title: Microchip 的 LCDC 显示屏

maintainers:
  - Nicolas Ferre <nicolas.ferre@microchip.com>
  - Dharma Balasubiramani <dharma.b@microchip.com>

description:
  液晶显示控制器（LCDC）包含从外部显示缓冲区向 TFT 液晶面板传输液晶图像数据的逻辑。LCDC 每层有一个显示输入缓冲区，通过单总线主机接口获取像素，并且有一个查找表以允许调色板配置显示。LCDC 可按每层进行编程，并支持不同的液晶分辨率、窗口大小、图像格式和像素深度。
# 由于此模式仅适用于具有以下属性的节点，因此我们需要在此处进行选择

select:
  anyOf:
    - required: [ 'atmel,dmacon' ]
    - required: [ 'atmel,lcdcon2' ]
    - required: [ 'atmel,guard-time' ]

properties:
  atmel,dmacon:
    $ref: /schemas/types.yaml#/definitions/uint32
    description: DMA 控制器配置

  atmel,lcdcon2:
    $ref: /schemas/types.yaml#/definitions/uint32
    description: 液晶控制器配置

  atmel,guard-time:
    $ref: /schemas/types.yaml#/definitions/uint32
    description: 液晶保护时间（帧周期中的延迟）
    maximum: 127

  bits-per-pixel:
    $ref: /schemas/types.yaml#/definitions/uint32
    description: 液晶面板位深度
    enum: [1, 2, 4, 8, 16, 24, 32]

  atmel,lcdcon-backlight:
    $ref: /schemas/types.yaml#/definitions/flag
    description: 启用背光

  atmel,lcdcon-backlight-inverted:
    $ref: /schemas/types.yaml#/definitions/flag
    description: 反转背光 PWM 极性

  atmel,lcd-wiring-mode:
    $ref: /schemas/types.yaml#/definitions/string
    description: 液晶接线模式 "RGB" 或 "BRG"
    enum:
      - RGB
      - BRG

  atmel,power-control-gpio:
    description: 用于开启或关闭液晶显示屏的 GPIO（根据需要的数量）
    maxItems: 1

  display-timings:
    $ref: panel/display-timings.yaml#

required:
  - atmel,dmacon
  - atmel,lcdcon2
  - atmel,guard-time
  - bits-per-pixel

additionalProperties: false

examples:
  - |
    display: panel {
      bits-per-pixel = <32>;
      atmel,lcdcon-backlight;
      atmel,dmacon = <0x1>;
      atmel,lcdcon2 = <0x80008002>;
      atmel,guard-time = <9>;
      atmel,lcd-wiring-mode = "RGB";

      display-timings {
        native-mode = <&timing0>;
        timing0: timing0 {
          clock-frequency = <9000000>;
          hactive = <480>;
          vactive = <272>;
          hback-porch = <1>;
          hfront-porch = <1>;
          vback-porch = <40>;
          vfront-porch = <1>;
          hsync-len = <45>;
          vsync-len = <1>;
        };
      };
    };
```
```markdown
注释：
- 此 YAML 文件定义了 Microchip 的 LCDC 显示屏在设备树中的表示方式。
- 它详细说明了必要的属性及其描述。
- 示例部分展示了如何在设备树中为特定显示器配置这些属性。
```
~~~~

## Documentation/devicetree/bindings/display/atmel,lcdc_cn.yaml
```yaml
# SPDX-文件许可人: (GPL-2.0 或 BSD-2-Clause)
%YAML 1.2
---
$id: http://devicetree.org/schemas/display/atmel,lcdc.yaml#
$schema: http://devicetree.org/meta-schemas/core.yaml#

标题: Microchip 的 LCDC 帧缓冲区

维护者:
  - Nicolas Ferre <nicolas.ferre@microchip.com>
  - Dharma Balasubiramani <dharma.b@microchip.com>

描述:
  LCDC 与帧缓冲区一起工作，帧缓冲区是包含表示显示像素值的完整帧数据的内存部分。LCDC 从帧缓冲区读取像素数据，并将其发送到 LCD 面板以渲染图像。
属性:
  compatible:
    枚举:
      - atmel,at91sam9261-lcdc
      - atmel,at91sam9263-lcdc
      - atmel,at91sam9g10-lcdc
      - atmel,at91sam9g45-lcdc
      - atmel,at91sam9g45es-lcdc
      - atmel,at91sam9rl-lcdc

  reg:
    最大项数: 1

  interrupts:
    最大项数: 1

  clocks:
    最大项数: 2

  clock-names:
    项:
      - 常量: hclk
      - 常量: lcdc_clk

  display:
    $ref: /schemas/types.yaml#/definitions/phandle
    描述: 指向 display 节点的 phandle
必需:
  - compatible
  - reg
  - interrupts
  - clocks
  - clock-names
  - display

附加属性: false

示例:
  - |
    #include <dt-bindings/clock/at91.h>
    #include <dt-bindings/interrupt-controller/irq.h>
    fb@500000 {
      compatible = "atmel,at91sam9g45-lcdc";
      reg = <0x00500000 0x1000>;
      interrupts = <23 IRQ_TYPE_LEVEL_HIGH 0>;
      pinctrl-names = "default";
      pinctrl-0 = <&pinctrl_fb>;
      clocks = <&pmc PMC_TYPE_PERIPHERAL 23>, <&pmc PMC_TYPE_PERIPHERAL 23>;
      clock-names = "hclk", "lcdc_clk";
      display = <&display>;
    };
```

## Documentation/devicetree/bindings/display/atmel/atmel,hlcdc-display-controller_cn.yaml
~~~~yaml
```yaml
# SPDX-许可证标识符: (GPL-2.0 或 BSD-2-Clause)
%YAML 1.2
---
$id: http://devicetree.org/schemas/display/atmel/atmel,hlcdc-display-controller.yaml#
$schema: http://devicetree.org/meta-schemas/core.yaml#

title: Atmel 的高分辨率 LCD 控制器 (HLCDC)

maintainers:
  - Nicolas Ferre <nicolas.ferre@microchip.com>
  - Alexandre Belloni <alexandre.belloni@bootlin.com>
  - Claudiu Beznea <claudiu.beznea@tuxon.dev>

description:
  液晶控制器 (LCDC) 包含从外部显示缓冲区向 TFT 液晶面板传输液晶图像数据的逻辑。LCDC 每层有一个显示输入缓冲区，通过单总线主机接口获取像素，并且有一个查找表以允许调色板配置显示。

properties:
  compatible:
    const: atmel,hlcdc-display-controller

  '#address-cells':
    const: 1

  '#size-cells':
    const: 0

  port@0:
    $ref: /schemas/graph.yaml#/$defs/port-base
    unevaluatedProperties: false
    description:
      控制器的输出端点，连接液晶面板信号
properties:
      '#address-cells':
        const: 1

      '#size-cells':
        const: 0

      reg:
        maxItems: 1

      endpoint:
        $ref: /schemas/media/video-interfaces.yaml#
        unevaluatedProperties: false
        description:
          连接液晶面板信号的端点
properties:
          bus-width:
            enum: [ 12, 16, 18, 24 ]

required:
  - '#address-cells'
  - '#size-cells'
  - compatible
  - port@0

additionalProperties: false
```

此文档定义了一个设备树 (Device Tree) 配置方案，用于描述 Atmel 公司的高分辨率 LCD 控制器 (HLCDC)。这个方案规定了如何在设备树中表示 HLCDC 的结构和属性，包括与外部液晶面板的连接方式。
~~~~

## Documentation/devicetree/bindings/display/brcm,bcm2711-hdmi_cn.yaml
```yaml
# SPDX-许可证标识符: GPL-2.0
%YAML 1.2
---
$id: http://devicetree.org/schemas/display/brcm,bcm2711-hdmi.yaml#
$schema: http://devicetree.org/meta-schemas/core.yaml#

标题: Broadcom BCM2711 HDMI 控制器

维护者:
  - Eric Anholt <eric@anholt.net>

属性:
  compatible:
    枚举:
      - brcm,bcm2711-hdmi0
      - brcm,bcm2711-hdmi1

  reg:
    项:
      - 描述: HDMI 控制器寄存器范围
      - 描述: DVP 寄存器范围
      - 描述: HDMI PHY 寄存器范围
      - 描述: Rate Manager 寄存器范围
      - 描述: Packet RAM 寄存器范围
      - 描述: Metadata RAM 寄存器范围
      - 描述: CSC 寄存器范围
      - 描述: CEC 寄存器范围
      - 描述: HD 寄存器范围

  reg-names:
    项:
      - 常量: hdmi
      - 常量: dvp
      - 常量: phy
      - 常量: rm
      - 常量: packet
      - 常量: metadata
      - 常量: csc
      - 常量: cec
      - 常量: hd

  clocks:
    项:
      - 描述: HDMI 状态机时钟
      - 描述: Pixel BVB 时钟
      - 描述: HDMI 音频父时钟
      - 描述: HDMI CEC 父时钟

  clock-names:
    项:
      - 常量: hdmi
      - 常量: bvb
      - 常量: audio
      - 常量: cec

  interrupts:
    项:
      - 描述: CEC TX 中断
      - 描述: CEC RX 中断
      - 描述: CEC 卡在低电平中断
      - 描述: 唤醒中断
      - 描述: 热插拔连接中断
      - 描述: 热插拔移除中断

  interrupt-names:
    项:
      - 常量: cec-tx
      - 常量: cec-rx
      - 常量: cec-low
      - 常量: wakeup
      - 常量: hpd-connected
      - 常量: hpd-removed

  ddc:
    $ref: /schemas/types.yaml#/definitions/phandle
    描述: >
      用于 DDC EDID 探测的 I2C 控制器的 phandle

  hpd-gpios:
    最大项数: 1
    描述: >
      HDMI 热插拔检测的 GPIO 引脚（如果它不作为中断/状态位出现在 HDMI 控制器本身中）

  dmas:
    最大项数: 1
    描述: >
      应包含一个条目，指向用于传输音频数据的 DMA 通道
  dma-names:
    常量: audio-rx

  resets:
    最大项数: 1

  wifi-2.4ghz-coexistence:
    类型: 布尔值
    描述: >
      是否应避免 WiFi 频率范围内的像素频率？

必需:
  - compatible
  - reg
  - reg-names
  - clocks
  - resets
  - ddc

额外属性: false

示例:
  - |
    hdmi0: hdmi@7ef00700 {
        compatible = "brcm,bcm2711-hdmi0";
        reg = <0x7ef00700 0x300>,
              <0x7ef00300 0x200>,
              <0x7ef00f00 0x80>,
              <0x7ef00f80 0x80>,
              <0x7ef01b00 0x200>,
              <0x7ef01f00 0x400>,
              <0x7ef00200 0x80>,
              <0x7ef04300 0x100>,
              <0x7ef20000 0x100>;
        reg-names = "hdmi",
                    "dvp",
                    "phy",
                    "rm",
                    "packet",
                    "metadata",
                    "csc",
                    "cec",
                    "hd";
        clocks = <&firmware_clocks 13>, <&firmware_clocks 14>, <&dvp 1>, <&clk_27MHz>;
        clock-names = "hdmi", "bvb", "audio", "cec";
        resets = <&dvp 0>;
        ddc = <&ddc0>;
    };

..
```

## Documentation/devicetree/bindings/display/brcm,bcm2835-dsi0_cn.yaml
~~~~yaml
下面是给定内容的中文翻译：

```yaml
# SPDX-文件许可标识符: GPL-2.0
%YAML 1.2
---
$id: http://devicetree.org/schemas/display/brcm,bcm2835-dsi0.yaml#
$schema: http://devicetree.org/meta-schemas/core.yaml#

title: Broadcom VC4 (VideoCore4) DSI 控制器

maintainers:
  - Eric Anholt <eric@anholt.net>

allOf:
  - $ref: dsi-controller.yaml#

properties:
  "#clock-cells":
    const: 1

  compatible:
    enum:
      - brcm,bcm2711-dsi1
      - brcm,bcm2835-dsi0
      - brcm,bcm2835-dsi1

  reg:
    maxItems: 1

  clocks:
    items:
      - description: 供给DSI模拟PHY的DSI PLL时钟
      - description: DSI ESC时钟
      - description: DSI像素时钟

  clock-names:
    items:
      - const: phy
      - const: escape
      - const: pixel

  clock-output-names: true
    # FIXME: 元模式似乎目前不允许这样做
    # items:
    #   - description: 供给PHY的DSI字节时钟
    #   - description: DSI DDR2时钟
    #   - description: DSI DDR时钟

  interrupts:
    maxItems: 1

  power-domains:
    maxItems: 1

required:
  - "#clock-cells"
  - compatible
  - reg
  - clocks
  - clock-names
  - clock-output-names
  - interrupts

unevaluatedProperties: false

examples:
  - |
    #include <dt-bindings/clock/bcm2835.h>

    dsi1: dsi@7e700000 {
        compatible = "brcm,bcm2835-dsi1";
        reg = <0x7e700000 0x8c>;
        interrupts = <2 12>;
        #address-cells = <1>;
        #size-cells = <0>;
        #clock-cells = <1>;

        clocks = <&clocks BCM2835_PLLD_DSI1>,
                 <&clocks BCM2835_CLOCK_DSI1E>,
                 <&clocks BCM2835_CLOCK_DSI1P>;
        clock-names = "phy", "escape", "pixel";

        clock-output-names = "dsi1_byte", "dsi1_ddr2", "dsi1_ddr";

    };
```

请注意，注释和示例中的代码保持了原有的格式。
~~~~

## Documentation/devicetree/bindings/display/brcm,bcm2835-hdmi_cn.yaml
```yaml
# SPDX-许可证标识符: GPL-2.0
%YAML 1.2
---
$id: http://devicetree.org/schemas/display/brcm,bcm2835-hdmi.yaml#
$schema: http://devicetree.org/meta-schemas/core.yaml#

标题: Broadcom VC4 (VideoCore4) HDMI 控制器

维护者:
  - Eric Anholt <eric@anholt.net>

属性:
  compatible:
    常量: brcm,bcm2835-hdmi

  reg:
    项:
      - 描述: HDMI 寄存器范围
      - 描述: HD 寄存器范围

  interrupts:
    最小项数: 2

  clocks:
    项:
      - 描述: 像素时钟
      - 描述: HDMI 状态机时钟

  clock-names:
    项:
      - 常量: pixel
      - 常量: hdmi

  ddc:
    $ref: /schemas/types.yaml#/definitions/phandle
    描述: >
      用于 DDC EDID 探测的 I2C 控制器的句柄

  hpd-gpios:
    最大项数: 1
    描述: >
      HDMI 热插拔检测的 GPIO 引脚（如果它不作为中断/状态位出现在 HDMI 控制器本身中）

  dmas:
    最大项数: 1
    描述: >
      应包含一个条目，指向用于传输音频数据的 DMA 通道
  dma-names:
    常量: audio-rx

  power-domains:
    最大项数: 1

必需:
  - compatible
  - reg
  - interrupts
  - clocks
  - ddc

附加属性: false

示例:
  - |
    #include <dt-bindings/clock/bcm2835.h>
    #include <dt-bindings/gpio/gpio.h>

    hdmi: hdmi@7e902000 {
        compatible = "brcm,bcm2835-hdmi";
        reg = <0x7e902000 0x600>,
              <0x7e808000 0x100>;
        interrupts = <2 8>, <2 9>;
        ddc = <&i2c2>;
        hpd-gpios = <&gpio 46 GPIO_ACTIVE_HIGH>;
        clocks = <&clocks BCM2835_PLLH_PIX>,
                 <&clocks BCM2835_CLOCK_HSM>;
        clock-names = "pixel", "hdmi";
    };

..
```
