## Documentation/devicetree/bindings/display/bridge/analogix,anx7625_cn.yaml
~~~~yaml
# SPDX-许可证标识符: (GPL-2.0 或 BSD-2-Clause)
# 版权所有 2019 Analogix Semiconductor, Inc
%YAML 1.2
---
$id: http://devicetree.org/schemas/display/bridge/analogix,anx7625.yaml#
$schema: http://devicetree.org/meta-schemas/core.yaml#

标题: Analogix ANX7625 SlimPort (4K 移动高清发射器)

维护者:
  - Xin Ji <xji@analogixsemi.com>

描述: |
  ANX7625 是一款超低功耗的 4K 移动高清发射器，
  专为便携式设备设计。
属性:
  compatible:
    常量: analogix,anx7625

  reg:
    最大项目数: 1

  interrupts:
    描述: 用于中断引脚 B8
    最大项目数: 1

  enable-gpios:
    描述: 用于芯片上电控制，POWER_EN 引脚 D2
    最大项目数: 1

  reset-gpios:
    描述: 用于芯片复位控制，RESET_N 引脚 B7
    最大项目数: 1

  vdd10-supply:
    描述: 提供电源 1.0V 的稳压器
  vdd18-supply:
    描述: 提供电源 1.8V 的稳压器
  vdd33-supply:
    描述: 提供电源 3.3V 的稳压器
  analogix,lane0-swing:
    $ref: /schemas/types.yaml#/definitions/uint8-array
    最小项目数: 1
    最大项目数: 20
    描述:
      用于 DP 发射通道0 PHY 的摆幅寄存器设置数组
      寄存器 0~9 分别是 Swing0_Pre0, Swing1_Pre0, Swing2_Pre0,
      Swing3_Pre0, Swing0_Pre1, Swing1_Pre1, Swing2_Pre1, Swing0_Pre2,
      Swing1_Pre2, Swing0_Pre3, 它们用于 [增强控制] 和
      [摆幅控制] 设置
以下是对提供的英文文本的中文翻译：

寄存器0~9，位3:0为[增强控制]，这些位用于控制光标后的手动增强，增加[增强控制]值可以提高预加重值。

寄存器0~9，位6:4为[摆幅控制]，这些位用于控制摆幅手动设置，增加[摆幅控制]设置可以为每次摆幅增加峰峰值Vp-p。

寄存器10~19分别是Swing0_Pre0、Swing1_Pre0、Swing2_Pre0、Swing3_Pre0、Swing0_Pre1、Swing1_Pre1、Swing2_Pre1、Swing0_Pre2、Swing1_Pre2、Swing0_Pre3，它们用于[R选择控制]和[R终止控制]设置。

寄存器10~19，位4:0为[R选择控制]，这些位是补偿手动设置，增加它可加强IO驱动强度和峰峰值Vp-p。

寄存器10~19，位5:6为[R终止控制]，这些位调整DP发送端50欧姆阻抗。00:55欧姆，01:50欧姆(默认)，10:45欧姆，11:40欧姆。

analogix,lane1-swing:
    $ref: /schemas/types.yaml#/definitions/uint8-array
    minItems: 1
    maxItems: 20
    description:
      DP发送端1通道PHY的摆幅寄存器设置数组
DP TX通道1摆幅寄存器设置与通道0相同，
请参阅lane0-swing属性描述。

analogix,audio-enable:
    类型: 布尔值
    描述: 是否允许驱动启用HDMI音频编解码功能

aux-bus:
    $ref: /schemas/display/dp-aux-bus.yaml#

  端口:
    $ref: /schemas/graph.yaml#/properties/ports

    属性:
      port@0:
        $ref: /schemas/graph.yaml#/$defs/port-base
        不评估其他属性: false
        描述:
          MIPI DSI/DPI输入
属性:
          终端:
            $ref: /schemas/media/video-interfaces.yaml#
            类型: 对象
            不允许其他属性: false

            属性:
              远程终端: true

              总线类型:
                枚举: [7]
                默认值: 1

              数据通道: true

      port@1:
        $ref: /schemas/graph.yaml#/properties/port
        描述:
          面板或连接器的视频端口
这段文本是 Device Tree (设备树) 的描述，用于定义硬件组件及其配置。下面是对这段文本的中文翻译：

```text
所需属性：
  - port@0
  - port@1

必需属性：
  - compatible
  - reg
  - vdd10-supply
  - vdd18-supply
  - vdd33-supply
  - ports

不允许额外属性。

示例：
  - |
    #include <dt-bindings/gpio/gpio.h>

    i2c {
        #address-cells = <1>;
        #size-cells = <0>;

        encoder@58 {
            compatible = "analogix,anx7625";  // 兼容性
            reg = <0x58>;                     // 寄存器地址
            enable-gpios = <&pio 45 GPIO_ACTIVE_HIGH>;  // 启用GPIO
            reset-gpios = <&pio 73 GPIO_ACTIVE_HIGH>;   // 重置GPIO
            vdd10-supply = <&pp1000_mipibrdg>;           // 1.0V电源
            vdd18-supply = <&pp1800_mipibrdg>;           // 1.8V电源
            vdd33-supply = <&pp3300_mipibrdg>;           // 3.3V电源
            analogix,audio-enable;                       // 启用音频
            analogix,lane0-swing = /bits/ 8 <0x14 0x54 0x64 0x74>;  // 车道0摆动控制
            analogix,lane1-swing = /bits/ 8 <0x14 0x54 0x64 0x74>;  // 车道1摆动控制

            ports {                                      // 端口
                #address-cells = <1>;
                #size-cells = <0>;

                mipi2dp_bridge_in: port@0 {              // 输入端口
                    reg = <0>;
                    anx7625_in: endpoint {              // 终端节点
                        remote-endpoint = <&mipi_dsi>;   // 远程终端
                        bus-type = <7>;                 // 总线类型
                        data-lanes = <0 1 2 3>;         // 数据通道
                    };
                };

                mipi2dp_bridge_out: port@1 {             // 输出端口
                    reg = <1>;
                    anx7625_out: endpoint {             // 终端节点
                        remote-endpoint = <&panel_in>;   // 远程终端
                    };
                };
            };

            aux-bus {                                   // 辅助总线
                panel {                                 // 面板
                    compatible = "innolux,n125hce-gn1";  // 兼容性
                    power-supply = <&pp3300_disp_x>;     // 电源供应
                    backlight = <&backlight_lcd0>;       // 背光

                    port {                              // 端口
                        panel_in: endpoint {            // 终端节点
                            remote-endpoint = <&anx7625_out>;  // 远程终端
                        };
                    };
                };
            };
        };
    };
```

请注意，这里的翻译尽量保持了原始 Device Tree 的结构和含义，并将一些专有名词和术语直接保留为英文形式，因为这些通常在技术文档中使用英文表达。
~~~~

## Documentation/devicetree/bindings/display/bridge/analogix,anx7814_cn.yaml
```yaml
下面是提供的 YAML 文件的中文翻译：

---

# SPDX 许可证标识符: (GPL-2.0-only 或 BSD-2-Clause)
%YAML 1.2
---
$id: http://devicetree.org/schemas/display/bridge/analogix,anx7814.yaml#
$schema: http://devicetree.org/meta-schemas/core.yaml#

title: Analogix ANX7814 SlimPort (全高清发射器)

maintainers:
  - Andrzej Hajda <andrzej.hajda@intel.com>
  - Neil Armstrong <neil.armstrong@linaro.org>
  - Robert Foss <robert.foss@linaro.org>

properties:
  compatible:
    enum:
      - analogix,anx7808
      - analogix,anx7812
      - analogix,anx7814
      - analogix,anx7816
      - analogix,anx7818

  reg:
    maxItems: 1
    description: 设备的 I2C 地址
  interrupts:
    maxItems: 1
    description: 应包含 INTP 中断
  hpd-gpios:
    deprecated: true
    maxItems: 1
    description: 用于 HPD 的 GPIO
  pd-gpios:
    maxItems: 1
    description: 用于电源关闭的 GPIO
  reset-gpios:
    maxItems: 1
    description: 用于复位的 GPIO
  dvdd10-supply:
    description: 1.0V 数字核心电源调节器
  ports:
    $ref: /schemas/graph.yaml#/properties/ports

    properties:
      port@0:
        $ref: /schemas/graph.yaml#/properties/port
        description: HDMI 输入视频端口
      port@1:
        $ref: /schemas/graph.yaml#/properties/port
        description: SlimPort、DisplayPort、eDP 或 MyDP 输出视频端口

required:
  - compatible
  - reg
  - ports

additionalProperties: false

examples:
  - |
    #include <dt-bindings/interrupt-controller/arm-gic.h>
    #include <dt-bindings/gpio/gpio.h>

    i2c {
        #address-cells = <1>;
        #size-cells = <0>;

        anx7814: bridge@38 {
            compatible = "analogix,anx7814";
            reg = <0x38>;
            interrupt-parent = <&gpio0>;
            interrupts = <99 IRQ_TYPE_LEVEL_LOW>;   /* INTP */
            pd-gpios = <&pio 33 GPIO_ACTIVE_HIGH>;
            reset-gpios = <&pio 98 GPIO_ACTIVE_HIGH>;

            ports {
                #address-cells = <1>;
                #size-cells = <0>;

                port@0 {
                    reg = <0>;
                    anx7814_in: endpoint {
                        remote-endpoint = <&hdmi0_out>;
                    };
                };

                port@1 {
                    reg = <1>;
                    anx7814_out: endpoint {
                        remote-endpoint = <&edp_out>;
                    };
                };
            };
        };
    };
```

## Documentation/devicetree/bindings/display/bridge/analogix,dp_cn.yaml
~~~~yaml
```yaml
# SPDX-许可证标识符: GPL-2.0
%YAML 1.2
---
$id: http://devicetree.org/schemas/display/bridge/analogix,dp.yaml#
$schema: http://devicetree.org/meta-schemas/core.yaml#

title: Analogix 显示端口桥接器

maintainers:
  - Rob Herring <robh@kernel.org>

properties:
  reg:
    maxItems: 1

  interrupts:
    maxItems: 1

  clocks: true

  clock-names: true

  phys: true

  phy-names:
    const: dp

  force-hpd:
    type: 布尔
    description:
      指示驱动程序需要在热插拔检测失败时强制执行热插拔检测，这
      是用于某些没有热插拔信号的eDP屏幕
hpd-gpios:
    description:
      热插拔检测GPIO
指示哪个GPIO应该用于热插拔检测

  ports:
    $ref: /schemas/graph.yaml#/properties/ports

    properties:
      port@0:
        $ref: /schemas/graph.yaml#/properties/port
        description:
          输入节点以接收像素数据
port@1:
        $ref: /schemas/graph.yaml#/properties/port
        description:
          端口节点，其一个端点连接到dp-connector节点
required:
      - port@0
      - port@1

required:
  - reg
  - interrupts
  - clock-names
  - clocks
  - ports

additionalProperties: true
```

请注意，部分翻译可能不太准确，如 `hpd-gpios:` 下面的描述，因为原文件中的这部分描述并未完成。另外，`force-hpd:` 中的 "hpd" 应该是 "hot plug detect"（热插拔检测）的缩写，但为了保持原文意思未作修改。
~~~~

## Documentation/devicetree/bindings/display/bridge/anx6345_cn.yaml
```yaml
# SPDX-文件许可人: GPL-2.0
%YAML 1.2
---
$id: http://devicetree.org/schemas/display/bridge/anx6345.yaml#
$schema: http://devicetree.org/meta-schemas/core.yaml#

title: Analogix ANX6345 eDP 发射器

maintainers:
  - Torsten Duwe <duwe@lst.de>

description: |
  ANX6345 是一款专为便携式设备设计的超低功耗全高清 eDP 发射器。
properties:
  compatible:
    const: analogix,anx6345

  reg:
    maxItems: 1
    description: 设备的基础 I2C 地址

  reset-gpios:
    maxItems: 1
    description: 连接到主动低电平复位的 GPIO

  dvdd12-supply:
    description: 1.2V 数字核心电源的稳压器
  dvdd25-supply:
    description: 2.5V 数字核心电源的稳压器
ports:
    $ref: /schemas/graph.yaml#/properties/ports

    properties:
      port@0:
        $ref: /schemas/graph.yaml#/properties/port
        description:
          LVTTL 输入的视频端口

      port@1:
        $ref: /schemas/graph.yaml#/properties/port
        description:
          视频端口用于 eDP 输出（面板或连接器）
如果 EDID 工作可靠则可以省略
required:
      - port@0

required:
  - compatible
  - reg
  - reset-gpios
  - dvdd12-supply
  - dvdd25-supply
  - ports

additionalProperties: false

examples:
  - |
    i2c {
      #address-cells = <1>;
      #size-cells = <0>;

      anx6345: anx6345@38 {
        compatible = "analogix,anx6345";
        reg = <0x38>;
        reset-gpios = <&pio42 1 /* GPIO_ACTIVE_LOW */>;
        dvdd25-supply = <&reg_dldo2>;
        dvdd12-supply = <&reg_fldo1>;

        ports {
          #address-cells = <1>;
          #size-cells = <0>;

          anx6345_in: port@0 {
            reg = <0>;
            anx6345_in_tcon0: endpoint {
              remote-endpoint = <&tcon0_out_anx6345>;
            };
          };

          anx6345_out: port@1 {
            reg = <1>;
            anx6345_out_panel: endpoint {
              remote-endpoint = <&panel_in_edp>;
            };
          };
        };
      };
    };
```

## Documentation/devicetree/bindings/display/bridge/cdns,dsi_cn.yaml
```yaml
此文档定义了Cadence DSI桥接设备在Device Tree中的表示方法。

# 许可证：(GPL-2.0 或 BSD-2-Clause)
%YAML 1.2
---
$id: http://devicetree.org/schemas/display/bridge/cdns,dsi.yaml#
$schema: http://devicetree.org/meta-schemas/core.yaml#

标题: Cadence DSI 桥接器

维护者:
  - Boris Brezillon <boris.brezillon@bootlin.com>

描述: |
   CDNS DSI 是一个桥接设备，它将DPI转换为DSI。

属性:
  compatible:
    枚举:
      - cdns,dsi
      - ti,j721e-dsi

  reg:
    最小项数: 1
    项:
      - 描述:
          控制器寄存器的寄存器块
- 描述:
          在TI J7系列SoC中用于封装设置寄存器的寄存器块

时钟:
    项:
      - 描述: PSM时钟，被IP使用
      - 描述: 系统时钟，被IP使用

  clock-names:
    项:
      - 常量: dsi_p_clk
      - 常量: dsi_sys_clk

  phys:
    最大项数: 1

  phy-names:
    常量: dphy

  interrupts:
    最大项数: 1

  resets:
    最大项数: 1

  reset-names:
    常量: dsi_p_rst

  ports:
    $ref: /schemas/graph.yaml#/properties/ports

    属性:
      port@0:
        $ref: /schemas/graph.yaml#/properties/port
        描述:
          表示DSI输出的输出端口。最多可以有4个终端。终端编号直接编码了该设备使用的DSI虚拟通道
port@1:
        $ref: /schemas/graph.yaml#/properties/port
        描述:
          表示DPI输入的输入端口
所需项:
      - port@1

allOf:
  - $ref: ../dsi-controller.yaml#

  - 如果:
      属性:
        compatible:
          包含:
            常量: ti,j721e-dsi
    那么:
      属性:
        reg:
          最小项数: 2
          最大项数: 2
        power-domains:
          最大项数: 1
    否则:
      属性:
        reg:
          最大项数: 1

所需项:
  - compatible
  - reg
  - interrupts
  - clocks
  - clock-names
  - phys
  - phy-names
  - ports

未评估属性: false

示例:
  - |
    bus {
        #address-cells = <2>;
        #size-cells = <2>;

        dsi@fd0c0000 {
            compatible = "cdns,dsi";
            reg = <0x0 0xfd0c0000 0x0 0x1000>;
            clocks = <&pclk>, <&sysclk>;
            clock-names = "dsi_p_clk", "dsi_sys_clk";
            interrupts = <1>;
            phys = <&dphy0>;
            phy-names = "dphy";

            #address-cells = <1>;
            #size-cells = <0>;

            ports {
                #address-cells = <1>;
                #size-cells = <0>;

                port@1 {
                    reg = <1>;
                    endpoint {
                        remote-endpoint = <&xxx_dpi_output>;
                    };
                };
            };

            panel@0 {
                compatible = "panasonic,vvx10f034n00";
                reg = <0>;
                power-supply = <&vcc_lcd_reg>;
            };
        };
    };

  - |
    bus {
        #address-cells = <2>;
        #size-cells = <2>;

        dsi@fd0c0000 {
            compatible = "cdns,dsi";
            reg = <0x0 0xfd0c0000 0x0 0x1000>;
            clocks = <&pclk>, <&sysclk>;
            clock-names = "dsi_p_clk", "dsi_sys_clk";
            interrupts = <1>;
            phys = <&dphy1>;
            phy-names = "dphy";

            ports {
                #address-cells = <1>;
                #size-cells = <0>;

                port@0 {
                    reg = <0>;
                    #address-cells = <1>;
                    #size-cells = <0>;

                    endpoint@0 {
                        reg = <0>;
                        remote-endpoint = <&dsi_panel_input>;
                    };
                };

                port@1 {
                    reg = <1>;
                    endpoint {
                        remote-endpoint = <&xxx_dpi_output>;
                    };
                };
            };
        };
    };
```
