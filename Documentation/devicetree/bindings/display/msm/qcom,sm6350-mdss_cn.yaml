## Documentation/devicetree/bindings/display/msm/qcom,sm6350-mdss_cn.yaml
```yaml
# SPDX-许可证标识符: GPL-2.0-only OR BSD-2-Clause
%YAML 1.2
---
$id: http://devicetree.org/schemas/display/msm/qcom,sm6350-mdss.yaml#
$schema: http://devicetree.org/meta-schemas/core.yaml#

标题: Qualcomm SM6350 显示 MDSS

维护者:
  - Krishna Manikandan <quic_mkrishn@quicinc.com>

描述:
  SM6350 MSM 移动显示子系统 (MDSS)，它封装了像 DPU 显示控制器、DSI 和 DP 接口等子模块。
$ref: /schemas/display/msm/mdss-common.yaml#

属性:
  compatible:
    常量: qcom,sm6350-mdss

  clocks:
    项目:
      - 描述: 来自 gcc 的显示 AHB 时钟
      - 描述: 来自 gcc 的显示 AXI 时钟
      - 描述: 显示核心时钟

  clock-names:
    项目:
      - 常量: iface
      - 常量: bus
      - 常量: core

  iommus:
    最大项数: 1

  interconnects:
    项目:
      - 描述: 从 mdp0 端口到数据总线的互连路径
      - 描述: 从 CPU 到配置总线的互连路径

  interconnect-names:
    项目:
      - 常量: mdp0-mem
      - 常量: cpu-cfg

模式属性:
  "^display-controller@[0-9a-f]+$":
    类型: 对象
    其他属性: true

    属性:
      compatible:
        常量: qcom,sm6350-dpu

  "^displayport-controller@[0-9a-f]+$":
    类型: 对象
    其他属性: true

    属性:
      compatible:
        包含:
          常量: qcom,sm6350-dp

  "^dsi@[0-9a-f]+$":
    类型: 对象
    其他属性: true

    属性:
      compatible:
        项目:
          - 常量: qcom,sm6350-dsi-ctrl
          - 常量: qcom,mdss-dsi-ctrl

  "^phy@[0-9a-f]+$":
    类型: 对象
    其他属性: true

    属性:
      compatible:
        常量: qcom,dsi-phy-10nm

未评估属性: false

示例:
  - |
    #include <dt-bindings/clock/qcom,dispcc-sm6350.h>
    #include <dt-bindings/clock/qcom,gcc-sm6350.h>
    #include <dt-bindings/clock/qcom,rpmh.h>
    #include <dt-bindings/interrupt-controller/arm-gic.h>
    #include <dt-bindings/power/qcom-rpmpd.h>

    display-subsystem@ae00000 {
        compatible = "qcom,sm6350-mdss";
        reg = <0x0ae00000 0x1000>;
        reg-names = "mdss";

        power-domains = <&dispcc MDSS_GDSC>;

        clocks = <&gcc GCC_DISP_AHB_CLK>,
                 <&gcc GCC_DISP_AXI_CLK>,
                 <&dispcc DISP_CC_MDSS_MDP_CLK>;
        clock-names = "iface", "bus", "core";

        interrupts = <GIC_SPI 83 IRQ_TYPE_LEVEL_HIGH>;
        interrupt-controller;
        #interrupt-cells = <1>;

        iommus = <&apps_smmu 0x800 0x2>;
        #address-cells = <1>;
        #size-cells = <1>;
        ranges;

        display-controller@ae01000 {
            compatible = "qcom,sm6350-dpu";
            reg = <0x0ae01000 0x8f000>,
                  <0x0aeb0000 0x2008>;
            reg-names = "mdp", "vbif";

            clocks = <&gcc GCC_DISP_AXI_CLK>,
              <&dispcc DISP_CC_MDSS_AHB_CLK>,
              <&dispcc DISP_CC_MDSS_ROT_CLK>,
              <&dispcc DISP_CC_MDSS_MDP_LUT_CLK>,
              <&dispcc DISP_CC_MDSS_MDP_CLK>,
              <&dispcc DISP_CC_MDSS_VSYNC_CLK>;
            clock-names = "bus", "iface", "rot", "lut", "core",
                    "vsync";

            assigned-clocks = <&dispcc DISP_CC_MDSS_MDP_CLK>,
                              <&dispcc DISP_CC_MDSS_VSYNC_CLK>,
                              <&dispcc DISP_CC_MDSS_ROT_CLK>,
                              <&dispcc DISP_CC_MDSS_AHB_CLK>;
            assigned-clock-rates = <300000000>,
                                   <19200000>,
                                   <19200000>,
                                   <19200000>;

            interrupt-parent = <&mdss>;
            interrupts = <0>;
            operating-points-v2 = <&mdp_opp_table>;
            power-domains = <&rpmhpd SM6350_CX>;

            ports {
                #address-cells = <1>;
                #size-cells = <0>;

                port@0 {
                    reg = <0>;
                    dpu_intf1_out: endpoint {
                        remote-endpoint = <&dsi0_in>;
                    };
                };
            };
        };

        dsi@ae94000 {
            compatible = "qcom,sm6350-dsi-ctrl", "qcom,mdss-dsi-ctrl";
            reg = <0x0ae94000 0x400>;
            reg-names = "dsi_ctrl";

            interrupt-parent = <&mdss>;
            interrupts = <4>;

            clocks = <&dispcc DISP_CC_MDSS_BYTE0_CLK>,
                     <&dispcc DISP_CC_MDSS_BYTE0_INTF_CLK>,
                     <&dispcc DISP_CC_MDSS_PCLK0_CLK>,
                     <&dispcc DISP_CC_MDSS_ESC0_CLK>,
                     <&dispcc DISP_CC_MDSS_AHB_CLK>,
                     <&gcc GCC_DISP_AXI_CLK>;
            clock-names = "byte",
                          "byte_intf",
                          "pixel",
                          "core",
                          "iface",
                          "bus";

            assigned-clocks = <&dispcc DISP_CC_MDSS_BYTE0_CLK_SRC>,
                              <&dispcc DISP_CC_MDSS_PCLK0_CLK_SRC>;
            assigned-clock-parents = <&dsi0_phy 0>, <&dsi0_phy 1>;

            operating-points-v2 = <&dsi_opp_table>;
            power-domains = <&rpmhpd SM6350_MX>;

            phys = <&dsi0_phy>;
            phy-names = "dsi";

            #address-cells = <1>;
            #size-cells = <0>;

            ports {
                #address-cells = <1>;
                #size-cells = <0>;

                port@0 {
                    reg = <0>;
                    dsi0_in: endpoint {
                        remote-endpoint = <&dpu_intf1_out>;
                    };
                };

                port@1 {
                    reg = <1>;
                    dsi0_out: endpoint {
                    };
                };
            };
        };

        dsi0_phy: phy@ae94400 {
            compatible = "qcom,dsi-phy-10nm";
            reg = <0x0ae94400 0x200>,
                  <0x0ae94600 0x280>,
                  <0x0ae94a00 0x1e0>;
            reg-names = "dsi_phy",
                        "dsi_phy_lane",
                        "dsi_pll";

            #clock-cells = <1>;
            #phy-cells = <0>;

            clocks = <&dispcc DISP_CC_MDSS_AHB_CLK>, <&rpmhcc RPMH_CXO_CLK>;
            clock-names = "iface", "ref";
        };
    };
..
```

## Documentation/devicetree/bindings/display/msm/qcom,sm6375-mdss_cn.yaml
```yaml
### 许可证说明：GPL-2.0-only 或 BSD-2-Clause
%YAML 1.2
---
$id: http://devicetree.org/schemas/display/msm/qcom,sm6375-mdss.yaml#
$schema: http://devicetree.org/meta-schemas/core.yaml#

标题: Qualcomm SM6375 显示 MDSS

维护者:
  - Konrad Dybcio <konrad.dybcio@linaro.org>

描述:
  SM6375 MSM 移动显示子系统 (MDSS)，它封装了如 DPU 显示控制器、DSI 和 DP 接口等子模块。
$ref: /schemas/display/msm/mdss-common.yaml#

属性:
  compatible:
    常量: qcom,sm6375-mdss

  clocks:
    项目:
      - 描述: 来自 gcc 的显示 AHB 时钟
      - 描述: 显示 AHB 时钟
      - 描述: 显示核心时钟

  clock-names:
    项目:
      - 常量: iface
      - 常量: ahb
      - 常量: core

  iommus:
    最大项目数: 1

  interconnects:
    项目:
      - 描述: 从 mdp0 端口到数据总线的互连路径
      - 描述: 从 CPU 到配置总线的互连路径

  interconnect-names:
    项目:
      - 常量: mdp0-mem
      - 常量: cpu-cfg

模式属性:
  "^display-controller@[0-9a-f]+$":
    类型: 对象
    其他属性: true

    属性:
      compatible:
        常量: qcom,sm6375-dpu

  "^dsi@[0-9a-f]+$":
    类型: 对象
    其他属性: true

    属性:
      compatible:
        项目:
          - 常量: qcom,sm6375-dsi-ctrl
          - 常量: qcom,mdss-dsi-ctrl

  "^phy@[0-9a-f]+$":
    类型: 对象
    其他属性: true

    属性:
      compatible:
        常量: qcom,sm6375-dsi-phy-7nm

未评估属性: false

示例:
  - |
    #include <dt-bindings/clock/qcom,rpmcc.h>
    #include <dt-bindings/clock/qcom,sm6375-gcc.h>
    #include <dt-bindings/clock/qcom,sm6375-dispcc.h>
    #include <dt-bindings/interrupt-controller/arm-gic.h>
    #include <dt-bindings/power/qcom-rpmpd.h>

    display-subsystem@5e00000 {
        compatible = "qcom,sm6375-mdss";
        reg = <0x05e00000 0x1000>;
        reg-names = "mdss";

        power-domains = <&dispcc MDSS_GDSC>;

        clocks = <&gcc GCC_DISP_AHB_CLK>,
                 <&dispcc DISP_CC_MDSS_AHB_CLK>,
                 <&dispcc DISP_CC_MDSS_MDP_CLK>;
        clock-names = "iface", "ahb", "core";

        interrupts = <GIC_SPI 83 IRQ_TYPE_LEVEL_HIGH>;
        interrupt-controller;
        #interrupt-cells = <1>;

        iommus = <&apps_smmu 0x820 0x2>;
        #address-cells = <1>;
        #size-cells = <1>;
        ranges;

        display-controller@5e01000 {
            compatible = "qcom,sm6375-dpu";
            reg = <0x05e01000 0x8e030>,
                  <0x05eb0000 0x2008>;
            reg-names = "mdp", "vbif";

            clocks = <&gcc GCC_DISP_HF_AXI_CLK>,
                     <&dispcc DISP_CC_MDSS_AHB_CLK>,
                     <&dispcc DISP_CC_MDSS_ROT_CLK>,
                     <&dispcc DISP_CC_MDSS_MDP_LUT_CLK>,
                     <&dispcc DISP_CC_MDSS_MDP_CLK>,
                     <&dispcc DISP_CC_MDSS_VSYNC_CLK>,
                     <&gcc GCC_DISP_THROTTLE_CORE_CLK>;
            clock-names = "bus",
                          "iface",
                          "rot",
                          "lut",
                          "core",
                          "vsync",
                          "throttle";

            assigned-clocks = <&dispcc DISP_CC_MDSS_VSYNC_CLK>;
            assigned-clock-rates = <19200000>;

            operating-points-v2 = <&mdp_opp_table>;
            power-domains = <&rpmpd SM6375_VDDCX>;

            interrupt-parent = <&mdss>;
            interrupts = <0>;

            ports {
                #address-cells = <1>;
                #size-cells = <0>;

                port@0 {
                    reg = <0>;
                    dpu_intf1_out: endpoint {
                        remote-endpoint = <&dsi0_in>;
                    };
                };
            };
        };

        dsi@5e94000 {
            compatible = "qcom,sm6375-dsi-ctrl", "qcom,mdss-dsi-ctrl";
            reg = <0x05e94000 0x400>;
            reg-names = "dsi_ctrl";

            interrupt-parent = <&mdss>;
            interrupts = <4>;

            clocks = <&dispcc DISP_CC_MDSS_BYTE0_CLK>,
                     <&dispcc DISP_CC_MDSS_BYTE0_INTF_CLK>,
                     <&dispcc DISP_CC_MDSS_PCLK0_CLK>,
                     <&dispcc DISP_CC_MDSS_ESC0_CLK>,
                     <&dispcc DISP_CC_MDSS_AHB_CLK>,
                     <&gcc GCC_DISP_HF_AXI_CLK>;
            clock-names = "byte",
                          "byte_intf",
                          "pixel",
                          "core",
                          "iface",
                          "bus";

            assigned-clocks = <&dispcc DISP_CC_MDSS_BYTE0_CLK_SRC>,
                              <&dispcc DISP_CC_MDSS_PCLK0_CLK_SRC>;
            assigned-clock-parents = <&mdss_dsi0_phy 0>, <&mdss_dsi0_phy 1>;

            operating-points-v2 = <&dsi_opp_table>;
            power-domains = <&rpmpd SM6375_VDDMX>;

            phys = <&mdss_dsi0_phy>;
            phy-names = "dsi";

            #address-cells = <1>;
            #size-cells = <0>;

            ports {
                #address-cells = <1>;
                #size-cells = <0>;

                port@0 {
                    reg = <0>;
                    dsi0_in: endpoint {
                        remote-endpoint = <&dpu_intf1_out>;
                    };
                };

                port@1 {
                    reg = <1>;
                    dsi0_out: endpoint {
                    };
                };
            };
        };

        mdss_dsi0_phy: phy@5e94400 {
            compatible = "qcom,sm6375-dsi-phy-7nm";
            reg = <0x05e94400 0x200>,
                  <0x05e94600 0x280>,
                  <0x05e94900 0x264>;
            reg-names = "dsi_phy",
                        "dsi_phy_lane",
                        "dsi_pll";

            #clock-cells = <1>;
            #phy-cells = <0>;

            clocks = <&dispcc DISP_CC_MDSS_AHB_CLK>,
                     <&rpmcc RPM_SMD_XO_CLK_SRC>;
            clock-names = "iface", "ref";
        };
    };
..
```

## Documentation/devicetree/bindings/display/msm/qcom,sm7150-dpu_cn.yaml
~~~~yaml
```yaml
# SPDX-文件许可人: GPL-2.0-only 或 BSD-2-Clause
%YAML 1.2
---
$id: http://devicetree.org/schemas/display/msm/qcom,sm7150-dpu.yaml#
$schema: http://devicetree.org/meta-schemas/core.yaml#

title: Qualcomm SM7150 显示处理单元 (DPU)

maintainers:
  - Danila Tikhonov <danila@jiaxyga.com>

$ref: /schemas/display/msm/dpu-common.yaml#

properties:
  compatible:
    const: qcom,sm7150-dpu

  reg:
    items:
      - description: MDP 寄存器集的地址偏移和大小
      - description: VBIF 寄存器集的地址偏移和大小

  reg-names:
    items:
      - const: mdp
      - const: vbif

  clocks:
    items:
      - description: 显示 HF AXI 时钟
      - description: 显示 AHB 时钟
      - description: 显示旋转器时钟
      - description: 显示查找表时钟
      - description: 显示核心时钟
      - description: 显示垂直同步时钟

  clock-names:
    items:
      - const: bus
      - const: iface
      - const: rot
      - const: lut
      - const: core
      - const: vsync

required:
  - compatible
  - reg
  - reg-names
  - clocks
  - clock-names

unevaluatedProperties: false

examples:
  - |
    #include <dt-bindings/interrupt-controller/arm-gic.h>
    #include <dt-bindings/power/qcom,rpmhpd.h>

    display-controller@ae01000 {
        compatible = "qcom,sm7150-dpu";
        reg = <0x0ae01000 0x8f000>,
              <0x0aeb0000 0x2008>;
        reg-names = "mdp", "vbif";

        clocks = <&gcc_disp_hf_axi_clk>,
                 <&dispcc_mdss_ahb_clk>,
                 <&dispcc_mdss_rot_clk>,
                 <&dispcc_mdss_mdp_lut_clk>,
                 <&dispcc_mdss_mdp_clk>,
                 <&dispcc_mdss_vsync_clk>;
        clock-names = "bus",
                      "iface",
                      "rot",
                      "lut",
                      "core",
                      "vsync";

        assigned-clocks = <&dispcc_mdss_vsync_clk>;
        assigned-clock-rates = <19200000>;

        operating-points-v2 = <&mdp_opp_table>;
        power-domains = <&rpmhpd RPMHPD_CX>;

        interrupt-parent = <&mdss>;
        interrupts = <0>;

        ports {
            #address-cells = <1>;
            #size-cells = <0>;

            port@0 {
                reg = <0>;
                dpu_intf1_out: endpoint {
                    remote-endpoint = <&mdss_dsi0_in>;
                };
            };

            port@1 {
                reg = <1>;
                dpu_intf2_out: endpoint {
                    remote-endpoint = <&mdss_dsi1_in>;
                };
            };

            port@2 {
                reg = <2>;
                dpu_intf0_out: endpoint {
                    remote-endpoint = <&dp_in>;
                };
            };
        };

        mdp_opp_table: opp-table {
            compatible = "operating-points-v2";

            opp-19200000 {
                opp-hz = /bits/ 64 <19200000>;
                required-opps = <&rpmhpd_opp_min_svs>;
            };

            opp-200000000 {
                opp-hz = /bits/ 64 <200000000>;
                required-opps = <&rpmhpd_opp_low_svs>;
            };

            opp-300000000 {
                opp-hz = /bits/ 64 <300000000>;
                required-opps = <&rpmhpd_opp_svs>;
            };

            opp-344000000 {
                opp-hz = /bits/ 64 <344000000>;
                required-opps = <&rpmhpd_opp_svs_l1>;
            };

            opp-430000000 {
                opp-hz = /bits/ 64 <430000000>;
                required-opps = <&rpmhpd_opp_nom>;
            };
        };
    };
..
```
请注意，上述翻译保持了原始 YAML 的结构，并且尽量将所有的技术术语翻译成了对应的中文术语。如果某些术语没有标准的中文对应项，则直接保留了原文。
~~~~
