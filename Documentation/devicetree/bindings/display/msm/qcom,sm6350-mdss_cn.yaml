## Documentation/devicetree/bindings/display/multi-inno,mi0283qt_cn.txt
~~~~
这段文本描述了如何在设备树(Device Tree)中配置 Multi-Inno MI0283QT 显示面板的属性。下面是对这段文本的中文翻译和解释：

### Multi-Inno MI0283QT 显示面板

**必需属性：**
- `compatible`: `"multi-inno,mi0283qt"`，用于指定此节点兼容的设备类型。

此驱动程序节点必须作为 SPI 控制器的子节点存在，因此必须指定 ../spi/spi-bus.txt 中描述的所有必需属性。

**可选属性：**
- `dc-gpios`: D/C 引脚。此 GPIO 的存在与否决定了面板接口模式（IM[3:0] 引脚）：
    - 存在时：IM=x110，4线 8位数据串行接口
    - 缺少时：IM=x101，3线 9位数据串行接口
- `reset-gpios`: 重置引脚。
- `power-supply`: 为供电电压提供的调节器节点。
- `backlight`: 面板所连接背光设备的 phandle。
- `rotation`: 面板逆时针旋转的角度（0、90、180、270 度）。

### 示例：

```plaintext
mi0283qt@0 {
	compatible = "multi-inno,mi0283qt";
	reg = <0>;
	spi-max-frequency = <32000000>;
	rotation = <90>;
	dc-gpios = <&gpio 25 0>;
	backlight = <&backlight>;
};
```

- `mi0283qt@0` 表示此节点的名称，其中 `@0` 指定了该设备的地址或标识符。
- `reg = <0>;` 通常用于指定硬件寄存器的地址，但在 SPI 设备中这可能是不必要的，具体取决于 SPI 控制器的要求。
- `spi-max-frequency = <32000000>;` 定义了 SPI 接口的最大频率为 32 MHz。
- `dc-gpios = <&gpio 25 0>;` 指定 D/C 引脚为 GPIO 25，方向为输出。
- `backlight = <&backlight>;` 指向背光设备的 phandle，表明与背光控制相关联。

以上是针对 Multi-Inno MI0283QT 显示面板在设备树中的配置说明。
~~~~

## Documentation/devicetree/bindings/display/panel/abt,y030xx067a_cn.yaml
~~~~yaml
```yaml
# SPDX-许可证标识符: (GPL-2.0 或 BSD-2-Clause)
%YAML 1.2
---
$id: http://devicetree.org/schemas/display/panel/abt,y030xx067a.yaml#
$schema: http://devicetree.org/meta-schemas/core.yaml#

title: 亚洲更佳科技 3.0英寸 (320x480像素) 24位 IPS 液晶显示屏

maintainers:
  - Paul Cercueil <paul@crapouillou.net>

allOf:
  - $ref: panel-common.yaml#
  - $ref: /schemas/spi/spi-peripheral-props.yaml#

properties:
  compatible:
    const: abt,y030xx067a

  reg:
    maxItems: 1

  backlight: true
  port: true
  power-supply: true
  reset-gpios: true

required:
  - compatible
  - reg
  - power-supply
  - reset-gpios

unevaluatedProperties: false

examples:
  - |
    #include <dt-bindings/gpio/gpio.h>

    spi {
        #address-cells = <1>;
        #size-cells = <0>;

        panel@0 {
            compatible = "abt,y030xx067a";
            reg = <0>;

            spi-max-frequency = <3125000>;

            reset-gpios = <&gpe 2 GPIO_ACTIVE_LOW>;

            backlight = <&backlight>;
            power-supply = <&vcc>;

            port {
                panel_input: endpoint {
                    remote-endpoint = <&panel_output>;
                };
            };
        };
    };
```

此段代码描述了一个设备树配置文件，用于定义亚洲更佳科技生产的特定型号的3.0英寸IPS液晶显示屏。它指定了与该显示屏相关的各种属性和要求，并提供了一个示例来说明如何在设备树中使用这些定义。
~~~~

## Documentation/devicetree/bindings/display/panel/advantech,idk-2121wr_cn.yaml
~~~~yaml
下面是给定 YAML 文档的中文翻译：

```yaml
# SPDX-许可证标识符: (GPL-2.0-only 或 BSD-2-Clause)
%YAML 1.2
---
$id: http://devicetree.org/schemas/display/panel/advantech,idk-2121wr.yaml#
$schema: http://devicetree.org/meta-schemas/core.yaml#

标题: Advantech IDK-2121WR 21.5英寸全高清双LVDS面板

维护者:
  - Lad Prabhakar <prabhakar.mahadev-lad.rj@bp.renesas.com>
  - Thierry Reding <thierry.reding@gmail.com>

描述: |
  Advantech 的 IDK-2121WR 是一款全高清双LVDS面板。
  双LVDS接口是一种双链路连接，其中偶数像素通过一条链路传输，
  而奇数像素通过另一条链路传输。
  面板期望奇数像素在第一个端口上，偶数像素在第二个端口上，
  因此必须相应地标记这些端口（使用 dual-lvds-odd-pixels 或 dual-lvds-even-pixels）。

allOf:
  - $ref: panel-common.yaml#

属性:
  compatible:
    items:
      - const: advantech,idk-2121wr
      - {} # panel-lvds, 但为了避免错误选择而不在此列出

  width-mm:
    const: 476

  height-mm:
    const: 268

  data-mapping:
    const: vesa-24

  panel-timing: true

  ports:
    $ref: /schemas/graph.yaml#/properties/ports

    属性:
      port@0:
        $ref: /schemas/graph.yaml#/$defs/port-base
        不评估属性: false
        描述: 奇数像素的接收端
        属性:
          dual-lvds-odd-pixels: true

        必需:
          - dual-lvds-odd-pixels

      port@1:
        $ref: /schemas/graph.yaml#/$defs/port-base
        不评估属性: false
        描述: 偶数像素的接收端
        属性:
          dual-lvds-even-pixels: true

        必需:
          - dual-lvds-even-pixels

    必需:
      - port@0
      - port@1

额外属性: false

必需:
  - compatible
  - width-mm
  - height-mm
  - data-mapping
  - panel-timing
  - ports

示例:
  - |+
    panel-lvds {
      compatible = "advantech,idk-2121wr", "panel-lvds";

      width-mm = <476>;
      height-mm = <268>;

      data-mapping = "vesa-24";

      panel-timing {
        clock-frequency = <148500000>;
        hactive = <1920>;
        vactive = <1080>;
        hsync-len = <44>;
        hfront-porch = <88>;
        hback-porch = <148>;
        vfront-porch = <4>;
        vback-porch = <36>;
        vsync-len = <5>;
      };

      ports {
        #address-cells = <1>;
        #size-cells = <0>;

        port@0 {
          reg = <0>;
          dual-lvds-odd-pixels;
          panel_in0: endpoint {
            remote-endpoint = <&lvds0_out>;
          };
        };

        port@1 {
          reg = <1>;
          dual-lvds-even-pixels;
          panel_in1: endpoint {
            remote-endpoint = <&lvds1_out>;
          };
        };
      };
    };
```

请注意，某些 YAML 特定语法如 `|+` 和 `<...>` 在中文语境下没有对应的直接翻译，因为它们是 YAML 语言的一部分。此外，“unevaluatedProperties”被翻译为“不评估属性”，这可能不是最直接的中文对应词，但它试图传达该属性的意义。
~~~~

## Documentation/devicetree/bindings/display/panel/arm,rtsm-display_cn.yaml
```yaml
# SPDX-文件许可人: GPL-2.0-only 或 BSD-2-Clause
%YAML 1.2
---
$id: http://devicetree.org/schemas/display/panel/arm,rtsm-display.yaml#
$schema: http://devicetree.org/meta-schemas/core.yaml#

标题: Arm RTSM 虚拟平台显示

维护者:
  - Linus Walleij <linus.walleij@linaro.org>

allOf:
  - $ref: panel-common.yaml#

属性:
  compatible:
    常量: arm,rtsm-display

  port: true

必需:
  - compatible
  - port

额外属性: false

..
```

## Documentation/devicetree/bindings/display/panel/arm,versatile-tft-panel_cn.yaml
```yaml
# SPDX-许可证标识符: GPL-2.0
%YAML 1.2
---
$id: http://devicetree.org/schemas/display/panel/arm,versatile-tft-panel.yaml#
$schema: http://devicetree.org/meta-schemas/core.yaml#

标题: ARM 多功能 TFT 显示屏

维护者:
  - Linus Walleij <linus.walleij@linaro.org>

描述: |
  这些显示屏连接到 ARM 多功能参考设计中发现的子板上。
  此设备节点必须作为 "syscon" 兼容节点的子节点出现。
所有Of:
  - $ref: panel-common.yaml#

属性:
  compatible:
    常量: arm,versatile-tft-panel

  port: 真

必需:
  - compatible
  - port

额外属性: 错误

示例:
  - |
    sysreg@0 {
        compatible = "arm,versatile-sysreg", "syscon", "simple-mfd";
        reg = <0x00000 0x1000>;

        panel {
            compatible = "arm,versatile-tft-panel";

            port {
                panel_in: endpoint {
                    remote-endpoint = <&foo>;
                };
            };
        };
    };
```

## Documentation/devicetree/bindings/display/panel/armadeus,st0700-adapt_cn.yaml
~~~~yaml
```yaml
# SPDX-许可证标识符: GPL-2.0
%YAML 1.2
---
$id: http://devicetree.org/schemas/display/panel/armadeus,st0700-adapt.yaml#
$schema: http://devicetree.org/meta-schemas/core.yaml#

title: Armadeus ST0700 适配器

description:
  这是一个配备有 Santek ST0700I5Y-RBSLW 7.0英寸 WVGA (800x480) TFT 的适配板
maintainers:
  - '"Sébastien Szymanski" <sebastien.szymanski@armadeus.com>'
  - Thierry Reding <thierry.reding@gmail.com>

allOf:
  - $ref: panel-common.yaml#

properties:
  compatible:
    const: armadeus,st0700-adapt

  power-supply: true
  backlight: true
  port: true

additionalProperties: false

required:
  - compatible
  - power-supply
```
请注意，上述翻译保留了原始 YAML 文件的结构和格式。其中一些术语如 `$ref` 和 `const` 等未进行翻译，因为它们是 YAML 文件中特定的关键词，通常在所有语言环境中保持一致。
~~~~

## Documentation/devicetree/bindings/display/panel/asus,z00t-tm5p5-nt35596_cn.yaml
~~~~yaml
```yaml
# SPDX-许可证标识符: (GPL-2.0-only 或 BSD-2-Clause)
%YAML 1.2
---
$id: http://devicetree.org/schemas/display/panel/asus,z00t-tm5p5-nt35596.yaml#
$schema: http://devicetree.org/meta-schemas/core.yaml#

标题: ASUS Z00T TM5P5 NT35596 5.5英寸 1080×1920 LCD 面板

维护者:
  - Konrad Dybcio <konradybcio@gmail.com>

描述: |+
  此面板似乎仅在 Asus Z00T
  智能手机中找到，我们没有直接的方法来
  实际获取正确的型号，
  因为没有公开发布的原理图
allOf:
  - $ref: panel-common.yaml#

属性:
  compatible:
    常量: asus,z00t-tm5p5-n35596

  reg:
    最大项数: 1

  reset-gpios: 真
  vdd-supply:
    描述: 核心电压供电
  vddio-supply:
    描述: vddio 供电

必需:
  - compatible
  - reg
  - vdd-supply
  - vddio-supply
  - reset-gpios

额外属性: 错误

示例:
  - |
    #include <dt-bindings/gpio/gpio.h>

    dsi {
            #address-cells = <1>;
            #size-cells = <0>;
            panel@0 {
                    reg = <0>;

                    compatible = "asus,z00t-tm5p5-n35596";

                    vdd-supply = <&pm8916_l8>;
                    vddio-supply = <&pm8916_l6>;
                    reset-gpios = <&msmgpio 25 GPIO_ACTIVE_HIGH>;
            };
    };
```

请注意，由于 YAML 和 Markdown 的格式限制，某些 YAML 特定的语法（如缩进和换行）可能在转换过程中有所改变。上述翻译尽量保持了原文件的结构与内容。
~~~~

## Documentation/devicetree/bindings/display/panel/auo,a030jtn01_cn.yaml
~~~~yaml
```yaml
# SPDX-许可证标识符: (GPL-2.0 或 BSD-2-Clause)
%YAML 1.2
---
$id: http://devicetree.org/schemas/display/panel/auo,a030jtn01.yaml#
$schema: http://devicetree.org/meta-schemas/core.yaml#

title: AUO A030JTN01 3.0" (320x480 像素) 24位 TFT 液晶面板

description: |
  在某些 Retrogame 手持设备中找到的 Delta RGB 8位 面板

maintainers:
  - Paul Cercueil <paul@crapouillou.net>
  - Christophe Branchereau <cbranchereau@gmail.com>

allOf:
  - $ref: panel-common.yaml#
  - $ref: /schemas/spi/spi-peripheral-props.yaml#

properties:
  compatible:
    const: auo,a030jtn01

  reg:
    maxItems: 1

required:
  - compatible
  - reg
  - power-supply
  - reset-gpios

unevaluatedProperties: false

examples:
  - |
    #include <dt-bindings/gpio/gpio.h>

    spi {
        #address-cells = <1>;
        #size-cells = <0>;

        panel@0 {
            compatible = "auo,a030jtn01";
            reg = <0>;

            spi-max-frequency = <10000000>;

            reset-gpios = <&gpe 4 GPIO_ACTIVE_LOW>;
            power-supply = <&lcd_power>;

            backlight = <&backlight>;

            port {
                panel_input: endpoint {
                    remote-endpoint = <&panel_output>;
                };
            };
        };
    };
```

此段代码定义了一个设备树片段，用于描述 AUO A030JTN01 液晶面板的配置。这包括了面板的基本信息、必需的属性以及示例配置。
~~~~

## Documentation/devicetree/bindings/display/panel/bananapi,s070wv20-ct16_cn.yaml
```yaml
# SPDX-文件许可人: GPL-2.0
%YAML 1.2
---
$id: http://devicetree.org/schemas/display/panel/bananapi,s070wv20-ct16.yaml#
$schema: http://devicetree.org/meta-schemas/core.yaml#

标题: Banana Pi 7" (S070WV20-CT16) TFT 液晶显示屏

维护者:
  - 陈宇蔡 <wens@csie.org>
  - Thierry Reding <thierry.reding@gmail.com>

allOf:
  - $ref: panel-common.yaml#

属性:
  compatible:
    常量: bananapi,s070wv20-ct16

  power-supply: 真
  backlight: 真
  enable-gpios: 真
  port: 真

额外属性: 假

必需:
  - compatible
  - power-supply

..
```

## Documentation/devicetree/bindings/display/panel/boe,bf060y8m-aj0_cn.yaml
```yaml
以下是给定 YAML 文档的中文翻译：

---

# SPDX 许可证标识符: (GPL-2.0-only 或 BSD-2-Clause)
%YAML 1.2
---
$id: http://devicetree.org/schemas/display/panel/boe,bf060y8m-aj0.yaml#
$schema: http://devicetree.org/meta-schemas/core.yaml#

title: BOE BF060Y8M-AJ0 5.99 英寸 1080x2160 AMOLED 显示屏

maintainers:
  - 安杰洛·乔阿基诺·德尔雷格诺 <angelogioacchino.delregno@somainline.org>

description: |
  这是一款 5.99 英寸 1080x2160 1670万色主动矩阵 AMOLED 视频模式显示屏模块，采用 MIPI-DSI 4 路接口，GGRB 像素排列，像素间距为 63 微米，有效区域尺寸为 68.04 毫米 x 136.08 毫米。
每个像素分为红色和绿色点或蓝色和绿色点，并且两个像素共享红色或蓝色点，这些点呈垂直条纹排列。
该显示屏模块的驱动 IC 是 SW43404。

allOf:
  - $ref: panel-common.yaml#

properties:
  compatible:
    const: boe,bf060y8m-aj0

  reg:
    maxItems: 1

  elvdd-supply:
    description: 正向驱动电压 (VDD) 供电（4.40-4.80V）
  elvss-supply:
    description: 负向驱动电压 (VSS) 供电（-5.00V 至 -1.40V）
  vcc-supply:
    description: 核心 (TSP) 电压供电（2.70-3.60V）
  vci-supply:
    description: 驱动 IC 工作供电（2.60-3.60V）
  vddio-supply:
    description: 输入输出电压供电（1.62-1.98V）

  port: true
  reset-gpios: true

required:
  - compatible
  - elvdd-supply
  - elvss-supply
  - vcc-supply
  - vci-supply
  - vddio-supply
  - reg
  - reset-gpios

additionalProperties: false

examples:
  - |
    #include <dt-bindings/gpio/gpio.h>

    dsi {
        #address-cells = <1>;
        #size-cells = <0>;
        panel@0 {
            compatible = "boe,bf060y8m-aj0";
            reg = <0>;

            reset-gpios = <&tlmm 94 GPIO_ACTIVE_HIGH>;

            vcc-supply = <&disp_vcc_vreg>;
            vddio-supply = <&disp_vddio_vreg>;
            vci-supply = <&disp_vci_vreg>;
            elvdd-supply = <&disp_elvdd_vreg>;
            elvss-supply = <&disp_elvss_vreg>;

            port {
                panel_in: endpoint {
                    remote-endpoint = <&dsi0_out>;
                };
            };
        };
    };
```

## Documentation/devicetree/bindings/display/panel/boe,himax8279d_cn.yaml
```yaml
# SPDX-许可证标识符: GPL-2.0
%YAML 1.2
---
$id: http://devicetree.org/schemas/display/panel/boe,himax8279d.yaml#
$schema: http://devicetree.org/meta-schemas/core.yaml#

标题: BOE Himax8279d 1200x1920 TFT LCD 面板

维护者:
  - Jerry Han <jerry.han.hq@gmail.com>

allOf:
  - $ref: panel-common.yaml#

属性:
  compatible:
    项目:
      - 常量: boe,himax8279d8p
      - 常量: boe,himax8279d10p

  reg:
    最大项数: 1

  backlight: 真
  enable-gpios: 真

  pp33-gpios:
    最大项数: 1
    描述: 为提供供电电压的 3.3v 引脚提供的 GPIO

  pp18-gpios:
    最大项数: 1
    描述: 为提供供电电压的 1.8v 引脚提供的 GPIO

必需:
  - compatible
  - reg
  - enable-gpios
  - pp33-gpios
  - pp18-gpios

附加属性: 假

示例:
  - |
    #include <dt-bindings/gpio/gpio.h>

    dsi {
        #address-cells = <1>;
        #size-cells = <0>;
        panel@0 {
            compatible = "boe,himax8279d8p", "boe,himax8279d10p";
            reg = <0>;
            backlight = <&backlight>;
            enable-gpios = <&gpio 45 GPIO_ACTIVE_HIGH>;
            pp33-gpios = <&gpio 35 GPIO_ACTIVE_HIGH>;
            pp18-gpios = <&gpio 36 GPIO_ACTIVE_HIGH>;
        };
    };

..
```
