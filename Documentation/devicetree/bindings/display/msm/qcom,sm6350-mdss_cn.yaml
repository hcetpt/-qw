## Documentation/devicetree/bindings/display/msm/qcom,sm8650-mdss_cn.yaml
~~~~yaml
下面是给定的 Device Tree 绑定文件的中文翻译：

```yaml
# SPDX 许可证标识符: GPL-2.0-only 或 BSD-2-Clause
%YAML 1.2
---
$id: http://devicetree.org/schemas/display/msm/qcom,sm8650-mdss.yaml#
$schema: http://devicetree.org/meta-schemas/core.yaml#

标题: 高通 SM8650 显示子系统 MDSS

维护者:
  - 尼尔·阿姆斯特朗 <neil.armstrong@linaro.org>

描述:
  SM8650 MSM 移动显示子系统 (MDSS)，它封装了诸如 DPU 显示控制器、DSI 和 DP 接口等子模块。
$ref: /schemas/display/msm/mdss-common.yaml#

属性:
  compatible:
    常量: qcom,sm8650-mdss

  clocks:
    项:
      - 描述: 显示 AHB
      - 描述: 显示高频 AXI
      - 描述: 显示核心

  iommus:
    最大项数: 1

  interconnects:
    最大项数: 2

  interconnect-names:
    最大项数: 2

模式属性:
  "^display-controller@[0-9a-f]+$":
    类型: 对象
    其他属性: 真
    属性:
      compatible:
        常量: qcom,sm8650-dpu

  "^displayport-controller@[0-9a-f]+$":
    类型: 对象
    其他属性: 真
    属性:
      compatible:
        常量: qcom,sm8650-dp

  "^dsi@[0-9a-f]+$":
    类型: 对象
    其他属性: 真
    属性:
      compatible:
        项:
          - 常量: qcom,sm8650-dsi-ctrl
          - 常量: qcom,mdss-dsi-ctrl

  "^phy@[0-9a-f]+$":
    类型: 对象
    其他属性: 真
    属性:
      compatible:
        常量: qcom,sm8650-dsi-phy-4nm

必需项:
  - compatible

未评估属性: 假

示例:
  - |
    #include <dt-bindings/clock/qcom,rpmh.h>
    #include <dt-bindings/interrupt-controller/arm-gic.h>
    #include <dt-bindings/power/qcom,rpmhpd.h>

    display-subsystem@ae00000 {
        compatible = "qcom,sm8650-mdss";
        reg = <0x0ae00000 0x1000>;
        reg-names = "mdss";

        resets = <&dispcc_core_bcr>;

        power-domains = <&dispcc_gdsc>;

        clocks = <&gcc_ahb_clk>,
                 <&gcc_axi_clk>,
                 <&dispcc_mdp_clk>;
        clock-names = "bus", "nrt_bus", "core";

        interrupts = <GIC_SPI 83 IRQ_TYPE_LEVEL_HIGH>;
        interrupt-controller;
        #interrupt-cells = <1>;

        iommus = <&apps_smmu 0x1c00 0x2>;

        #address-cells = <1>;
        #size-cells = <1>;
        ranges;

        display-controller@ae01000 {
            compatible = "qcom,sm8650-dpu";
            reg = <0x0ae01000 0x8f000>,
                  <0x0aeb0000 0x2008>;
            reg-names = "mdp", "vbif";

            clocks = <&gcc_axi_clk>,
                     <&dispcc_ahb_clk>,
                     <&dispcc_mdp_lut_clk>,
                     <&dispcc_mdp_clk>,
                     <&dispcc_mdp_vsync_clk>;
            clock-names = "nrt_bus",
                          "iface",
                          "lut",
                          "core",
                          "vsync";

            assigned-clocks = <&dispcc_mdp_vsync_clk>;
            assigned-clock-rates = <19200000>;

            operating-points-v2 = <&mdp_opp_table>;
            power-domains = <&rpmhpd RPMHPD_MMCX>;

            interrupt-parent = <&mdss>;
            interrupts = <0>;

            ports {
                #address-cells = <1>;
                #size-cells = <0>;

                port@0 {
                    reg = <0>;
                    dpu_intf1_out: endpoint {
                        remote-endpoint = <&dsi0_in>;
                    };
                };

                port@1 {
                    reg = <1>;
                    dpu_intf2_out: endpoint {
                        remote-endpoint = <&dsi1_in>;
                    };
                };
            };

            mdp_opp_table: opp-table {
                compatible = "operating-points-v2";

                opp-200000000 {
                    opp-hz = /bits/ 64 <200000000>;
                    required-opps = <&rpmhpd_opp_low_svs>;
                };

                opp-325000000 {
                    opp-hz = /bits/ 64 <325000000>;
                    required-opps = <&rpmhpd_opp_svs>;
                };

                opp-375000000 {
                    opp-hz = /bits/ 64 <375000000>;
                    required-opps = <&rpmhpd_opp_svs_l1>;
                };

                opp-514000000 {
                    opp-hz = /bits/ 64 <514000000>;
                    required-opps = <&rpmhpd_opp_nom>;
                };
            };
        };

        dsi@ae94000 {
            compatible = "qcom,sm8650-dsi-ctrl", "qcom,mdss-dsi-ctrl";
            reg = <0x0ae94000 0x400>;
            reg-names = "dsi_ctrl";

            interrupt-parent = <&mdss>;
            interrupts = <4>;

            clocks = <&dispc_byte_clk>,
                     <&dispcc_intf_clk>,
                     <&dispcc_pclk>,
                     <&dispcc_esc_clk>,
                     <&dispcc_ahb_clk>,
                     <&gcc_bus_clk>;
            clock-names = "byte",
                          "byte_intf",
                          "pixel",
                          "core",
                          "iface",
                          "bus";

            assigned-clocks = <&dispcc_byte_clk>,
                              <&dispcc_pclk>;
            assigned-clock-parents = <&dsi0_phy 0>, <&dsi0_phy 1>;

            operating-points-v2 = <&dsi_opp_table>;
            power-domains = <&rpmhpd RPMHPD_MMCX>;

            phys = <&dsi0_phy>;
            phy-names = "dsi";

            #address-cells = <1>;
            #size-cells = <0>;

            ports {
                #address-cells = <1>;
                #size-cells = <0>;

                port@0 {
                    reg = <0>;
                    dsi0_in: endpoint {
                        remote-endpoint = <&dpu_intf1_out>;
                    };
                };

                port@1 {
                    reg = <1>;
                    dsi0_out: endpoint {
                    };
                };
            };

            dsi_opp_table: opp-table {
                compatible = "operating-points-v2";

                opp-187500000 {
                    opp-hz = /bits/ 64 <187500000>;
                    required-opps = <&rpmhpd_opp_low_svs>;
                };

                opp-300000000 {
                    opp-hz = /bits/ 64 <300000000>;
                    required-opps = <&rpmhpd_opp_svs>;
                };

                opp-358000000 {
                    opp-hz = /bits/ 64 <358000000>;
                    required-opps = <&rpmhpd_opp_svs_l1>;
                };
            };
        };

        dsi0_phy: phy@ae94400 {
            compatible = "qcom,sm8650-dsi-phy-4nm";
            reg = <0x0ae95000 0x200>,
                  <0x0ae95200 0x280>,
                  <0x0ae95500 0x400>;
            reg-names = "dsi_phy",
                        "dsi_phy_lane",
                        "dsi_pll";

            #clock-cells = <1>;
            #phy-cells = <0>;

            clocks = <&dispcc_iface_clk>,
                     <&rpmhcc_ref_clk>;
            clock-names = "iface", "ref";
        };

        dsi@ae96000 {
            compatible = "qcom,sm8650-dsi-ctrl", "qcom,mdss-dsi-ctrl";
            reg = <0x0ae96000 0x400>;
            reg-names = "dsi_ctrl";

            interrupt-parent = <&mdss>;
            interrupts = <5>;

            clocks = <&dispc_byte_clk>,
                     <&dispcc_intf_clk>,
                     <&dispcc_pclk>,
                     <&dispcc_esc_clk>,
                     <&dispcc_ahb_clk>,
                     <&gcc_bus_clk>;
            clock-names = "byte",
                          "byte_intf",
                          "pixel",
                          "core",
                          "iface",
                          "bus";

            assigned-clocks = <&dispcc_byte_clk>,
                              <&dispcc_pclk>;
            assigned-clock-parents = <&dsi1_phy 0>, <&dsi1_phy 1>;

            operating-points-v2 = <&dsi_opp_table>;
            power-domains = <&rpmhpd RPMHPD_MMCX>;

            phys = <&dsi1_phy>;
            phy-names = "dsi";

            #address-cells = <1>;
            #size-cells = <0>;

            ports {
                #address-cells = <1>;
                #size-cells = <0>;

                port@0 {
                    reg = <0>;
                    dsi1_in: endpoint {
                        remote-endpoint = <&dpu_intf2_out>;
                    };
                };

                port@1 {
                    reg = <1>;
                    dsi1_out: endpoint {
                    };
                };
            };
        };

        dsi1_phy: phy@ae96400 {
            compatible = "qcom,sm8650-dsi-phy-4nm";
            reg = <0x0ae97000 0x200>,
                  <0x0ae97200 0x280>,
                  <0x0ae97500 0x400>;
            reg-names = "dsi_phy",
                        "dsi_phy_lane",
                        "dsi_pll";

            #clock-cells = <1>;
            #phy-cells = <0>;

            clocks = <&dispcc_iface_clk>,
                     <&rpmhcc_ref_clk>;
            clock-names = "iface", "ref";
        };
    };
..
```
请注意，由于 YAML 格式在中文环境下的特殊性（例如，某些关键字如 `true` 和 `false` 保持英文），本翻译仅限于描述性和注释部分。对于代码中的固定关键字和语法结构，仍需使用英文。
~~~~

## Documentation/devicetree/bindings/display/msm/qcom,x1e80100-mdss_cn.yaml
```yaml
下面是给定内容的中文翻译：

# SPDX-许可证标识符: GPL-2.0-only OR BSD-2-Clause
%YAML 1.2
---
$id: http://devicetree.org/schemas/display/msm/qcom,x1e80100-mdss.yaml#
$schema: http://devicetree.org/meta-schemas/core.yaml#

标题: 高通 X1E80100 显示子系统 (MDSS)

维护者:
  - Abel Vesa <abel.vesa@linaro.org>

描述:
  X1E80100 MSM 移动显示子系统 (MDSS)，它封装了诸如 DPU 显示控制器、DP 接口等子模块。
$ref: /schemas/display/msm/mdss-common.yaml#

属性:
  compatible:
    常量: qcom,x1e80100-mdss

  clocks:
    项目:
      - 描述: 显示 AHB
      - 描述: 显示高频 AXI
      - 描述: 显示核心

  iommus:
    最大项目数: 1

  interconnects:
    最大项目数: 3

  interconnect-names:
    最大项目数: 3

模式属性:
  "^display-controller@[0-9a-f]+$":
    类型: 对象
    其他属性: 真
    属性:
      compatible:
        常量: qcom,x1e80100-dpu

  "^displayport-controller@[0-9a-f]+$":
    类型: 对象
    其他属性: 真
    属性:
      compatible:
        常量: qcom,x1e80100-dp

  "^phy@[0-9a-f]+$":
    类型: 对象
    其他属性: 真
    属性:
      compatible:
        常量: qcom,x1e80100-dp-phy

必需:
  - compatible

未评估属性: 假

示例:
  - |
    #include <dt-bindings/clock/qcom,rpmh.h>
    #include <dt-bindings/interrupt-controller/arm-gic.h>
    #include <dt-bindings/interconnect/qcom,x1e80100-rpmh.h>
    #include <dt-bindings/phy/phy-qcom-qmp.h>
    #include <dt-bindings/power/qcom,rpmhpd.h>

    display-subsystem@ae00000 {
        compatible = "qcom,x1e80100-mdss";
        reg = <0x0ae00000 0x1000>;
        reg-names = "mdss";

        interconnects = <&mmss_noc MASTER_MDP 0 &gem_noc SLAVE_LLCC 0>,
                        <&mc_virt MASTER_LLCC 0 &mc_virt SLAVE_EBI1 0>,
                        <&gem_noc MASTER_APPSS_PROC 0 &config_noc SLAVE_DISPLAY_CFG 0>;
        interconnect-names = "mdp0-mem", "mdp1-mem", "cpu-cfg";

        resets = <&dispcc_core_bcr>;

        power-domains = <&dispcc_gdsc>;

        clocks = <&dispcc_ahb_clk>,
                 <&gcc_disp_hf_axi_clk>,
                 <&dispcc_mdp_clk>;
        clock-names = "bus", "nrt_bus", "core";

        interrupts = <GIC_SPI 83 IRQ_TYPE_LEVEL_HIGH>;
        interrupt-controller;
        #interrupt-cells = <1>;

        iommus = <&apps_smmu 0x1c00 0x2>;

        #address-cells = <1>;
        #size-cells = <1>;
        ranges;

        display-controller@ae01000 {
            compatible = "qcom,x1e80100-dpu";
            reg = <0x0ae01000 0x8f000>,
                  <0x0aeb0000 0x2008>;
            reg-names = "mdp", "vbif";

            clocks = <&gcc_axi_clk>,
                     <&dispcc_ahb_clk>,
                     <&dispcc_mdp_lut_clk>,
                     <&dispcc_mdp_clk>,
                     <&dispcc_mdp_vsync_clk>;
            clock-names = "nrt_bus",
                          "iface",
                          "lut",
                          "core",
                          "vsync";

            assigned-clocks = <&dispcc_mdp_vsync_clk>;
            assigned-clock-rates = <19200000>;

            operating-points-v2 = <&mdp_opp_table>;
            power-domains = <&rpmhpd RPMHPD_MMCX>;

            interrupt-parent = <&mdss>;
            interrupts = <0>;

            ports {
                #address-cells = <1>;
                #size-cells = <0>;

                port@0 {
                    reg = <0>;
                    dpu_intf1_out: endpoint {
                        remote-endpoint = <&dsi0_in>;
                    };
                };

                port@1 {
                    reg = <1>;
                    dpu_intf2_out: endpoint {
                        remote-endpoint = <&dsi1_in>;
                    };
                };
            };

            mdp_opp_table: opp-table {
                compatible = "operating-points-v2";

                opp-200000000 {
                    opp-hz = /bits/ 64 <200000000>;
                    required-opps = <&rpmhpd_opp_low_svs>;
                };

                opp-325000000 {
                    opp-hz = /bits/ 64 <325000000>;
                    required-opps = <&rpmhpd_opp_svs>;
                };

                opp-375000000 {
                    opp-hz = /bits/ 64 <375000000>;
                    required-opps = <&rpmhpd_opp_svs_l1>;
                };

                opp-514000000 {
                    opp-hz = /bits/ 64 <514000000>;
                    required-opps = <&rpmhpd_opp_nom>;
                };
            };
        };

        displayport-controller@ae90000 {
            compatible = "qcom,x1e80100-dp";
            reg = <0 0xae90000 0 0x200>,
                  <0 0xae90200 0 0x200>,
                  <0 0xae90400 0 0x600>,
                  <0 0xae91000 0 0x400>,
                  <0 0xae91400 0 0x400>;

            interrupt-parent = <&mdss>;
            interrupts = <12>;

            clocks = <&dispcc_mdss_ahb_clk>,
               <&dispcc_dptx0_aux_clk>,
               <&dispcc_dptx0_link_clk>,
               <&dispcc_dptx0_link_intf_clk>,
               <&dispcc_dptx0_pixel0_clk>;
            clock-names = "core_iface", "core_aux",
                    "ctrl_link",
                    "ctrl_link_iface",
                    "stream_pixel";

            assigned-clocks = <&dispcc_mdss_dptx0_link_clk_src>,
                  <&dispcc_mdss_dptx0_pixel0_clk_src>;
            assigned-clock-parents = <&usb_1_ss0_qmpphy QMP_USB43DP_DP_LINK_CLK>,
                  <&usb_1_ss0_qmpphy QMP_USB43DP_DP_VCO_DIV_CLK>;

            operating-points-v2 = <&mdss_dp0_opp_table>;

            power-domains = <&rpmhpd RPMHPD_MMCX>;

            phys = <&usb_1_ss0_qmpphy QMP_USB43DP_DP_PHY>;
            phy-names = "dp";

            #sound-dai-cells = <0>;

            ports {
              #address-cells = <1>;
              #size-cells = <0>;

              port@0 {
                  reg = <0>;

                  mdss_dp0_in: endpoint {
                    remote-endpoint = <&mdss_intf0_out>;
                  };
              };

              port@1 {
                  reg = <1>;

                  mdss_dp0_out: endpoint {
                  };
              };
            };

            mdss_dp0_opp_table: opp-table {
              compatible = "operating-points-v2";

              opp-160000000 {
                 opp-hz = /bits/ 64 <160000000>;
                 required-opps = <&rpmhpd_opp_low_svs>;
              };

              opp-270000000 {
                 opp-hz = /bits/ 64 <270000000>;
                 required-opps = <&rpmhpd_opp_svs>;
              };

              opp-540000000 {
                 opp-hz = /bits/ 64 <540000000>;
                 required-opps = <&rpmhpd_opp_svs_l1>;
              };

              opp-810000000 {
                 opp-hz = /bits/ 64 <810000000>;
                 required-opps = <&rpmhpd_opp_nom>;
              };
            };
        };
    };
..
```
