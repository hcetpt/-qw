## Documentation/devicetree/bindings/display/msm/dsi-controller-main_cn.yaml
```yaml
# SPDX-文件许可人: GPL-2.0-only 或 BSD-2-Clause
%YAML 1.2
---
$id: http://devicetree.org/schemas/display/msm/dsi-controller-main.yaml#
$schema: http://devicetree.org/meta-schemas/core.yaml#

标题: Qualcomm 显示屏 DSI 控制器

维护者:
  - Krishna Manikandan <quic_mkrishn@quicinc.com>

属性:
  compatible:
    oneOf:
      - items:
          - enum:
              - qcom,apq8064-dsi-ctrl
              - qcom,msm8226-dsi-ctrl
              - qcom,msm8916-dsi-ctrl
              - qcom,msm8953-dsi-ctrl
              - qcom,msm8974-dsi-ctrl
              - qcom,msm8976-dsi-ctrl
              - qcom,msm8996-dsi-ctrl
              - qcom,msm8998-dsi-ctrl
              - qcom,qcm2290-dsi-ctrl
              - qcom,sc7180-dsi-ctrl
              - qcom,sc7280-dsi-ctrl
              - qcom,sdm660-dsi-ctrl
              - qcom,sdm670-dsi-ctrl
              - qcom,sdm845-dsi-ctrl
              - qcom,sm6115-dsi-ctrl
              - qcom,sm6125-dsi-ctrl
              - qcom,sm6350-dsi-ctrl
              - qcom,sm6375-dsi-ctrl
              - qcom,sm7150-dsi-ctrl
              - qcom,sm8150-dsi-ctrl
              - qcom,sm8250-dsi-ctrl
              - qcom,sm8350-dsi-ctrl
              - qcom,sm8450-dsi-ctrl
              - qcom,sm8550-dsi-ctrl
              - qcom,sm8650-dsi-ctrl
          - const: qcom,mdss-dsi-ctrl
      - enum:
          - qcom,dsi-ctrl-6g-qcm2290
          - qcom,mdss-dsi-ctrl # 此兼容项应始终与特定SoC的兼容项一起使用
        已废弃: true

  reg:
    maxItems: 1

  reg-names:
    const: dsi_ctrl

  interrupts:
    maxItems: 1

  clocks:
    描述: |
      根据变体的不同，会使用多个时钟。典型的有：
       - bus:: 显示 AHB 时钟
       - byte:: 显示字节时钟
       - byte_intf:: 显示字节接口时钟
       - core:: 显示核心时钟
       - core_mss:: 核心多媒体子系统时钟
       - iface:: 显示 AXI 时钟
       - mdp_core:: MDP 核心时钟
       - mnoc:: MNOC 时钟
       - pixel:: 显示像素时钟
    minItems: 3
    maxItems: 9

  clock-names:
    minItems: 3
    maxItems: 9

  phys:
    maxItems: 1

  phy-names:
    已废弃: true
    const: dsi

  syscon-sfpb:
    描述: 指向 mmss_sfpb syscon 节点的句柄（仅适用于 DSIv2）
$ref: /schemas/types.yaml#/definitions/phandle

  qcom,dual-dsi-mode:
    类型: 布尔值
    描述: |
      表明 DSI 控制器是否正在驱动一个需要 2 条 DSI 链路的面板
下面是提供的英文描述翻译成中文的结果：

qcom,master-dsi:
    类型: 布尔值
    描述: |
      指示当启用 qcom,dual-dsi-mode 时，DSI 控制器是否为主 DSI 控制器。

qcom,sync-dual-dsi:
    类型: 布尔值
    描述: |
      指示当启用 qcom,dual-dsi-mode 时，DSI 控制器是否需要通过 MIPI DCS 命令与其他 DSI 控制器同步。

assigned-clocks:
    最少项数: 2
    最多项数: 4
    描述: |
      给定平台的 "byte" 和 "pixel" 的父级。
对于 DSIv2 平台，这应包含 "byte"、"esc"、"src" 和 "pixel_src" 时钟。

assigned-clock-parents:
    最少项数: 2
    最多项数: 4
    描述: |
      由 DSI PHY 块提供的 Byte 时钟和 Pixel 时钟 PLL 输出。

power-domains:
    最多项数: 1

operating-points-v2: 真

opp-table:
    类型: 对象

ports:
    $ref: /schemas/graph.yaml#/properties/ports
    描述: |
      包含作为子节点的 DSI 控制器输入和输出端口，每个端口包含一个端点子节点。

属性:
      port@0:
        $ref: /schemas/graph.yaml#/$defs/port-base
        不评估的属性: 错误
        描述: |
          控制器的输入端点。
属性:
          endpoint:
            $ref: /schemas/media/video-interfaces.yaml#
            不评估的属性: 错误
            属性:
              data-lanes:
                最多项数: 4
                最少项数: 1
                项:
                  枚举: [ 0, 1, 2, 3 ]

      port@1:
        $ref: /schemas/graph.yaml#/$defs/port-base
        不评估的属性: 错误
        描述: |
          控制器的输出端点。
属性:
          endpoint:
            $ref: /schemas/media/video-interfaces.yaml#
            不评估的属性: 错误
            属性:
              data-lanes:
                最多项数: 4
                最少项数: 1
                项:
                  枚举: [ 0, 1, 2, 3 ]

              qcom,te-source:
                $ref: /schemas/types.yaml#/definitions/string
                描述:
                  指定用于消除撕裂效果的来自面板的垂直同步信号源。
默认: mdp_vsync_p
                枚举:
                  - mdp_vsync_p
                  - mdp_vsync_s
                  - mdp_vsync_e
                  - timer0
                  - timer1
                  - timer2
                  - timer3
                  - timer4

必需:
  - port@0
  - port@1

avdd-supply:
    描述:
      vdd 调压器设备节点的 phandle。

refgen-supply:
    描述:
      REFGEN 调压器设备节点的 phandle。

vcca-supply:
    描述:
      vdd 调压器设备节点的 phandle。

vdd-supply:
    描述:
      VDD 调压器。

vddio-supply:
    描述:
      VDD-IO 调压器。

vdda-supply:
    描述:
      VDDA 调压器。

必需:
  - compatible
  - reg
  - reg-names
  - interrupts
  - clocks
  - clock-names
  - phys
  - assigned-clocks
  - assigned-clock-parents
  - ports

allOf:
  - $ref: ../dsi-controller.yaml#
  - 如果:
      属性:
        compatible:
          包含:
            枚举:
              - qcom,apq8064-dsi-ctrl
    那么:
      属性:
        clocks:
          最多项数: 7
        clock-names:
          项:
            - 常量: iface
            - 常量: bus
            - 常量: core_mmss
            - 常量: src
            - 常量: byte
            - 常量: pixel
            - 常量: core

  - 如果:
      属性:
        compatible:
          包含:
            枚举:
              - qcom,msm8916-dsi-ctrl
    那么:
      属性:
        clocks:
          最多项数: 6
        clock-names:
          项:
            - 常量: mdp_core
            - 常量: iface
            - 常量: bus
            - 常量: byte
            - 常量: pixel
            - 常量: core

  - 如果:
      属性:
        compatible:
          包含:
            枚举:
              - qcom,msm8953-dsi-ctrl
              - qcom,msm8976-dsi-ctrl
    那么:
      属性:
        clocks:
          最多项数: 6
        clock-names:
          项:
            - 常量: mdp_core
            - 常量: iface
            - 常量: bus
            - 常量: byte
            - 常量: pixel
            - 常量: core

  - 如果:
      属性:
        compatible:
          包含:
            枚举:
              - qcom,msm8226-dsi-ctrl
              - qcom,msm8974-dsi-ctrl
    那么:
      属性:
        clocks:
          最多项数: 7
        clock-names:
          项:
            - 常量: mdp_core
            - 常量: iface
            - 常量: bus
            - 常量: byte
            - 常量: pixel
            - 常量: core
            - 常量: core_mmss

  - 如果:
      属性:
        compatible:
          包含:
            枚举:
              - qcom,msm8996-dsi-ctrl
    那么:
      属性:
        clocks:
          最多项数: 7
        clock-names:
          项:
            - 常量: mdp_core
            - 常量: byte
            - 常量: iface
            - 常量: bus
            - 常量: core_mmss
            - 常量: pixel
            - 常量: core

  - 如果:
      属性:
        compatible:
          包含:
            枚举:
              - qcom,msm8998-dsi-ctrl
              - qcom,sm6125-dsi-ctrl
              - qcom,sm6350-dsi-ctrl
    那么:
      属性:
        clocks:
          最多项数: 6
        clock-names:
          项:
            - 常量: byte
            - 常量: byte_intf
            - 常量: pixel
            - 常量: core
            - 常量: iface
            - 常量: bus

  - 如果:
      属性:
        compatible:
          包含:
            枚举:
              - qcom,sc7180-dsi-ctrl
              - qcom,sc7280-dsi-ctrl
              - qcom,sm7150-dsi-ctrl
              - qcom,sm8150-dsi-ctrl
              - qcom,sm8250-dsi-ctrl
              - qcom,sm8350-dsi-ctrl
              - qcom,sm8450-dsi-ctrl
              - qcom,sm8550-dsi-ctrl
              - qcom,sm8650-dsi-ctrl
    那么:
      属性:
        clocks:
          最多项数: 6
        clock-names:
          项:
            - 常量: byte
            - 常量: byte_intf
            - 常量: pixel
            - 常量: core
            - 常量: iface
            - 常量: bus

  - 如果:
      属性:
        compatible:
          包含:
            枚举:
              - qcom,sdm660-dsi-ctrl
    那么:
      属性:
        clocks:
          最多项数: 9
        clock-names:
          项:
            - 常量: mdp_core
            - 常量: byte
            - 常量: byte_intf
            - 常量: mnoc
            - 常量: iface
            - 常量: bus
            - 常量: core_mmss
            - 常量: pixel
            - 常量: core

  - 如果:
      属性:
        compatible:
          包含:
            枚举:
              - qcom,sdm845-dsi-ctrl
              - qcom,sm6115-dsi-ctrl
              - qcom,sm6375-dsi-ctrl
    那么:
      属性:
        clocks:
          最多项数: 6
        clock-names:
          项:
            - 常量: byte
            - 常量: byte_intf
            - 常量: pixel
            - 常量: core
            - 常量: iface
            - 常量: bus

不评估的属性: 错误

示例:
  - |
     #include <dt-bindings/interrupt-controller/arm-gic.h>
     #include <dt-bindings/clock/qcom,dispcc-sdm845.h>
     #include <dt-bindings/clock/qcom,gcc-sdm845.h>
     #include <dt-bindings/power/qcom-rpmpd.h>

     dsi@ae94000 {
           compatible = "qcom,sc7180-dsi-ctrl", "qcom,mdss-dsi-ctrl";
           reg = <0x0ae94000 0x400>;
           reg-names = "dsi_ctrl";

           #address-cells = <1>;
           #size-cells = <0>;

           interrupt-parent = <&mdss>;
           interrupts = <4>;

           clocks = <&dispcc DISP_CC_MDSS_BYTE0_CLK>,
                    <&dispcc DISP_CC_MDSS_BYTE0_INTF_CLK>,
                    <&dispcc DISP_CC_MDSS_PCLK0_CLK>,
                    <&dispcc DISP_CC_MDSS_ESC0_CLK>,
                    <&dispcc DISP_CC_MDSS_AHB_CLK>,
                    <&dispcc DISP_CC_MDSS_AXI_CLK>;
           clock-names = "byte",
                         "byte_intf",
                         "pixel",
                         "core",
                         "iface",
                         "bus";

           phys = <&dsi0_phy>;
           phy-names = "dsi";

           assigned-clocks = <&dispcc DISP_CC_MDSS_BYTE0_CLK_SRC>, <&dispcc DISP_CC_MDSS_PCLK0_CLK_SRC>;
           assigned-clock-parents = <&dsi_phy 0>, <&dsi_phy 1>;

           power-domains = <&rpmhpd SC7180_CX>;
           operating-points-v2 = <&dsi_opp_table>;

           ports {
                  #address-cells = <1>;
                  #size-cells = <0>;

                  port@0 {
                          reg = <0>;
                          dsi0_in: endpoint {
                                   remote-endpoint = <&dpu_intf1_out>;
                          };
                  };

                  port@1 {
                          reg = <1>;
                          dsi0_out: endpoint {
                                   remote-endpoint = <&sn65dsi86_in>;
                                   data-lanes = <0 1 2 3>;
                                   qcom,te-source = "mdp_vsync_e";
                          };
                  };
           };
     };
..
您没有提供需要翻译的文本。请提供需要翻译成中文的英文或其他语言的文本。
```

## Documentation/devicetree/bindings/display/msm/dsi-phy-10nm_cn.yaml
```yaml
# SPDX-许可证标识符: GPL-2.0-only OR BSD-2-Clause
%YAML 1.2
---
$id: http://devicetree.org/schemas/display/msm/dsi-phy-10nm.yaml#
$schema: http://devicetree.org/meta-schemas/core.yaml#

标题: Qualcomm 显示 DSI 10nm PHY

维护者:
  - Krishna Manikandan <quic_mkrishn@quicinc.com>

allOf:
  - $ref: dsi-phy-common.yaml#

属性:
  compatible:
    枚举:
      - qcom,dsi-phy-10nm
      - qcom,dsi-phy-10nm-8998

  reg:
    项目:
      - 描述: DSI PHY 寄存器集
      - 描述: DSI PHY 车道寄存器集
      - 描述: DSI PLL 寄存器集

  reg-names:
    项目:
      - 常量: dsi_phy
      - 常量: dsi_phy_lane
      - 常量: dsi_pll

  vdds-supply:
    描述: |
      对于 sc7180 目标，连接到 DSI0_MIPI_DSI_PLL_VDDA0P9 引脚；对于 sdm845 目标，连接到 VDDA_MIPI_DSI_0_PLL_0P9 引脚。

  qcom,phy-rescode-offset-top:
    $ref: /schemas/types.yaml#/definitions/int8-array
    最大项数: 5
    描述:
      所有五个车道的上拉腿 rescode 的整数数组偏移量
为了以递增的方式调整驱动强度远离校准值，-32 表示最弱，+31 表示最强。
项:
      最小值: -32
      最大值: 31

  qcom,phy-rescode-offset-bot:
    $ref: /schemas/types.yaml#/definitions/int8-array
    最大项数: 5
    描述:
      所有五个车道的下拉腿 rescode 的整数数组偏移量
为了以递减的方式调整驱动强度远离校准值，-32 表示最弱，+31 表示最强。
项:
      最小值: -32
      最大值: 31

  qcom,phy-drive-ldo-level:
    $ref: /schemas/types.yaml#/definitions/uint32
    描述:
      PHY LDO 具有幅度调节功能，可以调整 LDO 输出以适应 HSTX 驱动。使用支持的电平（mV）来调整驱动电平从默认值
枚举: [375, 400, 425, 450, 475, 500]

必需:
  - compatible
  - reg
  - reg-names

未评估属性: false

示例:
  - |
     #include <dt-bindings/clock/qcom,dispcc-sdm845.h>
     #include <dt-bindings/clock/qcom,rpmh.h>

     dsi-phy@ae94400 {
         compatible = "qcom,dsi-phy-10nm";
         reg = <0x0ae94400 0x200>,
               <0x0ae94600 0x280>,
               <0x0ae94a00 0x1e0>;
         reg-names = "dsi_phy",
                     "dsi_phy_lane",
                     "dsi_pll";

         #clock-cells = <1>;
         #phy-cells = <0>;

         vdds-supply = <&vdda_mipi_dsi0_pll>;
         clocks = <&dispcc DISP_CC_MDSS_AHB_CLK>,
                  <&rpmhcc RPMH_CXO_CLK>;
         clock-names = "iface", "ref";

         qcom,phy-rescode-offset-top = /bits/ 8 <0 0 0 0 0>;
         qcom,phy-rescode-offset-bot = /bits/ 8 <0 0 0 0 0>;
         qcom,phy-drive-ldo-level = <400>;
     };
```

## Documentation/devicetree/bindings/display/msm/dsi-phy-14nm_cn.yaml
~~~~yaml
```yaml
# SPDX-License-Identifier: GPL-2.0-only OR BSD-2-Clause
%YAML 1.2
---
$id: 'http://devicetree.org/schemas/display/msm/dsi-phy-14nm.yaml#'
$schema: 'http://devicetree.org/meta-schemas/core.yaml#'

title: Qualcomm 显示 DSI 14nm 物理层

maintainers:
  - Krishna Manikandan <quic_mkrishn@quicinc.com>

allOf:
  - $ref: 'dsi-phy-common.yaml#'

properties:
  compatible:
    enum:
      - qcom,dsi-phy-14nm
      - qcom,dsi-phy-14nm-2290
      - qcom,dsi-phy-14nm-660
      - qcom,dsi-phy-14nm-8953
      - qcom,sm6125-dsi-phy-14nm

  reg:
    items:
      - description: DSI 物理层寄存器集
      - description: DSI 物理层通道寄存器集
      - description: DSI PLL 寄存器集

  reg-names:
    items:
      - const: dsi_phy
      - const: dsi_phy_lane
      - const: dsi_pll

  vcca-supply:
    description: 指向 vcca 调压器设备节点的 phandle

power-domains:
    description:
      为可选电源域指定的 phandle 和 PM 域标识符
maxItems: 1

  required-opps:
    description:
      指向描述电源域性能点的 OPP 节点的 phandle
maxItems: 1

required:
  - compatible
  - reg
  - reg-names

unevaluatedProperties: false

examples:
  - |
     #include <dt-bindings/clock/qcom,dispcc-sdm845.h>
     #include <dt-bindings/clock/qcom,rpmh.h>

     dsi-phy@ae94400 {
         compatible = "qcom,dsi-phy-14nm";
         reg = <0x0ae94400 0x200>,
               <0x0ae94600 0x280>,
               <0x0ae94a00 0x1e0>;
         reg-names = "dsi_phy",
                     "dsi_phy_lane",
                     "dsi_pll";

         #clock-cells = <1>;
         #phy-cells = <0>;

         vcca-supply = <&vcca_reg>;
         clocks = <&dispcc DISP_CC_MDSS_AHB_CLK>,
                  <&rpmhcc RPMH_CXO_CLK>;
         clock-names = "iface", "ref";
     };
..
```
~~~~
