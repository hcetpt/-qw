## Documentation/devicetree/bindings/display/msm/qcom,sc7280-mdss_cn.yaml
```yaml
# SPDX-许可证标识符: GPL-2.0-only 或 BSD-2-Clause
%YAML 1.2
---
$id: http://devicetree.org/schemas/display/msm/qcom,sc7280-mdss.yaml#
$schema: http://devicetree.org/meta-schemas/core.yaml#

标题: Qualcomm SC7280 显示屏 MDSS

维护者:
  - Krishna Manikandan <quic_mkrishn@quicinc.com>

描述:
  设备树绑定适用于MSM移动显示子系统(MDSS)，该系统封装了诸如DPU显示屏控制器、DSI和DP接口等子模块。这里特别提到了SC7280的MDSS设备树绑定。
$ref: /schemas/display/msm/mdss-common.yaml#

属性:
  compatible:
    常量: qcom,sc7280-mdss

  clocks:
    项目:
      - 描述: 来自GCC的显示AHB时钟
      - 描述: 来自DISPCC的显示AHB时钟
      - 描述: 显示核心时钟

  clock-names:
    项目:
      - 常量: iface
      - 常量: ahb
      - 常量: core

  iommus:
    最大项数: 1

  interconnects:
    项目:
      - 描述: 从MDP0端口到数据总线的互连路径
      - 描述: 从CPU到配置总线的互连路径

  interconnect-names:
    项目:
      - 常量: mdp0-mem
      - 常量: cpu-cfg

模式属性:
  "^display-controller@[0-9a-f]+$":
    类型: 对象
    其他属性: 真

    属性:
      compatible:
        常量: qcom,sc7280-dpu

  "^displayport-controller@[0-9a-f]+$":
    类型: 对象
    其他属性: 真

    属性:
      compatible:
        常量: qcom,sc7280-dp

  "^dsi@[0-9a-f]+$":
    类型: 对象
    其他属性: 真

    属性:
      compatible:
        项目:
          - 常量: qcom,sc7280-dsi-ctrl
          - 常量: qcom,mdss-dsi-ctrl

  "^edp@[0-9a-f]+$":
    类型: 对象
    其他属性: 真

    属性:
      compatible:
        常量: qcom,sc7280-edp

  "^phy@[0-9a-f]+$":
    类型: 对象
    其他属性: 真

    属性:
      compatible:
        枚举:
          - qcom,sc7280-dsi-phy-7nm
          - qcom,sc7280-edp-phy

必需项:
  - compatible

未评估属性: 假

示例:
  - |
    #include <dt-bindings/clock/qcom,dispcc-sc7280.h>
    #include <dt-bindings/clock/qcom,gcc-sc7280.h>
    #include <dt-bindings/clock/qcom,rpmh.h>
    #include <dt-bindings/interrupt-controller/arm-gic.h>
    #include <dt-bindings/interconnect/qcom,sc7280.h>
    #include <dt-bindings/power/qcom-rpmpd.h>

    display-subsystem@ae00000 {
        #address-cells = <1>;
        #size-cells = <1>;
        compatible = "qcom,sc7280-mdss";
        reg = <0xae00000 0x1000>;
        reg-names = "mdss";
        power-domains = <&dispcc DISP_CC_MDSS_CORE_GDSC>;
        clocks = <&gcc GCC_DISP_AHB_CLK>,
                 <&dispcc DISP_CC_MDSS_AHB_CLK>,
                 <&dispcc DISP_CC_MDSS_MDP_CLK>;
        clock-names = "iface",
                      "ahb",
                      "core";

        interrupts = <GIC_SPI 83 IRQ_TYPE_LEVEL_HIGH>;
        interrupt-controller;
        #interrupt-cells = <1>;

        interconnects = <&mmss_noc MASTER_MDP0 &mc_virt SLAVE_EBI1>,
                        <&gem_noc MASTER_APPSS_PROC &cnoc2 SLAVE_DISPLAY_CFG>;
        interconnect-names = "mdp0-mem",
                             "cpu-cfg";

        iommus = <&apps_smmu 0x900 0x402>;
        ranges;

        display-controller@ae01000 {
            compatible = "qcom,sc7280-dpu";
            reg = <0x0ae01000 0x8f000>,
                  <0x0aeb0000 0x2008>;

            reg-names = "mdp", "vbif";

            clocks = <&gcc GCC_DISP_HF_AXI_CLK>,
                     <&gcc GCC_DISP_SF_AXI_CLK>,
                     <&dispcc DISP_CC_MDSS_AHB_CLK>,
                     <&dispcc DISP_CC_MDSS_MDP_LUT_CLK>,
                     <&dispcc DISP_CC_MDSS_MDP_CLK>,
                     <&dispcc DISP_CC_MDSS_VSYNC_CLK>;
            clock-names = "bus",
                          "nrt_bus",
                          "iface",
                          "lut",
                          "core",
                          "vsync";

            interrupt-parent = <&mdss>;
            interrupts = <0>;
            power-domains = <&rpmhpd SC7280_CX>;
            operating-points-v2 = <&mdp_opp_table>;

            ports {
                #address-cells = <1>;
                #size-cells = <0>;

                port@0 {
                    reg = <0>;
                    dpu_intf1_out: endpoint {
                        remote-endpoint = <&dsi0_in>;
                    };
                };

                port@1 {
                    reg = <1>;
                    dpu_intf5_out: endpoint {
                        remote-endpoint = <&edp_in>;
                    };
                };

                port@2 {
                    reg = <2>;
                    dpu_intf0_out: endpoint {
                        remote-endpoint = <&dp_in>;
                    };
                };
            };
        };

        dsi@ae94000 {
            compatible = "qcom,sc7280-dsi-ctrl", "qcom,mdss-dsi-ctrl";
            reg = <0x0ae94000 0x400>;
            reg-names = "dsi_ctrl";

            interrupt-parent = <&mdss>;
            interrupts = <4>;

            clocks = <&dispcc DISP_CC_MDSS_BYTE0_CLK>,
                     <&dispcc DISP_CC_MDSS_BYTE0_INTF_CLK>,
                     <&dispcc DISP_CC_MDSS_PCLK0_CLK>,
                     <&dispcc DISP_CC_MDSS_ESC0_CLK>,
                     <&dispcc DISP_CC_MDSS_AHB_CLK>,
                     <&gcc GCC_DISP_HF_AXI_CLK>;
            clock-names = "byte",
                          "byte_intf",
                          "pixel",
                          "core",
                          "iface",
                          "bus";

            assigned-clocks = <&dispcc DISP_CC_MDSS_BYTE0_CLK_SRC>,
                              <&dispcc DISP_CC_MDSS_PCLK0_CLK_SRC>;
            assigned-clock-parents = <&mdss_dsi_phy 0>, <&mdss_dsi_phy 1>;

            operating-points-v2 = <&dsi_opp_table>;
            power-domains = <&rpmhpd SC7280_CX>;

            phys = <&mdss_dsi_phy>;
            phy-names = "dsi";

            #address-cells = <1>;
            #size-cells = <0>;

            ports {
                #address-cells = <1>;
                #size-cells = <0>;

                port@0 {
                    reg = <0>;
                    dsi0_in: endpoint {
                        remote-endpoint = <&dpu_intf1_out>;
                    };
                };

                port@1 {
                    reg = <1>;
                    dsi0_out: endpoint {
                    };
                };
            };

            dsi_opp_table: opp-table {
                compatible = "operating-points-v2";

                opp-187500000 {
                    opp-hz = /bits/ 64 <187500000>;
                    required-opps = <&rpmhpd_opp_low_svs>;
                };

                opp-300000000 {
                    opp-hz = /bits/ 64 <300000000>;
                    required-opps = <&rpmhpd_opp_svs>;
                };

                opp-358000000 {
                    opp-hz = /bits/ 64 <358000000>;
                    required-opps = <&rpmhpd_opp_svs_l1>;
                };
            };
        };

        mdss_dsi_phy: phy@ae94400 {
            compatible = "qcom,sc7280-dsi-phy-7nm";
            reg = <0x0ae94400 0x200>,
                  <0x0ae94600 0x280>,
                  <0x0ae94900 0x280>;
            reg-names = "dsi_phy",
                        "dsi_phy_lane",
                        "dsi_pll";

            #clock-cells = <1>;
            #phy-cells = <0>;

            clocks = <&dispcc DISP_CC_MDSS_AHB_CLK>,
                     <&rpmhcc RPMH_CXO_CLK>;
            clock-names = "iface", "ref";

            vdds-supply = <&vreg_dsi_supply>;
        };

        edp@aea0000 {
            compatible = "qcom,sc7280-edp";
            pinctrl-names = "default";
            pinctrl-0 = <&edp_hot_plug_det>;

            reg = <0xaea0000 0x200>,
                  <0xaea0200 0x200>,
                  <0xaea0400 0xc00>,
                  <0xaea1000 0x400>;

            interrupt-parent = <&mdss>;
            interrupts = <14>;

            clocks = <&dispcc DISP_CC_MDSS_AHB_CLK>,
                     <&dispcc DISP_CC_MDSS_EDP_AUX_CLK>,
                     <&dispcc DISP_CC_MDSS_EDP_LINK_CLK>,
                     <&dispcc DISP_CC_MDSS_EDP_LINK_INTF_CLK>,
                     <&dispcc DISP_CC_MDSS_EDP_PIXEL_CLK>;
            clock-names = "core_iface",
                          "core_aux",
                          "ctrl_link",
                          "ctrl_link_iface",
                          "stream_pixel";
            assigned-clocks = <&dispcc DISP_CC_MDSS_EDP_LINK_CLK_SRC>,
                              <&dispcc DISP_CC_MDSS_EDP_PIXEL_CLK_SRC>;
            assigned-clock-parents = <&mdss_edp_phy 0>, <&mdss_edp_phy 1>;

            phys = <&mdss_edp_phy>;
            phy-names = "dp";

            operating-points-v2 = <&edp_opp_table>;
            power-domains = <&rpmhpd SC7280_CX>;

            ports {
                #address-cells = <1>;
                #size-cells = <0>;

                port@0 {
                    reg = <0>;
                    edp_in: endpoint {
                        remote-endpoint = <&dpu_intf5_out>;
                    };
                };

                port@1 {
                    reg = <1>;
                    mdss_edp_out: endpoint { };
                };
            };

            edp_opp_table: opp-table {
                compatible = "operating-points-v2";

                opp-160000000 {
                    opp-hz = /bits/ 64 <160000000>;
                    required-opps = <&rpmhpd_opp_low_svs>;
                };

                opp-270000000 {
                    opp-hz = /bits/ 64 <270000000>;
                    required-opps = <&rpmhpd_opp_svs>;
                };

                opp-540000000 {
                    opp-hz = /bits/ 64 <540000000>;
                    required-opps = <&rpmhpd_opp_nom>;
                };

                opp-810000000 {
                    opp-hz = /bits/ 64 <810000000>;
                    required-opps = <&rpmhpd_opp_nom>;
                };
            };
        };

        mdss_edp_phy: phy@aec2a00 {
            compatible = "qcom,sc7280-edp-phy";

            reg = <0xaec2a00 0x19c>,
                  <0xaec2200 0xa0>,
                  <0xaec2600 0xa0>,
                  <0xaec2000 0x1c0>;

            clocks = <&rpmhcc RPMH_CXO_CLK>,
                     <&gcc GCC_EDP_CLKREF_EN>;
            clock-names = "aux",
                          "cfg_ahb";

            #clock-cells = <1>;
            #phy-cells = <0>;
        };

        displayport-controller@ae90000 {
            compatible = "qcom,sc7280-dp";

            reg = <0xae90000 0x200>,
                  <0xae90200 0x200>,
                  <0xae90400 0xc00>,
                  <0xae91000 0x400>,
                  <0xae91400 0x400>;

            interrupt-parent = <&mdss>;
            interrupts = <12>;

            clocks = <&dispcc DISP_CC_MDSS_AHB_CLK>,
                     <&dispcc DISP_CC_MDSS_DP_AUX_CLK>,
                     <&dispcc DISP_CC_MDSS_DP_LINK_CLK>,
                     <&dispcc DISP_CC_MDSS_DP_LINK_INTF_CLK>,
                     <&dispcc DISP_CC_MDSS_DP_PIXEL_CLK>;
            clock-names = "core_iface",
                          "core_aux",
                          "ctrl_link",
                          "ctrl_link_iface",
                          "stream_pixel";
            assigned-clocks = <&dispcc DISP_CC_MDSS_DP_LINK_CLK_SRC>,
                              <&dispcc DISP_CC_MDSS_DP_PIXEL_CLK_SRC>;
            assigned-clock-parents = <&dp_phy 0>, <&dp_phy 1>;
            phys = <&dp_phy>;
            phy-names = "dp";

            operating-points-v2 = <&dp_opp_table>;
            power-domains = <&rpmhpd SC7280_CX>;

            #sound-dai-cells = <0>;

            ports {
                #address-cells = <1>;
                #size-cells = <0>;

                port@0 {
                    reg = <0>;
                    dp_in: endpoint {
                        remote-endpoint = <&dpu_intf0_out>;
                    };
                };

                port@1 {
                    reg = <1>;
                    dp_out: endpoint { };
                };
            };

            dp_opp_table: opp-table {
                compatible = "operating-points-v2";

                opp-160000000 {
                    opp-hz = /bits/ 64 <160000000>;
                    required-opps = <&rpmhpd_opp_low_svs>;
                };

                opp-270000000 {
                    opp-hz = /bits/ 64 <270000000>;
                    required-opps = <&rpmhpd_opp_svs>;
                };

                opp-540000000 {
                    opp-hz = /bits/ 64 <540000000>;
                    required-opps = <&rpmhpd_opp_svs_l1>;
                };

                opp-810000000 {
                    opp-hz = /bits/ 64 <810000000>;
                    required-opps = <&rpmhpd_opp_nom>;
                };
            };
        };
    };
..
```

## Documentation/devicetree/bindings/display/msm/qcom,sc8280xp-dpu_cn.yaml
```yaml
# SPDX-许可证标识符: GPL-2.0-only 或 BSD-2-Clause
%YAML 1.2
---
$id: http://devicetree.org/schemas/display/msm/qcom,sc8280xp-dpu.yaml#
$schema: http://devicetree.org/meta-schemas/core.yaml#

标题: Qualcomm SC8280XP 显示处理单元

维护者:
  - Bjorn Andersson <andersson@kernel.org>

描述:
  SC8280XP 显示处理单元的设备树绑定
$ref: /schemas/display/msm/dpu-common.yaml#

属性:
  compatible:
    常量: qcom,sc8280xp-dpu

  reg:
    项目:
      - 描述: MDP 寄存器集的地址偏移和大小
      - 描述: VBIF 寄存器集的地址偏移和大小

  reg-names:
    项目:
      - 常量: mdp
      - 常量: vbif

  clocks:
    项目:
      - 描述: 显示高频 AXI 时钟
      - 描述: 显示低频 AXI 时钟
      - 描述: 显示 AHB 时钟
      - 描述: 显示 LUT 时钟
      - 描述: 显示核心时钟
      - 描述: 显示 VSYNC 时钟

  clock-names:
    项目:
      - 常量: bus
      - 常量: nrt_bus
      - 常量: iface
      - 常量: lut
      - 常量: core
      - 常量: vsync

未评估属性: false

示例:
  - |
    #include <dt-bindings/clock/qcom,dispcc-sc8280xp.h>
    #include <dt-bindings/clock/qcom,gcc-sc8280xp.h>
    #include <dt-bindings/interrupt-controller/arm-gic.h>
    #include <dt-bindings/interconnect/qcom,sc8280xp.h>
    #include <dt-bindings/power/qcom-rpmpd.h>

    display-controller@ae01000 {
        compatible = "qcom,sc8280xp-dpu";
        reg = <0x0ae01000 0x8f000>,
              <0x0aeb0000 0x2008>;
        reg-names = "mdp", "vbif";

        clocks = <&gcc GCC_DISP_HF_AXI_CLK>,
                 <&gcc GCC_DISP_SF_AXI_CLK>,
                 <&dispcc0 DISP_CC_MDSS_AHB_CLK>,
                 <&dispcc0 DISP_CC_MDSS_MDP_LUT_CLK>,
                 <&dispcc0 DISP_CC_MDSS_MDP_CLK>,
                 <&dispcc0 DISP_CC_MDSS_VSYNC_CLK>;
        clock-names = "bus",
                      "nrt_bus",
                      "iface",
                      "lut",
                      "core",
                      "vsync";

        assigned-clocks = <&dispcc0 DISP_CC_MDSS_MDP_CLK>,
                          <&dispcc0 DISP_CC_MDSS_VSYNC_CLK>;
        assigned-clock-rates = <460000000>,
                               <19200000>;

        operating-points-v2 = <&mdp_opp_table>;
        power-domains = <&rpmhpd SC8280XP_MMCX>;

        interrupt-parent = <&mdss0>;
        interrupts = <0>;

        ports {
            #address-cells = <1>;
            #size-cells = <0>;

            port@0 {
                reg = <0>;
                endpoint {
                    remote-endpoint = <&mdss0_dp0_in>;
                };
            };

            port@4 {
                reg = <4>;
                endpoint {
                    remote-endpoint = <&mdss0_dp1_in>;
                };
            };

            port@5 {
                reg = <5>;
                endpoint {
                    remote-endpoint = <&mdss0_dp3_in>;
                };
            };

            port@6 {
                reg = <6>;
                endpoint {
                    remote-endpoint = <&mdss0_dp2_in>;
                };
            };
        };
    };
..
```
