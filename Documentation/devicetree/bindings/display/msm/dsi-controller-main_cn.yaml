## Documentation/devicetree/bindings/display/msm/qcom,sm6115-mdss_cn.yaml
```yaml
# SPDX-License-Identifier: GPL-2.0-only OR BSD-2-Clause
%YAML 1.2
---
$id: http://devicetree.org/schemas/display/msm/qcom,sm6115-mdss.yaml#
$schema: http://devicetree.org/meta-schemas/core.yaml#

标题: Qualcomm SM6115 显示器 MDSS

维护者:
  - Dmitry Baryshkov <dmitry.baryshkov@linaro.org>

描述:
  设备树绑定适用于MSM移动显示子系统 (MDSS)，该系统封装了诸如DPU显示器控制器和DSI等子模块。此处提到的MDSS设备树绑定针对SM6115目标。
$ref: /schemas/display/msm/mdss-common.yaml#

属性:
  compatible:
    常量: qcom,sm6115-mdss

  clocks:
    项目:
      - 描述: 来自GCC的显示AHB时钟
      - 描述: 显示AXI时钟
      - 描述: 显示核心时钟

  iommus:
    最大项数: 2

  interconnects:
    项目:
      - 描述: 从mdp0端口到数据总线的互连路径
      - 描述: 从CPU到寄存器总线的互连路径

  interconnect-names:
    项目:
      - 常量: mdp0-mem
      - 常量: cpu-cfg

模式属性:
  "^display-controller@[0-9a-f]+$":
    类型: 对象
    其他属性: true

    属性:
      compatible:
        常量: qcom,sm6115-dpu

  "^dsi@[0-9a-f]+$":
    类型: 对象
    其他属性: true

    属性:
      compatible:
        oneOf:
          - 项目:
              - 常量: qcom,sm6115-dsi-ctrl
              - 常量: qcom,mdss-dsi-ctrl
          - 描述: 旧的绑定，请不要使用
            过时: true
            常量: qcom,dsi-ctrl-6g-qcm2290

  "^phy@[0-9a-f]+$":
    类型: 对象
    其他属性: true

    属性:
      compatible:
        常量: qcom,dsi-phy-14nm-2290

必需项:
  - compatible

未评估的属性: false

示例:
  - |
    #include <dt-bindings/clock/qcom,sm6115-dispcc.h>
    #include <dt-bindings/clock/qcom,gcc-sm6115.h>
    #include <dt-bindings/clock/qcom,rpmcc.h>
    #include <dt-bindings/interrupt-controller/arm-gic.h>
    #include <dt-bindings/power/qcom-rpmpd.h>

    display-subsystem@5e00000 {
        #address-cells = <1>;
        #size-cells = <1>;
        compatible = "qcom,sm6115-mdss";
        reg = <0x05e00000 0x1000>;
        reg-names = "mdss";
        power-domains = <&dispcc MDSS_GDSC>;
        clocks = <&gcc GCC_DISP_AHB_CLK>,
                 <&gcc GCC_DISP_HF_AXI_CLK>,
                 <&dispcc DISP_CC_MDSS_MDP_CLK>;

        interrupts = <GIC_SPI 186 IRQ_TYPE_LEVEL_HIGH>;
        interrupt-controller;
        #interrupt-cells = <1>;

        iommus = <&apps_smmu 0x420 0x2>,
                 <&apps_smmu 0x421 0x0>;
        ranges;

        display-controller@5e01000 {
            compatible = "qcom,sm6115-dpu";
            reg = <0x05e01000 0x8f000>,
                  <0x05eb0000 0x2008>;
            reg-names = "mdp", "vbif";

            clocks = <&gcc GCC_DISP_HF_AXI_CLK>,
                     <&dispcc DISP_CC_MDSS_AHB_CLK>,
                     <&dispcc DISP_CC_MDSS_MDP_CLK>,
                     <&dispcc DISP_CC_MDSS_MDP_LUT_CLK>,
                     <&dispcc DISP_CC_MDSS_ROT_CLK>,
                     <&dispcc DISP_CC_MDSS_VSYNC_CLK>;
            clock-names = "bus", "iface", "core", "lut", "rot", "vsync";

            operating-points-v2 = <&mdp_opp_table>;
            power-domains = <&rpmpd SM6115_VDDCX>;

            interrupt-parent = <&mdss>;
            interrupts = <0>;

            ports {
                #address-cells = <1>;
                #size-cells = <0>;

                port@0 {
                    reg = <0>;
                    dpu_intf1_out: endpoint {
                        remote-endpoint = <&dsi0_in>;
                    };
                };
            };
        };

        dsi@5e94000 {
            compatible = "qcom,sm6115-dsi-ctrl", "qcom,mdss-dsi-ctrl";
            reg = <0x05e94000 0x400>;
            reg-names = "dsi_ctrl";

            interrupt-parent = <&mdss>;
            interrupts = <4>;

            clocks = <&dispcc DISP_CC_MDSS_BYTE0_CLK>,
                     <&dispcc DISP_CC_MDSS_BYTE0_INTF_CLK>,
                     <&dispcc DISP_CC_MDSS_PCLK0_CLK>,
                     <&dispcc DISP_CC_MDSS_ESC0_CLK>,
                     <&dispcc DISP_CC_MDSS_AHB_CLK>,
                     <&gcc GCC_DISP_HF_AXI_CLK>;
            clock-names = "byte",
                          "byte_intf",
                          "pixel",
                          "core",
                          "iface",
                          "bus";
            assigned-clocks = <&dispcc DISP_CC_MDSS_BYTE0_CLK_SRC>, <&dispcc DISP_CC_MDSS_PCLK0_CLK_SRC>;
            assigned-clock-parents = <&dsi0_phy 0>, <&dsi0_phy 1>;

            operating-points-v2 = <&dsi_opp_table>;
            power-domains = <&rpmpd SM6115_VDDCX>;
            phys = <&dsi0_phy>;

            #address-cells = <1>;
            #size-cells = <0>;

            ports {
                #address-cells = <1>;
                #size-cells = <0>;

                port@0 {
                    reg = <0>;
                    dsi0_in: endpoint {
                        remote-endpoint = <&dpu_intf1_out>;
                    };
                };

                port@1 {
                    reg = <1>;
                    dsi0_out: endpoint {
                    };
                };
            };
        };

        dsi0_phy: phy@5e94400 {
            compatible = "qcom,dsi-phy-14nm-2290";
            reg = <0x05e94400 0x100>,
                  <0x05e94500 0x300>,
                  <0x05e94800 0x188>;
            reg-names = "dsi_phy",
                        "dsi_phy_lane",
                        "dsi_pll";

            #clock-cells = <1>;
            #phy-cells = <0>;

            clocks = <&dispcc DISP_CC_MDSS_AHB_CLK>, <&rpmcc RPM_SMD_XO_CLK_SRC>;
            clock-names = "iface", "ref";
        };
    };
..
```

## Documentation/devicetree/bindings/display/msm/qcom,sm6125-mdss_cn.yaml
```yaml
下面是给定内容的中文翻译：

# SPDX-许可证标识符: GPL-2.0-only OR BSD-2-Clause
%YAML 1.2
---
$id: http://devicetree.org/schemas/display/msm/qcom,sm6125-mdss.yaml#
$schema: http://devicetree.org/meta-schemas/core.yaml#

标题: 高通SM6125显示子系统MDSS

维护者:
  - Marijn Suijten <marijn.suijten@somainline.org>

描述:
  SM6125 MSM移动显示子系统（MDSS），它封装了如DPU显示控制器、DSI和DP接口等子模块。
$ref: /schemas/display/msm/mdss-common.yaml#

属性:
  compatible:
    常量: qcom,sm6125-mdss

  clocks:
    项目:
      - 描述: 显示AHB时钟（来自GCC）
      - 描述: 显示AHB时钟
      - 描述: 显示核心时钟

  clock-names:
    项目:
      - 常量: iface
      - 常量: ahb
      - 常量: core

  iommus:
    最大项数: 1

  interconnects:
    项目:
      - 描述: 从mdp0端口到数据总线的互连路径
      - 描述: 从CPU到配置总线的互连路径

  interconnect-names:
    项目:
      - 常量: mdp0-mem
      - 常量: cpu-cfg

模式属性:
  "^display-controller@[0-9a-f]+$":
    类型: 对象
    其他属性: true

    属性:
      compatible:
        常量: qcom,sm6125-dpu

  "^dsi@[0-9a-f]+$":
    类型: 对象
    其他属性: true

    属性:
      compatible:
        项目:
          - 常量: qcom,sm6125-dsi-ctrl
          - 常量: qcom,mdss-dsi-ctrl

  "^phy@[0-9a-f]+$":
    类型: 对象
    其他属性: true

    属性:
      compatible:
        常量: qcom,sm6125-dsi-phy-14nm

未评估属性: false

示例:
  - |
    #include <dt-bindings/clock/qcom,dispcc-sm6125.h>
    #include <dt-bindings/clock/qcom,gcc-sm6125.h>
    #include <dt-bindings/clock/qcom,rpmcc.h>
    #include <dt-bindings/interrupt-controller/arm-gic.h>
    #include <dt-bindings/power/qcom-rpmpd.h>

    display-subsystem@5e00000 {
        compatible = "qcom,sm6125-mdss";
        reg = <0x05e00000 0x1000>;
        reg-names = "mdss";

        interrupts = <GIC_SPI 186 IRQ_TYPE_LEVEL_HIGH>;
        interrupt-controller;
        #interrupt-cells = <1>;

        clocks = <&gcc GCC_DISP_AHB_CLK>,
                 <&dispcc DISP_CC_MDSS_AHB_CLK>,
                 <&dispcc DISP_CC_MDSS_MDP_CLK>;
        clock-names = "iface",
                      "ahb",
                      "core";

        power-domains = <&dispcc MDSS_GDSC>;

        iommus = <&apps_smmu 0x400 0x0>;

        #address-cells = <1>;
        #size-cells = <1>;
        ranges;

        display-controller@5e01000 {
            compatible = "qcom,sm6125-dpu";
            reg = <0x05e01000 0x83208>,
                  <0x05eb0000 0x2008>;
            reg-names = "mdp", "vbif";

            interrupt-parent = <&mdss>;
            interrupts = <0>;

            clocks = <&gcc GCC_DISP_HF_AXI_CLK>,
                     <&dispcc DISP_CC_MDSS_AHB_CLK>,
                     <&dispcc DISP_CC_MDSS_ROT_CLK>,
                     <&dispcc DISP_CC_MDSS_MDP_LUT_CLK>,
                     <&dispcc DISP_CC_MDSS_MDP_CLK>,
                     <&dispcc DISP_CC_MDSS_VSYNC_CLK>,
                     <&gcc GCC_DISP_THROTTLE_CORE_CLK>;
            clock-names = "bus",
                          "iface",
                          "rot",
                          "lut",
                          "core",
                          "vsync",
                          "throttle";
            assigned-clocks = <&dispcc DISP_CC_MDSS_VSYNC_CLK>;
            assigned-clock-rates = <19200000>;

            operating-points-v2 = <&mdp_opp_table>;
            power-domains = <&rpmpd SM6125_VDDCX>;

            ports {
                #address-cells = <1>;
                #size-cells = <0>;

                port@0 {
                    reg = <0>;
                    dpu_intf1_out: endpoint {
                        remote-endpoint = <&mdss_dsi0_in>;
                    };
                };
            };
        };

        dsi@5e94000 {
            compatible = "qcom,sm6125-dsi-ctrl", "qcom,mdss-dsi-ctrl";
            reg = <0x05e94000 0x400>;
            reg-names = "dsi_ctrl";

            interrupt-parent = <&mdss>;
            interrupts = <4>;

            clocks = <&dispcc DISP_CC_MDSS_BYTE0_CLK>,
                     <&dispcc DISP_CC_MDSS_BYTE0_INTF_CLK>,
                     <&dispcc DISP_CC_MDSS_PCLK0_CLK>,
                     <&dispcc DISP_CC_MDSS_ESC0_CLK>,
                     <&dispcc DISP_CC_MDSS_AHB_CLK>,
                     <&gcc GCC_DISP_HF_AXI_CLK>;
            clock-names = "byte",
                          "byte_intf",
                          "pixel",
                          "core",
                          "iface",
                          "bus";
            assigned-clocks = <&dispcc DISP_CC_MDSS_BYTE0_CLK_SRC>,
                      <&dispcc DISP_CC_MDSS_PCLK0_CLK_SRC>;
            assigned-clock-parents = <&mdss_dsi0_phy 0>, <&mdss_dsi0_phy 1>;

            operating-points-v2 = <&dsi_opp_table>;
            power-domains = <&rpmpd SM6125_VDDCX>;

            phys = <&mdss_dsi0_phy>;
            phy-names = "dsi";

            #address-cells = <1>;
            #size-cells = <0>;

            ports {
                #address-cells = <1>;
                #size-cells = <0>;

                port@0 {
                    reg = <0>;
                    mdss_dsi0_in: endpoint {
                        remote-endpoint = <&dpu_intf1_out>;
                    };
                };

                port@1 {
                    reg = <1>;
                    mdss_dsi0_out: endpoint {
                    };
                };
            };
        };

        phy@5e94400 {
            compatible = "qcom,sm6125-dsi-phy-14nm";
            reg = <0x05e94400 0x100>,
                  <0x05e94500 0x300>,
                  <0x05e94800 0x188>;
            reg-names = "dsi_phy",
                        "dsi_phy_lane",
                        "dsi_pll";

            #clock-cells = <1>;
            #phy-cells = <0>;

            clocks = <&dispcc DISP_CC_MDSS_AHB_CLK>,
                     <&rpmcc RPM_SMD_XO_CLK_SRC>;
            clock-names = "iface",
                          "ref";

            required-opps = <&rpmpd_opp_nom>;
            power-domains = <&rpmpd SM6125_VDDMX>;
        };
    };
..
```
