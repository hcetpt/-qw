## Documentation/devicetree/bindings/display/msm/dsi-phy-28nm_cn.yaml
```yaml
# SPDX-许可证标识符: GPL-2.0-only 或 BSD-2-Clause
%YAML 1.2
---
$id: http://devicetree.org/schemas/display/msm/dsi-phy-28nm.yaml#
$schema: http://devicetree.org/meta-schemas/core.yaml#

标题: Qualcomm 显示 DSI 28nm PHY

维护者:
  - Krishna Manikandan <quic_mkrishn@quicinc.com>

allOf:
  - $ref: dsi-phy-common.yaml#

属性:
  compatible:
    枚举:
      - qcom,dsi-phy-28nm-8226
      - qcom,dsi-phy-28nm-8937
      - qcom,dsi-phy-28nm-8960
      - qcom,dsi-phy-28nm-hpm
      - qcom,dsi-phy-28nm-hpm-fam-b
      - qcom,dsi-phy-28nm-lp

  reg:
    项目:
      - 描述: dsi pll 寄存器集
      - 描述: dsi phy 寄存器集
      - 描述: dsi phy 电源调节器寄存器集

  reg-names:
    项目:
      - 常量: dsi_pll
      - 常量: dsi_phy
      - 常量: dsi_phy_regulator

  vddio-supply:
    描述: 指向 vdd-io 电源调节器设备节点的 phandle
  qcom,dsi-phy-regulator-ldo-mode:
    类型: 布尔值
    描述: 表明是否需要 LDO 模式 PHY 电源调节器
必需:
  - compatible
  - reg
  - reg-names
  - vddio-supply

未评估属性: false

示例:
  - |
     #include <dt-bindings/clock/qcom,dispcc-sdm845.h>
     #include <dt-bindings/clock/qcom,rpmh.h>

     dsi-phy@fd922a00 {
         compatible = "qcom,dsi-phy-28nm-lp";
         reg = <0xfd922a00 0xd4>,
               <0xfd922b00 0x2b0>,
               <0xfd922d80 0x7b>;
         reg-names = "dsi_pll",
                     "dsi_phy",
                     "dsi_phy_regulator";

         #clock-cells = <1>;
         #phy-cells = <0>;

         vddio-supply = <&vddio_reg>;

         clocks = <&dispcc DISP_CC_MDSS_AHB_CLK>,
                  <&rpmhcc RPMH_CXO_CLK>;
         clock-names = "iface", "ref";
     };
..
```

## Documentation/devicetree/bindings/display/msm/dsi-phy-7nm_cn.yaml
~~~~yaml
```yaml
# SPDX-许可证标识符: GPL-2.0-only 或 BSD-2-Clause
%YAML 1.2
---
$id: http://devicetree.org/schemas/display/msm/dsi-phy-7nm.yaml#
$schema: http://devicetree.org/meta-schemas/core.yaml#

title: Qualcomm 显示屏 DSI 7nm 物理层

maintainers:
  - Jonathan Marek <jonathan@marek.ca>

allOf:
  - $ref: dsi-phy-common.yaml#

properties:
  compatible:
    enum:
      - qcom,dsi-phy-7nm
      - qcom,dsi-phy-7nm-8150
      - qcom,sc7280-dsi-phy-7nm
      - qcom,sm6375-dsi-phy-7nm
      - qcom,sm8350-dsi-phy-5nm
      - qcom,sm8450-dsi-phy-5nm
      - qcom,sm8550-dsi-phy-4nm
      - qcom,sm8650-dsi-phy-4nm

  reg:
    items:
      - description: DSI 物理层寄存器集
      - description: DSI 物理层通道寄存器集
      - description: DSI PLL 寄存器集

  reg-names:
    items:
      - const: dsi_phy
      - const: dsi_phy_lane
      - const: dsi_pll

  vdds-supply:
    description: |
      连接到 VDD_A_DSI_PLL_0P9 引脚（对于 sm8150 为 VDDA_DSI{0,1}_PLL_0P9）

  phy-type:
    description: D-PHY（默认）或 C-PHY 模式
    enum: [ 10, 11 ]
    default: 10

required:
  - compatible
  - reg
  - reg-names

unevaluatedProperties: false

examples:
  - |
     #include <dt-bindings/clock/qcom,dispcc-sm8250.h>
     #include <dt-bindings/clock/qcom,rpmh.h>

     dsi-phy@ae94400 {
         compatible = "qcom,dsi-phy-7nm";
         reg = <0x0ae94400 0x200>,
               <0x0ae94600 0x280>,
               <0x0ae94900 0x260>;
         reg-names = "dsi_phy",
                     "dsi_phy_lane",
                     "dsi_pll";

         #clock-cells = <1>;
         #phy-cells = <0>;

         vdds-supply = <&vreg_l5a_0p88>;
         clocks = <&dispcc DISP_CC_MDSS_AHB_CLK>,
                  <&rpmhcc RPMH_CXO_CLK>;
         clock-names = "iface", "ref";
     };
```

以上是将给定的 YAML 文档翻译成了中文。请注意，代码中的注释和字符串常量保持英文不变，因为它们通常是特定于硬件或技术规范的描述。
~~~~

## Documentation/devicetree/bindings/display/msm/gmu_cn.yaml
~~~~yaml
以下是提供的 YAML 文件的中文翻译：

```yaml
# SPDX 许可证标识符: GPL-2.0-only
# 版权所有 2019-2020, Linux 基金会, 保留所有权利
%YAML 1.2
---

$id: http://devicetree.org/schemas/display/msm/gmu.yaml#
$schema: http://devicetree.org/meta-schemas/core.yaml#

title: 连接到特定 Adreno GPU 的图形管理单元 (GMU)

maintainers:
  - Rob Clark <robdclark@gmail.com>

description: |
  这些绑定描述了连接到 Adreno A6xx GPU 系列成员的图形管理单元 (GMU)。GMU 提供了设备上的电源管理支持，以提高能效并减轻 CPU 负担。

properties:
  compatible:
    oneOf:
      - items:
          - pattern: '^qcom,adreno-gmu-[67][0-9][0-9]\.[0-9]$'
          - const: qcom,adreno-gmu
      - items:
          - pattern: '^qcom,adreno-gmu-x[1-9][0-9][0-9]\.[0-9]$'
          - const: qcom,adreno-gmu
      - const: qcom,adreno-gmu-wrapper

  reg:
    minItems: 1
    maxItems: 4

  reg-names:
    minItems: 1
    maxItems: 4

  clocks:
    minItems: 4
    maxItems: 7

  clock-names:
    minItems: 4
    maxItems: 7

  interrupts:
    items:
      - description: GMU HFI 中断
      - description: GMU 中断

  interrupt-names:
    items:
      - const: hfi
      - const: gmu

  power-domains:
    items:
      - description: CX 电源域
      - description: GX 电源域

  power-domain-names:
    items:
      - const: cx
      - const: gx

  iommus:
    maxItems: 1

  qcom,qmp:
    $ref: /schemas/types.yaml#/definitions/phandle
    description: 引用 AOSS 边信道消息 RAM

  operating-points-v2: true

  opp-table:
    type: object

required:
  - compatible
  - reg
  - reg-names
  - power-domains
  - power-domain-names

additionalProperties: false

allOf:
  - if:
      properties:
        compatible:
          contains:
            enum:
              - qcom,adreno-gmu-618.0
              - qcom,adreno-gmu-630.2
    then:
      properties:
        reg:
          items:
            - description: 核心 GMU 寄存器
            - description: GMU PDC 寄存器
            - description: GMU PDC 序列寄存器
        reg-names:
          items:
            - const: gmu
            - const: gmu_pdc
            - const: gmu_pdc_seq
        clocks:
          items:
            - description: GMU 时钟
            - description: GPU CX 时钟
            - description: GPU AXI 时钟
            - description: GPU MEMNOC 时钟
        clock-names:
          items:
            - const: gmu
            - const: cxo
            - const: axi
            - const: memnoc

  - if:
      properties:
        compatible:
          contains:
            enum:
              - qcom,adreno-gmu-635.0
              - qcom,adreno-gmu-660.1
    then:
      properties:
        reg:
          items:
            - description: 核心 GMU 寄存器
            - description: 资源控制器寄存器
            - description: GMU PDC 寄存器
        reg-names:
          items:
            - const: gmu
            - const: rscc
            - const: gmu_pdc
        clocks:
          items:
            - description: GMU 时钟
            - description: GPU CX 时钟
            - description: GPU AXI 时钟
            - description: GPU MEMNOC 时钟
            - description: GPU AHB 时钟
            - description: GPU HUB CX 时钟
            - description: GPU SMMU 投票时钟
        clock-names:
          items:
            - const: gmu
            - const: cxo
            - const: axi
            - const: memnoc
            - const: ahb
            - const: hub
            - const: smmu_vote

  - if:
      properties:
        compatible:
          contains:
            enum:
              - qcom,adreno-gmu-640.1
    then:
      properties:
        reg:
          items:
            - description: 核心 GMU 寄存器
            - description: GMU PDC 寄存器
            - description: GMU PDC 序列寄存器
        reg-names:
          items:
            - const: gmu
            - const: gmu_pdc
            - const: gmu_pdc_seq

  - if:
      properties:
        compatible:
          contains:
            enum:
              - qcom,adreno-gmu-650.2
    then:
      properties:
        reg:
          items:
            - description: 核心 GMU 寄存器
            - description: 资源控制器寄存器
            - description: GMU PDC 寄存器
            - description: GMU PDC 序列寄存器
        reg-names:
          items:
            - const: gmu
            - const: rscc
            - const: gmu_pdc
            - const: gmu_pdc_seq

  - if:
      properties:
        compatible:
          contains:
            enum:
              - qcom,adreno-gmu-640.1
              - qcom,adreno-gmu-650.2
    then:
      properties:
        clocks:
          items:
            - description: GPU AHB 时钟
            - description: GMU 时钟
            - description: GPU CX 时钟
            - description: GPU AXI 时钟
            - description: GPU MEMNOC 时钟
        clock-names:
          items:
            - const: ahb
            - const: gmu
            - const: cxo
            - const: axi
            - const: memnoc

  - if:
      properties:
        compatible:
          contains:
            enum:
              - qcom,adreno-gmu-730.1
              - qcom,adreno-gmu-740.1
              - qcom,adreno-gmu-750.1
              - qcom,adreno-gmu-x185.1
    then:
      properties:
        reg:
          items:
            - description: 核心 GMU 寄存器
            - description: 资源控制器寄存器
            - description: GMU PDC 寄存器
        reg-names:
          items:
            - const: gmu
            - const: rscc
            - const: gmu_pdc
        clocks:
          items:
            - description: GPU AHB 时钟
            - description: GMU 时钟
            - description: GPU CX 时钟
            - description: GPU AXI 时钟
            - description: GPU MEMNOC 时钟
            - description: GMU HUB 时钟
            - description: GPUSS DEMET 时钟
        clock-names:
          items:
            - const: ahb
            - const: gmu
            - const: cxo
            - const: axi
            - const: memnoc
            - const: hub
            - const: demet

      required:
        - qcom,qmp

  - if:
      properties:
        compatible:
          contains:
            const: qcom,adreno-gmu-wrapper
    then:
      properties:
        reg:
          items:
            - description: GMU 包装器寄存器空间
        reg-names:
          items:
            - const: gmu
    else:
      required:
        - clocks
        - clock-names
        - interrupts
        - interrupt-names
        - iommus
        - operating-points-v2

examples:
  - |
    #include <dt-bindings/clock/qcom,gpucc-sdm845.h>
    #include <dt-bindings/clock/qcom,gcc-sdm845.h>
    #include <dt-bindings/interrupt-controller/irq.h>
    #include <dt-bindings/interrupt-controller/arm-gic.h>

    gmu: gmu@506a000 {
        compatible = "qcom,adreno-gmu-630.2", "qcom,adreno-gmu";

        reg = <0x506a000 0x30000>,
              <0xb280000 0x10000>,
              <0xb480000 0x10000>;
        reg-names = "gmu", "gmu_pdc", "gmu_pdc_seq";

        clocks = <&gpucc GPU_CC_CX_GMU_CLK>,
                 <&gpucc GPU_CC_CXO_CLK>,
                 <&gcc GCC_DDRSS_GPU_AXI_CLK>,
                 <&gcc GCC_GPU_MEMNOC_GFX_CLK>;
        clock-names = "gmu", "cxo", "axi", "memnoc";

        interrupts = <GIC_SPI 304 IRQ_TYPE_LEVEL_HIGH>,
                     <GIC_SPI 305 IRQ_TYPE_LEVEL_HIGH>;
        interrupt-names = "hfi", "gmu";

        power-domains = <&gpucc GPU_CX_GDSC>,
                        <&gpucc GPU_GX_GDSC>;
        power-domain-names = "cx", "gx";

        iommus = <&adreno_smmu 5>;
        operating-points-v2 = <&gmu_opp_table>;
    };

    gmu_wrapper: gmu@596a000 {
        compatible = "qcom,adreno-gmu-wrapper";
        reg = <0x0596a000 0x30000>;
        reg-names = "gmu";
        power-domains = <&gpucc GPU_CX_GDSC>,
                        <&gpucc GPU_GX_GDSC>;
        power-domain-names = "cx", "gx";
    };
```

此 YAML 文件定义了 Device Tree 绑定，用于描述连接到特定 Adreno GPU 的图形管理单元 (GMU) 的配置和属性。
~~~~
