## Documentation/devicetree/bindings/display/msm/gpu_cn.yaml
~~~~yaml
以下是提供的 YAML 文件的中文翻译：

```yaml
# SPDX 许可证标识符: (GPL-2.0-only 或 BSD-2-Clause)
%YAML 1.2
---

$id: http://devicetree.org/schemas/display/msm/gpu.yaml#
$schema: http://devicetree.org/meta-schemas/core.yaml#

title: Adreno 或 Snapdragon 图形处理单元 (GPU)

maintainers:
  - Rob Clark <robdclark@gmail.com>

# 由于 dtschema 不支持基于模式+常量选择节点，因此添加自定义选择作为变通方案：
select:
  properties:
    compatible:
      contains:
        enum:
          - qcom,adreno
          - amd,imageon
  required:
    - compatible

properties:
  compatible:
    oneOf:
      - description: |
          驱动程序通过解析 Adreno 的兼容字符串来确定芯片 ID
items:
          - pattern: '^qcom,adreno-[0-9a-f]{8}$'
          - const: qcom,adreno
      - description: |
          驱动程序通过解析 Adreno 的兼容字符串来确定 GPU ID 和补丁级别
items:
          - pattern: '^qcom,adreno-[3-7][0-9][0-9]\.[0-9]+$'
          - const: qcom,adreno
      - description: |
          驱动程序通过解析 Imageon 的兼容字符串来确定 GPU ID 和补丁级别
items:
          - pattern: '^amd,imageon-200\.[0-1]$'
          - const: amd,imageon

  clocks:
    minItems: 2
    maxItems: 7

  clock-names:
    minItems: 2
    maxItems: 7

  reg:
    minItems: 1
    maxItems: 3

  reg-names:
    minItems: 1
    items:
      - const: kgsl_3d0_reg_memory
      - const: cx_mem
      - const: cx_dbgc

  interrupts:
    maxItems: 1

  interrupt-names:
    maxItems: 1

  interconnects:
    minItems: 1
    maxItems: 2

  interconnect-names:
    minItems: 1
    items:
      - const: gfx-mem
      - const: ocmem

  iommus:
    minItems: 1
    maxItems: 64

  sram:
    $ref: /schemas/types.yaml#/definitions/phandle-array
    minItems: 1
    maxItems: 4
    items:
      maxItems: 1
    description: |
      指向一个或多个保留的片上 SRAM 区域的 phandle
phandle 指向一些 a3xx 和 a4xx Snapdragon 系统级芯片 (SoC) 上存在的片上内存 (OCMEM)。参见
      文档/devicetree/bindings/sram/qcom,ocmem.yaml

  operating-points-v2: true
  opp-table:
    type: object

  power-domains:
    maxItems: 1

  zap-shader:
    type: object
    additionalProperties: false
    description: |
      对于 a5xx 和 a6xx 设备，此节点包含指向保留内存的内存区域，该内存用于存储 zap 着色器，以帮助将 GPU 从安全模式中带出
properties:
      memory-region:
        maxItems: 1

      firmware-name:
        description: |
          默认要加载到远程处理器的固件名称
"#cooling-cells":
    const: 2

  nvmem-cell-names:
    maxItems: 1

  nvmem-cells:
    description: efuse 寄存器
    maxItems: 1

  qcom,gmu:
    $ref: /schemas/types.yaml#/definitions/phandle
    description: |
      对于带有 GMU 的设备，指向控制 GPU 电源的 GMU 设备的 phandle
required:
  - compatible
  - reg
  - interrupts

additionalProperties: false

allOf:
  - if:
      properties:
        compatible:
          contains:
            pattern: '^qcom,adreno-[3-5][0-9][0-9]\.[0-9]+$'

    then:
      properties:
        clocks:
          minItems: 2
          maxItems: 7

        clock-names:
          items:
            anyOf:
              - const: core
                description: GPU 核心时钟
              - const: iface
                description: GPU 接口时钟
              - const: mem
                description: GPU 内存时钟
              - const: mem_iface
                description: GPU 内存接口时钟
              - const: alt_mem_iface
                description: GPU 备用内存接口时钟
              - const: gfx3d
                description: GPU 3D 引擎时钟
              - const: rbbmtimer
                description: GPU RBBM 定时器（Adreno 5xx 系列）
              - const: rbcpr
                description: GPU RB 核心功率降低时钟
          minItems: 2
          maxItems: 7

      required:
        - clocks
        - clock-names

  - if:
      properties:
        compatible:
          contains:
            enum:
              - qcom,adreno-610.0
              - qcom,adreno-619.1
    then:
      properties:
        clocks:
          minItems: 6
          maxItems: 6

        clock-names:
          items:
            - const: core
              description: GPU 核心时钟
            - const: iface
              description: GPU 接口时钟
            - const: mem_iface
              description: GPU 内存接口时钟
            - const: alt_mem_iface
              description: GPU 备用内存接口时钟
            - const: gmu
              description: CX GMU 时钟
            - const: xo
              description: GPUCC 时钟源时钟

        reg-names:
          minItems: 1
          items:
            - const: kgsl_3d0_reg_memory
            - const: cx_dbgc

      required:
        - clocks
        - clock-names
    else:
      if:
        properties:
          compatible:
            contains:
              pattern: '^qcom,adreno-[67][0-9][0-9]\.[0-9]+$'

      then: # 从 A6xx 开始，时钟通常在 GMU 节点中定义
        properties:
          clocks: false
          clock-names: false

          reg-names:
            minItems: 1
            items:
              - const: kgsl_3d0_reg_memory
              - const: cx_mem
              - const: cx_dbgc

examples:
  - |

    // 示例 a3xx/4xx:

    #include <dt-bindings/clock/qcom,mmcc-msm8974.h>
    #include <dt-bindings/clock/qcom,rpmcc.h>
    #include <dt-bindings/interrupt-controller/irq.h>
    #include <dt-bindings/interrupt-controller/arm-gic.h>

    gpu: gpu@fdb00000 {
        compatible = "qcom,adreno-330.2", "qcom,adreno";

        reg = <0xfdb00000 0x10000>;
        reg-names = "kgsl_3d0_reg_memory";

        clock-names = "core", "iface", "mem_iface";
        clocks = <&mmcc OXILI_GFX3D_CLK>,
                 <&mmcc OXILICX_AHB_CLK>,
                 <&mmcc OXILICX_AXI_CLK>;

        interrupts = <GIC_SPI 33 IRQ_TYPE_LEVEL_HIGH>;
        interrupt-names = "kgsl_3d0_irq";

        sram = <&gpu_sram>;
        power-domains = <&mmcc OXILICX_GDSC>;
        operating-points-v2 = <&gpu_opp_table>;
        iommus = <&gpu_iommu 0>;
        #cooling-cells = <2>;
    };

    ocmem@fdd00000 {
        compatible = "qcom,msm8974-ocmem";

        reg = <0xfdd00000 0x2000>,
              <0xfec00000 0x180000>;
        reg-names = "ctrl", "mem";

        clocks = <&rpmcc RPM_SMD_OCMEMGX_CLK>,
                 <&mmcc OCMEMCX_OCMEMNOC_CLK>;
        clock-names = "core", "iface";

        #address-cells = <1>;
        #size-cells = <1>;
        ranges = <0 0xfec00000 0x100000>;

        gpu_sram: gpu-sram@0 {
            reg = <0x0 0x100000>;
        };
    };
  - |

    // 示例 a6xx（带有 GMU）:

    #include <dt-bindings/clock/qcom,gpucc-sdm845.h>
    #include <dt-bindings/clock/qcom,gcc-sdm845.h>
    #include <dt-bindings/power/qcom-rpmpd.h>
    #include <dt-bindings/interrupt-controller/irq.h>
    #include <dt-bindings/interrupt-controller/arm-gic.h>
    #include <dt-bindings/interconnect/qcom,sdm845.h>

    reserved-memory {
        #address-cells = <2>;
        #size-cells = <2>;

        zap_shader_region: gpu@8f200000 {
            compatible = "shared-dma-pool";
            reg = <0x0 0x90b00000 0x0 0xa00000>;
            no-map;
        };
    };

    gpu@5000000 {
        compatible = "qcom,adreno-630.2", "qcom,adreno";

        reg = <0x5000000 0x40000>, <0x509e000 0x10>;
        reg-names = "kgsl_3d0_reg_memory", "cx_mem";

        #cooling-cells = <2>;

        interrupts = <GIC_SPI 300 IRQ_TYPE_LEVEL_HIGH>;

        iommus = <&adreno_smmu 0>;

        operating-points-v2 = <&gpu_opp_table>;

        interconnects = <&rsc_hlos MASTER_GFX3D &rsc_hlos SLAVE_EBI1>;
        interconnect-names = "gfx-mem";

        qcom,gmu = <&gmu>;

        gpu_opp_table: opp-table {
            compatible = "operating-points-v2";

            opp-430000000 {
                opp-hz = /bits/ 64 <430000000>;
                opp-level = <RPMH_REGULATOR_LEVEL_SVS_L1>;
                opp-peak-kBps = <5412000>;
            };

            opp-355000000 {
                opp-hz = /bits/ 64 <355000000>;
                opp-level = <RPMH_REGULATOR_LEVEL_SVS>;
                opp-peak-kBps = <3072000>;
            };

            opp-267000000 {
                opp-hz = /bits/ 64 <267000000>;
                opp-level = <RPMH_REGULATOR_LEVEL_LOW_SVS>;
                opp-peak-kBps = <3072000>;
            };

            opp-180000000 {
                opp-hz = /bits/ 64 <180000000>;
                opp-level = <RPMH_REGULATOR_LEVEL_MIN_SVS>;
                opp-peak-kBps = <1804000>;
            };
        };

        zap-shader {
            memory-region = <&zap_shader_region>;
            firmware-name = "qcom/LENOVO/81JL/qcdxkmsuc850.mbn";
        };
    };
```
请注意，部分注释和描述可能根据上下文进行了适当的翻译调整。
~~~~

## Documentation/devicetree/bindings/display/msm/hdmi_cn.yaml
~~~~yaml
下面是给定 YAML 文档的中文翻译：

```yaml
# SPDX-文件许可标识符: (GPL-2.0-only 或 BSD-2-Clause)
%YAML 1.2
---

$id: http://devicetree.org/schemas/display/msm/hdmi.yaml#
$schema: http://devicetree.org/meta-schemas/core.yaml#

标题: Qualcomm Adreno/Snapdragon HDMI 输出

维护者:
  - Rob Clark <robdclark@gmail.com>

属性:
  兼容性:
    枚举:
      - qcom,hdmi-tx-8084
      - qcom,hdmi-tx-8660
      - qcom,hdmi-tx-8960
      - qcom,hdmi-tx-8974
      - qcom,hdmi-tx-8994
      - qcom,hdmi-tx-8996

  时钟:
    最小项目数: 1
    最大项目数: 5

  时钟名称:
    最小项目数: 1
    最大项目数: 5

  寄存器:
    最小项目数: 1
    最大项目数: 3

  寄存器名称:
    最小项目数: 1
    项目:
      - 常量: core_physical
      - 常量: qfprom_physical
      - 常量: hdcp_physical

  中断:
    最大项目数: 1

  物理层:
    最大项目数: 1

  物理层名称:
    枚举:
      - hdmi_phy
      - hdmi-phy
    过时: true

  core-vdda-电源:
    描述: 指向 VDDA 电源调节器的 phandle

  hdmi-mux-电源:
    描述: 指向多路复用器调节器的 phandle
    过时: true

  core-vcc-电源:
    描述: 指向 VCC 电源调节器的 phandle

  hpd-gpios:
    最大项目数: 1
    描述: hpd 引脚

  qcom,hdmi-tx-mux-en-gpios:
    最大项目数: 1
    过时: true
    描述: HDMI 多路复用器使能引脚

  qcom,hdmi-tx-mux-sel-gpios:
    最大项目数: 1
    过时: true
    描述: HDMI 多路复用器选择引脚

  qcom,hdmi-tx-mux-lpm-gpios:
    最大项目数: 1
    过时: true
    描述: HDMI 多路复用器低功耗模式引脚

  '#sound-dai-cells':
    常量: 1

  端口:
    类型: 对象
    $ref: /schemas/graph.yaml#/properties/ports
    属性:
      端口@0:
        $ref: /schemas/graph.yaml#/$defs/port-base
        描述: |
          控制器的输入端点
      端口@1:
        $ref: /schemas/graph.yaml#/$defs/port-base
        描述: |
          控制器的输出端点
    必需:
      - 端口@0

必需:
  - 兼容性
  - 时钟
  - 时钟名称
  - 寄存器
  - 寄存器名称
  - 中断
  - 物理层

allOf:
  - 如果:
      属性:
        兼容性:
          包含:
            枚举:
              - qcom,hdmi-tx-8960
              - qcom,hdmi-tx-8660
    那么:
      属性:
        时钟:
          最小项目数: 3
          最大项目数: 3
        时钟名称:
          项目:
            - 常量: core
            - 常量: master_iface
            - 常量: slave_iface
        core-vcc-电源: false

  - 如果:
      属性:
        兼容性:
          包含:
            枚举:
              - qcom,hdmi-tx-8974
              - qcom,hdmi-tx-8084
              - qcom,hdmi-tx-8994
              - qcom,hdmi-tx-8996
    那么:
      属性:
        时钟:
          最小项目数: 5
        时钟名称:
          项目:
            - 常量: mdp_core
            - 常量: iface
            - 常量: core
            - 常量: alt_iface
            - 常量: extp
        hdmi-mux-电源: false

额外属性: false

示例:
  - |
    #include <dt-bindings/gpio/gpio.h>
    #include <dt-bindings/interrupt-controller/irq.h>
    #include <dt-bindings/interrupt-controller/arm-gic.h>
    hdmi: hdmi@4a00000 {
      兼容性 = "qcom,hdmi-tx-8960";
      寄存器名称 = "core_physical";
      寄存器 = <0x04a00000 0x2f0>;
      中断 = <GIC_SPI 79 IRQ_TYPE_LEVEL_HIGH>;
      时钟名称 = "core",
                "master_iface",
                "slave_iface";
      时钟 = <&clk 61>,
             <&clk 72>,
             <&clk 98>;
      hpd-gpios = <&msmgpio 72 GPIO_ACTIVE_HIGH>;
      core-vdda-电源 = <&pm8921_hdmi_mvs>;
      hdmi-mux-电源 = <&ext_3p3v>;
      pinctrl-名称 = "默认", "睡眠";
      pinctrl-0 = <&hpd_active  &ddc_active  &cec_active>;
      pinctrl-1 = <&hpd_suspend &ddc_suspend &cec_suspend>;

      物理层 = <&hdmi_phy>;
    };
  - |
    #include <dt-bindings/clock/qcom,gcc-msm8996.h>
    #include <dt-bindings/clock/qcom,mmcc-msm8996.h>
    #include <dt-bindings/gpio/gpio.h>
    #include <dt-bindings/interrupt-controller/irq.h>
    #include <dt-bindings/interrupt-controller/arm-gic.h>
    hdmi@9a0000 {
      兼容性 = "qcom,hdmi-tx-8996";
      寄存器 = <0x009a0000 0x50c>,
               <0x00070000 0x6158>,
               <0x009e0000 0xfff>;
      寄存器名称 = "core_physical",
                  "qfprom_physical",
                  "hdcp_physical";

      中断父级 = <&mdss>;
      中断 = <8 IRQ_TYPE_LEVEL_HIGH>;

      时钟 = <&mmcc MDSS_MDP_CLK>,
             <&mmcc MDSS_AHB_CLK>,
             <&mmcc MDSS_HDMI_CLK>,
             <&mmcc MDSS_HDMI_AHB_CLK>,
             <&mmcc MDSS_EXTPCLK_CLK>;
      时钟名称 = "mdp_core",
                "iface",
                "core",
                "alt_iface",
                "extp";

      物理层 = <&hdmi_phy>;
      #sound-dai-cells = <1>;

      pinctrl-名称 = "默认", "睡眠";
      pinctrl-0 = <&hdmi_hpd_active &hdmi_ddc_active>;
      pinctrl-1 = <&hdmi_hpd_suspend &hdmi_ddc_suspend>;

      core-vdda-电源 = <&vreg_l12a_1p8>;
      core-vcc-电源 = <&vreg_s4a_1p8>;

      端口 {
        #address-cells = <1>;
        #size-cells = <0>;

        端口@0 {
          寄存器 = <0>;
          终端 {
            远程终端 = <&mdp5_intf3_out>;
          };
        };
      };
    };
..
```
请注意，此翻译尽可能保持了原文结构，并进行了适当的本地化调整。
~~~~

## Documentation/devicetree/bindings/display/msm/mdp4_cn.yaml
```yaml
# SPDX-License-Identifier: (GPL-2.0-only OR BSD-2-Clause)
%YAML 1.2
---
$id: http://devicetree.org/schemas/display/msm/mdp4.yaml#
$schema: http://devicetree.org/meta-schemas/core.yaml#

标题: Qualcomm Adreno/Snapdragon MDP4 显示控制器

描述: >
  在诸如 MSM8960、APQ8064 和 MSM8660 等片上系统(SoC)中发现的 MDP4 显示控制器
维护者:
  - Rob Clark <robdclark@gmail.com>

属性:
  compatible:
    常量: qcom,mdp4

  clocks:
    最少项数: 6
    最多项数: 6

  clock-names:
    项:
      - 常量: core_clk
      - 常量: iface_clk
      - 常量: bus_clk
      - 常量: lut_clk
      - 常量: hdmi_clk
      - 常量: tv_clk

  reg:
    最多项数: 1

  interrupts:
    最多项数: 1

  iommus:
    最多项数: 4

  ports:
    $ref: /schemas/graph.yaml#/properties/ports
    属性:
      port@0:
        $ref: /schemas/graph.yaml#/properties/port
        描述: LCDC/LVDS

      port@1:
        $ref: /schemas/graph.yaml#/properties/port
        描述: DSI1 Cmd / Video

      port@2:
        $ref: /schemas/graph.yaml#/properties/port
        描述: DSI2 Cmd / Video

      port@3:
        $ref: /schemas/graph.yaml#/properties/port
        描述: 数字电视

  qcom,lcdc-align-lsb:
    类型: 布尔值
    描述: >
      表示对于 LCDC 应使用最低有效位(Least Significant Bit, LSB)对齐
      这仅适用于 18bpp 面板
必需:
  - compatible
  - reg
  - clocks
  - ports

额外属性: false

示例:
  - |
    mdp: mdp@5100000 {
        compatible = "qcom,mdp4";
        reg = <0x05100000 0xf0000>;
        interrupts = <0 75 0>;
        clock-names =
            "core_clk",
            "iface_clk",
            "bus_clk",
            "lut_clk",
            "hdmi_clk",
            "tv_clk";
        clocks =
            <&mmcc 77>,
            <&mmcc 86>,
            <&mmcc 102>,
            <&mmcc 75>,
            <&mmcc 97>,
            <&mmcc 12>;

        ports {
            #address-cells = <1>;
            #size-cells = <0>;

            port@0 {
                reg = <0>;
                mdp_lvds_out: endpoint {
                };
            };

            port@1 {
                reg = <1>;
                mdp_dsi1_out: endpoint {
                };
            };

            port@2 {
                reg = <2>;
                mdp_dsi2_out: endpoint {
                };
            };

            port@3 {
                reg = <3>;
                mdp_dtv_out: endpoint {
                    remote-endpoint = <&hdmi_in>;
                };
            };
        };
    };
```
