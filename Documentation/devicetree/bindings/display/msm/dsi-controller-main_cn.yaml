## Documentation/devicetree/bindings/display/msm/qcom,mdp5_cn.yaml
```yaml
下面是给定内容的中文翻译：

# SPDX-License-Identifier: GPL-2.0-only OR BSD-2-Clause
%YAML 1.2
---
$id: http://devicetree.org/schemas/display/msm/qcom,mdp5.yaml#
$schema: http://devicetree.org/meta-schemas/core.yaml#

title: Qualcomm Adreno/Snapdragon 移动显示控制器 (MDP5)

description:
  在诸如 MSM8974、APQ8084、MSM8916、MSM8994 和 MSM8996 等片上系统中发现的 MDP5 显示控制器。
maintainers:
  - Dmitry Baryshkov <dmitry.baryshkov@linaro.org>
  - Rob Clark <robdclark@gmail.com>

properties:
  compatible:
    oneOf:
      - const: qcom,mdp5
        deprecated: true
      - items:
          - enum:
              - qcom,apq8084-mdp5
              - qcom,msm8226-mdp5
              - qcom,msm8916-mdp5
              - qcom,msm8917-mdp5
              - qcom,msm8937-mdp5
              - qcom,msm8953-mdp5
              - qcom,msm8974-mdp5
              - qcom,msm8976-mdp5
              - qcom,msm8994-mdp5
              - qcom,msm8996-mdp5
              - qcom,sdm630-mdp5
              - qcom,sdm660-mdp5
          - const: qcom,mdp5

  $nodename:
    pattern: '^display-controller@[0-9a-f]+$'

  reg:
    maxItems: 1

  reg-names:
    items:
      - const: mdp_phys

  interrupts:
    maxItems: 1

  clocks:
    minItems: 4
    maxItems: 7

  clock-names:
    oneOf:
      - minItems: 4
        items:
          - const: iface
          - const: bus
          - const: core
          - const: vsync
          - const: lut
          - const: tbu
          - const: tbu_rt
        # MSM8996 具有额外的 iommu 时钟
      - items:
          - const: iface
          - const: bus
          - const: core
          - const: iommu
          - const: vsync

  interconnects:
    minItems: 1
    items:
      - description: 从 mdp0（或单一 mdp）端口到数据总线的互联路径
      - description: 从 mdp1 端口到数据总线的互联路径
      - description: 从旋转器端口到数据总线的互联路径

  interconnect-names:
    minItems: 1
    items:
      - const: mdp0-mem
      - const: mdp1-mem
      - const: rotator-mem

  iommus:
    items:
      - description: 应用 SMMU 及其对于 Hard-Fail 端口 0 的 Stream-ID 掩码

  power-domains:
    maxItems: 1

  operating-points-v2: true
  opp-table:
    type: object

  ports:
    $ref: /schemas/graph.yaml#/properties/ports
    description: >
      包含来自 DPU 设备的输出端口列表。这些端口连接到 DPU 硬件外部的接口，
      如 DSI、DP 等。MDP5 设备最多支持 4 个端口：
      一个或两个 DSI 端口，HDMI 和 eDP
patternProperties:
      "^port@[0-3]+$":
        $ref: /schemas/graph.yaml#/properties/port

    # 至少需要一个端口
    required:
      - port@0

required:
  - compatible
  - reg
  - reg-names
  - clocks
  - clock-names
  - ports

additionalProperties: false

examples:
  - |
    #include <dt-bindings/clock/qcom,gcc-msm8916.h>
    #include <dt-bindings/interrupt-controller/arm-gic.h>
    display-controller@1a01000 {
        compatible = "qcom,mdp5";
        reg = <0x1a01000 0x90000>;
        reg-names = "mdp_phys";

        interrupt-parent = <&mdss>;
        interrupts = <0>;

        clocks = <&gcc GCC_MDSS_AHB_CLK>,
                 <&gcc GCC_MDSS_AXI_CLK>,
                 <&gcc GCC_MDSS_MDP_CLK>,
                 <&gcc GCC_MDSS_VSYNC_CLK>;
        clock-names = "iface",
                      "bus",
                      "core",
                      "vsync";

        ports {
            #address-cells = <1>;
            #size-cells = <0>;

            port@0 {
                reg = <0>;
                endpoint {
                    remote-endpoint = <&dsi0_in>;
                };
            };
        };
    };
..
```

## Documentation/devicetree/bindings/display/msm/qcom,mdss_cn.yaml
```yaml
# SPDX-许可证标识符: GPL-2.0-only 或 BSD-2-Clause
%YAML 1.2
---
$id: http://devicetree.org/schemas/display/msm/qcom,mdss.yaml#
$schema: http://devicetree.org/meta-schemas/core.yaml#

标题: Qualcomm 移动显示子系统 (MDSS)

维护者:
  - Dmitry Baryshkov <dmitry.baryshkov@linaro.org>
  - Rob Clark <robdclark@gmail.com>

描述:
  这是移动显示子系统 (MDSS) 的绑定文档，该子系统封装了如 MDP5、DSI、HDMI、eDP 等子模块。

属性:
  $nodename:
    模式: "^display-subsystem@[0-9a-f]+$"

  compatible:
    枚举:
      - qcom,mdss

  reg:
    minItems: 2
    maxItems: 3

  reg-names:
    minItems: 2
    items:
      - 常量: mdss_phys
      - 常量: vbif_phys
      - 常量: vbif_nrt_phys

  interrupts:
    maxItems: 1

  interrupt-controller: true

  "#interrupt-cells":
    常量: 1

  power-domains:
    maxItems: 1
    描述: |
      由 GCC 提供的 MDSS 电源域

  clocks:
    oneOf:
      - minItems: 3
        items:
          - 描述: 显示 abh 时钟
          - 描述: 显示 axi 时钟
          - 描述: 显示 vsync 时钟
          - 描述: 显示核心时钟
      - minItems: 1
        items:
          - 描述: 显示 abh 时钟
          - 描述: 显示核心时钟

  clock-names:
    oneOf:
      - minItems: 3
        items:
          - 常量: iface
          - 常量: bus
          - 常量: vsync
          - 常量: core
      - minItems: 1
        items:
          - 常量: iface
          - 常量: core

  "#address-cells":
    常量: 1

  "#size-cells":
    常量: 1

  ranges: true

  resets:
    items:
      - 描述: MDSS_CORE 重置

必需:
  - compatible
  - reg
  - reg-names
  - interrupts
  - interrupt-controller
  - "#interrupt-cells"
  - power-domains
  - clocks
  - clock-names
  - "#address-cells"
  - "#size-cells"
  - ranges

模式属性:
  "^display-controller@[1-9a-f][0-9a-f]*$":
    类型: 对象
    additionalProperties: true
    属性:
      compatible:
        包含:
          常量: qcom,mdp5

  "^dsi@[1-9a-f][0-9a-f]*$":
    类型: 对象
    additionalProperties: true
    属性:
      compatible:
        包含:
          常量: qcom,mdss-dsi-ctrl

  "^phy@[1-9a-f][0-9a-f]*$":
    类型: 对象
    additionalProperties: true
    属性:
      compatible:
        枚举:
          - qcom,dsi-phy-14nm
          - qcom,dsi-phy-14nm-660
          - qcom,dsi-phy-14nm-8953
          - qcom,dsi-phy-20nm
          - qcom,dsi-phy-28nm-8226
          - qcom,dsi-phy-28nm-8937
          - qcom,dsi-phy-28nm-hpm
          - qcom,dsi-phy-28nm-hpm-fam-b
          - qcom,dsi-phy-28nm-lp
          - qcom,hdmi-phy-8084
          - qcom,hdmi-phy-8660
          - qcom,hdmi-phy-8960
          - qcom,hdmi-phy-8974
          - qcom,hdmi-phy-8996

  "^hdmi-tx@[1-9a-f][0-9a-f]*$":
    类型: 对象
    additionalProperties: true
    属性:
      compatible:
        枚举:
          - qcom,hdmi-tx-8084
          - qcom,hdmi-tx-8660
          - qcom,hdmi-tx-8960
          - qcom,hdmi-tx-8974
          - qcom,hdmi-tx-8994
          - qcom,hdmi-tx-8996

additionalProperties: false

示例:
  - |
    #include <dt-bindings/clock/qcom,gcc-msm8916.h>
    #include <dt-bindings/interrupt-controller/arm-gic.h>
    display-subsystem@1a00000 {
        compatible = "qcom,mdss";
        reg = <0x1a00000 0x1000>,
              <0x1ac8000 0x3000>;
        reg-names = "mdss_phys", "vbif_phys";

        power-domains = <&gcc MDSS_GDSC>;

        clocks = <&gcc GCC_MDSS_AHB_CLK>,
                 <&gcc GCC_MDSS_AXI_CLK>,
                 <&gcc GCC_MDSS_VSYNC_CLK>;
        clock-names = "iface",
                      "bus",
                      "vsync";

        interrupts = <GIC_SPI 72 IRQ_TYPE_LEVEL_HIGH>;

        interrupt-controller;
        #interrupt-cells = <1>;

        #address-cells = <1>;
        #size-cells = <1>;
        ranges;

        display-controller@1a01000 {
            compatible = "qcom,msm8916-mdp5", "qcom,mdp5";
            reg = <0x01a01000 0x89000>;
            reg-names = "mdp_phys";

            interrupt-parent = <&mdss>;
            interrupts = <0>;

            clocks = <&gcc GCC_MDSS_AHB_CLK>,
                     <&gcc GCC_MDSS_AXI_CLK>,
                     <&gcc GCC_MDSS_MDP_CLK>,
                     <&gcc GCC_MDSS_VSYNC_CLK>;
            clock-names = "iface",
                      "bus",
                      "core",
                      "vsync";

            iommus = <&apps_iommu 4>;

            ports {
                #address-cells = <1>;
                #size-cells = <0>;

                port@0 {
                    reg = <0>;
                    mdp5_intf1_out: endpoint {
                        remote-endpoint = <&dsi0_in>;
                    };
                };
            };
        };
    };
..
```

## Documentation/devicetree/bindings/display/msm/qcom,msm8998-dpu_cn.yaml
```yaml
下面是给定内容的中文翻译：

# SPDX-许可证标识符: GPL-2.0-only 或 BSD-2-Clause
%YAML 1.2
---
$id: http://devicetree.org/schemas/display/msm/qcom,msm8998-dpu.yaml#
$schema: http://devicetree.org/meta-schemas/core.yaml#

标题: 骁龙MSM8998上的Qualcomm显示DPU

维护者:
  - 安杰洛·乔亚基诺·德尔·雷格诺 <angelogioacchino.delregno@somainline.org>

$ref: /schemas/display/msm/dpu-common.yaml#

属性:
  compatible:
    常量: qcom,msm8998-dpu

  reg:
    项:
      - 描述: MDP寄存器集的地址偏移和大小
      - 描述: REGDMA寄存器集的地址偏移和大小
      - 描述: VBIF寄存器集的地址偏移和大小
      - 描述: 非实时VBIF寄存器集的地址偏移和大小

  reg-names:
    项:
      - 常量: mdp
      - 常量: regdma
      - 常量: vbif
      - 常量: vbif_nrt

  clocks:
    项:
      - 描述: 显示AHB时钟
      - 描述: 显示AXI时钟
      - 描述: 显示内存NOC时钟
      - 描述: 显示核心时钟
      - 描述: 显示同步时钟

  clock-names:
    项:
      - 常量: iface
      - 常量: bus
      - 常量: mnoc
      - 常量: core
      - 常量: vsync

必需:
  - compatible
  - reg
  - reg-names
  - clocks
  - clock-names

未评估属性: false

示例:
  - |
    #include <dt-bindings/clock/qcom,mmcc-msm8998.h>
    #include <dt-bindings/power/qcom-rpmpd.h>

    display-controller@c901000 {
        compatible = "qcom,msm8998-dpu";
        reg = <0x0c901000 0x8f000>,
              <0x0c9a8e00 0xf0>,
              <0x0c9b0000 0x2008>,
              <0x0c9b8000 0x1040>;
        reg-names = "mdp", "regdma", "vbif", "vbif_nrt";

        clocks = <&mmcc MDSS_AHB_CLK>,
                 <&mmcc MDSS_AXI_CLK>,
                 <&mmcc MNOC_AHB_CLK>,
                 <&mmcc MDSS_MDP_CLK>,
                 <&mmcc MDSS_VSYNC_CLK>;
        clock-names = "iface", "bus", "mnoc", "core", "vsync";

        interrupt-parent = <&mdss>;
        interrupts = <0>;
        operating-points-v2 = <&mdp_opp_table>;
        power-domains = <&rpmpd MSM8998_VDDMX>;

        ports {
            #address-cells = <1>;
            #size-cells = <0>;

            port@0 {
                reg = <0>;
                endpoint {
                    remote-endpoint = <&dsi0_in>;
                };
            };

            port@1 {
                reg = <1>;
                endpoint {
                    remote-endpoint = <&dsi1_in>;
                };
            };
        };
    };
..
```
