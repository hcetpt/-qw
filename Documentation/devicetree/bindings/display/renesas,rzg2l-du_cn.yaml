## Documentation/devicetree/bindings/display/samsung/samsung,exynos-hdmi_cn.yaml
~~~~yaml
# SPDX-许可证标识符: GPL-2.0-only
%YAML 1.2
---
$id: http://devicetree.org/schemas/display/samsung/samsung,exynos-hdmi.yaml#
$schema: http://devicetree.org/meta-schemas/core.yaml#

标题: Samsung Exynos 系统芯片 HDMI

维护者:
  - Inki Dae <inki.dae@samsung.com>
  - Seung-Woo Kim <sw0312.kim@samsung.com>
  - Kyungmin Park <kyungmin.park@samsung.com>
  - Krzysztof Kozlowski <krzk@kernel.org>

属性:
  compatible:
    枚举:
      - samsung,exynos4210-hdmi
      - samsung,exynos4212-hdmi
      - samsung,exynos5420-hdmi
      - samsung,exynos5433-hdmi

  clocks:
    最小项目数: 5
    最大项目数: 10

  clock-names:
    最小项目数: 5
    最大项目数: 10

  ddc:
    $ref: /schemas/types.yaml#/definitions/phandle
    描述:
      HDMI DDC 节点的 phandle
hdmi-en-supply:
    描述:
      提供 HDMI 连接器上的 DCC 线路电压源。当没有为 DDC EEPROM 提供电源时，某些电视机不会拉起 HPD（热插拔检测）线，这会导致 HDMI 块保持关闭状态。如果提供此电源调节器，则允许电视机正确地发出 HPD 事件信号。
hpd-gpios:
    最大项目数: 1
    描述:
      连接到 HPD 的 GPIO 线

  interrupts:
    最大项目数: 1

  phy:
    $ref: /schemas/types.yaml#/definitions/phandle
    描述: HDMI PHY 节点的 phandle
ports:
    $ref: /schemas/graph.yaml#/properties/ports
    描述:
      包含一个连接到麦克风节点的端口
power-domains:
    最大项目数: 1

  reg:
    最大项目数: 1

  samsung,syscon-phandle:
    $ref: /schemas/types.yaml#/definitions/phandle
    描述:
      PMU 系统控制器节点的 phandle
samsung,sysreg-phandle:
    $ref: /schemas/types.yaml#/definitions/phandle
    描述:
      DISP 系统控制器接口的 phandle
'#sound-dai-cells':
    常量: 0

  vdd-supply:
    描述:
      VDD 1.0V HDMI TX
vdd_osc-supply:
    描述:
      VDD 1.8V HDMI OSC
vdd_pll-supply:
    描述:
      VDD 1.0V HDMI PLL
这段文本包含了特定硬件组件的配置描述，主要用于定义与Samsung Exynos 5433 HDMI相关的设备树属性。下面是翻译成中文的内容：

所需属性:
  - compatible（兼容性）
  - clocks（时钟）
  - clock-names（时钟名称）
  - ddc（数字显示通道）
  - hpd-gpios（热插拔检测GPIOs）
  - interrupts（中断）
  - phy（物理层）
  - reg（寄存器）
  - samsung,syscon-phandle（Samsung系统控制句柄）
  - `#sound-dai-cells`（音频DAI单元格数量）
  - vdd-supply（VDD电源供应）
  - vdd_osc-supply（VDD_Osc电源供应）
  - vdd_pll-supply（VDD_PLL电源供应）

全部包含:
  - 如果:
      属性:
        compatible（兼容性）:
          包含:
            常量: samsung,exynos5433-hdmi
    那么:
      属性:
        clocks（时钟）:
          项:
            - 描述: HDMI IP APB总线的门控时钟
            - 描述: HDMI-PHY IP APB总线的门控时钟
            - 描述: HDMI TMDS时钟的门控时钟
            - 描述: HDMI像素时钟的门控时钟
            - 描述: 由HDMI-PHY产生的TMDS时钟
            - 描述: 在HDMI-PHY关闭和运行时分别用于切换oscclk和tmds_clko的多路复用器
            - 描述: 由HDMI-PHY产生的像素时钟
            - 描述: 在HDMI-PHY关闭和运行时分别用于切换oscclk和pixel_clko的多路复用器
            - 描述: 振荡器时钟，在HDMI-PHY不运行的情况下作为*_user时钟的父时钟
            - 描述: HDMI SPDIF时钟的门控时钟
This DT (Device Tree) snippet configures an HDMI controller for the Exynos5433 SoC (System on Chip). Below is a translation and explanation of the provided code into Chinese, along with explanations of the key components.

### 配置说明:

```yaml
# 如果存在 samsung,sysreg-phandle 属性
clocks:
  items:
    - const: hdmi_pclk # HDMI PCLK (Pixel Clock)
    - const: hdmi_i_pclk # HDMI I PCLK (Internal Pixel Clock)
    - const: i_tmds_clk # TMDS (Transition Minimized Differential Signaling) Clock Input
    - const: i_pixel_clk # Pixel Clock Input (one of the possible inputs for the HDMI clock multiplexer)
    - const: tmds_clko # TMDS Clock Output (one of the two possible inputs for the HDMI clock multiplexer)
    - const: tmds_clko_user # User TMDS Clock Output
    - const: pixel_clko # Pixel Clock Output
    - const: pixel_clko_user # User Pixel Clock Output
    - const: oscclk # Oscillator Clock
    - const: i_spdif_clk # SPDIF (Sony/Philips Digital Interface) Clock Input
clock-names:
  items:
    - const: hdmi
    - const: sclk_hdmi # HDMI Special Clock
    - const: sclk_pixel # Pixel Special Clock
    - const: sclk_hdmiphy # HDMI PHY Clock
    - const: mout_hdmi # HDMI MOUT (Multiplexer Output)

# 如果不存在 samsung,sysreg-phandle 属性，则不需要上述配置
additionalProperties: false
```

### 示例代码:
```yaml
- |
  #include <dt-bindings/clock/exynos5433.h>
  #include <dt-bindings/gpio/gpio.h>
  #include <dt-bindings/interrupt-controller/arm-gic.h>

  hdmi@13970000 { # HDMI 控制器的设备树节点
      compatible = "samsung,exynos5433-hdmi"; # 兼容性声明
      reg = <0x13970000 0x70000>; # 寄存器基地址和大小
      interrupts = <GIC_SPI 208 IRQ_TYPE_LEVEL_HIGH>; # 中断配置
      clocks = <&cmu_disp CLK_PCLK_HDMI>, # HDMI IP Bus Clock
               <&cmu_disp CLK_PCLK_HDMIPHY>, # HDMI PHY Bus Clock
               <&cmu_disp CLK_PHYCLK_HDMIPHY_TMDS_CLKO>, # HDMI PHY TMDS Clock Output
               <&cmu_disp CLK_PHYCLK_HDMI_PIXEL>, # HDMI Pixel Clock
               <&cmu_disp CLK_PHYCLK_HDMIPHY_TMDS_CLKO_PHY>, # HDMI PHY TMDS Clock Output for PHY
               <&cmu_disp CLK_MOUT_PHYCLK_HDMIPHY_TMDS_CLKO_USER>, # User TMDS Clock Output for PHY
               <&cmu_disp CLK_PHYCLK_HDMIPHY_PIXEL_CLKO_PHY>, # HDMI PHY Pixel Clock Output for PHY
               <&cmu_disp CLK_MOUT_PHYCLK_HDMIPHY_PIXEL_CLKO_USER>, # User Pixel Clock Output for PHY
               <&xxti>, # Oscillator Clock
               <&cmu_disp CLK_SCLK_HDMI_SPDIF>; # SPDIF Clock
      clock-names = "hdmi_pclk", # HDMI PCLK (Pixel Clock)
                     "hdmi_i_pclk", # HDMI I PCLK (Internal Pixel Clock)
                     "i_tmds_clk", # TMDS (Transition Minimized Differential Signaling) Clock Input
                     "i_pixel_clk", # Pixel Clock Input (one of the possible inputs for the HDMI clock multiplexer)
                     "tmds_clko", # TMDS Clock Output (one of the two possible inputs for the HDMI clock multiplexer)
                     "tmds_clko_user", # User TMDS Clock Output
                     "pixel_clko", # Pixel Clock Output
                     "pixel_clko_user", # User Pixel Clock Output
                     "oscclk", # Oscillator Clock
                     "i_spdif_clk"; # SPDIF (Sony/Philips Digital Interface) Clock Input
      phy = <&hdmiphy>; # HDMI PHY 设备树节点
      ddc = <&hsi2c_11>; # DDC (Display Data Channel) 设备树节点
      samsung,syscon-phandle = <&syscon_disp>; # System Control 设备树节点
      samsung,sysreg-phandle = <&pmu_system_controller>; # Power Management Unit System Controller 设备树节点
      #sound-dai-cells = <0>; # 不使用音频设备抽象接口 (D-AI)

      hpd-gpios = <&gpa3 0 GPIO_ACTIVE_HIGH>; # HDMI 热插拔检测 (HPD) GPIO 配置
      vdd-supply = <&ldo6_reg>; # VDD (Power Supply) 配置
      vdd_osc-supply = <&ldo7_reg>; # VDD_OSC (Oscillator Power Supply) 配置
      vdd_pll-supply = <&ldo6_reg>; # VDD_PLL (Phase-Locked Loop Power Supply) 配置

      ports { # HDMI 端口配置
          #address-cells = <1>;
          #size-cells = <0>;

          port@0 { # 第一个端口配置
              reg = <0>;
              hdmi_to_tv: endpoint { # HDMI 到 TV 的连接点
                  remote-endpoint = <&tv_to_hdmi>; # 远程端点，TV 到 HDMI
              };
          };

          port@1 { # 第二个端口配置
              reg = <1>;
              hdmi_to_mhl: endpoint { # HDMI 到 MHL (Mobile High-Definition Link) 的连接点
                  remote-endpoint = <&mhl_to_hdmi>; # 远程端点，MHL 到 HDMI
              };
          };
      };
  };
```

此示例配置了一个基于Exynos5433的HDMI控制器，并详细指定了其所需的时钟、GPIO、电源管理等配置。
~~~~

## Documentation/devicetree/bindings/display/samsung/samsung,exynos-mixer_cn.yaml
~~~~yaml
这段 Device Tree 文件描述了三星 Exynos 系统芯片中的混合器（Mixer）配置。以下是中文翻译：

```yaml
# SPDX 许可证标识符: (GPL-2.0-only 或 BSD-2-Clause)
%YAML 1.2
---
$id: http://devicetree.org/schemas/display/samsung/samsung,exynos-mixer.yaml#
$schema: http://devicetree.org/meta-schemas/core.yaml#

标题: 三星 Exynos SoC 混合器

维护者:
  - Inki Dae <inki.dae@samsung.com>
  - Seung-Woo Kim <sw0312.kim@samsung.com>
  - Kyungmin Park <kyungmin.park@samsung.com>
  - Krzysztof Kozlowski <krzk@kernel.org>

描述:
  三星 Exynos SoC 混合器负责在将数据传送给输出设备之前混合和融合多个数据输入。输出通过 HDMI 发送。

属性:
  compatible:
    oneOf:
      - 枚举:
          - samsung,exynos4210-mixer
          - samsung,exynos4212-mixer
          - samsung,exynos5250-mixer
          - samsung,exynos5420-mixer
      - 常量: samsung,exynos5-mixer
        过时: true

  clocks:
    minItems: 3
    items:
      - 描述: 混合器 IP 总线时钟门
      - 描述: HDMI IP 总线时钟门，与 sclk_hdmi 一起需要
      - 描述: HDMI 特殊时钟，是混合器多路选择器的两个可能输入之一
      - 描述: 视频处理器时钟
      - 描述: 混合器多路选择器时钟
      - 描述: 混合器特殊时钟

  clock-names:
    minItems: 3
    items:
      - 常量: mixer
      - 常量: hdmi
      - 常量: sclk_hdmi
      - 常量: vp
      - 常量: mout_mixer
      - 常量: sclk_mixer

  interconnects:
    maxItems: 1

  interrupts:
    maxItems: 1

  iommus:
    maxItems: 1

  power-domains:
    maxItems: 1

  reg:
    minItems: 1
    items:
      - 描述: 混合器内存区域
      - 描述: 视频处理器内存区域

必需:
  - compatible
  - clocks
  - clock-names
  - interrupts
  - reg

allOf:
  - 如果:
      属性:
        compatible:
          包含:
            常量: samsung,exynos4210-mixer
            常量: samsung,exynos4212-mixer
    那么:
      属性:
        clocks:
          minItems: 6
          maxItems: 6
        reg:
          minItems: 2
          maxItems: 2

  - 如果:
      属性:
        compatible:
          包含:
            常量: samsung,exynos4212-mixer
    那么:
      属性:
        clocks:
          minItems: 4
          maxItems: 4
        reg:
          minItems: 2
          maxItems: 2

  - 如果:
      属性:
        compatible:
          包含:
            枚举:
              - samsung,exynos5-mixer
              - samsung,exynos5250-mixer
              - samsung,exynos5420-mixer
    那么:
      属性:
        clocks:
          minItems: 3
          maxItems: 3
        reg:
          minItems: 1
          maxItems: 1

additionalProperties: false

示例:
  - |
    #include <dt-bindings/clock/exynos5250.h>
    #include <dt-bindings/interrupt-controller/arm-gic.h>

    mixer@14450000 {
        compatible = "samsung,exynos5250-mixer";
        reg = <0x14450000 0x10000>;
        interrupts = <GIC_SPI 94 IRQ_TYPE_LEVEL_HIGH>;
        clocks = <&clock CLK_MIXER>,
                 <&clock CLK_HDMI>,
                 <&clock CLK_SCLK_HDMI>;
        clock-names = "mixer",
                      "hdmi",
                      "sclk_hdmi";
        iommus = <&sysmmu_tv>;
        power-domains = <&pd_disp1>;
    };
```

请注意，`allOf` 部分定义了针对不同兼容性的具体要求，这使得配置能够根据不同型号的 Exynos 芯片进行调整。
~~~~

## Documentation/devicetree/bindings/display/samsung/samsung,exynos5-dp_cn.yaml
```yaml
以下是提供的 YAML 文件的中文翻译：

---

# SPDX 许可证标识符: GPL-2.0-only 或 BSD-2-Clause
%YAML 1.2
---
$id: http://devicetree.org/schemas/display/samsung/samsung,exynos5-dp.yaml#
$schema: http://devicetree.org/meta-schemas/core.yaml#

title: Samsung Exynos5250/Exynos5420 SoC 显示端口

maintainers:
  - Inki Dae <inki.dae@samsung.com>
  - Seung-Woo Kim <sw0312.kim@samsung.com>
  - Kyungmin Park <kyungmin.park@samsung.com>
  - Krzysztof Kozlowski <krzk@kernel.org>

properties:
  compatible:
    const: samsung,exynos5-dp

  reg:
    maxItems: 1

  clocks:
    maxItems: 1

  clock-names:
    items:
      - const: dp

  display-timings:
    $ref: /schemas/display/panel/display-timings.yaml#

  interrupts:
    maxItems: 1

  hpd-gpios:
    description:
      热插拔检测 GPIO
      指示用于热插拔检测的 GPIO

  phys:
    maxItems: 1

  phy-names:
    items:
      - const: dp

  power-domains:
    maxItems: 1

  interlaced:
    type: boolean
    deprecated: true
    description:
      隔行扫描模式。定义为逐行，未定义为隔行
  vsync-active-high:
    type: boolean
    deprecated: true
    description:
      VSYNC 极性配置。定义为高电平，未定义为低电平

  hsync-active-high:
    type: boolean
    deprecated: true
    description:
      HSYNC 极性配置。定义为高电平，未定义为低电平

  ports:
    $ref: /schemas/graph.yaml#/properties/ports

    properties:
      port:
        $ref: /schemas/graph.yaml#/properties/port
        description:
          带有一个连接到 dp-connector 节点的端点的端口节点
      required:
      - port

  samsung,hpd-gpios:
    maxItems: 1
    deprecated: true

  samsung,ycbcr-coeff:
    $ref: /schemas/types.yaml#/definitions/uint32
    deprecated: true
    description:
      已废弃的属性，可以从 drm_display_mode 解析
  samsung,dynamic-range:
    $ref: /schemas/types.yaml#/definitions/uint32
    deprecated: true
    description:
      已废弃的属性，可以从 drm_display_mode 解析
  samsung,color-space:
    $ref: /schemas/types.yaml#/definitions/uint32
    deprecated: true
    description:
      已废弃的属性，可以从 drm_display_info 解析
  samsung,color-depth:
    $ref: /schemas/types.yaml#/definitions/uint32
    deprecated: true
    description:
      已废弃的属性，可以从 drm_display_info 解析
  samsung,link-rate:
    $ref: /schemas/types.yaml#/definitions/uint32
    deprecated: true
    description:
      已废弃的属性，可以通过 DPCD 方法从显示器读取
  samsung,lane-count:
    $ref: /schemas/types.yaml#/definitions/uint32
    deprecated: true
    description:
      已废弃的属性，可以通过 DPCD 方法从显示器读取
required:
  - compatible
  - reg
  - clocks
  - clock-names
  - interrupts
  - phys
  - phy-names

additionalProperties: false

examples:
  - |
    #include <dt-bindings/clock/exynos5250.h>
    #include <dt-bindings/gpio/gpio.h>
    #include <dt-bindings/interrupt-controller/arm-gic.h>

    dp-controller@145b0000 {
        compatible = "samsung,exynos5-dp";
        reg = <0x145b0000 0x1000>;
        clocks = <&clock CLK_DP>;
        clock-names = "dp";
        interrupts = <10 3>;
        interrupt-parent = <&combiner>;
        phys = <&dp_phy>;
        phy-names = "dp";
        pinctrl-0 = <&dp_hpd>;
        pinctrl-names = "default";
        power-domains = <&pd_disp1>;

        samsung,color-space = <0>;
        samsung,color-depth = <1>;
        samsung,link-rate = <0x0a>;
        samsung,lane-count = <2>;
        hpd-gpios = <&gpx0 7 GPIO_ACTIVE_HIGH>;

        ports {
            port {
                dp_out: endpoint {
                    remote-endpoint = <&bridge_in>;
                };
            };
        };
    };
```
