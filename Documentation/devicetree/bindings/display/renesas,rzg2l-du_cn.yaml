## Documentation/devicetree/bindings/display/simple-framebuffer_cn.yaml
~~~~yaml
# SPDX-许可证标识符: GPL-2.0
%YAML 1.2
---
$id: http://devicetree.org/schemas/display/simple-framebuffer.yaml#
$schema: http://devicetree.org/meta-schemas/core.yaml#

标题: 简单的帧缓冲区

维护者:
  - Hans de Goede <hdegoede@redhat.com>

描述: |+
  一个简单的帧缓冲区描述了由固件或启动加载程序设置的帧缓冲区，假定显示硬件已经被配置为从由"reg"属性所指向的内存进行扫描。
由于简单的帧缓冲节点表示运行时信息，它们必须是选定节点(*)的子节点。简单的帧缓冲节点必须命名为framebuffer@<地址>
如果设备树包含用于简单帧缓冲区的显示硬件节点，则简单的帧缓冲节点必须包含一个名为"display"的属性，其中包含指向主要显示硬件节点的phandle，以便操作系统知道在将控制权交给真实硬件驱动程序时禁用哪个简单的帧缓冲区。硬件节点的绑定必须指定哪个节点被认为是主要节点
如果指定了面板节点，则驱动程序使用此节点来配置显示的实际宽度和高度。如果没有给出面板节点，则驱动程序使用简单的帧缓冲节点中的width和height属性来估算它
建议添加display#别名以帮助操作系统确定如何编号。如果使用了display#别名，则如果简单的帧缓冲节点包含"display"属性，则"/aliases/display#"路径必须指向"display"属性所指向的显示硬件节点，否则必须直接指向简单的帧缓冲节点
如果简单的帧缓冲节点代表用户交互的首选控制台，则选定节点的"stdout-path"属性应该指向它，或者指向主要显示硬件节点，如同display#别名一样。如果使用了display别名，则应将其设置为该别名
建议设备树文件包含预填充但禁用的帧缓冲节点，以便固件只需要更新模式信息并启用它们。这样，例如，如果以后支持更多的显示时钟被添加，简单的帧缓冲节点将已经包含这些信息，而不需要更新固件
如果使用了预填充的帧缓冲节点，固件可能需要额外的信息来找到正确的节点。在这种情况下，应该使用额外的平台特定兼容性和平台特定属性，并对其进行记录
属性:
  compatible:
    oneOf:
      - items:
          - enum:
              - apple,simple-framebuffer
              - allwinner,simple-framebuffer
              - amlogic,simple-framebuffer
          - const: simple-framebuffer
      - const: simple-framebuffer

  reg:
    描述: 帧缓冲区内存的位置和大小

  memory-region:
    maxItems: 1
    描述: 指向描述将用于帧缓冲区的内存的节点的phandle。如果存在，将覆盖"reg"属性（如果存在）
clocks:
    描述: 帧缓冲区使用的时钟列表
下面是给定 YAML 配置的中文翻译：

```yaml
power-domains:
    description: 用于帧缓冲区的电源域列表
width:
    $ref: /schemas/types.yaml#/definitions/uint32
    description: 帧缓冲区的像素宽度

height:
    $ref: /schemas/types.yaml#/definitions/uint32
    description: 帧缓冲区的像素高度

stride:
    $ref: /schemas/types.yaml#/definitions/uint32
    description: 帧缓冲区中一行的字节数

format:
    description: >
      帧缓冲区格式：
        * `a1r5g5b5` - 16位像素，d[15]=a, d[14:10]=r, d[9:5]=g, d[4:0]=b
        * `a2r10g10b10` - 32位像素，d[31:30]=a, d[29:20]=r, d[19:10]=g, d[9:0]=b
        * `a8b8g8r8` - 32位像素，d[31:24]=a, d[23:16]=b, d[15:8]=g, d[7:0]=r
        * `a8r8g8b8` - 32位像素，d[31:24]=a, d[23:16]=r, d[15:8]=g, d[7:0]=b
        * `r5g6b5` - 16位像素，d[15:11]=r, d[10:5]=g, d[4:0]=b
        * `r5g5b5a1` - 16位像素，d[15:11]=r, d[10:6]=g, d[5:1]=b d[1:0]=a
        * `r8g8b8` - 24位像素，d[23:16]=r, d[15:8]=g, d[7:0]=b
        * `x1r5g5b5` - 16位像素，d[14:10]=r, d[9:5]=g, d[4:0]=b
        * `x2r10g10b10` - 32位像素，d[29:20]=r, d[19:10]=g, d[9:0]=b
        * `x8r8g8b8` - 32位像素，d[23:16]=r, d[15:8]=g, d[7:0]=b
        * `x8b8g8r8` - 32位像素，d[23:16]=b, d[15:8]=g, d[7:0]=r
    enum:
      - a1r5g5b5
      - a2r10g10b10
      - a8b8g8r8
      - a8r8g8b8
      - r5g6b5
      - r5g5b5a1
      - r8g8b8
      - x1r5g5b5
      - x2r10g10b10
      - x8r8g8b8
      - x8b8g8r8

display:
    $ref: /schemas/types.yaml#/definitions/phandle
    description: 主显示硬件节点

panel:
    $ref: /schemas/types.yaml#/definitions/phandle
    description: 显示面板节点

allwinner,pipeline:
    description: 在 Allwinner 系统级芯片上由帧缓冲区使用的管道
    enum:
      - de_be0-lcd0
      - de_be0-lcd0-hdmi
      - de_be0-lcd0-tve0
      - de_be1-lcd0
      - de_be1-lcd1-hdmi
      - de_fe0-de_be0-lcd0
      - de_fe0-de_be0-lcd0-hdmi
      - de_fe0-de_be0-lcd0-tve0
      - mixer0-lcd0
      - mixer0-lcd0-hdmi
      - mixer1-lcd1-hdmi
      - mixer1-lcd1-tve

amlogic,pipeline:
    description: 在 Amlogic 系统级芯片上由帧缓冲区使用的管道
    enum:
      - vpu-cvbs
      - vpu-hdmi

patternProperties:
  "^[a-zA-Z0-9-]+-supply$":
    $ref: /schemas/types.yaml#/definitions/phandle
    description:
      帧缓冲区使用的稳压器。这些应根据设备设计中的名称命名
required:
  # 此绑定还需要 reg、width、height、stride 和 format，
  # 但通常它们将由引导加载程序填充
- compatible

allOf:
  - if:
      properties:
        compatible:
          contains:
            const: allwinner,simple-framebuffer

    then:
      required:
        - allwinner,pipeline

  - if:
      properties:
        compatible:
          contains:
            const: amlogic,simple-framebuffer

    then:
      required:
        - amlogic,pipeline


additionalProperties: false

examples:
  - |
    / {
        compatible = "foo";
        model = "foo";
        #address-cells = <1>;
        #size-cells = <1>;

        chosen {
            #address-cells = <1>;
            #size-cells = <1>;
            framebuffer0: framebuffer@1d385000 {
                compatible = "allwinner,simple-framebuffer", "simple-framebuffer";
                allwinner,pipeline = "de_be0-lcd0";
                reg = <0x1d385000 3840000>;
                width = <1600>;
                height = <1200>;
                stride = <3200>;
                format = "r5g6b5";
                clocks = <&ahb_gates 36>, <&ahb_gates 43>, <&ahb_gates 44>;
                lcd-supply = <&reg_dc1sw>;
                display = <&lcdc0>;
            };
        };
    };
..
```

这段配置描述了一个帧缓冲区（framebuffer）的属性和要求，并提供了示例。它详细地定义了如何设置和使用帧缓冲区，包括其兼容性、电源管理、显示管道等信息。
~~~~

## Documentation/devicetree/bindings/display/sitronix,st7586_cn.txt
~~~~
Sitronix ST7586 显示屏面板的配置节点如下：

**必需属性：**
- `compatible`：兼容性字符串，对于此设备应为 `"lego,ev3-lcd"`。
- `a0-gpios`：A0信号（由于此绑定用于串行模式，因此这是控制器上标记为D1的引脚，而非标记为A0的引脚）。
- `reset-gpios`：复位引脚。

此驱动程序对应的节点必须是SPI控制器子节点，因此在`../spi/spi-bus.txt`中描述的所有强制性属性都必须指定。

**可选属性：**
- `rotation`：以逆时针方向表示的面板旋转角度（0、90、180、270度）。

**示例：**
```yaml
display@0 {
    compatible = "lego,ev3-lcd";
    reg = <0>;  // SPI设备地址
    spi-max-frequency = <10000000>;  // SPI最大频率
    a0-gpios = <&gpio 43 GPIO_ACTIVE_HIGH>;  // A0信号，连接到GPIO 43，高电平有效
    reset-gpios = <&gpio 80 GPIO_ACTIVE_HIGH>;  // 复位信号，连接到GPIO 80，高电平有效
};
```

这个配置定义了一个与`ev3-lcd`兼容的显示屏节点，该节点位于SPI控制器下。它指定了A0和复位引脚，以及SPI的最大工作频率。
~~~~

## Documentation/devicetree/bindings/display/sitronix,st7735r_cn.yaml
```yaml
下面是给定内容的中文翻译：

# SPDX-License-Identifier: GPL-2.0-only
%YAML 1.2
---
$id: http://devicetree.org/schemas/display/sitronix,st7735r.yaml#
$schema: http://devicetree.org/meta-schemas/core.yaml#

title: Sitronix ST7735R 显示屏

maintainers:
  - David Lechner <david@lechnology.com>

description:
  本绑定适用于使用 Sitronix ST7715R 或 ST7735R 控制器并通过 SPI 模式工作的显示屏。
allOf:
  - $ref: panel/panel-common.yaml#
  - $ref: /schemas/spi/spi-peripheral-props.yaml#

properties:
  compatible:
    oneOf:
      - description:
          Adafruit 1.8" 160x128 彩色 TFT LCD（产品ID 358 或 618）
        items:
          - enum:
              - jianda,jd-t18003-t01
          - const: sitronix,st7735r
      - description:
          Okaya 1.44" 128x128 彩色 TFT LCD（例如：Renesas YRSK-LCD-PMOD）
        items:
          - enum:
              - okaya,rh128128t
          - const: sitronix,st7715r

  dc-gpios:
    maxItems: 1
    description: 显示数据/命令选择（D/CX）

  backlight: true
  reg: true
  spi-max-frequency: true
  reset-gpios: true
  rotation: true

required:
  - compatible
  - reg
  - dc-gpios

additionalProperties: false

examples:
  - |
    #include <dt-bindings/gpio/gpio.h>

    spi {
            #address-cells = <1>;
            #size-cells = <0>;

            display@0{
                    compatible = "jianda,jd-t18003-t01", "sitronix,st7735r";
                    reg = <0>;
                    spi-max-frequency = <32000000>;
                    dc-gpios = <&gpio 43 GPIO_ACTIVE_HIGH>;
                    reset-gpios = <&gpio 80 GPIO_ACTIVE_HIGH>;
                    rotation = <270>;
                    backlight = <&backlight>;
            };
    };

..
```

## Documentation/devicetree/bindings/display/sm501fb_cn.txt
~~~~
SM SM501 是一款液晶显示器控制器，配备合适的硬件时，它也能驱动 DVI 显示器。
必需属性：
- compatible（兼容性）: 应该设置为 "smi,sm501"
- reg（寄存器）: 包含两个条目：
    - 第一个条目：系统配置寄存器
    - 第二个条目：I/O 空间（显示控制器寄存器）
- interrupts（中断）: 描述发送到 CPU 的 SMI 中断
可选属性：
- mode（模式）: 选择视频模式:
    `<xres>x<yres>[-<bpp>][@<refresh>]`
- edid：直接描述连接的显示设备的 EDID 数据块
从详细定时描述符中获取的数据将用于
编程显示控制器
- little-endian（小端模式）: 在大端系统上可用，以
设置不同的字节序
- big-endian（大端模式）: 在小端系统上可用，以
设置不同的字节序
MPC5200 示例：
``` 
display@1,0 {
	compatible = "smi,sm501";
	reg = <1 0x00000000 0x00800000
	       1 0x03e00000 0x00200000>;
	interrupts = <1 1 3>;
	mode = "640x480-32@60";
	edid = [edid-data];
};
```
请注意，`[edid-data]` 需要替换为实际的 EDID 数据。
~~~~

## Documentation/devicetree/bindings/display/snps,arcpgu_cn.txt
~~~~
ARC PGU 是一种显示控制器，可以在由新思科技（Synopsys）生产的多个开发板上找到。ARC PGU 是一个 RGB 流处理器，它从帧缓冲区读取数据，并将其发送到单个数字编码器（通常是 HDMI 编码器）。下面是 ARC PGU 的一些必需属性和子节点：

**必需的属性：**
- `compatible`: 必须为 "snps,arcpgu"
- `reg`: 控制器寄存器的物理基地址及其长度
- `clocks`: 一个 phandle 和时钟指定符对列表，每个条目对应 `clock-names` 中的一个条目
- `clock-names`: 对于 ARC PGU，应该包含：
  - `"pxlclk"`: 用于提供给控制器输出 PLL 的时钟

**必需的子节点：**
- `port`: PGU 到编码器芯片的连接

**示例：**

```device-tree
/ {
	...
	pgu@XXXXXXXX {  // XXXXXXXX 需要替换为实际的十六进制地址
		compatible = "snps,arcpgu";  // 兼容性字符串
		reg = <0xXXXXXXXX 0x400>;  // 控制器寄存器的物理基地址和长度
		clocks = <&clock_node>;  // 时钟节点引用
		clock-names = "pxlclk";  // 时钟名称

		port {  // PGU 连接到编码器芯片的端口
			pgu_output: endpoint {  // 端点名称
				remote-endpoint = <&hdmi_enc_input>;  // 指向 HDMI 编码器输入端点的引用
			};
		};
	};
};
```

请注意，上述示例中的 `0xXXXXXXXX` 和 `&clock_node` 都需要根据实际情况进行替换。例如，`0xXXXXXXXX` 应该被替换成控制器的实际物理基地址，而 `&clock_node` 应指向设备树中定义的时钟节点。
~~~~

## Documentation/devicetree/bindings/display/solomon,ssd-common_cn.yaml
~~~~yaml
```yaml
# SPDX-许可证标识符: (GPL-2.0-only 或 BSD-2-Clause)
%YAML 1.2
---
$id: http://devicetree.org/schemas/display/solomon,ssd-common.yaml#
$schema: http://devicetree.org/meta-schemas/core.yaml#

title: Solomon OLED 显示控制器的通用属性

maintainers:
  - Javier Martinez Canillas <javierm@redhat.com>

properties:
  reg:
    maxItems: 1

  reset-gpios:
    maxItems: 1

  # 仅SPI所需
  dc-gpios:
    description:
      连接到控制器的 D/C#（数据/命令）引脚的 GPIO，这是 4 线 SPI 所需的，用于告诉控制器发送的数据是针对命令寄存器还是显示数据 RAM
    maxItems: 1

  solomon,height:
    $ref: /schemas/types.yaml#/definitions/uint32
    description:
      由控制器驱动的屏幕的高度（以像素为单位）
默认值取决于控制器
  solomon,width:
    $ref: /schemas/types.yaml#/definitions/uint32
    description:
      由控制器驱动的屏幕的宽度（以像素为单位）
默认值取决于控制器
allOf:
  - $ref: /schemas/spi/spi-peripheral-props.yaml#

additionalProperties: true
```

以上是将提供的 YAML 文件内容翻译成了中文。请注意，由于 YAML 是一种结构化数据格式，其中文翻译保持了与原文相同的结构和格式。
~~~~
