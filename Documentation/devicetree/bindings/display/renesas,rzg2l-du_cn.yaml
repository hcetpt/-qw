## Documentation/devicetree/bindings/display/rockchip/rockchip,lvds_cn.yaml
~~~~yaml
```yaml
# SPDX-文件许可人: GPL-2.0
%YAML 1.2
---
$id: http://devicetree.org/schemas/display/rockchip/rockchip,lvds.yaml#
$schema: http://devicetree.org/meta-schemas/core.yaml#

title: Rockchip 低压差分信号 (LVDS) 发射器

maintainers:
  - Sandy Huang <hjc@rock-chips.com>
  - Heiko Stuebner <heiko@sntech.de>

properties:
  compatible:
    enum:
      - rockchip,px30-lvds
      - rockchip,rk3288-lvds

  reg:
    maxItems: 1

  clocks:
    maxItems: 1

  clock-names:
    const: pclk_lvds

  avdd1v0-supply:
    description: 1.0V 模拟电源
  avdd1v8-supply:
    description: 1.8V 模拟电源
  avdd3v3-supply:
    description: 3.3V 模拟电源
  rockchip,grf:
    $ref: /schemas/types.yaml#/definitions/phandle
    description: 通用寄存器文件 syscon 的 phandle
  rockchip,output:
    $ref: /schemas/types.yaml#/definitions/string
    enum: [rgb, lvds, duallvds]
    description: 描述输出接口
  phys:
    maxItems: 1

  phy-names:
    const: dphy

  pinctrl-names:
    const: lcdc

  pinctrl-0: true

  power-domains:
    maxItems: 1

  ports:
    $ref: /schemas/graph.yaml#/properties/ports

    properties:
      port@0:
        $ref: /schemas/graph.yaml#/properties/port
        description:
          视频端口 0 用于 VOP 输入
          远程终端可能是 vopb 或 vopl
      port@1:
        $ref: /schemas/graph.yaml#/properties/port
        description:
          视频端口 1 用于面板或后续编码器
required:
      - port@0
      - port@1

required:
  - compatible
  - rockchip,grf
  - rockchip,output
  - ports

allOf:
  - if:
      properties:
        compatible:
          contains:
            const: rockchip,px30-lvds

    then:
      properties:
        reg: false
        clocks: false
        clock-names: false
        avdd1v0-supply: false
        avdd1v8-supply: false
        avdd3v3-supply: false

      required:
        - phys
        - phy-names

  - if:
      properties:
        compatible:
          contains:
            const: rockchip,rk3288-lvds

    then:
      properties:
        phys: false
        phy-names: false

      required:
        - reg
        - clocks
        - clock-names
        - avdd1v0-supply
        - avdd1v8-supply
        - avdd3v3-supply

additionalProperties: false

examples:
  - |
    #include <dt-bindings/clock/rk3288-cru.h>

    lvds: lvds@ff96c000 {
      compatible = "rockchip,rk3288-lvds";
      reg = <0xff96c000 0x4000>;
      clocks = <&cru PCLK_LVDS_PHY>;
      clock-names = "pclk_lvds";
      avdd1v0-supply = <&vdd10_lcd>;
      avdd1v8-supply = <&vcc18_lcd>;
      avdd3v3-supply = <&vcca_33>;
      pinctrl-names = "lcdc";
      pinctrl-0 = <&lcdc_ctl>;
      rockchip,grf = <&grf>;
      rockchip,output = "rgb";

      ports {
        #address-cells = <1>;
        #size-cells = <0>;

        lvds_in: port@0 {
          reg = <0>;
          #address-cells = <1>;
          #size-cells = <0>;

          lvds_in_vopb: endpoint@0 {
            reg = <0>;
            remote-endpoint = <&vopb_out_lvds>;
          };
          lvds_in_vopl: endpoint@1 {
            reg = <1>;
            remote-endpoint = <&vopl_out_lvds>;
          };
        };

        lvds_out: port@1 {
          reg = <1>;

          lvds_out_panel: endpoint {
            remote-endpoint = <&panel_in_lvds>;
          };
        };
      };
    };
```
请注意，上述翻译已尽可能保持原有结构和格式，并尽量保留了原文件中的注释和描述。
~~~~

## Documentation/devicetree/bindings/display/rockchip/rockchip,rk3066-hdmi_cn.yaml
~~~~yaml
```yaml
# SPDX-许可证标识符: GPL-2.0
%YAML 1.2
---
$id: http://devicetree.org/schemas/display/rockchip/rockchip,rk3066-hdmi.yaml#
$schema: http://devicetree.org/meta-schemas/core.yaml#

title: Rockchip rk3066 HDMI 控制器

maintainers:
  - Sandy Huang <hjc@rock-chips.com>
  - Heiko Stuebner <heiko@sntech.de>

allOf:
  - $ref: /schemas/sound/dai-common.yaml#

properties:
  compatible:
    const: rockchip,rk3066-hdmi

  reg:
    maxItems: 1

  interrupts:
    maxItems: 1

  clocks:
    maxItems: 1

  clock-names:
    const: hclk

  power-domains:
    maxItems: 1

  rockchip,grf:
    $ref: /schemas/types.yaml#/definitions/phandle
    description:
      这个SoC使用GRF寄存器来在vop0和vop1之间切换HDMI TX输入
"#sound-dai-cells":
    const: 0

  ports:
    $ref: /schemas/graph.yaml#/properties/ports

    properties:
      port@0:
        $ref: /schemas/graph.yaml#/properties/port
        description:
          具有两个端点的端口节点，编号为0和1，
          分别连接到vop0和vop1
port@1:
        $ref: /schemas/graph.yaml#/properties/port
        description:
          与一个hdmi-connector节点相连的一个端点的端口节点
required:
      - port@0
      - port@1

required:
  - compatible
  - reg
  - interrupts
  - clocks
  - clock-names
  - pinctrl-0
  - pinctrl-names
  - power-domains
  - rockchip,grf
  - ports

additionalProperties: false

examples:
  - |
    #include <dt-bindings/clock/rk3066a-cru.h>
    #include <dt-bindings/interrupt-controller/arm-gic.h>
    #include <dt-bindings/pinctrl/rockchip.h>
    #include <dt-bindings/power/rk3066-power.h>
    hdmi: hdmi@10116000 {
      compatible = "rockchip,rk3066-hdmi";
      reg = <0x10116000 0x2000>;
      interrupts = <GIC_SPI 64 IRQ_TYPE_LEVEL_HIGH>;
      clocks = <&cru HCLK_HDMI>;
      clock-names = "hclk";
      pinctrl-0 = <&hdmii2c_xfer>, <&hdmi_hpd>;
      pinctrl-names = "default";
      power-domains = <&power RK3066_PD_VIO>;
      rockchip,grf = <&grf>;
      #sound-dai-cells = <0>;

      ports {
        #address-cells = <1>;
        #size-cells = <0>;
        hdmi_in: port@0 {
          reg = <0>;
          #address-cells = <1>;
          #size-cells = <0>;
          hdmi_in_vop0: endpoint@0 {
            reg = <0>;
            remote-endpoint = <&vop0_out_hdmi>;
          };
          hdmi_in_vop1: endpoint@1 {
            reg = <1>;
            remote-endpoint = <&vop1_out_hdmi>;
          };
        };
        hdmi_out: port@1 {
          reg = <1>;
          hdmi_out_con: endpoint {
            remote-endpoint = <&hdmi_con_in>;
          };
        };
      };
    };

    pinctrl {
      hdmi {
        hdmi_hpd: hdmi-hpd {
          rockchip,pins = <0 RK_PA0 1 &pcfg_pull_default>;
        };
        hdmii2c_xfer: hdmii2c-xfer {
          rockchip,pins = <0 RK_PA1 1 &pcfg_pull_none>,
                          <0 RK_PA2 1 &pcfg_pull_none>;
        };
      };
    };
```
请注意，部分注释和结构是根据上下文进行的手动翻译。某些部分（如`"#sound-dai-cells"`）保持原样是因为它们可能代表了特定的设备树属性或约定。
~~~~

## Documentation/devicetree/bindings/display/rockchip/rockchip-drm_cn.yaml
```yaml
# SPDX-许可证标识符: (GPL-2.0-only)
%YAML 1.2
---
$id: http://devicetree.org/schemas/display/rockchip/rockchip-drm.yaml#
$schema: http://devicetree.org/meta-schemas/core.yaml#

标题: Rockchip DRM 主设备

维护者:
  - Sandy Huang <hjc@rock-chips.com>
  - Heiko Stuebner <heiko@sntech.de>

描述: |
  Rockchip DRM 主设备是一个虚拟设备，用于列出构成图形子系统的所有 VOP 设备或其他显示接口节点。
属性:
  compatible:
    常量: rockchip,display-subsystem

  ports:
    $ref: /schemas/types.yaml#/definitions/phandle-array
    items:
      最大项数: 1
    描述: |
      应包含指向 VOP 设备的显示接口端口的 phandle 列表。VOP 定义如在
      文档/devicetree/bindings/display/rockchip/rockchip-vop.yaml 中定义。

必需:
  - compatible
  - ports

附加属性: false

示例:
  - |
    display-subsystem {
        compatible = "rockchip,display-subsystem";
        ports = <&vopl_out>, <&vopb_out>;
    };
```

## Documentation/devicetree/bindings/display/rockchip/rockchip-vop2_cn.yaml
~~~~yaml
# SPDX-许可证标识符: GPL-2.0-only OR BSD-2-Clause
%YAML 1.2
---
$id: http://devicetree.org/schemas/display/rockchip/rockchip-vop2.yaml#
$schema: http://devicetree.org/meta-schemas/core.yaml#

title: Rockchip SoC 显示控制器 (VOP2)

description:
  VOP2（视频输出处理器v2）是Rockchip系列片上系统(SoC)的显示控制器，它将图像数据从视频内存缓冲区传输到外部LCD接口。
maintainers:
  - Sandy Huang <hjc@rock-chips.com>
  - Heiko Stuebner <heiko@sntech.de>

properties:
  compatible:
    enum:
      - rockchip,rk3566-vop
      - rockchip,rk3568-vop
      - rockchip,rk3588-vop

  reg:
    items:
      - description:
          必须包含一个条目，对应于寄存器空间的基本地址和长度
- description:
          可选地包含第二个条目，对应于CRTC伽玛查找表地址
reg-names:
    items:
      - const: vop
      - const: gamma-lut

  interrupts:
    maxItems: 1
    description:
      VOP中断被多个中断源共享，例如帧开始（VSYNC）、行标志和其他状态中断
# 请参阅下面特定兼容性的约束
clocks:
    minItems: 5
    items:
      - description: 用于通过AXI进行DDR缓冲区传输的时钟
- description: 用于读写寄存器的AHB总线时钟
- description: 视频端口0的像素时钟
- description: 视频端口1的像素时钟
- description: 视频端口2的像素时钟
这段文本定义了一个设备树节点，描述了Rockchip RK3588 SoC 中视频输出处理器 (VOP) 的配置。下面是翻译成中文的版本：

### 描述
- **Pixel clock for video port 3**: 视频端口 3 的像素时钟。
- **Peripheral (vop grf/dsi) clock**: VOP GRF/DSI 外设时钟。

### 时钟名称:
- **minItems**: 5
- **items**:
  - **const**: aclk
  - **const**: hclk
  - **const**: dclk_vp0
  - **const**: dclk_vp1
  - **const**: dclk_vp2
  - **const**: dclk_vp3
  - **const**: pclk_vop

### Rockchip,grf:
- **$ref**: 指向 `/schemas/types.yaml` 中定义的 phandle。
- **description**: 用于控制 DPI 的 dclk/hsync/vsync 极性的 GRF 寄存器的 phandle；同时也用于查询 VOP 内存 BISR 启用状态等。

### Rockchip,vo1-grf:
- **$ref**: 指向 `/schemas/types.yaml` 中定义的 phandle。
- **description**: 在 rk3588 上用于控制 HDMI 的 dclk/hsync/vsync 极性的 VO GRF 寄存器的 phandle。

### Rockchip,vop-grf:
- **$ref**: 指向 `/schemas/types.yaml` 中定义的 phandle。
- **description**: 用于控制 vopr 和 HDMI/EDP 之间的数据路径的 VOP GRF 寄存器的 phandle。

### Rockchip,pmu:
- **$ref**: 指向 `/schemas/types.yaml` 中定义的 phandle。
- **description**: 用于查询 rk3588 上 VOP 内存 BISR 状态的 PMU GRF 的 phandle。

### 端口:
- **$ref**: 指向 `/schemas/graph.yaml` 中定义的端口属性。

- **patternProperties**:
  - **"^port@[0-3]$"**:
    - **$ref**: 指向 `/schemas/graph.yaml` 中定义的端口属性。
    - **description**: VP0/1/2/3 的输出端点。

### 必需项:
- **- port@0**

- **unevaluatedProperties**: false

### IOMMU:
- **maxItems**: 1

### 电源域:
- **maxItems**: 1

### 必须包含:
- **compatible**
- **reg**
- **reg-names**
- **interrupts**
- **clocks**
- **clock-names**
- **ports**

### 所有必需项:
- **if**:
  - **properties**:
    - **compatible**:
      - **contains**:
        - **const**: rockchip,rk3588-vop
- **then**:
  - **properties**:
    - **clocks**:
      - **minItems**: 7
    - **clock-names**:
      - **minItems**: 7

    - **ports**:
      - **required**:
        - **port@0**
        - **port@1**
        - **port@2**
        - **port@3**

  - **required**:
    - **rockchip,grf**
    - **rockchip,vo1-grf**
    - **rockchip,vop-grf**
    - **rockchip,pmu**

- **else**:
  - **properties**:
    - **rockchip,vo1-grf**: false
    - **rockchip,vop-grf**: false
    - **rockchip,pmu**: false

    - **clocks**:
      - **maxItems**: 5
    - **clock-names**:
      - **maxItems**: 5

    - **ports**:
      - **required**:
        - **port@0**
        - **port@1**
        - **port@2**

### 其他属性: false

### 示例:
```yaml
#include <dt-bindings/clock/rk3568-cru.h>
#include <dt-bindings/interrupt-controller/arm-gic.h>
#include <dt-bindings/power/rk3568-power.h>
bus {
    #address-cells = <2>;
    #size-cells = <2>;
    vop: vop@fe040000 {
        compatible = "rockchip,rk3568-vop";
        reg = <0x0 0xfe040000 0x0 0x3000>, <0x0 0xfe044000 0x0 0x1000>;
        reg-names = "vop", "gamma-lut";
        interrupts = <GIC_SPI 148 IRQ_TYPE_LEVEL_HIGH>;
        clocks = <&cru ACLK_VOP>,
                 <&cru HCLK_VOP>,
                 <&cru DCLK_VOP0>,
                 <&cru DCLK_VOP1>,
                 <&cru DCLK_VOP2>;
        clock-names = "aclk",
                      "hclk",
                      "dclk_vp0",
                      "dclk_vp1",
                      "dclk_vp2";
        power-domains = <&power RK3568_PD_VO>;
        iommus = <&vop_mmu>;
        vop_out: ports {
            #address-cells = <1>;
            #size-cells = <0>;
            vp0: port@0 {
                reg = <0>;
                #address-cells = <1>;
                #size-cells = <0>;
            };
            vp1: port@1 {
                reg = <1>;
                #address-cells = <1>;
                #size-cells = <0>;
            };
            vp2: port@2 {
                reg = <2>;
                #address-cells = <1>;
                #size-cells = <0>;
            };
        };
    };
};
```
这个示例展示了如何在设备树中配置一个 Rockchip RK3568 的 VOP 模块。
~~~~

## Documentation/devicetree/bindings/display/rockchip/rockchip-vop_cn.yaml
```yaml
# SPDX-许可证标识符: GPL-2.0
%YAML 1.2
---
$id: http://devicetree.org/schemas/display/rockchip/rockchip-vop.yaml#
$schema: http://devicetree.org/meta-schemas/core.yaml#

标题: Rockchip SoC 显示控制器 (VOP)

描述:
  VOP (视频输出处理器) 是为Rockchip系列系统级芯片(SoC)设计的显示控制器，它将图像数据从视频内存缓冲区传输到外部LCD接口。
维护者:
  - Sandy Huang <hjc@rock-chips.com>
  - Heiko Stuebner <heiko@sntech.de>

属性:
  compatible:
    枚举:
      - rockchip,px30-vop-big
      - rockchip,px30-vop-lit
      - rockchip,rk3036-vop
      - rockchip,rk3066-vop
      - rockchip,rk3126-vop
      - rockchip,rk3188-vop
      - rockchip,rk3228-vop
      - rockchip,rk3288-vop
      - rockchip,rk3328-vop
      - rockchip,rk3366-vop
      - rockchip,rk3368-vop
      - rockchip,rk3399-vop-big
      - rockchip,rk3399-vop-lit
      - rockchip,rv1126-vop

  reg:
    minItems: 1
    items:
      - 描述:
          必须包含一个条目，对应于寄存器空间的基本地址和长度
- 描述:
          可选地包含第二个条目，对应于CRTC伽马LUT地址
中断:
    maxItems: 1
    描述:
      VOP中断由多个中断源共享，例如帧开始(VSYNC)，行标志和其他状态中断
时钟:
    items:
      - 描述: 用于DDR缓冲区传输的时钟
- 描述: 像素时钟
- 描述: 用于读写PHY寄存器的AHB总线时钟
时钟名称:
    items:
      - 常量: aclk_vop
      - 常量: dclk_vop
      - 常量: hclk_vop

  resets:
    maxItems: 3

  reset-names:
    items:
      - 常量: axi
      - 常量: ahb
      - 常量: dclk

  端口:
    $ref: /schemas/graph.yaml#/properties/port

  assigned-clocks:
    maxItems: 2

  assigned-clock-rates:
    maxItems: 2

  iommus:
    maxItems: 1

  power-domains:
    maxItems: 1

必需:
  - compatible
  - reg
  - interrupts
  - clocks
  - clock-names
  - resets
  - reset-names
  - port

额外属性: false

示例:
  - |
    #include <dt-bindings/clock/rk3288-cru.h>
    #include <dt-bindings/interrupt-controller/arm-gic.h>
    #include <dt-bindings/power/rk3288-power.h>
    vopb: vopb@ff930000 {
      compatible = "rockchip,rk3288-vop";
      reg = <0xff930000 0x19c>,
            <0xff931000 0x1000>;
      interrupts = <GIC_SPI 15 IRQ_TYPE_LEVEL_HIGH>;
      clocks = <&cru ACLK_VOP0>,
               <&cru DCLK_VOP0>,
               <&cru HCLK_VOP0>;
      clock-names = "aclk_vop", "dclk_vop", "hclk_vop";
      power-domains = <&power RK3288_PD_VIO>;
      resets = <&cru SRST_LCDC1_AXI>,
               <&cru SRST_LCDC1_AHB>,
               <&cru SRST_LCDC1_DCLK>;
      reset-names = "axi", "ahb", "dclk";
      iommus = <&vopb_mmu>;
      vopb_out: port {
        #address-cells = <1>;
        #size-cells = <0>;
        vopb_out_edp: endpoint@0 {
          reg = <0>;
          remote-endpoint = <&edp_in_vopb>;
        };
        vopb_out_hdmi: endpoint@1 {
          reg = <1>;
          remote-endpoint = <&hdmi_in_vopb>;
        };
      };
    };
```

## Documentation/devicetree/bindings/display/samsung/samsung,exynos-hdmi-ddc_cn.yaml
```yaml
# SPDX-许可证标识符: (GPL-2.0-only 或 BSD-2-Clause)
%YAML 1.2
---
$id: http://devicetree.org/schemas/display/samsung/samsung,exynos-hdmi-ddc.yaml#
$schema: http://devicetree.org/meta-schemas/core.yaml#

title: Samsung Exynos 系统级芯片 HDMI DDC

维护者:
  - Inki Dae <inki.dae@samsung.com>
  - Seung-Woo Kim <sw0312.kim@samsung.com>
  - Kyungmin Park <kyungmin.park@samsung.com>
  - Krzysztof Kozlowski <krzk@kernel.org>

属性:
  compatible:
    oneOf:
      - 常量: samsung,exynos4210-hdmiddc
      - 常量: samsung,exynos5-hdmiddc
        过时: true

  reg:
    最大项数: 1

必需:
  - compatible
  - reg

额外属性: false

示例:
  - |
    i2c {
        #address-cells = <1>;
        #size-cells = <0>;

        ddc@50 {
            compatible = "samsung,exynos4210-hdmiddc";
            reg = <0x50>;
        };
    };
```
