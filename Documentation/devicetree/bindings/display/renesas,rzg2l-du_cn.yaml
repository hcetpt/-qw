## Documentation/devicetree/bindings/display/renesas,rzg2l-du_cn.yaml
```yaml
下面是给定内容的中文翻译：

# SPDX-许可证标识符: (GPL-2.0-only 或 BSD-2-Clause)
%YAML 1.2
---
$id: http://devicetree.org/schemas/display/renesas,rzg2l-du.yaml#
$schema: http://devicetree.org/meta-schemas/core.yaml#

标题: Renesas RZ/G2L 显示单元 (DU)

维护者:
  - Biju Das <biju.das.jz@bp.renesas.com>
  - Laurent Pinchart <laurent.pinchart+renesas@ideasonboard.com>

描述: |
  这些设备树绑定描述了嵌入在Renesas RZ/G2L 和 RZ/V2L 系统芯片中的显示单元 (DU)。

属性:
  compatible:
    oneOf:
      - enum:
          - renesas,r9a07g044-du # RZ/G2{L,LC}
      - items:
          - enum:
              - renesas,r9a07g054-du    # RZ/V2L
          - const: renesas,r9a07g044-du # RZ/G2L 备选

  reg:
    maxItems: 1

  interrupts:
    maxItems: 1

  clocks:
    items:
      - description: 主时钟
      - description: 寄存器访问时钟
      - description: 视频时钟

  clock-names:
    items:
      - const: aclk
      - const: pclk
      - const: vclk

  resets:
    maxItems: 1

  power-domains:
    maxItems: 1

  ports:
    $ref: /schemas/graph.yaml#/properties/ports
    description: |
      DU 输出视频端口的连接使用OF图绑定进行建模。端口的数量及其分配取决于具体模型。每个端口应仅有一个终点。
patternProperties:
      "^port@[0-1]$":
        $ref: /schemas/graph.yaml#/properties/port
        unevaluatedProperties: false

    required:
      - port@0

    unevaluatedProperties: false

  renesas,vsps:
    $ref: /schemas/types.yaml#/definitions/phandle-array
    items:
      items:
        - description: 指向处理 DU 通道的 VSP 实例的 phandle
        - description: 在该 VSP 中标识 LIF 实例的通道索引
    description:
      处理 DU 通道内存接口的 VSP 的 phandle 和通道索引对列表。

所需属性:
  - compatible
  - reg
  - interrupts
  - clocks
  - clock-names
  - resets
  - power-domains
  - ports
  - renesas,vsps

additionalProperties: false

示例:
  # RZ/G2L DU
  - |
    #include <dt-bindings/clock/r9a07g044-cpg.h>
    #include <dt-bindings/interrupt-controller/arm-gic.h>

    display@10890000 {
        compatible = "renesas,r9a07g044-du";
        reg = <0x10890000 0x10000>;
        interrupts = <GIC_SPI 152 IRQ_TYPE_LEVEL_HIGH>;
        clocks = <&cpg CPG_MOD R9A07G044_LCDC_CLK_A>,
                 <&cpg CPG_MOD R9A07G044_LCDC_CLK_P>,
                 <&cpg CPG_MOD R9A07G044_LCDC_CLK_D>;
        clock-names = "aclk", "pclk", "vclk";
        resets = <&cpg R9A07G044_LCDC_RESET_N>;
        power-domains = <&cpg>;

        renesas,vsps = <&vspd0 0>;

        ports {
            #address-cells = <1>;
            #size-cells = <0>;

            port@0 {
                reg = <0>;
                endpoint {
                    remote-endpoint = <&dsi0_in>;
                };
            };
            port@1 {
                reg = <1>;
            };
        };
    };
```

## Documentation/devicetree/bindings/display/renesas,shmobile-lcdc_cn.yaml
```yaml
这段 Device Tree 代码描述了瑞萨 (Renesas) SH-Mobile 液晶控制器 (LCDC) 的配置。下面是翻译后的中文版本：

# SPDX-许可证标识符: (GPL-2.0-only 或 BSD-2-Clause)
%YAML 1.2
---
$id: http://devicetree.org/schemas/display/renesas,shmobile-lcdc.yaml#
$schema: http://devicetree.org/meta-schemas/core.yaml#

标题: 瑞萨 SH-Mobile 液晶控制器 (LCDC)

维护者:
  - Laurent Pinchart <laurent.pinchart+renesas@ideasonboard.com>
  - Geert Uytterhoeven <geert+renesas@glider.be>

属性:
  compatible:
    枚举:
      - renesas,r8a7740-lcdc # R-Mobile A1
      - renesas,sh73a0-lcdc  # SH-Mobile AG5

  reg:
    最大项数: 1

  interrupts:
    最大项数: 1

  clocks:
    最小项数: 1
    最大项数: 5
    描述:
      只有功能时钟是必须的。
      部分可选时钟取决于模型（例如，“video”（又名“vou”或“dv_clk”）仅在 R-Mobile A1 上可用）

  clock-names:
    最小项数: 1
    项:
      - 常量: fck
      - 枚举: [ media, lclk, hdmi, video ]
      - 枚举: [ media, lclk, hdmi, video ]
      - 枚举: [ media, lclk, hdmi, video ]
      - 枚举: [ media, lclk, hdmi, video ]

  power-domains:
    最大项数: 1

  ports:
    $ref: /schemas/graph.yaml#/properties/ports

    属性:
      port@0:
        $ref: /schemas/graph.yaml#/properties/port
        描述: LCD 端口（R-Mobile A1 和 SH-Mobile AG5）
        未评估属性: false

      port@1:
        $ref: /schemas/graph.yaml#/properties/port
        描述: HDMI 端口（R-Mobile A1 LCDC1 和 SH-Mobile AG5）
        未评估属性: false

      port@2:
        $ref: /schemas/graph.yaml#/properties/port
        描述: MIPI-DSI 端口（SH-Mobile AG5）
        未评估属性: false

    必需:
      - port@0

    未评估属性: false

必需:
  - compatible
  - reg
  - interrupts
  - clocks
  - clock-names
  - power-domains
  - ports

额外属性: false

allOf:
  - 如果:
      属性:
        compatible:
          包含:
            常量: renesas,r8a7740-lcdc
    那么:
      属性:
        ports:
          属性:
            port@2: false

  - 如果:
      属性:
        compatible:
          包含:
            常量: renesas,sh73a0-lcdc
    那么:
      属性:
        ports:
          必需:
            - port@1
            - port@2

示例:
  - |
    #include <dt-bindings/clock/r8a7740-clock.h>
    #include <dt-bindings/interrupt-controller/arm-gic.h>

    lcd-controller@fe940000 {
        compatible = "renesas,r8a7740-lcdc";
        reg = <0xfe940000 0x4000>;
        interrupts = <GIC_SPI 177 IRQ_TYPE_LEVEL_HIGH>;
        clocks = <&mstp1_clks R8A7740_CLK_LCDC0>,
                 <&cpg_clocks R8A7740_CLK_M3>, <&lcdlclk0_clk>,
                 <&vou_clk>;
        clock-names = "fck", "media", "lclk", "video";
        power-domains = <&pd_a4lc>;

        ports {
            #address-cells = <1>;
            #size-cells = <0>;

            port@0 {
                reg = <0>;

                lcdc0_rgb: endpoint {
                };
            };
        };
    };
```

## Documentation/devicetree/bindings/display/repaper_cn.txt
~~~~
这段文本描述了如何配置Pervasive Displays的RePaper品牌电子墨水显示屏(e-ink)的设备树节点，以便在基于SPI接口的系统中使用。以下是根据提供的内容翻译成中文：

### Pervasive Displays RePaper 品牌电子墨水显示屏 (e-ink)

**必需属性:**
- `compatible`: 
    - 对于1.44英寸显示屏，值为`"pervasive,e1144cs021"`
    - 对于1.9英寸显示屏，值为`"pervasive,e1190cs021"`
    - 对于2.0英寸显示屏，值为`"pervasive,e2200cs021"`
    - 对于2.7英寸显示屏，值为`"pervasive,e2271cs021"`

- `panel-on-gpios`: 时序控制器电源控制
- `discharge-gpios`: 放电控制
- `reset-gpios`: RESET引脚
- `busy-gpios`: BUSY引脚

**对于e2271cs021型号所需的额外属性:**
- `border-gpios`: 边框控制

此驱动程序对应的节点必须是SPI控制器子节点，因此必须指定../spi/spi-bus.txt中描述的所有必需属性。

**可选属性:**
- `pervasive,thermal-zone`: 温度计的热区名称

**示例配置:**

```plaintext
温度传感器节点:
	display_temp: lm75@48 {
		compatible = "lm75b";
		reg = <0x48>;
		#thermal-sensor-cells = <0>;
	};

热区配置:
	thermal-zones {
		display {
			polling-delay-passive = <0>;
			polling-delay = <0>;
			thermal-sensors = <&display_temp>;
		};
	};

2.7英寸显示屏配置:
	papirus27@0{
		compatible = "pervasive,e2271cs021";
		reg = <0>;

		spi-max-frequency = <8000000>;

		panel-on-gpios = <&gpio 23 0>;
		border-gpios = <&gpio 14 0>;
		discharge-gpios = <&gpio 15 0>;
		reset-gpios = <&gpio 24 0>;
		busy-gpios = <&gpio 25 0>;

		pervasive,thermal-zone = "display";
	};
```

这段示例代码展示了如何配置一个2.7英寸的Pervasive Displays RePaper电子墨水显示屏，并关联了一个温度传感器来监测显示屏的温度。
~~~~

## Documentation/devicetree/bindings/display/rockchip/cdn-dp-rockchip_cn.txt
~~~~
### Rockchip RK3399 CDN DisplayPort 的特定扩展

#### 必需的属性：
- `compatible`：必须为 `"rockchip,rk3399-cdn-dp"`。
- `reg`：控制器的物理基地址及其长度。
- `clocks`：根据通用时钟绑定：指向DP时钟的句柄。
- `clock-names`：根据通用时钟绑定：
       必需元素：`"core-clk"` `"pclk"` `"spdif"` `"grf"`。
- `resets`：重置列表，包含句柄和重置规范符对。
- `reset-names`：重置名称字符串。
       必需元素：`"apb"`, `"core"`, `"dptx"`, `"spdif"`。
- `power-domains`：通过指向相应电源域的句柄定义的电源域属性。
- `assigned-clocks`：主时钟，应为 `<&cru SCLK_DP_CORE>`。
- `assigned-clock-rates`：DP核心时钟频率，应为：100000000。
- `rockchip,grf`：此SoC需要设置GRF寄存器，因此需要在此处获取grf。
- `ports`：包含端口节点，其中包含如Documentation/devicetree/bindings/media/video-interfaces.txt中所定义的端点定义。包含两个端点，连接到VOP输出。
- `phys`：根据通用PHY绑定：PHY设备的句柄。
- `extcon`：用于Power Delivery的extcon规范符。
- `#sound-dai-cells`：如果系统使用2个DAI（I2S、SPDIF），则必须为1。

### 示例：

```dt
cdn_dp: dp@fec00000 {
	compatible = "rockchip,rk3399-cdn-dp";
	reg = <0x0 0xfec00000 0x0 0x100000>; // 控制器的基地址和长度
	interrupts = <GIC_SPI 9 IRQ_TYPE_LEVEL_HIGH>; // 中断配置
	clocks = <&cru SCLK_DP_CORE>, <&cru PCLK_DP_CTRL>, // 时钟配置
			 <&cru SCLK_SPDIF_REC_DPTX>, <&cru PCLK_VIO_GRF>;
	clock-names = "core-clk", "pclk", "spdif", "grf"; // 时钟名称
	assigned-clocks = <&cru SCLK_DP_CORE>; // 分配的时钟
	assigned-clock-rates = <100000000>; // DP核心时钟频率
	power-domains = <&power RK3399_PD_HDCP>; // 电源域
	phys = <&tcphy0_dp>, <&tcphy1_dp>; // PHY设备
	resets = <&cru SRST_DPTX_SPDIF_REC>; // 重置配置
	reset-names = "spdif"; // 重置名称
	extcon = <&fusb0>, <&fusb1>; // extcon配置
	rockchip,grf = <&grf>; // GRF配置
	#address-cells = <1>; // 地址单元
	#size-cells = <0>; // 大小单元
	#sound-dai-cells = <1>; // 声音DAI单元数

	ports { // 端口定义
		#address-cells = <1>;
		#size-cells = <0>;

		dp_in: port { // 显示端口
			#address-cells = <1>;
			#size-cells = <0>;
			dp_in_vopb: endpoint@0 { // VOPB输入端点
				reg = <0>;
				remote-endpoint = <&vopb_out_dp>; // 连接到VOPB输出
			};

			dp_in_vopl: endpoint@1 { // VOPL输入端点
				reg = <1>;
				remote-endpoint = <&vopl_out_dp>; // 连接到VOPL输出
			};
		};
	};
};
```

这个示例展示了如何在Device Tree中定义一个Rockchip RK3399 CDN DisplayPort的配置，包括必要的属性和示例值。
~~~~

## Documentation/devicetree/bindings/display/rockchip/rockchip,analogix-dp_cn.yaml
```yaml
# SPDX-许可证标识符: GPL-2.0
%YAML 1.2
---
$id: http://devicetree.org/schemas/display/rockchip/rockchip,analogix-dp.yaml#
$schema: http://devicetree.org/meta-schemas/core.yaml#

标题: Rockchip 对 Analogix 显示端口的特定扩展

维护者:
  - Sandy Huang <hjc@rock-chips.com>
  - Heiko Stuebner <heiko@sntech.de>

属性:
  compatible:
    枚举:
      - rockchip,rk3288-dp
      - rockchip,rk3399-edp

  clocks:
    最小项数: 2
    最大项数: 3

  clock-names:
    最小项数: 2
    项:
      - 常量: dp
      - 常量: pclk
      - 常量: grf

  power-domains:
    最大项数: 1

  resets:
    最大项数: 1

  reset-names:
    常量: dp

  rockchip,grf:
    $引用: /schemas/types.yaml#/definitions/phandle
    描述:
      此SoC利用了GRF寄存器

必需:
  - compatible
  - clocks
  - clock-names
  - resets
  - reset-names
  - rockchip,grf

allOf:
  - $引用: /schemas/display/bridge/analogix,dp.yaml#

未评估属性: false

示例:
  - |
    #include <dt-bindings/clock/rk3288-cru.h>
    #include <dt-bindings/interrupt-controller/arm-gic.h>
    #include <dt-bindings/interrupt-controller/irq.h>
    dp@ff970000 {
      compatible = "rockchip,rk3288-dp";
      reg = <0xff970000 0x4000>;
      interrupts = <GIC_SPI 98 IRQ_TYPE_LEVEL_HIGH>;
      clocks = <&cru SCLK_EDP>, <&cru PCLK_EDP_CTRL>;
      clock-names = "dp", "pclk";
      phys = <&dp_phy>;
      phy-names = "dp";
      resets = <&cru 111>;
      reset-names = "dp";
      rockchip,grf = <&grf>;
      pinctrl-0 = <&edp_hpd>;
      pinctrl-names = "default";

      ports {
        #address-cells = <1>;
        #size-cells = <0>;

        edp_in: port@0 {
          reg = <0>;
          #address-cells = <1>;
          #size-cells = <0>;

          edp_in_vopb: endpoint@0 {
            reg = <0>;
            remote-endpoint = <&vopb_out_edp>;
          };
          edp_in_vopl: endpoint@1 {
            reg = <1>;
            remote-endpoint = <&vopl_out_edp>;
          };
        };

        edp_out: port@1 {
          reg = <1>;

          edp_out_panel: endpoint {
            remote-endpoint = <&panel_in_edp>;
          };
        };
      };
    };
```

## Documentation/devicetree/bindings/display/rockchip/rockchip,dw-hdmi_cn.yaml
```yaml
以下是提供的 YAML 文件翻译成中文：

# SPDX 许可证标识符: (GPL-2.0-only 或 BSD-2-Clause)
%YAML 1.2
---
$id: http://devicetree.org/schemas/display/rockchip/rockchip,dw-hdmi.yaml#
$schema: http://devicetree.org/meta-schemas/core.yaml#

标题: Rockchip DWC HDMI 发送器编码器

维护者:
  - 邵马克 <markyao0591@gmail.com>

描述: |
  HDMI 发送器是一个 Synopsys DesignWare HDMI 1.4 TX 控制器 IP
  加上一个配套的 PHY IP。
allOf:
  - $ref: ../bridge/synopsys,dw-hdmi.yaml#
  - $ref: /schemas/sound/dai-common.yaml#

属性:
  compatible:
    枚举:
      - rockchip,rk3228-dw-hdmi
      - rockchip,rk3288-dw-hdmi
      - rockchip,rk3328-dw-hdmi
      - rockchip,rk3399-dw-hdmi
      - rockchip,rk3568-dw-hdmi

  reg-io-width:
    常量: 4

  avdd-0v9-supply:
    描述:
      0.9V 供电，用于启动 SoC 内部电路。实际的引脚名称
      在不同的 SoC 中各不相同，通常是 HDMI_TX_AVDD_0V9 或有时为
      HDMI_AVDD_1V0。
  avdd-1v8-supply:
    描述:
      1.8V 供电，用于启动 SoC 内部电路。SoC 上的引脚名称
      通常是 HDMI_TX_AVDD_1V8。
clocks:
    最小项目数: 2
    项目:
      - {}
      - {}
      # 下面三个时钟都是可选的，但如果存在，则应按此顺序指定
- 描述: HDMI CEC 控制器主时钟
      - 描述: GRF IO 的电源
      - 描述: 一些 HDMI PHY 的外部时钟（旧时钟名称，已废弃）
      - 描述: 一些 HDMI PHY 的外部时钟（新名称）

  clock-names:
    最小项目数: 2
    项目:
      - {}
      - {}
      - 枚举:
          - cec
          - grf
          - vpll
          - ref
      - 枚举:
          - grf
          - vpll
          - ref
      - 枚举:
          - vpll
          - ref

  phys:
    最大项目数: 1
    描述: HDMI PHY。

  phy-names:
    常量: hdmi

  pinctrl-names:
    描述:
      unwedge pinctrl 入口应当使 DDC SDA 线保持低电平。这是
      为了绕过可能造成 DDC I2C 总线卡住的硬件错误
最小项目数: 1
    项目:
      - 常量: default
      - 常量: unwedge

  power-domains:
    最大项目数: 1

  ports:
    $ref: /schemas/graph.yaml#/properties/ports

    属性:
      port@0:
        $ref: /schemas/graph.yaml#/properties/port
        描述: DWC HDMI TX 的输入
        属性:
          endpoint:
            描述: 连接到 VOP
          endpoint@0:
            描述: 连接到 VOPB
          endpoint@1:
            描述: 连接到 VOPL
      port@1:
        $ref: /schemas/graph.yaml#/properties/port
        描述: DWC HDMI TX 的输出

    必需:
      - port@0
      - port@1

  rockchip,grf:
    $ref: /schemas/types.yaml#/definitions/phandle
    描述:
      指向 GRF 的 phandle 以多路复用 vopl/vopb
"#sound-dai-cells":
    常量: 0

必需:
  - compatible
  - reg
  - reg-io-width
  - clocks
  - clock-names
  - interrupts
  - ports
  - rockchip,grf

未评估的属性: false

示例:
  - |
    #include <dt-bindings/clock/rk3288-cru.h>
    #include <dt-bindings/interrupt-controller/arm-gic.h>
    #include <dt-bindings/interrupt-controller/irq.h>
    #include <dt-bindings/power/rk3288-power.h>

    hdmi: hdmi@ff980000 {
        compatible = "rockchip,rk3288-dw-hdmi";
        reg = <0xff980000 0x20000>;
        reg-io-width = <4>;
        interrupts = <GIC_SPI 103 IRQ_TYPE_LEVEL_HIGH>;
        clocks = <&cru  PCLK_HDMI_CTRL>, <&cru SCLK_HDMI_HDCP>;
        clock-names = "iahb", "isfr";
        ddc-i2c-bus = <&i2c5>;
        power-domains = <&power RK3288_PD_VIO>;
        rockchip,grf = <&grf>;
        #sound-dai-cells = <0>;

        ports {
            #address-cells = <1>;
            #size-cells = <0>;

            port@0 {
                reg = <0>;
                #address-cells = <1>;
                #size-cells = <0>;

                hdmi_in_vopb: endpoint@0 {
                    reg = <0>;
                    remote-endpoint = <&vopb_out_hdmi>;
                };

                hdmi_in_vopl: endpoint@1 {
                    reg = <1>;
                    remote-endpoint = <&vopl_out_hdmi>;
                };
            };

            port@1 {
                reg = <1>;

                hdmi_out_con: endpoint {
                    remote-endpoint = <&hdmi_con_in>;
                };
            };
        };
    };

..
```
