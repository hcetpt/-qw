## Documentation/devicetree/bindings/display/samsung/samsung,exynos5433-decon_cn.yaml
```yaml
以下是提供的 YAML 文件的中文翻译：

---

SPDX 许可证标识符: (GPL-2.0-only 或 BSD-2-Clause)

YAML 1.2
---
$id: http://devicetree.org/schemas/display/samsung/samsung,exynos5433-decon.yaml#
$schema: http://devicetree.org/meta-schemas/core.yaml#

标题: Samsung Exynos5433 SoC 显示和增强控制器 (DECON)

维护者:
  - Inki Dae <inki.dae@samsung.com>
  - Seung-Woo Kim <sw0312.kim@samsung.com>
  - Kyungmin Park <kyungmin.park@samsung.com>
  - Krzysztof Kozlowski <krzk@kernel.org>

描述: |
  DECON (显示和增强控制器) 是针对 Exynos5433 系列 SoC 的显示控制器，它将视频内存缓冲区中的图像数据传输到外部 LCD 接口。
属性:
  compatible:
    枚举:
      - samsung,exynos5433-decon
      - samsung,exynos5433-decon-tv

  clocks:
    最大项数: 11

  clock-names:
    项:
      - 常量: pclk
      - 常量: aclk_decon
      - 常量: aclk_smmu_decon0x
      - 常量: aclk_xiu_decon0x
      - 常量: pclk_smmu_decon0x
      - 常量: aclk_smmu_decon1x
      - 常量: aclk_xiu_decon1x
      - 常量: pclk_smmu_decon1x
      - 常量: sclk_decon_vclk
      - 常量: sclk_decon_eclk
      - 常量: dsd

  interrupts:
    最小项数: 3
    最大项数: 4
    描述: |
      中断取决于工作模式：
       - 视频模式: vsync
       - 命令模式: lcd_sys
       - 具有软件触发的命令模式: lcd_sys, te

  interrupt-names:
    最小项数: 3
    项:
      - 常量: fifo
      - 常量: vsync
      - 常量: lcd_sys
      - 常量: te

  iommus:
    最大项数: 2

  iommu-names:
    项:
      - 常量: m0
      - 常量: m1

  ports:
    $ref: /schemas/graph.yaml#/properties/ports
    描述:
      包含一个与微控制器节点相连的端口
电源域:
    最大项数: 1

  reg:
    最大项数: 1

  samsung,disp-sysreg:
    $ref: /schemas/types.yaml#/definitions/phandle
    描述:
      DISP 系统控制器接口的 phandle
所需属性:
  - compatible
  - clocks
  - clock-names
  - interrupts
  - interrupt-names
  - ports
  - reg

附加属性: false

示例:
  - |
    #include <dt-bindings/clock/exynos5433.h>
    #include <dt-bindings/interrupt-controller/arm-gic.h>

    display-controller@13800000 {
        compatible = "samsung,exynos5433-decon";
        reg = <0x13800000 0x2104>;
        clocks = <&cmu_disp CLK_PCLK_DECON>,
                 <&cmu_disp CLK_ACLK_DECON>,
                 <&cmu_disp CLK_ACLK_SMMU_DECON0X>,
                 <&cmu_disp CLK_ACLK_XIU_DECON0X>,
                 <&cmu_disp CLK_PCLK_SMMU_DECON0X>,
                 <&cmu_disp CLK_ACLK_SMMU_DECON1X>,
                 <&cmu_disp CLK_ACLK_XIU_DECON1X>,
                 <&cmu_disp CLK_PCLK_SMMU_DECON1X>,
                 <&cmu_disp CLK_SCLK_DECON_VCLK>,
                 <&cmu_disp CLK_SCLK_DECON_ECLK>,
                 <&cmu_disp CLK_SCLK_DSD>;
        clock-names = "pclk",
                      "aclk_decon",
                      "aclk_smmu_decon0x",
                      "aclk_xiu_decon0x",
                      "pclk_smmu_decon0x",
                      "aclk_smmu_decon1x",
                      "aclk_xiu_decon1x",
                      "pclk_smmu_decon1x",
                      "sclk_decon_vclk",
                      "sclk_decon_eclk",
                      "dsd";
        power-domains = <&pd_disp>;
        interrupt-names = "fifo", "vsync", "lcd_sys";
        interrupts = <GIC_SPI 201 IRQ_TYPE_LEVEL_HIGH>,
                     <GIC_SPI 202 IRQ_TYPE_LEVEL_HIGH>,
                     <GIC_SPI 203 IRQ_TYPE_LEVEL_HIGH>;
        samsung,disp-sysreg = <&syscon_disp>;
        iommus = <&sysmmu_decon0x>, <&sysmmu_decon1x>;
        iommu-names = "m0", "m1";

        ports {
            #address-cells = <1>;
            #size-cells = <0>;

            port@0 {
                reg = <0>;
                decon_to_mic: endpoint {
                    remote-endpoint = <&mic_to_decon>;
                };
            };
        };
    };
```

## Documentation/devicetree/bindings/display/samsung/samsung,exynos5433-mic_cn.yaml
```yaml
# SPDX-许可证标识符: GPL-2.0-only
%YAML 1.2
---
$id: http://devicetree.org/schemas/display/samsung/samsung,exynos5433-mic.yaml#
$schema: http://devicetree.org/meta-schemas/core.yaml#

标题: Samsung Exynos5433 SoC 移动图像压缩器 (MIC)

维护者:
  - Inki Dae <inki.dae@samsung.com>
  - Seung-Woo Kim <sw0312.kim@samsung.com>
  - Kyungmin Park <kyungmin.park@samsung.com>
  - Krzysztof Kozlowski <krzk@kernel.org>

描述: |
  MIC (移动图像压缩器) 位于 DECON 和 MIPI DSI 之间。MIPI DSI 无法像 DECON 那样传输高分辨率帧数据。MIC 通过在数据通过 MIPI DSI 传输前将其压缩至 1/2 来解决这个问题。压缩后的帧数据必须在面板 PCB 上解压。
属性:
  compatible:
    常量: samsung,exynos5433-mic

  clocks:
    最大项目数: 2

  clock-names:
    项目:
      - 常量: pclk_mic0
      - 常量: sclk_rgb_vclk_to_mic0

  ports:
    $ref: /schemas/graph.yaml#/properties/ports
    描述:
      包含一个连接到 MIC 节点的端口
电源域:
    最大项目数: 1

  reg:
    最大项目数: 1

  samsung,disp-syscon:
    $ref: /schemas/types.yaml#/definitions/phandle
    描述:
      DISP 系统控制器接口的 phandle
必需:
  - compatible
  - clocks
  - clock-names
  - ports
  - reg
  - samsung,disp-syscon

附加属性: false

示例:
  - |
    #include <dt-bindings/clock/exynos5433.h>
    #include <dt-bindings/interrupt-controller/arm-gic.h>

    image-processor@13930000 {
        compatible = "samsung,exynos5433-mic";
        reg = <0x13930000 0x48>;
        clocks = <&cmu_disp CLK_PCLK_MIC0>,
                 <&cmu_disp CLK_SCLK_RGB_VCLK_TO_MIC0>;
        clock-names = "pclk_mic0",
                      "sclk_rgb_vclk_to_mic0";
        power-domains = <&pd_disp>;
        samsung,disp-syscon = <&syscon_disp>;

        ports {
            #address-cells = <1>;
            #size-cells = <0>;

            port@0 {
                reg = <0>;
                mic_to_decon: endpoint {
                    remote-endpoint = <&decon_to_mic>;
                };
            };

            port@1 {
                reg = <1>;
                mic_to_dsi: endpoint {
                    remote-endpoint = <&dsi_to_mic>;
                };
            };
        };
    };
```

## Documentation/devicetree/bindings/display/samsung/samsung,exynos7-decon_cn.yaml
```yaml
下面是给定内容的中文翻译：

# SPDX-许可证标识符: (GPL-2.0-only 或 BSD-2-Clause)
%YAML 1.2
---
$id: http://devicetree.org/schemas/display/samsung/samsung,exynos7-decon.yaml#
$schema: http://devicetree.org/meta-schemas/core.yaml#

标题: Samsung Exynos7 系列系统芯片的显示与增强控制器（DECON）

维护者:
  - Inki Dae <inki.dae@samsung.com>
  - Seung-Woo Kim <sw0312.kim@samsung.com>
  - Kyungmin Park <kyungmin.park@samsung.com>
  - Krzysztof Kozlowski <krzk@kernel.org>

描述: |
  DECON（显示与增强控制器）是针对Exynos7系列系统芯片的显示控制器，它负责将视频内存缓冲区中的图像数据传输到外部LCD接口。

属性:
  compatible:
    常量: samsung,exynos7-decon

  clocks:
    最大项目数: 4

  clock-names:
    项目:
      - 常量: pclk_decon0
      - 常量: aclk_decon0
      - 常量: decon0_eclk
      - 常量: decon0_vclk

  display-timings:
    $ref: ../panel/display-timings.yaml#

  i80-if-timings:
    类型: 对象
    不允许额外属性
    描述: 用于支持LCD I80接口的时序配置
    属性:
      cs-setup:
        $ref: /schemas/types.yaml#/definitions/uint32
        描述:
          地址信号启用到芯片选择信号启用之间有效周期内的时钟周期数
默认值: 0

      wr-active:
        $ref: /schemas/types.yaml#/definitions/uint32
        描述:
          芯片选择信号CS启用期间的有效周期内的时钟周期数
默认值: 1

      wr-hold:
        $ref: /schemas/types.yaml#/definitions/uint32
        描述:
          写入信号禁用到芯片选择信号CS禁用之间有效周期内的时钟周期数
默认值: 0

      wr-setup:
        $ref: /schemas/types.yaml#/definitions/uint32
        描述:
          芯片选择信号CS启用到写入信号启用之间有效周期内的时钟周期数
默认值: 0

  interrupts:
    项目:
      - 描述: FIFO电平
      - 描述: VSYNC
      - 描述: LCD系统

  interrupt-names:
    项目:
      - 常量: fifo
      - 常量: vsync
      - 常量: lcd_sys

  power-domains:
    最大项目数: 1

  reg:
    最大项目数: 1

必需:
  - compatible
  - clocks
  - clock-names
  - interrupts
  - interrupt-names
  - reg

不允许额外属性

示例:
  - |
    #include <dt-bindings/clock/exynos7-clk.h>
    #include <dt-bindings/interrupt-controller/arm-gic.h>

    display-controller@13930000 {
        compatible = "samsung,exynos7-decon";
        reg = <0x13930000 0x1000>;
        interrupt-names = "fifo", "vsync", "lcd_sys";
        interrupts = <GIC_SPI 190 IRQ_TYPE_LEVEL_HIGH>,
                     <GIC_SPI 189 IRQ_TYPE_LEVEL_HIGH>,
                     <GIC_SPI 188 IRQ_TYPE_LEVEL_HIGH>;
        clocks = <&clock_disp 100>, /* PCLK_DECON_INT */
                 <&clock_disp 101>, /* ACLK_DECON_INT */
                 <&clock_disp 102>, /* SCLK_DECON_INT_ECLK */
                 <&clock_disp 103>; /* SCLK_DECON_INT_EXTCLKPLL */
        clock-names = "pclk_decon0",
                      "aclk_decon0",
                      "decon0_eclk",
                      "decon0_vclk";
        pinctrl-0 = <&lcd_clk &pwm1_out>;
        pinctrl-names = "default";
    };
```

## Documentation/devicetree/bindings/display/samsung/samsung,fimd_cn.yaml
~~~~yaml
此文档定义了三星S3C/S5P/Exynos系统级芯片中全互动移动显示(FIMD)的设备树配置。

- **许可证**: GPL-2.0-only
- **YAML版本**: 1.2
- **Schema ID**: `http://devicetree.org/schemas/display/samsung/samsung,fimd.yaml#`
- **Schema**: 基于`http://devicetree.org/meta-schemas/core.yaml#`

### 标题
三星S3C/S5P/Exynos SoC 全互动移动显示 (FIMD)

### 维护者
- Inki Dae <inki.dae@samsung.com>
- Seung-Woo Kim <sw0312.kim@samsung.com>
- Kyungmin Park <kyungmin.park@samsung.com>
- Krzysztof Kozlowski <krzk@kernel.org>

### 属性
- **compatible**:
  - 枚举值:
    - `samsung,s3c2443-fimd`
    - `samsung,s3c6400-fimd`
    - `samsung,s5pv210-fimd`
    - `samsung,exynos3250-fimd`
    - `samsung,exynos4210-fimd`
    - `samsung,exynos5250-fimd`
    - `samsung,exynos5420-fimd`

- **`#address-cells`**:
  - 常量: 1

- **clocks**:
  - 最大项数: 2

- **clock-names**:
  - 项:
    - 常量: `sclk_fimd`
    - 常量: `fimd`

- **display-timings**:
  - 引用: `../panel/display-timings.yaml#`

- **i80-if-timings**:
  - 类型: 对象
  - 额外属性: 不允许
  - 描述: 为LCD I80接口支持的定时配置。
  - 属性:
    - **cs-setup**:
      - 类型: uint32
      - 默认值: 0
      - 描述: 地址信号启用到片选信号启用之间的时钟周期数。
    - **wr-active**:
      - 类型: uint32
      - 默认值: 1
      - 描述: 片选信号启用期间的时钟周期数。
    - **wr-hold**:
      - 类型: uint32
      - 默认值: 0
      - 描述: 写信号失效前片选信号失效后的时钟周期数。
    - **wr-setup**:
      - 类型: uint32
      - 默认值: 0
      - 描述: 片选信号启用到写信号启用之间的时钟周期数。

- **iommus**:
  - 最小项数: 1
  - 最大项数: 2

- **iommu-names**:
  - 项:
    - 常量: `m0`
    - 常量: `m1`

- **interrupts**:
  - 项:
    - 描述: FIFO 水平
    - 描述: VSYNC
    - 描述: LCD 系统

- **interrupt-names**:
  - 项:
    - 常量: `fifo`
    - 常量: `vsync`
    - 常量: `lcd_sys`

- **power-domains**:
  - 最大项数: 1

- **reg**:
  - 最大项数: 1

- **samsung,invert-vden**:
  - 类型: 布尔
  - 描述: 视频使能信号被反转。

- **samsung,invert-vclk**:
  - 类型: 布尔
  - 描述: 视频时钟信号被反转。

- **samsung,sysreg**:
  - 类型: phandle
  - 描述: 指向系统寄存器(syscon)的句柄。

- **`#size-cells`**:
  - 常量: 0

- **patternProperties**:
  - `^port@[0-4]+$`:
    - 引用: `/schemas/graph.yaml#/properties/port`
    - 描述: 包含端口，端口索引:
      - 0 - 用于CAMIF0输入
      - 1 - 用于CAMIF1输入
      - 2 - 用于CAMIF2输入
      - 3 - 用于并行输出
      - 4 - 用于回写接口

### 必需属性
- compatible
- clocks
- clock-names
- interrupts
- interrupt-names
- reg

### 示例
```yaml
#include <dt-bindings/clock/exynos4.h>

fimd@11c00000 {
    compatible = "samsung,exynos4210-fimd";
    interrupt-parent = <&combiner>;
    reg = <0x11c00000 0x20000>;
    interrupt-names = "fifo", "vsync", "lcd_sys";
    interrupts = <11 0>, <11 1>, <11 2>;
    clocks = <&clock CLK_SCLK_FIMD0>, <&clock CLK_FIMD0>;
    clock-names = "sclk_fimd", "fimd";
    power-domains = <&pd_lcd0>;
    iommus = <&sysmmu_fimd0>;
    samsung,sysreg = <&sys_reg>;

    #address-cells = <1>;
    #size-cells = <0>;

    samsung,invert-vden;
    samsung,invert-vclk;

    pinctrl-0 = <&lcd_clk>, <&lcd_data24>;
    pinctrl-names = "default";

    port@3 {
        reg = <3>;

        fimd_dpi_ep: endpoint {
            remote-endpoint = <&lcd_ep>;
        };
    };
};
```

该示例展示了如何在设备树中配置一个三星 Exynos 4210 FIMD 控制器。
~~~~
