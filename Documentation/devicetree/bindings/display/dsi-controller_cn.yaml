## Documentation/devicetree/bindings/display/ingenic,lcd_cn.yaml
```yaml
这段 Device Tree 绑定文档描述了 Ingenic 系列 SoC 中的 LCD 控制器配置。

# 许可证
SPDX 许可证标识符: (GPL-2.0 或 BSD-2-Clause)

%YAML 1.2
---
$id: http://devicetree.org/schemas/display/ingenic,lcd.yaml#
$schema: http://devicetree.org/meta-schemas/core.yaml#

# 标题
title: Ingenic 系列 SoC 的 LCD 控制器

# 维护者
maintainers:
  - Paul Cercueil <paul@crapouillou.net>

# 属性
properties:
  $nodename:
    pattern: "^lcd-controller@[0-9a-f]+$"

  compatible:
    enum:
      - ingenic,jz4740-lcd
      - ingenic,jz4725b-lcd
      - ingenic,jz4760-lcd
      - ingenic,jz4760b-lcd
      - ingenic,jz4770-lcd
      - ingenic,jz4780-lcd

  reg:
    maxItems: 1

  interrupts:
    maxItems: 1

  clocks:
    items:
      - description: 像素时钟
      - description: 模块时钟
    minItems: 1

  clock-names:
    items:
      - const: lcd_pclk
      - const: lcd
    minItems: 1

  port:
    $ref: /schemas/graph.yaml#/properties/port

  ports:
    $ref: /schemas/graph.yaml#/properties/ports

    properties:
      port@0:
        $ref: /schemas/graph.yaml#/properties/port
        description: DPI 输出，用于连接 TFT 面板
      port@8:
        $ref: /schemas/graph.yaml#/properties/port
        description: 连接到图像处理单元 (IPU)（参见 ingenic,ipu.yaml）

# 必需属性
required:
  - compatible
  - reg
  - interrupts
  - clocks
  - clock-names

# 兼容性条件
if:
  properties:
    compatible:
      contains:
        enum:
          - ingenic,jz4740-lcd
          - ingenic,jz4780-lcd
then:
  properties:
    clocks:
      minItems: 2
    clock-names:
      minItems: 2
else:
  properties:
    clocks:
      maxItems: 1
    clock-names:
      maxItems: 1

# 其他属性
additionalProperties: false

# 示例
examples:
  - |
    #include <dt-bindings/clock/ingenic,jz4740-cgu.h>
    lcd-controller@13050000 {
      compatible = "ingenic,jz4740-lcd";
      reg = <0x13050000 0x1000>;

      interrupt-parent = <&intc>;
      interrupts = <30>;

      clocks = <&cgu JZ4740_CLK_LCD_PCLK>, <&cgu JZ4740_CLK_LCD>;
      clock-names = "lcd_pclk", "lcd";

      port {
        endpoint {
          remote-endpoint = <&panel_input>;
        };
      };
    };

  - |
    #include <dt-bindings/clock/ingenic,jz4725b-cgu.h>
    lcd-controller@13050000 {
      compatible = "ingenic,jz4725b-lcd";
      reg = <0x13050000 0x1000>;

      interrupt-parent = <&intc>;
      interrupts = <31>;

      clocks = <&cgu JZ4725B_CLK_LCD>;
      clock-names = "lcd_pclk";

      port {
        endpoint {
          remote-endpoint = <&panel_input>;
        };
      };
    };
```

## Documentation/devicetree/bindings/display/intel,keembay-display_cn.yaml
~~~~yaml
```yaml
# SPDX-许可证标识符: (GPL-2.0-only 或 BSD-2-Clause)
%YAML 1.2
---
$id: http://devicetree.org/schemas/display/intel,keembay-display.yaml#
$schema: http://devicetree.org/meta-schemas/core.yaml#

title: Intel Keem Bay 显示控制器

maintainers:
  - Anitha Chrisanthus <anitha.chrisanthus@intel.com>
  - Edmond J Dea <edmund.j.dea@intel.com>

properties:
  compatible:
    const: intel,keembay-display

  reg:
    items:
      - description: LCD 寄存器范围

  reg-names:
    items:
      - const: lcd

  clocks:
    items:
      - description: LCD 控制器时钟
      - description: pll0 时钟

  clock-names:
    items:
      - const: clk_lcd
      - const: clk_pll0

  interrupts:
    maxItems: 1

  port:
    $ref: /schemas/graph.yaml#/properties/port
    description: 显示输出节点到 DSI
required:
  - compatible
  - reg
  - reg-names
  - clocks
  - clock-names
  - interrupts
  - port

additionalProperties: false

examples:
  - |
    #include <dt-bindings/interrupt-controller/irq.h>
    #include <dt-bindings/interrupt-controller/arm-gic.h>

    display@20930000 {
        compatible = "intel,keembay-display";
        reg = <0x20930000 0x3000>;
        reg-names = "lcd";
        interrupts = <GIC_SPI 33 IRQ_TYPE_LEVEL_HIGH>;
        clocks = <&scmi_clk 0x83>,
                 <&scmi_clk 0x0>;
        clock-names = "clk_lcd", "clk_pll0";

        port {
            disp_out: endpoint {
                remote-endpoint = <&dsi_in>;
            };
        };
    };
```

此文档描述了Intel Keem Bay显示控制器的Device Tree规范，包括兼容性声明、寄存器范围和名称、时钟配置及中断设置等，并提供了一个具体的示例。
~~~~

## Documentation/devicetree/bindings/display/intel,keembay-msscam_cn.yaml
~~~~yaml
```yaml
# SPDX-许可证标识符: (GPL-2.0-only 或 BSD-2-Clause)
%YAML 1.2
---
$id: http://devicetree.org/schemas/display/intel,keembay-msscam.yaml#
$schema: http://devicetree.org/meta-schemas/core.yaml#

title: Intel Keem Bay MSSCAM

maintainers:
  - Anitha Chrisanthus <anitha.chrisanthus@intel.com>
  - Edmond J Dea <edmund.j.dea@intel.com>

description: |
   MSSCAM 控制显示子系统中的本地时钟，包括 LCD 时钟和 MIPI DSI 时钟。它还配置了 LCD 和 MIPI DSI 之间的互联。
properties:
  compatible:
    items:
      - const: intel,keembay-msscam
      - const: syscon

  reg:
    maxItems: 1

  reg-io-width:
    const: 4

required:
  - compatible
  - reg
  - reg-io-width

additionalProperties: false

examples:
  - |
    msscam:msscam@20910000 {
        compatible = "intel,keembay-msscam", "syscon";
        reg = <0x20910000 0x30>;
        reg-io-width = <4>;
    };
```

以上是将给定的 YAML 文件翻译成中文版本。请注意，代码示例中的英文字符串（例如设备树兼容字符串）保持不变，因为它们是特定于硬件的标识符，不需要翻译。
~~~~

## Documentation/devicetree/bindings/display/marvell,pxa2xx-lcdc_cn.txt
~~~~
PXA LCD 控制器
--------------

必需属性：
- `compatible`：必须是以下之一
  - `"marvell,pxa2xx-lcdc"`
  - `"marvell,pxa270-lcdc"`
  - `"marvell,pxa300-lcdc"`
- `reg`：应包含一个寄存器范围（地址和长度）
- `interrupts`：帧缓冲控制器中断
- `clocks`：输入时钟的物理句柄

可选属性：
- `lcd-supply`：一个指向控制LCD电压的电源调节器的物理句柄

必需节点：
- `port`：连接到LCD面板（参见video-interfaces.txt）
  此节点必须设置其属性`bus-width`和`remote-endpoint`

如果面板不是TFT彩色面板，则应在面板中使用`lcd-type`属性指定面板类型。
此面板节点应位于板级DTS文件中。

示例：
```dts
lcd-controller@40500000 {
    compatible = "marvell,pxa2xx-lcdc";
    reg = <0x44000000 0x10000>;
    interrupts = <17>;
    clocks = <&clks CLK_LCD>;

    port {
        lcdb_out: endpoint {
            remote-endpoint = <&panel_in>;
            bus-width = <16>;
        };
    };
};
```
请注意，示例中的`lcdb_out`标签应与实际配置保持一致。如果原始文档中使用的是`lcdb_out`，那么在示例中也应使用`lcdb_out`；如果原始文档中使用的是`lccd_out`或其它标签，则应相应地进行更改。
~~~~

## Documentation/devicetree/bindings/display/marvell,pxa300-gcu_cn.txt
~~~~
PXA3xx 图形控制单元 (GCU) 控制器  
---------------------

必需的属性：
- `compatible`：应为 `"marvell,pxa300-gcu"`。
- `reg`：应包含寄存器范围（地址和长度）。
- `interrupts`：控制器中断。
- `clocks`：指向特定于PXA的输入时钟的句柄。

PXA300 示例配置：

``` 
display-controller@54000000 { 
	compatible = "marvell,pxa300-gcu"; 
	reg = <0x54000000 0x1000>; 
	interrupts = <39>; 
	clocks = <&clks CLK_PXA300_GCU>; 
};
```
这里，`display-controller@54000000` 是设备的节点名称，表示该图形控制单元控制器位于地址 `0x54000000`。`reg` 属性指定了控制器的基地址和大小。`interrupts` 属性定义了与该控制器相关的中断号。最后，`clocks` 属性给出了指向时钟控制器的引用及其具体的时钟类型 `CLK_PXA300_GCU`。
~~~~

## Documentation/devicetree/bindings/display/mediatek/mediatek,aal_cn.yaml
```yaml
# SPDX-License-Identifier: (GPL-2.0-only OR BSD-2-Clause)
%YAML 1.2
---
$id: http://devicetree.org/schemas/display/mediatek/mediatek,aal.yaml#
$schema: http://devicetree.org/meta-schemas/core.yaml#

标题: Mediatek 显示自适应环境光处理器

维护者:
  - 春光 胡 <chunkuang.hu@kernel.org>
  - 菲利普·扎贝尔 <p.zabel@pengutronix.de>

描述: |
  Mediatek 显示自适应环境光处理器（简称 AAL）负责背光节能和提高日光下的可见度。
  AAL 设备节点必须与中央 MMSYS_CONFIG 节点同级。
  关于 MMSYS_CONFIG 的绑定描述，请参阅
  Documentation/devicetree/bindings/arm/mediatek/mediatek,mmsys.yaml 获取详细信息。

属性:
  compatible:
    oneOf:
      - 枚举:
          - mediatek,mt8173-disp-aal
          - mediatek,mt8183-disp-aal
          - mediatek,mt8195-mdp3-aal
      - items:
          - 枚举:
              - mediatek,mt2712-disp-aal
              - mediatek,mt6795-disp-aal
          - 常量: mediatek,mt8173-disp-aal
      - items:
          - 枚举:
              - mediatek,mt8186-disp-aal
              - mediatek,mt8188-disp-aal
              - mediatek,mt8192-disp-aal
              - mediatek,mt8195-disp-aal
              - mediatek,mt8365-disp-aal
          - 常量: mediatek,mt8183-disp-aal

  reg:
    最大项数: 1

  interrupts:
    最大项数: 1

  power-domains:
    描述: 根据由 phandle 指定的电源控制器绑定定义的 phandle 和 PM 域标识符。详情请见
      Documentation/devicetree/bindings/power/power-domain.yaml
时钟:
    items:
      - 描述: AAL 时钟

  mediatek,gce-client-reg:
    描述: 客户端驱动程序的寄存器可以被 GCE 配置，此属性中定义了 4 个参数，例如 GCE 的 phandle、子系统 ID、寄存器偏移量和大小。每个 GCE 子系统 ID 对应一个在头文件 include/dt-bindings/gce/<chip>-gce.h 中定义的客户端
$ref: /schemas/types.yaml#/definitions/phandle-array
    最大项数: 1

必需:
  - compatible
  - reg
  - interrupts
  - power-domains
  - clocks

额外属性: false

示例:
  - |
    #include <dt-bindings/interrupt-controller/arm-gic.h>
    #include <dt-bindings/clock/mt8173-clk.h>
    #include <dt-bindings/power/mt8173-power.h>
    #include <dt-bindings/gce/mt8173-gce.h>

    soc {
        #address-cells = <2>;
        #size-cells = <2>;

        aal@14015000 {
           compatible = "mediatek,mt8173-disp-aal";
           reg = <0 0x14015000 0 0x1000>;
           interrupts = <GIC_SPI 189 IRQ_TYPE_LEVEL_LOW>;
           power-domains = <&scpsys MT8173_POWER_DOMAIN_MM>;
           clocks = <&mmsys CLK_MM_DISP_AAL>;
           mediatek,gce-client-reg = <&gce SUBSYS_1401XXXX 0x5000 0x1000>;
       };
    };
```
