## Documentation/devicetree/bindings/display/dsi-controller_cn.yaml
~~~~yaml
下面是给定文档的中文翻译：

```yaml
# SPDX-许可证标识符: (GPL-2.0-only 或 BSD-2-Clause)
%YAML 1.2
---
$id: http://devicetree.org/schemas/display/dsi-controller.yaml#
$schema: http://devicetree.org/meta-schemas/core.yaml#

标题: DSI 显示面板通用属性

维护者:
  - Linus Walleij <linus.walleij@linaro.org>

描述: |
  本文件定义了适用于 DSI（Display Serial Interface）控制器及其所连接面板的设备树中的通用属性。它本身并不构成一个完整的设备树绑定规范，而是旨在被其他设备树绑定引用。
当从面板设备树绑定中引用时，本文件中定义的属性如下。面板设备树绑定负责定义每个属性是必需的还是可选的。
注意：此绑定关注的是直接连接到主控器而中间没有任何端口图的 DSI 面板。每个 DSI 主控器可以控制一到四个虚拟通道到一个面板。每个虚拟通道应为其虚拟通道编号设置一个“panel”节点及其 reg 属性，通常只有一个虚拟通道，编号为 0。
属性:
  $nodename:
    模式: "^dsi(@.*)?$"

  clock-master:
    类型: 布尔值
    描述:
      如果主机与另一个 DSI 主机一起使用以驱动相同的外设，则应启用此属性。支持此类配置的硬件通常需要两个总线上的数据由同一个时钟驱动。仅控制该时钟的 DSI 主机实例应包含此属性。
"#address-cells":
    常量: 1

  "#size-cells":
    常量: 0

模式属性:
  "^panel@[0-3]$":
    描述: 连接到 DSI 链路的面板
    类型: 对象

    属性:
      reg:
        最小值: 0
        最大值: 3
        描述:
          DSI 外设的虚拟通道编号。必须在 0 到 3 的范围内，因为 DSI 使用 2 位寻址方案。一些 DSI 外设可以响应多个虚拟通道。在这种情况下，reg 属性可以取多个条目，每个虚拟通道一个，对应于外设响应的虚拟通道。
enforce-video-mode:
        类型: 布尔值
        描述:
          最佳选择通常是让面板运行在命令模式下，因为这样可以更好地控制面板硬件。但是出于各种原因，如硬件故障、缺少功能或测试需求，可能需要将能够运行命令模式的面板强制转换为视频模式。
必需:
      - reg

附加属性: 真

示例:
  - |
    #include <dt-bindings/gpio/gpio.h>
    dsi@a0351000 {
        reg = <0xa0351000 0x1000>;
        #address-cells = <1>;
        #size-cells = <0>;
        panel@0 {
            compatible = "sony,acx424akp";
            reg = <0>;
            vddi-supply = <&ab8500_ldo_aux1_reg>;
            reset-gpios = <&gpio2 1 GPIO_ACTIVE_LOW>;
        };
    };
```

请注意，此翻译尽量保持了原文件的结构和格式，并将其中的英文描述翻译成了中文。
~~~~

## Documentation/devicetree/bindings/display/faraday,tve200_cn.yaml
~~~~yaml
```yaml
# SPDX-许可证标识符: (GPL-2.0-only 或 BSD-2-Clause)
%YAML 1.2
---
$id: http://devicetree.org/schemas/display/faraday,tve200.yaml#
$schema: http://devicetree.org/meta-schemas/core.yaml#

title: Faraday 电视编码器 TVE200

maintainers:
  - Linus Walleij <linus.walleij@linaro.org>

properties:
  compatible:
    oneOf:
      - const: faraday,tve200
      - items:
          - const: cortina,gemini-tvc
          - const: faraday,tve200

  reg:
    maxItems: 1

  interrupts:
    minItems: 1

  clock-names:
    items:
      - const: PCLK
      - const: TVE

  clocks:
    minItems: 2

  resets:
    minItems: 1

  port:
    $ref: /schemas/graph.yaml#/properties/port

required:
  - compatible
  - reg
  - interrupts
  - clock-names
  - clocks

additionalProperties: false

examples:
  - |
    #include <dt-bindings/clock/cortina,gemini-clock.h>
    #include <dt-bindings/interrupt-controller/irq.h>
    #include <dt-bindings/reset/cortina,gemini-reset.h>
    display-controller@6a000000 {
      compatible = "faraday,tve200";
      reg = <0x6a000000 0x1000>;
      interrupts = <13 IRQ_TYPE_EDGE_RISING>;
      resets = <&syscon GEMINI_RESET_TVC>;
      clocks = <&syscon GEMINI_CLK_GATE_TVC>,
               <&syscon GEMINI_CLK_TVC>;
      clock-names = "PCLK", "TVE";

      port {
        display_out: endpoint {
          remote-endpoint = <&panel_in>;
        };
      };
    };
```

这段代码描述了一个设备树配置文件的结构，用于定义一个名为 Faraday TVE200 的电视编码器。此配置文件规定了该设备所需的兼容性字符串、寄存器地址范围、中断配置、时钟配置等信息，并给出了一个示例来说明如何在设备树中配置这个电视编码器。
~~~~

## Documentation/devicetree/bindings/display/fsl,dcu_cn.txt
~~~~
Freescale DCU DRM 驱动的设备树绑定

必需属性：
- compatible：应为以下之一
    * "fsl,ls1021a-dcu"
    * "fsl,vf610-dcu"
- reg：DCU寄存器集的地址和长度
- clocks：指向"dcu"和"pix"时钟的句柄（按以下顺序）
            这可以是同一个时钟（例如，LS1021a）
            详情请参阅 ../clocks/clock-bindings.txt
- clock-names：应为"dcu"和"pix"
            详情请参阅 ../clocks/clock-bindings.txt
- big-endian：布尔属性，LS1021A DCU 寄存器采用大端字节序
- port：面板输出的视频端口

可选属性：
- fsl,tcon：指向时序控制器节点的句柄

示例：
```
dcu: dcu@2ce0000 {
    compatible = "fsl,ls1021a-dcu";
    reg = <0x0 0x2ce0000 0x0 0x10000>;
    clocks = <&platform_clk 0>, <&platform_clk 0>;
    clock-names = "dcu", "pix";
    big-endian;
    fsl,tcon = <&tcon>;

    port {
        dcu_out: endpoint {
            remote-endpoint = <&panel_out>;
        };
    };
};
```
~~~~

## Documentation/devicetree/bindings/display/fsl,lcdif_cn.yaml
```yaml
下面是给定内容的中文翻译：

# SPDX-许可证标识符: (GPL-2.0-only 或 BSD-2-Clause)
%YAML 1.2
---
$id: http://devicetree.org/schemas/display/fsl,lcdif.yaml#
$schema: http://devicetree.org/meta-schemas/core.yaml#

标题: Freescale/NXP i.MX 液晶显示接口 (LCDIF)

维护者:
  - Marek Vasut <marex@denx.de>
  - Stefan Agner <stefan@agner.ch>

描述: |
  在Freescale/NXP i.MX 系统级芯片中发现的 (e)LCDIF 显示控制器
属性:
  compatible:
    oneOf:
      - 枚举:
          - fsl,imx23-lcdif
          - fsl,imx28-lcdif
          - fsl,imx6sx-lcdif
          - fsl,imx8mp-lcdif
          - fsl,imx93-lcdif
      - items:
          - 枚举:
              - fsl,imx6sl-lcdif
              - fsl,imx6sll-lcdif
              - fsl,imx6ul-lcdif
              - fsl,imx7d-lcdif
              - fsl,imx8mm-lcdif
              - fsl,imx8mn-lcdif
              - fsl,imx8mq-lcdif
          - 常量: fsl,imx6sx-lcdif

  reg:
    maxItems: 1

  clocks:
    items:
      - 描述: 像素时钟
      - 描述: 总线时钟
      - 描述: 显示AXI时钟
    minItems: 1

  clock-names:
    items:
      - 常量: pix
      - 常量: axi
      - 常量: disp_axi
    minItems: 1

  interrupts:
    items:
      - 描述: LCDIF DMA中断
      - 描述: LCDIF 错误中断
    minItems: 1

  power-domains:
    maxItems: 1

  port:
    $ref: /schemas/graph.yaml#/properties/port
    描述: LCDIF 输出端口

必需:
  - compatible
  - reg
  - clocks
  - interrupts
  - port

额外属性: false

allOf:
  - 如果:
      属性:
        compatible:
          包含:
            常量: fsl,imx6sx-lcdif
    那么:
      属性:
        clocks:
          minItems: 2
          maxItems: 3
        clock-names:
          minItems: 2
          maxItems: 3
      必需:
        - clock-names
  - 如果:
      属性:
        compatible:
          包含:
            枚举:
              - fsl,imx8mp-lcdif
              - fsl,imx93-lcdif
    那么:
      属性:
        clocks:
          minItems: 3
          maxItems: 3
        clock-names:
          minItems: 3
          maxItems: 3
      必需:
        - clock-names
  - 如果:
      not:
        属性:
          compatible:
            包含:
              枚举:
                - fsl,imx6sx-lcdif
                - fsl,imx8mp-lcdif
                - fsl,imx93-lcdif
    那么:
      属性:
        clocks:
          maxItems: 1
        clock-names:
          maxItems: 1
  - 如果:
      属性:
        compatible:
          常量: fsl,imx6sx-lcdif
    那么:
      必需:
        - power-domains
  - 如果:
      属性:
        compatible:
          包含:
            枚举:
              - fsl,imx6sl-lcdif
              - fsl,imx8mm-lcdif
              - fsl,imx8mn-lcdif
              - fsl,imx8mp-lcdif
              - fsl,imx93-lcdif
    那么:
      必需:
        - power-domains
  - 如果:
      属性:
        compatible:
          包含:
            枚举:
              - fsl,imx23-lcdif
    那么:
      属性:
        interrupts:
          minItems: 2
          maxItems: 2
    否则:
      属性:
        interrupts:
          maxItems: 1

示例:
  - |
    #include <dt-bindings/clock/imx6sx-clock.h>
    #include <dt-bindings/interrupt-controller/arm-gic.h>

    display-controller@2220000 {
        compatible = "fsl,imx6sx-lcdif";
        reg = <0x02220000 0x4000>;
        interrupts = <GIC_SPI 5 IRQ_TYPE_LEVEL_HIGH>;
        clocks = <&clks IMX6SX_CLK_LCDIF1_PIX>,
                 <&clks IMX6SX_CLK_LCDIF_APB>,
                 <&clks IMX6SX_CLK_DISPLAY_AXI>;
        clock-names = "pix", "axi", "disp_axi";
        power-domains = <&pd_disp>;

        port {
            endpoint {
                remote-endpoint = <&panel_in>;
            };
        };
    };
```

## Documentation/devicetree/bindings/display/fsl,tcon_cn.txt
~~~~
Freescale TCON 驱动的设备树绑定

所需属性：
- compatible：      应该是下列之一
    * "fsl,vf610-tcon"
- reg：            TCON 寄存器集的地址和长度
- clocks：         根据通用时钟绑定：指向 TCON IPG 时钟的句柄
- clock-names：     根据通用时钟绑定：应为 "ipg"

示例：
``` 
timing-controller@4003d000 {
	compatible = "fsl,vf610-tcon";
	reg = <0x4003d000 0x1000>;
	clocks = <&clks VF610_CLK_TCON0>;
	clock-names = "ipg";
};
```
这段代码描述了一个在地址 `0x4003d000` 开始，长度为 `0x1000` 的 TCON 控制器节点。它指定了与 Freescale VF610 TCON 兼容，并且指定了其使用的时钟为 TCON IPG 时钟。
~~~~

## Documentation/devicetree/bindings/display/google,goldfish-fb_cn.txt
~~~~
这段描述可以翻译为：

### Android 金鱼帧缓冲设备

这是 Android 模拟器中使用的 Android Goldfish 帧缓冲设备。
**必需的属性：**

- `compatible`：应包含 `"google,goldfish-fb"`。
- `reg`         ：<寄存器映射>。
- `interrupts`  ：<中断映射>。

**示例：**

```plaintext
display-controller@1f008000 {
	compatible = "google,goldfish-fb";
	interrupts = <0x10>;
	reg = <0x1f008000 0x100>;
};
```

这里的 `display-controller@1f008000` 表示该设备的基地址，`compatible = "google,goldfish-fb"` 表明了设备兼容性，`interrupts = <0x10>` 定义了中断编号，而 `reg = <0x1f008000 0x100>` 指定了寄存器的范围。
~~~~

## Documentation/devicetree/bindings/display/himax,hx8357d_cn.txt
~~~~
Himax HX8357D 显示屏

此绑定适用于使用 Himax HX8357D 控制器并通过 SPI 模式工作的显示屏，例如适用于 Raspberry Pi 的 Adafruit 3.5" TFT。
必需的属性：
- compatible: "adafruit,yx350hv15", "himax,hx8357d"
- dc-gpios: D/C 引脚
- reg: SPI 总线上该面板的地址

此驱动程序的节点必须是 SPI 控制器的子节点，因此在 ../spi/spi-bus.txt 中描述的所有强制性属性都必须指定。
可选属性：
- rotation: 面板逆时针旋转的角度（0、90、180、270）
- backlight: 面板所连接背光设备的 phandle

示例：
```
display@0{
	compatible = "adafruit,yx350hv15", "himax,hx8357d";
	reg = <0>;
	spi-max-frequency = <32000000>;
	dc-gpios = <&gpio0 25 GPIO_ACTIVE_HIGH>;
	rotation = <90>;
	backlight = <&backlight>;
};
```
~~~~

## Documentation/devicetree/bindings/display/hisilicon/dw-dsi_cn.txt
~~~~
DesignWare DSI 主控制器 v1.20a 驱动的设备树绑定说明：

DSI 主控制器位于显示控制器和外部 HDMI 转换器或面板之间。
必需属性：
- compatible：值应为 "hisilicon,hi6220-dsi"
- reg：DSI 控制器寄存器的物理基地址及其长度
- clocks：包含 APB 时钟的单元句柄和时钟指定符对
- clock-names：应为 "pclk"
- ports：包含 DSI 控制器的输入和输出子端口
输入端口通过 reg 值 "0" 连接到 ADE 输出端口
输出端口的 reg 值为 "1"，它可以连接到面板或其他桥接终端
有关更多设备图信息，请参阅文档/devicetree/bindings/graph.txt
HiKey 板载 hi6220 SoC 和板级特定的设备树示例：
示例：

SoC 特定部分：
```dtb
dsi: dsi@f4107800 {
	compatible = "hisilicon,hi6220-dsi";
	reg = <0x0 0xf4107800 0x0 0x100>;
	clocks = <&media_ctrl  HI6220_DSI_PCLK>;
	clock-names = "pclk";
	status = "disabled";

	ports {
		#address-cells = <1>;
		#size-cells = <0>;

		/* 0 表示输入端口 */
		port@0 {
			reg = <0>;
			dsi_in: endpoint {
				remote-endpoint = <&ade_out>;
			};
		};
	};
};
```

板级特定部分：
```dtb
&dsi {
	status = "ok";

	ports {
		/* 1 表示输出端口 */
		port@1 {
			reg = <1>;

			dsi_out0: endpoint@0 {
				remote-endpoint = <&adv7533_in>;
			};
		};
	};
};

&i2c2 {
	..
```
以上示例展示了如何在设备树中配置 HiKey 板上的 hi6220 SoC 的 DSI 主控制器。它包括了 SoC 级别的配置和板级配置，以确保正确连接显示控制器与外部 HDMI 转换器或面板。
这段文本似乎是设备树源代码的一部分，用于描述硬件组件之间的连接关系。下面是对这段文本的中文翻译：

``` 
adv7533: adv7533@39 {
    ...
    port {
        // adv7533_in 端口定义:
        adv7533_in: endpoint {
            // 与 dsi_out0 远程端点相连
            remote-endpoint = <&dsi_out0>;
        };
    };
};
```

请注意，这个翻译保持了原始代码的结构和格式，并尽量准确地传达了其含义。在实际应用中，“endpoint”、“remote-endpoint”等关键词通常指定了硬件接口或端点之间的连接方式。
~~~~

## Documentation/devicetree/bindings/display/hisilicon/hisi-ade_cn.txt
~~~~
为 Hisilicon ADE 显示控制器驱动程序的设备树绑定

ADE（高级显示引擎）是显示控制器，它从内存中获取图像数据，进行合成、后图像处理、生成RGB时序流，并传输到DSI。
必需属性：
- compatible：值应为 "hisilicon,hi6220-ade"
- reg：ADE 控制器寄存器的物理基地址和长度
- hisilicon,noc-syscon：ADE NOC QoS 系统控制节点
- resets：ADE 重置控制器节点
- interrupt：用于 LDI VBlank 中断的编号
- clocks：一系列 phandle + 时钟指定符对，对应于 clock-names 中的每一项
- clock-names：应包含：
  "clk_ade_core" —— 对于 ADE 核心时钟
  "clk_codec_jpeg" —— 对于媒体 NOC QoS 时钟，其与 JPEG 编码器使用相同的时钟
  "clk_ade_pix" —— 对于 ADE 像素时钟
以下内容为设备树配置示例中的属性描述及一个HiKey板载hi6220系统级芯片特定的设备树（Device Tree，简称DT）条目示例。

- `assigned-clocks`: 应包含"clk_ade_core"和"clk_codec_jpeg"时钟及其对应的phandle+时钟标识符对。
- `assigned-clock-rates`: 时钟速率，对应`assigned-clocks`中的每一项。例如："clk_ade_core"的速率可以是"360000000"或"180000000"；"clk_codec_jpeg"的速率可以是"1440000000"或更低。这些速率值可以根据性能和功耗需求进行配置。
- `port`: 输出端口。该端口包含一个子节点endpoint，其`remote-endpoint`被设置为连接的DSI输入端点的phandle。
  
更多关于设备图（device graph）的信息，请参阅文档`Documentation/devicetree/bindings/graph.txt`。

可选属性：
- `dma-coherent`: 如果DMA操作是连贯的，则存在此属性。

下面是一个HiKey板载hi6220系统级芯片特定的设备树条目的示例：

```text
ade: ade@f4100000 { // 设备标识符
    compatible = "hisilicon,hi6220-ade"; // 兼容性声明
    reg = <0x0 0xf4100000 0x0 0x7800>; // 寄存器基址范围
    reg-names = "ade_base"; // 寄存器名称
    hisilicon,noc-syscon = <&medianoc_ade>; // NoC系统控制节点
    resets = <&media_ctrl MEDIA_ADE>; // 重置控制
    interrupts = <0 115 4>; // 中断信息

    clocks = <&media_ctrl HI6220_ADE_CORE>,
             <&media_ctrl HI6220_CODEC_JPEG>,
             <&media_ctrl HI6220_ADE_PIX_SRC>; // 时钟源
    clock-names  = "clk_ade_core", // 时钟名称
                   "clk_codec_jpeg",
                   "clk_ade_pix";

    assigned-clocks = <&media_ctrl HI6220_ADE_CORE>, // 分配的时钟
                       <&media_ctrl HI6220_CODEC_JPEG>;
    assigned-clock-rates = <360000000>, <288000000>; // 分配的时钟速率
    dma-coherent; // DMA一致性

    port { // 输出端口
        ade_out: endpoint { // 端点
            remote-endpoint = <&dsi_in>; // 远程端点
        };
    };
};
```

请注意，上述示例中`assigned-clock-rates`的值仅为示例，并且根据具体应用场景可能需要调整。
~~~~

## Documentation/devicetree/bindings/display/ilitek,ili9225_cn.txt
~~~~
Ilitek ILI9225 显示屏面板

此绑定适用于使用 Ilitek ILI9225 控制器并处于 SPI 模式的显示屏面板。
必需的属性：
- compatible: "vot,v220hf01a-t", "ilitek,ili9225"
- rs-gpios: 寄存器选择信号
- reset-gpios: 重置引脚

此驱动程序的节点必须是 SPI 控制器子节点，因此在 ../spi/spi-bus.txt 中描述的所有强制性属性都必须指定。
可选属性：
- rotation: 逆时针方向的面板旋转角度（0、90、180、270）

示例：
``` 
display@0 {
	compatible = "vot,v220hf01a-t", "ilitek,ili9225";
	reg = <0>;
	spi-max-frequency = <12000000>;
	rs-gpios = <&gpio0 9 GPIO_ACTIVE_HIGH>;
	reset-gpios = <&gpio0 8 GPIO_ACTIVE_HIGH>;
	rotation = <270>;
};
```
~~~~

## Documentation/devicetree/bindings/display/ilitek,ili9486_cn.yaml
```yaml
# SPDX-许可证标识符: GPL-2.0-only
%YAML 1.2
---
$id: http://devicetree.org/schemas/display-ilitek,ili9486.yaml#
$schema: http://devicetree.org/meta-schemas/core.yaml#

标题: Ilitek ILI9486 显示屏

维护者:
  - Kamlesh Gurudasani <kamlesh.gurudasani@gmail.com>

描述:
  此绑定适用于使用 Ilitek ILI9486 控制器以 SPI 模式运行的显示屏
allOf:
  - $ref: panel/panel-common.yaml#

属性:
  compatible:
    items:
      - enum:
          # Waveshare 3.5" 320x480 彩色 TFT LCD
          - waveshare,rpi-lcd-35
          # Ozzmaker 3.5" 320x480 彩色 TFT LCD
          - ozzmaker,piscreen
      - const: ilitek,ili9486

  spi-max-frequency:
    maximum: 32000000

  dc-gpios:
    maxItems: 1
    描述: 显示数据/命令选择 (D/CX)

  backlight: 真
  reg: 真
  reset-gpios: 真
  rotation: 真

必需:
  - compatible
  - reg
  - dc-gpios
  - reset-gpios

附加属性: 假

示例:
  - |
    #include <dt-bindings/gpio/gpio.h>

    spi {
            #address-cells = <1>;
            #size-cells = <0>;


            display@0{
                    compatible = "waveshare,rpi-lcd-35", "ilitek,ili9486";
                    reg = <0>;
                    spi-max-frequency = <32000000>;
                    dc-gpios = <&gpio0 24 GPIO_ACTIVE_HIGH>;
                    reset-gpios = <&gpio0 25 GPIO_ACTIVE_HIGH>;
                    rotation = <180>;
                    backlight = <&backlight>;
            };
    };

..
```
