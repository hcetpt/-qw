## Documentation/devicetree/bindings/display/imx/fsl,imx-lcdc_cn.yaml
```yaml
这段 Device Tree 配置描述了 Freescale i.MX 系列处理器中的 LCD 控制器，该控制器在 i.MX1、i.MX21、i.MX25 和 i.MX27 芯片中可以找到。

- **维护者**：
  - Sascha Hauer <s.hauer@pengutronix.de>
  - Pengutronix Kernel Team <kernel@pengutronix.de>

- **兼容性**：
  - `fsl,imx1-fb`：适用于 i.MX1。
  - `fsl,imx21-fb`：适用于 i.MX21。
  - `fsl,imx25-fb`：适用于 i.MX25。
  - `fsl,imx27-fb`：适用于 i.MX27。
  - `fsl,imx1-lcdc` 和 `fsl,imx21-lcdc`：专为 i.MX1 和 i.MX21 设计的 LCD 控制器。

- **属性**：
  - **compatible**：指定兼容性字符串。
  - **clocks**：最多支持三个时钟源。
  - **clock-names**：指定时钟名称，包括 IPG、AHB 和 PER。
  - **port**：定义一个端口用于连接外部设备。
  - **display**：指向显示设备的句柄。
  - **interrupts**：最多包含一个中断项。
  - **reg**：定义寄存器地址和大小。
  - **lcd-supply**：LCD 电源电压调节器。
  - **fsl,dmacr**：DMA 控制寄存器值。
  - **fsl,lpccr**：对比度控制寄存器值。
  - **fsl,lscr1**：LCDC 锐化配置寄存器值。

- **条件**：
  - 如果兼容性设置为 `fsl,imx1-lcdc` 或 `fsl,imx21-lcdc`，则不需要 `display`、`fsl,dmacr`、`fsl,lpccr` 和 `fsl,lscr1` 属性，并且必须有 `port` 属性。
  - 否则，`port` 属性无效，并且必须提供 `display` 属性。

- **必需属性**：
  - `compatible`
  - `clocks`
  - `clock-names`
  - `interrupts`
  - `reg`

- **示例**：
  - **示例 1**：i.MX25 的 LCD 控制器配置。
    - 兼容性：`fsl,imx25-lcdc`, `fsl,imx21-lcdc`
    - 寄存器地址：0x53fbc000
    - 中断：IRQ 39
    - 时钟源：IPG、AHB、PER
    - 端口：连接到面板输入端点。
  - **示例 2**：i.MX21 显示帧缓冲配置。
    - 兼容性：`fsl,imx21-fb`
    - 中断：IRQ 61
    - 寄存器地址：0x10021000
    - 显示设备：指向 `display0`
    - 时钟源：IPG、AHB、PER
  - **示例 3**：`display0` 显示设备配置。
    - 模型：Primeview-PD050VL1
    - 每像素位数：16
    - PCR 寄存器值：非标准但需要
    - 显示定时信息：包括分辨率、前/后门廊、同步长度等。
```

## Documentation/devicetree/bindings/display/imx/fsl,imx6-hdmi_cn.yaml
```yaml
下面是给定内容的中文翻译：

# SPDX-文件许可标识符: (GPL-2.0-only 或 BSD-2-Clause)
%YAML 1.2
---
$id: http://devicetree.org/schemas/display/imx/fsl,imx6-hdmi.yaml#
$schema: http://devicetree.org/meta-schemas/core.yaml#

标题: Freescale i.MX6 DWC HDMI 发送器编码器

维护者:
  - Philipp Zabel <p.zabel@pengutronix.de>

描述: |
  HDMI 发送器是一个 Synopsys DesignWare HDMI 1.4 TX 控制器 IP，附带一个配套的 PHY IP。

全部符合:
  - $ref: ../bridge/synopsys,dw-hdmi.yaml#

属性:
  compatible:
    枚举:
      - fsl,imx6dl-hdmi
      - fsl,imx6q-hdmi

  reg-io-width:
    常量: 1

  clocks:
    最大项数: 2

  clock-names:
    最大项数: 2

  gpr:
    $ref: /schemas/types.yaml#/definitions/phandle
    描述:
      指向包含 HDMI 复用器控制寄存器的 iomuxc-gpr 区域的 phandle
端口:
    $ref: /schemas/graph.yaml#/properties/ports
    描述: |
      该设备有四个视频端口，对应 HDMI 复用器的四个输入。每个端口应具有一个终端点
属性:
      port@0:
        $ref: /schemas/graph.yaml#/properties/port
        描述: HDMI 复用器的第一个输入

      port@1:
        $ref: /schemas/graph.yaml#/properties/port
        描述: HDMI 复用器的第二个输入

      port@2:
        $ref: /schemas/graph.yaml#/properties/port
        描述: HDMI 复用器的第三个输入

      port@3:
        $ref: /schemas/graph.yaml#/properties/port
        描述: HDMI 复用器的第四个输入

    任一符合:
      - 必须:
          - port@0
      - 必须:
          - port@1
      - 必须:
          - port@2
      - 必须:
          - port@3

必需:
  - compatible
  - reg
  - clocks
  - clock-names
  - gpr
  - interrupts
  - ports

未评估属性: false

示例:
  - |
    #include <dt-bindings/clock/imx6qdl-clock.h>

    hdmi: hdmi@120000 {
        reg = <0x00120000 0x9000>;
        interrupts = <0 115 0x04>;
        gpr = <&gpr>;
        clocks = <&clks IMX6QDL_CLK_HDMI_IAHB>,
                 <&clks IMX6QDL_CLK_HDMI_ISFR>;
        clock-names = "iahb", "isfr";

        ports {
            #address-cells = <1>;
            #size-cells = <0>;

            port@0 {
                reg = <0>;

                hdmi_mux_0: 终端点 {
                    remote-endpoint = <&ipu1_di0_hdmi>;
                };
            };

            port@1 {
                reg = <1>;

                hdmi_mux_1: 终端点 {
                    remote-endpoint = <&ipu1_di1_hdmi>;
                };
            };
        };
    };

..
```

## Documentation/devicetree/bindings/display/imx/fsl,imx8mp-hdmi-pvi_cn.yaml
```yaml
下面是给定内容的中文翻译：

# SPDX-文件许可标识符: (GPL-2.0-only 或 BSD-2-Clause)
%YAML 1.2
---
$id: http://devicetree.org/schemas/display/imx/fsl,imx8mp-hdmi-pvi.yaml#
$schema: http://devicetree.org/meta-schemas/core.yaml#

title: Freescale i.MX8MP HDMI 并行视频接口

maintainers:
  - Lucas Stach <l.stach@pengutronix.de>

description:
  HDMI 并行视频接口是 i.MX8MP 系统级芯片中位于视频源和 HDMI 发送控制器之间的时序与同步生成模块。

properties:
  compatible:
    const: fsl,imx8mp-hdmi-pvi

  reg:
    maxItems: 1

  interrupts:
    maxItems: 1

  power-domains:
    maxItems: 1

  ports:
    $ref: /schemas/graph.yaml#/properties/ports

    properties:
      port@0:
        $ref: /schemas/graph.yaml#/properties/port
        description: 来自 LCDIF 控制器的输入
      port@1:
        $ref: /schemas/graph.yaml#/properties/port
        description: 输出到 HDMI 发送控制器

required:
  - compatible
  - reg
  - interrupts
  - power-domains
  - ports
  - port@0
  - port@1

additionalProperties: false

examples:
  - |
    #include <dt-bindings/interrupt-controller/irq.h>
    #include <dt-bindings/power/imx8mp-power.h>

    display-bridge@32fc4000 {
        compatible = "fsl,imx8mp-hdmi-pvi";
        reg = <0x32fc4000 0x44>;
        interrupt-parent = <&irqsteer_hdmi>;
        interrupts = <12 IRQ_TYPE_LEVEL_HIGH>;
        power-domains = <&hdmi_blk_ctrl IMX8MP_HDMIBLK_PD_PVI>;

        ports {
            #address-cells = <1>;
            #size-cells = <0>;

            port@0 {
                reg = <0>;
                pvi_from_lcdif3: endpoint {
                    remote-endpoint = <&lcdif3_to_pvi>;
                };
            };

            port@1 {
                reg = <1>;
                pvi_to_hdmi_tx: endpoint {
                    remote-endpoint = <&hdmi_tx_from_pvi>;
                };
            };
        };
    };
```

## Documentation/devicetree/bindings/display/imx/fsl-imx-drm_cn.txt
~~~~
Freescale i.MX DRM 主设备
=======================

Freescale i.MX DRM 主设备是一个虚拟设备，用于列出构成图形子系统的所有 IPU 或其他显示接口节点。
必需属性：
- compatible：应为 "fsl,imx-display-subsystem"
- ports：应包含指向 IPU 设备的显示接口端口的句柄列表

示例：

```text
display-subsystem {
	compatible = "fsl,imx-display-subsystem";
	ports = <&ipu_di0>;
};
```

Freescale i.MX IPUv3
====================

必需属性：
- compatible：应为 "fsl,<chip>-ipu" 其中 <chip> 可以是
  - imx51
  - imx53
  - imx6q
  - imx6qp
- reg：应按照数据手册中的说明设置寄存器基址和长度
- interrupts：应包含同步中断和错误中断，顺序如上
- resets：指向系统复位控制器的句柄及其复位行索引，详情参见 reset/fsl,imx-src.txt
对于 fsl,imx6qp-ipu 的额外必需属性：
- fsl,prg：指向与此 IPU 实例关联的 prg 节点的句柄
可选属性：
- port@[0-3]：具有端点定义的端口节点，定义参见 Documentation/devicetree/bindings/media/video-interfaces.txt
端口 0 和 1 应对应于 CSI0 和 CSI1，端口 2 和 3 应分别对应于 DI0 和 DI1

示例：

```text
ipu: ipu@18000000 {
	#address-cells = <1>;
	#size-cells = <0>;
	compatible = "fsl,imx53-ipu";
	reg = <0x18000000 0x080000000>;
	interrupts = <11 10>;
	resets = <&src 2>;

	ipu_di0: port@2 {
		reg = <2>;

		ipu_di0_disp0: endpoint {
			remote-endpoint = <&display_in>;
		};
	};
};
```

Freescale i.MX PRE（预取解析引擎）
==================================

必需属性：
- compatible：应为 "fsl,imx6qp-pre"
- reg：应按照数据手册中的说明设置寄存器基址和长度
- clocks ：指向 PRE axi 时钟输入的句柄，如在 Documentation/devicetree/bindings/clock/clock-bindings.txt 和 Documentation/devicetree/bindings/clock/imx6q-clock.yaml 中所述
- clock-names：应为 "axi"
- interrupts：应包含 PRE 中断
- fsl,iram：指向 mmio-sram 设备节点的句柄，该节点应用于 PRE SRAM 双缓冲

示例：

```text
pre@21c8000 {
	compatible = "fsl,imx6qp-pre";
	reg = <0x021c8000 0x1000>;
	interrupts = <GIC_SPI 90 IRQ_TYPE_EDGE_RISING>;
	clocks = <&clks IMX6QDL_CLK_PRE0>;
	clock-names = "axi";
	fsl,iram = <&ocram2>;
};
```

Freescale i.MX PRG（预取解析衬垫）
==================================

必需属性：
- compatible：应为 "fsl,imx6qp-prg"
- reg：应按照数据手册中的说明设置寄存器基址和长度
- clocks ：指向 PRG ipg 和 axi 时钟输入的句柄，如在 Documentation/devicetree/bindings/clock/clock-bindings.txt 和 Documentation/devicetree/bindings/clock/imx6q-clock.yaml 中所述
- clock-names：应为 "ipg" 和 "axi"
- fsl,pres：指向连接到此 PRG 的 PRE 单元的句柄，固定 PRE 作为第一个条目，随后是可选 PRE

示例：

```text
prg@21cc000 {
	compatible = "fsl,imx6qp-prg";
	reg = <0x021cc000 0x1000>;
	clocks = <&clks IMX6QDL_CLK_PRG0_APB>,
		 <&clks IMX6QDL_CLK_PRG0_AXI>;
	clock-names = "ipg", "axi";
	fsl,pres = <&pre1>, <&pre2>, <&pre3>;
};
```

并行显示支持
=============

必需属性：
- compatible：应为 "fsl,imx-parallel-display"
可选属性：
- interface-pix-fmt：此显示如何连接到显示接口。当前支持的类型："rgb24"、"rgb565"、"bgr666" 和 "lvds666"
- edid：描述连接显示的逐字 EDID 数据块
这段 Device Tree 代码描述了一个显示控制器（`disp0`）及其与输入端口（IPU 显示接口）和输出端口（面板）的连接。下面是这段配置的中文翻译：

- `ddc`: 描述处理显示数据通道的 I²C 总线的节点句柄。

- `port@[0-1]`: 根据 `Documentation/devicetree/bindings/media/video-interfaces.txt` 中定义的端口节点，其中包含了端点定义。端口 0 是连接到 IPU 显示接口的输入端口；端口 1 是连接到面板的输出端口。
  
示例：

```plaintext
disp0 { 
	compatible = "fsl,imx-parallel-display"; 
	edid = [edid-data]; 
	interface-pix-fmt = "rgb24"; 

	port@0 { 
		reg = <0>; 

		display_in: endpoint { 
			remote-endpoint = <&ipu_di0_disp0>; 
		}; 
	}; 

	port@1 { 
		reg = <1>; 

		display_out: endpoint { 
			remote-endpoint = <&panel_in>; 
		}; 
	}; 
}; 

panel { 
	... 
	port { 
		panel_in: endpoint { 
			remote-endpoint = <&display_out>; 
		}; 
	}; 
};
```

- `disp0`: 显示控制器的节点名称。
- `compatible = "fsl,imx-parallel-display";`: 指定此设备兼容的型号为 FSL 的 i.MX 平行显示控制器。
- `edid`: 包含 EDID 数据，这些数据通常用于提供关于显示器的信息，如制造商、最大分辨率等。
- `interface-pix-fmt`: 设置像素格式为 RGB24。
- `port@0` 和 `port@1`: 分别表示输入端口和输出端口。
- `reg = <0>` 和 `reg = <1>`: 定义了端口编号。
- `display_in` 和 `display_out`: 定义了端点，并指定了远程端点。`display_in` 连接到 IPU 显示接口 (`<&ipu_di0_disp0>`), 而 `display_out` 连接到面板 (`<&panel_in>`).
- `panel`: 面板节点，包含与 `display_out` 端口相连的端点定义。
~~~~

## Documentation/devicetree/bindings/display/imx/ldb_cn.txt
~~~~
LVDS 显示桥接器的设备树绑定 (ldb)

LVDS 显示桥接器
==============

LVDS 显示桥接器的设备树节点最多包含两个 `lvds-channel` 节点，描述桥接器中每个 LVDS 编码器通道。

**必需属性**：
- `#address-cells`：应为 `<1>`。
- `#size-cells`：应为 `<0>`。
- `compatible`：应为 `"fsl,imx53-ldb"` 或 `"fsl,imx6q-ldb"`。两种 LDB 版本相似，但 i.MX6 中有一个额外的多路复用器用于选择四个 IPU 显示接口中的任何一个作为每个 LVDS 通道的输入。
- `gpr`：在 i.MX53 和 i.MX6q 上应为 `<&gpr>`。phandle 指向包含 LVDS 控制寄存器的 iomuxc-gpr 区域。
- `clocks`, `clock-names`：指向 LDB 分频器和选择器时钟以及显示接口选择器时钟的 phandle，具体描述参见 `Documentation/devicetree/bindings/clock/clock-bindings.txt`。
  - 在 i.MX53 上期望的时钟有：
    - `"di0_pll"` - LDB LVDS 通道 0 多路复用器
    - `"di1_pll"` - LDB LVDS 通道 1 多路复用器
    - `"di0"` - LDB LVDS 通道 0 门控
    - `"di1"` - LDB LVDS 通道 1 门控
    - `"di0_sel"` - IPU1 DI0 多路复用器
    - `"di1_sel"` - IPU1 DI1 多路复用器
  - 在 i.MX6q 上还需要以下附加时钟：
    - `"di2_sel"` - IPU2 DI0 多路复用器
    - `"di3_sel"` - IPU2 DI1 多路复用器
  - 各自所需的时钟编号记录在 `Documentation/devicetree/bindings/clock/imx5-clock.yaml` 和 `Documentation/devicetree/bindings/clock/imx6q-clock.yaml` 中。

**可选属性**：
- `pinctrl-names`：在 i.MX53 上应为 `"default"`，在 i.MX6q 上不使用。
- `pinctrl-0`：指向 i.MX53 上 LVDS 引脚设置的 phandle，在 i.MX6q 上不使用。
- `fsl,dual-channel`：布尔值。如果存在，则只应配置 LVDS 通道 0 —— 双通道模式下，一个输入将被分配到两个输出上。

LVDS 通道
=========

每个 LVDS 通道都必须包含指向面板设备节点的 of 图形链接或描述连接的 LVDS 显示视频定时的 `display-timings` 节点，以及 `fsl,data-mapping` 和 `fsl,data-width` 属性。

**必需属性**：
- `reg`：应为 `<0>` 或 `<1>`。
- `port`：输入和输出端口节点，其定义遵循 `Documentation/devicetree/bindings/graph.txt` 中的端点定义。
  - 在 i.MX5 上，内部双输入多路复用器被使用。由于硬件限制，每个通道只能使用一个输入端口（`port@[0,1]`）。
  - 在 i.MX6 上，应该有四个输入端口（`port@[0-3]`），对应于四个 LVDS 多路复用器输入。
一个输出端口（i.MX5上的`port@2`，i.MX6上的`port@4`）必须连接到面板的输入端口。如果使用`display-timings`代替，则可以选择性地省略该输出端口。

可选属性（如果使用`display-timings`则为必需）：
- `ddc-i2c-bus`：用于DDC EDID探测的I2C控制器的phandle
- `display-timings`：描述显示时序的节点，具体定义参见`Documentation/devicetree/bindings/display/panel/display-timing.txt`
- `fsl,data-mapping`：应为"spwg"或"jeida"。这描述了颜色位在序列化的LVDS信号中的布局方式。
- `fsl,data-width`：应为`<18>`或`<24>`。

示例：

```dtl
gpr: iomuxc-gpr@53fa8000 {
	/* ... */
};

ldb: ldb@53fa8008 {
	#address-cells = <1>;
	#size-cells = <0>;
	compatible = "fsl,imx53-ldb";
	gpr = <&gpr>;
	clocks = <&clks IMX5_CLK_LDB_DI0_SEL>,
		 <&clks IMX5_CLK_LDB_DI1_SEL>,
		 <&clks IMX5_CLK_IPU_DI0_SEL>,
		 <&clks IMX5_CLK_IPU_DI1_SEL>,
		 <&clks IMX5_CLK_LDB_DI0_GATE>,
		 <&clks IMX5_CLK_LDB_DI1_GATE>;
	clock-names = "di0_pll", "di1_pll",
		      "di0_sel", "di1_sel",
		      "di0", "di1";

	/* 通过of-graph端点链接来连接面板 */
	lvds-channel@0 {
		#address-cells = <1>;
		#size-cells = <0>;
		reg = <0>;

		port@0 {
			reg = <0>;

			lvds0_in: endpoint {
				remote-endpoint = <&ipu_di0_lvds0>;
			};
		};

		port@2 {
			reg = <2>;

			lvds0_out: endpoint {
				remote-endpoint = <&panel_in>;
			};
		};
	};

	/* 使用display-timings和fsl,data-mapping/width代替 */
	lvds-channel@1 {
		#address-cells = <1>;
		#size-cells = <0>;
		reg = <1>;
		fsl,data-mapping = "spwg";
		fsl,data-width = <24>;

		display-timings {
			/* ... */
		};

		port@1 {
			reg = <1>;

			lvds1_in: endpoint {
				remote-endpoint = <&ipu_di1_lvds1>;
			};
		};
	};
};

panel: lvds-panel {
	/* ... */

	port {
		panel_in: endpoint {
			remote-endpoint = <&lvds0_out>;
		};
	};
};
```

这段代码示例展示了如何在设备树中配置i.MX53的LVDS控制器，并通过两种不同的方式连接到LVDS面板：一种是直接通过硬件端口连接，另一种则是通过指定显示时序参数。
~~~~

## Documentation/devicetree/bindings/display/imx/nxp,imx8mq-dcss_cn.yaml
```yaml
# SPDX-文件许可人: (GPL-2.0 或 BSD-2-Clause)
# 版权所有 2019 NXP
%YAML 1.2
---
$id: http://devicetree.org/schemas/display/imx/nxp,imx8mq-dcss.yaml#
$schema: http://devicetree.org/meta-schemas/core.yaml#

标题: iMX8MQ 显示控制器子系统 (DCSS)

维护者:
  - Laurentiu Palcu <laurentiu.palcu@nxp.com>

描述:

  DCSS (显示控制器子系统) 用于生成最多三个显示缓冲区，组合这些缓冲区，并使用 HDMI 2.0a（带 HDCP 2.2）或 MIPI-DSI 驱动显示器。DCSS 支持高达 4kp60 的显示器。包括 HDR10 图像处理功能以提供能够驱动下一代高动态范围显示器的解决方案。

属性:
  compatible:
    常量: nxp,imx8mq-dcss

  reg:
    项目:
      - 描述: DCSS 基地址和大小，直到 IRQ 路由开始
      - 描述: DCSS BLKCTL 基地址和大小

  interrupts:
    项目:
      - 描述: 上下文加载器完成和错误中断
      - 描述: DTG 中断用于触发上下文加载器的时间点
      - 描述: DTG 中断用于 Vblank

  interrupt-names:
    项目:
      - 常量: ctxld
      - 常量: ctxld_kick
      - 常量: vblank

  clocks:
    项目:
      - 描述: 显示 APB 时钟，用于所有外围 PIO 访问接口
      - 描述: 显示 AXI 时钟，用于 DPR、Scaler 和 RTRAM_CTRL
      - 描述: RTRAM 时钟
      - 描述: 像素时钟，可以由 HDMI 物理层时钟或 MIPI 驱动
      - 描述: DTRC 时钟，视频解压缩器所需

  clock-names:
    项目:
      - 常量: apb
      - 常量: axi
      - 常量: rtrm
      - 常量: pix
      - 常量: dtrc

  assigned-clocks:
    项目:
      - 描述: IMX8MQ_CLK_DISP_AXI_ROOT 的句柄和时钟标识符
      - 描述: IMX8MQ_CLK_DISP_RTRM 的句柄和时钟标识符
      - 描述: IMX8MQ_VIDEO2_PLL1_REF_SEL 或 IMX8MQ_VIDEO_PLL1_REF_SEL 的句柄和时钟标识符

  assigned-clock-parents:
    项目:
      - 描述: IMX8MQ_SYS1_PLL_800M 的句柄和时钟标识符
      - 描述: IMX8MQ_SYS1_PLL_800M 的句柄和时钟标识符
      - 描述: IMX8MQ_CLK_27M 的句柄和时钟标识符

  assigned-clock-rates:
    项目:
      - 描述: 必须为 800 MHz
      - 描述: 必须为 400 MHz

  port:
    $ref: /schemas/graph.yaml#/properties/port
    描述:
      指向 HDMI/DP 或 MIPI 显示桥接器输入端口的端口节点

additionalProperties: false

示例:
  - |
    #include <dt-bindings/clock/imx8mq-clock.h>
    dcss: display-controller@32e00000 {
        compatible = "nxp,imx8mq-dcss";
        reg = <0x32e00000 0x2d000>, <0x32e2f000 0x1000>;
        interrupts = <6>, <8>, <9>;
        interrupt-names = "ctxld", "ctxld_kick", "vblank";
        interrupt-parent = <&irqsteer>;
        clocks = <&clk IMX8MQ_CLK_DISP_APB_ROOT>, <&clk IMX8MQ_CLK_DISP_AXI_ROOT>,
                 <&clk IMX8MQ_CLK_DISP_RTRM_ROOT>, <&clk IMX8MQ_VIDEO2_PLL_OUT>,
                 <&clk IMX8MQ_CLK_DISP_DTRC>;
        clock-names = "apb", "axi", "rtrm", "pix", "dtrc";
        assigned-clocks = <&clk IMX8MQ_CLK_DISP_AXI>, <&clk IMX8MQ_CLK_DISP_RTRM>,
                          <&clk IMX8MQ_VIDEO2_PLL1_REF_SEL>;
        assigned-clock-parents = <&clk IMX8MQ_SYS1_PLL_800M>, <&clk IMX8MQ_SYS1_PLL_800M>,
                                 <&clk IMX8MQ_CLK_27M>;
        assigned-clock-rates = <800000000>,
                               <400000000>;
        port {
            dcss_out: endpoint {
                remote-endpoint = <&hdmi_in>;
            };
        };
    };
```
