## Documentation/devicetree/bindings/display/ti/ti,omap4-dss_cn.txt
```
### 德州仪器 OMAP4 显示子系统
=========================================

请参阅 `Documentation/devicetree/bindings/display/ti/ti,omap-dss.txt`，了解关于 OMAP 显示子系统的通用绑定描述。

#### DSS 核心
**必需属性：**
- `compatible`: `"ti,omap4-dss"`
- `reg`: 寄存器空间的地址和长度
- `ti,hwmods`: `"dss_core"`
- `clocks`: 对 `fclk` 的句柄
- `clock-names`: `"fck"`

**必需节点：**
- `DISPC`

**可选节点：**
- `DSS 子模块`: RFBI, VENC, DSI, HDMI
- DPI 输出的视频端口

**DPI 端点必需属性：**
- `data-lines`: 使用的线数

### DISPC
**必需属性：**
- `compatible`: `"ti,omap4-dispc"`
- `reg`: 寄存器空间的地址和长度
- `ti,hwmods`: `"dss_dispc"`
- `interrupts`: DISPC 中断
- `clocks`: 对 `fclk` 的句柄
- `clock-names`: `"fck"`

**可选属性：**
- `max-memory-bandwidth`: 从主内存到 DISPC 的输入内存带宽限制（每秒字节数）

### RFBI
**必需属性：**
- `compatible`: `"ti,omap4-rfbi"`
- `reg`: 寄存器空间的地址和长度
- `ti,hwmods`: `"dss_rfbi"`
- `clocks`: 对 `fclk` 和 `ickl` 的句柄
- `clock-names`: `"fck"`, `"ick"`

**可选节点：**
- RFBI 输出的视频端口
- RFBI 控制的外设

### VENC
**必需属性：**
- `compatible`: `"ti,omap4-venc"`
- `reg`: 寄存器空间的地址和长度
- `ti,hwmods`: `"dss_venc"`
- `vdda-supply`: DAC 的电源供应
- `clocks`: 对 `fclk` 的句柄
- `clock-names`: `"fck"`

**可选节点：**
- VENC 输出的视频端口

**VENC 端点必需属性：**
- `ti,invert-polarity`: 反转视频信号的极性
- `ti,channels`: 1 表示复合视频，2 表示 S 视频

### DSI
**必需属性：**
- `compatible`: `"ti,omap4-dsi"`
- `reg`: `'proto'`, `'phy'` 和 `'pll'` 寄存器空间的地址和长度
- `reg-names`: `"proto"`, `"phy"`, `"pll"`
- `interrupts`: DSI 中断线
- `ti,hwmods`: `"dss_dsi1"` 或 `"dss_dsi2"`
- `vdd-supply`: DSI 的电源供应
- `clocks`: 对 `fclk` 和 `pll` 时钟的句柄
- `clock-names`: `"fck"`, `"sys_clk"`

**可选节点：**
- DSI 输出的视频端口
- DSI 控制的外设

**DSI 端点必需属性：**
- `lanes`: DSI 通道的针脚编号列表：CLK+, CLK-, DATA0+, DATA0-, DATA1+, DATA1-, ...

### HDMI
**必需属性：**
- `compatible`: `"ti,omap4-hdmi"`
- `reg`: `'wp'`, `'pll'`, `'phy'`, `'core'` 寄存器空间的地址和长度
- `reg-names`: `"wp"`, `"pll"`, `"phy"`, `"core"`
- `interrupts`: HDMI 中断线
- `ti,hwmods`: `"dss_hdmi"`
- `vdda-supply`: VDDA 电源供应
- `clocks`: 对 `fclk` 和 `pll` 时钟的句柄
- `clock-names`: `"fck"`, `"sys_clk"`

**可选节点：**
- HDMI 输出的视频端口

**HDMI 端点可选属性：**
- `lanes`: HDMI 通道的 8 个针脚编号列表：CLK+, CLK-, D0+, D0-, D1+, D1-, D2+, D2-。 （默认值：0,1,2,3,4,5,6,7）
```

## Documentation/devicetree/bindings/display/ti/ti,omap5-dss_cn.txt
```
### 德州仪器 OMAP5 显示子系统

请参阅 `Documentation/devicetree/bindings/display/ti/ti,omap-dss.txt` 获取关于 OMAP 显示子系统的通用描述。

#### DSS 核心

**必需属性：**
- `compatible`: `"ti,omap5-dss"`
- `reg`: 寄存器空间的地址和长度
- `ti,hwmods`: `"dss_core"`
- `clocks`: 对 `fclk` 的句柄
- `clock-names`: `"fck"`

**必需节点：**
- `DISPC`

**可选节点：**
- `DSS 子模块`: RFBI, DSI, HDMI
- 用于 DPI 输出的视频端口

**DPI 终端必需属性：**
- `data-lines`: 使用的线数

#### DISPC

**必需属性：**
- `compatible`: `"ti,omap5-dispc"`
- `reg`: 寄存器空间的地址和长度
- `ti,hwmods`: `"dss_dispc"`
- `interrupts`: DISPC 中断
- `clocks`: 对 `fclk` 的句柄
- `clock-names`: `"fck"`

**可选属性：**
- `max-memory-bandwidth`: 从主内存到 DISPC 的输入内存带宽限制（每秒字节数）

#### RFBI

**必需属性：**
- `compatible`: `"ti,omap5-rfbi"`
- `reg`: 寄存器空间的地址和长度
- `ti,hwmods`: `"dss_rfbi"`
- `clocks`: 对 `fclk` 和 `ickl` 的句柄
- `clock-names`: `"fck"`, `"ick"`

**可选节点：**
- 用于 RFBI 输出的视频端口
- RFBI 控制的外设

#### DSI

**必需属性：**
- `compatible`: `"ti,omap5-dsi"`
- `reg`: `proto`, `phy` 和 `pll` 的寄存器空间地址和长度
- `reg-names`: `"proto"`, `"phy"`, `"pll"`
- `interrupts`: DSI 中断线
- `ti,hwmods`: `"dss_dsi1"` 或 `"dss_dsi2"`
- `vdd-supply`: DSI 的电源供应
- `clocks`: 对 `fclk` 和 `pll` 时钟的句柄
- `clock-names`: `"fck"`, `"sys_clk"`

**可选节点：**
- 用于 DSI 输出的视频端口
- DSI 控制的外设

**DSI 终端必需属性：**
- `lanes`: DSI 车道的针脚编号列表: CLK+, CLK-, DATA0+, DATA0-, DATA1+, DATA1-, ...

#### HDMI

**必需属性：**
- `compatible`: `"ti,omap5-hdmi"`
- `reg`: `wp`, `pll`, `phy`, `core` 的寄存器空间地址和长度
- `reg-names`: `"wp"`, `"pll"`, `"phy"`, `"core"`
- `interrupts`: HDMI 中断线
- `ti,hwmods`: `"dss_hdmi"`
- `vdda-supply`: VDDA 电源供应
- `clocks`: 对 `fclk` 和 `pll` 时钟的句柄
- `clock-names`: `"fck"`, `"sys_clk"`

**可选节点：**
- 用于 HDMI 输出的视频端口

**HDMI 终端可选属性：**
- `lanes`: HDMI 车道的 8 个针脚编号列表: CLK+, CLK-, D0+, D0-, D1+, D1-, D2+, D2-。（默认值：0,1,2,3,4,5,6,7）
```

## Documentation/devicetree/bindings/display/ti/ti,opa362_cn.txt
```
这段代码描述了一个基于德州仪器 (TI) OPA362 的模拟视频放大器的设备树配置。下面是对这段代码的中文解释和结构化说明：

### 设备定义：OPA362 模拟视频放大器 (`tv_amp: opa362`)

- **兼容性** (`compatible`)：
  - `"ti,opa362"`：表示此节点与 TI OPA362 兼容。

- **使能 GPIOs** (`enable-gpios`)：
  - `<&gpio1 23 0>`：表示通过 GPIO1 的第 23 号引脚（模式为 0）来启用/禁用视频输出放大器。

### 必需的节点

#### 视频端口 0：用于 OPA362 输入 (`port@0`)

- **地址单元格** (`#address-cells`)：
  - `<1>`：表示需要一个单元格来表示端口地址。
  
- **大小单元格** (`#size-cells`)：
  - `<0>`：表示不需要任何单元格来表示端口大小。

- **端口配置** (`reg`)：
  - `<0>`：标识此端口为 0 号端口。

- **输入端点** (`opa_in: endpoint@0`)：
  - `remote-endpoint = <&venc_out>`：表示此端口连接到远程节点 `venc_out`，即视频编码器的输出。

#### 视频端口 1：用于 OPA362 输出 (`port@1`)

- **地址单元格** (`#address-cells`)：
  - `<1>`：表示需要一个单元格来表示端口地址。
  
- **大小单元格** (`#size-cells`)：
  - `<0>`：表示不需要任何单元格来表示端口大小。

- **端口配置** (`reg`)：
  - `<1>`：标识此端口为 1 号端口。

- **输出端点** (`opa_out: endpoint@0`)：
  - `remote-endpoint = <&tv_connector_in>`：表示此端口连接到远程节点 `tv_connector_in`，即电视连接器的输入端。

---

这个示例展示了如何在设备树中定义一个包含输入输出端口的 OPA362 视频放大器，并指定了启用/禁用放大器所使用的 GPIO 引脚。
```

## Documentation/devicetree/bindings/display/ti/ti,tpd12s015_cn.txt
```
TPD12S015 HDMI 电平转换器及静电保护芯片
==========================================

必需属性：
- compatible: "ti,tpd12s015"

可选属性：
- gpios: CT CP HPD, LS OE 和 HPD GPIOs

必需节点：
- 视频端口 0 用于 HDMI 输入
- 视频端口 1 用于 HDMI 输出

示例
------

tpd12s015: encoder@1 {
	compatible = "ti,tpd12s015";

	gpios = <&gpio2 28 GPIO_ACTIVE_HIGH>,	/* 60, CT CP HPD */
		<&gpio2 9 GPIO_ACTIVE_HIGH>,	/* 41, LS OE */
		<&gpio2 31 GPIO_ACTIVE_HIGH>;	/* 63, HPD */

	ports {
		#address-cells = <1>;
		#size-cells = <0>;

		port@0 {
			reg = <0>;

			tpd12s015_in: endpoint@0 {
				remote-endpoint = <&hdmi_out>;
			};
		};

		port@1 {
			reg = <1>;

			tpd12s015_out: endpoint@0 {
				remote-endpoint = <&hdmi_connector_in>;
			};
		};
	};
};
```

## Documentation/devicetree/bindings/display/tilcdc/panel_cn.txt
~~~~
这是针对TI LCDC (Tilcdc) DRM 通用面板输出驱动的设备树绑定说明。以下是对各个属性的中文解释：

### 必需属性
- `compatible`: 值应为 `"ti,tilcdc,panel"`。
- `panel-info`: 配置信息，用于正确配置LCDC以适配面板。
  - `ac-bias`: AC偏置引脚频率。
  - `ac-bias-intrpt`: 每次中断时AC偏置引脚的转换次数。
  - `dma-burst-sz`: DMA突发大小。
  - `bpp`: 每像素位数。
  - `fdd`: FIFO DMA请求延迟。
  - `sync-edge`: 水平和垂直同步边沿：0=上升沿，1=下降沿。
  - `sync-ctrl`: 水平和垂直同步控制：0=忽略。
  - `raster-order`: 光栅数据顺序选择：1=从高位到低位，0=从低位到高位。
  - `fifo-th`: DMA FIFO阈值。
- `display-timings`: LCD面板的典型视频模式。如果面板支持多种时序，则可以列出多个视频模式，但`native-mode`应该是首选/默认分辨率。详情请参阅文档 `Documentation/devicetree/bindings/display/panel/display-timing.txt`。

### 可选属性
- `backlight`: 面板上背光设备的phandle。
- `enable-gpios`: 用于启用或禁用面板的GPIO引脚。

### 推荐属性
- `pinctrl-names`, `pinctrl-0`: 用于配置连接到TFP410设备的引脚的多路复用设置。

### 示例

```devicetree
/* CDTech_S035Q01 / LCD3扩展板的设置: */
lcd3 {
	compatible = "ti,tilcdc,panel";
	pinctrl-names = "default";
	pinctrl-0 = <&bone_lcd3_cape_lcd_pins>;
	backlight = <&backlight>;
	enable-gpios = <&gpio3 19 0>;

	panel-info {
		ac-bias           = <255>;
		ac-bias-intrpt    = <0>;
		dma-burst-sz      = <16>;
		bpp               = <16>;
		fdd               = <0x80>;
		sync-edge         = <0>;
		sync-ctrl         = <1>;
		raster-order      = <0>;
		fifo-th           = <0>;
	};
	display-timings {
		native-mode = <&timing0>;
		timing0: 320x240 {
			hactive         = <320>;
			vactive         = <240>;
			hback-porch     = <21>;
			hfront-porch    = <58>;
			hsync-len       = <47>;
			vback-porch     = <11>;
			vfront-porch    = <23>;
			vsync-len       = <2>;
			clock-frequency = <8000000>;
			hsync-active    = <0>;
			vsync-active    = <0>;
		};
	};
};
```

这个示例展示了如何在设备树中定义一个特定于CDTech_S035Q01 / LCD3扩展板的配置。
~~~~

## Documentation/devicetree/bindings/display/tilcdc/tilcdc_cn.txt
~~~~
为 tilcdc DRM 驱动提供的设备树绑定

必需属性：
- `compatible`：值应为以下之一：
    - 对于基于 AM335x 的板卡，使用 `"ti,am33xx-tilcdc"`
    - 对于基于 DA850/AM18x/OMAP-L138 的板卡，使用 `"ti,da850-tilcdc"`
- `interrupts`：中断号
- `reg`：LCDC 设备的基地址和大小

推荐属性：
- `ti,hwmods`：与 LCDC 关联的硬件模块名称

可选属性：
- `max-bandwidth`：内存接口和 LCD 控制器组合能够维持的最大像素数/秒
- `max-width`：LCD 控制器支持的最大水平像素宽度
- `max-pixelclock`：LCD 控制器能支持的最大像素时钟频率（以千赫兹为单位）
- `blue-and-red-wiring`：可识别的值为 "straight" 或 "crossed"。此属性处理 LCDC 修订版 2（在 AM335x 上发现）的颜色错误 [1]。
    - "straight" 表示正常的接线方式，支持 RGB565、BGR888 和 XBGR8888 颜色格式
    - "crossed" 表示将蓝色和红色线交叉的接线方式。这种设置支持 BGR565、RGB888 和 XRGB8888 格式
    - 如果该属性不存在或其值未被识别，则假设为遗留模式。此配置支持 RGB565、RGB888 和 XRGB8888 格式。但是，根据接线方式，在 16 位或 24 位颜色模式下，红色和蓝色会互换

可选节点：
- `port/ports`：用于描述连接到外部编码器的连接。绑定遵循 `Documentation/devicetree/bindings/graph.txt` 并且支持一个端口带有一个终端点
- 参见 `Documentation/devicetree/bindings/display/tilcdc/panel.txt` 和 `Documentation/devicetree/bindings/display/bridge/ti,tfp410.yaml`，用于将 tfp410 DVI 编码器或 LCD 面板连接到 lcdc

[1] 关于 AM335x 的颜色接线存在一个错误。对于 16 位颜色模式，接线工作正常（LCD_DATA[0:4] 用于 Blue[3:7]），但对于 24 位颜色模式，蓝色和红色组件的接线是交叉的，并且 LCD_DATA[0:4] 用于 Red[3:7] 而 LCD_DATA[11:15] 用于 Blue[3:7]。更多详情请参阅 AM335x 硅片错误报告第 3.1.1 节：
https://www.ti.com/general/docs/lit/getliterature.tsp?baseLiteratureNumber=sprz360

示例：

```devicetree
fb: fb@4830e000 {
	compatible = "ti,am33xx-tilcdc", "ti,da850-tilcdc";
	reg = <0x4830e000 0x1000>;
	interrupt-parent = <&intc>;
	interrupts = <36>;
	ti,hwmods = "lcdc";

	blue-and-red-wiring = "crossed";

	port {
		lcdc_0: endpoint {
			remote-endpoint = <&hdmi_0>;
		};
	};
};

tda19988: tda19988 {
	compatible = "nxp,tda998x";
	reg = <0x70>;

	pinctrl-names = "default", "off";
	pinctrl-0 = <&nxp_hdmi_bonelt_pins>;
	pinctrl-1 = <&nxp_hdmi_bonelt_off_pins>;

	port {
		hdmi_0: endpoint {
			remote-endpoint = <&lcdc_0>;
		};
	};
};
```
~~~~

## Documentation/devicetree/bindings/display/truly,nt35597_cn.txt
~~~~
真正NT35597 DSI显示驱动

真正NT35597是一个通用的显示驱动，目前仅配置用于Qualcomm SDM845 MTP板上的2K显示屏。
必需属性：
- compatible（兼容性）：应为"truly,nt35597-2K-display"
- vdda-supply（VDDA供电）：提供供电电压的稳压器的phandle，电源IC供电
- vdispp-supply（VDISPP供电）：提供LCD正偏置供电电压的稳压器的phandle
- vdispn-supply（VDISPN供电）：提供LCD负偏置供电电压的稳压器的phandle
- reset-gpios（复位GPIO）：复位线的GPIO的phandle。这应该是8mA，GPIO可以通过mux、pinctrl和pinctrl-names进行配置（低电平有效）
- mode-gpios（模式GPIO）：选择显示屏模式（单DSI或双DSI）的GPIO的phandle。对于双DSI应设置为低电平，对于单DSI模式应设置为高电平
- ports（端口）：此设备有两个由两个DSI驱动的视频端口。它们的连接采用OF图绑定规范，该规范在Documentation/devicetree/bindings/graph.txt中指定
- port@0：由主DSI驱动的DSI输入端口
  - port@1：由次级DSI驱动的DSI输入端口

示例：

```dtb
dsi@ae94000 {
    panel@0 {
        compatible = "truly,nt35597-2K-display";
        reg = <0>;
        vdda-supply = <&pm8998_l14>;
        vdispp-supply = <&lab_regulator>;
        vdispn-supply = <&ibb_regulator>;
        pinctrl-names = "default", "suspend";
        pinctrl-0 = <&dpu_dsi_active>;
        pinctrl-1 = <&dpu_dsi_suspend>;

        reset-gpios = <&tlmm 6 GPIO_ACTIVE_LOW>;
        mode-gpios = <&tlmm 52 GPIO_ACTIVE_HIGH>;
        ports {
            #address-cells = <1>;
            #size-cells = <0>;
            port@0 {
                reg = <0>;
                panel0_in: endpoint {
                    remote-endpoint = <&dsi0_out>;
                };
            };

            port@1 {
                reg = <1>;
                panel1_in: endpoint {
                    remote-endpoint = <&dsi1_out>;
                };
            };
        };
    };
};
```
```
~~~~

## Documentation/devicetree/bindings/display/via,vt8500-fb_cn.txt
~~~~
VIA VT8500 帧缓冲区
-----------------------------------------------------

必需属性：
- compatible（兼容性）: "via,vt8500-fb"
- reg（寄存器范围）: 应包含 1 个寄存器范围(地址和长度)
- interrupts（中断）: 帧缓冲区控制器的中断
- bits-per-pixel（每像素位数）: 帧缓冲区的位深度（16 或 32）

必需子节点：
- display-timings（显示时序）: 请参阅 display-timing.txt 获取相关信息

示例：

```text
fb@d8050800 { 
	compatible = "via,vt8500-fb"; 
	reg = <0xd800e400 0x400>; 
	interrupts = <12>; 
	bits-per-pixel = <16>; 

	display-timings { 
		native-mode = <&timing0>; 
		timing0: 800x480 { 
			clock-frequency = <0>; /* 未使用但必需 */
			hactive = <800>; 
			vactive = <480>; 
			hfront-porch = <40>; 
			hback-porch = <88>; 
			hsync-len = <0>; 
			vback-porch = <32>; 
			vfront-porch = <11>; 
			vsync-len = <1>; 
		}; 
	}; 
};
```
以上示例展示了如何定义 VIA VT8500 帧缓冲区设备及其相关配置。
~~~~

## Documentation/devicetree/bindings/display/wm,prizm-ge-rops_cn.txt
```
VIA/Wondermedia 图形引擎控制器
---------------------------------

所需属性：
- compatible（兼容性）: "wm,prizm-ge-rops"
- reg（寄存器）: 应包含 1 个寄存器范围（地址和长度）

示例：

	ge_rops@d8050400 {
		compatible = "wm,prizm-ge-rops";
		reg = <0xd8050400 0x100>;
	};

翻译为中文：

VIA/Wondermedia 图形引擎控制器
---------------------------------

所需属性：
- 兼容性： "wm,prizm-ge-rops"
- 寄存器：应包含 1 个寄存器范围（地址和长度）

示例：

	ge_rops@d8050400 {
		兼容性 = "wm,prizm-ge-rops";
		寄存器 = <0xd8050400 0x100>;
	};
```

## Documentation/devicetree/bindings/display/wm,wm8505-fb_cn.txt
```
Wondermedia WM8505 帧缓冲器
-----------------------------------------------------

必需属性：
- compatible（兼容性）: "wm,wm8505-fb"
- reg（寄存器）: 应包含1个寄存器范围(地址和长度)
- bits-per-pixel（每像素位数）: 帧缓冲器的位深度(16或32)

必需的子节点：
- display-timings（显示定时）: 请参阅display-timing.txt以获取更多信息

示例：

	fb@d8051700 { 
		compatible = "wm,wm8505-fb"; 
		reg = <0xd8051700 0x200>; 
		bits-per-pixel = <16>; 

		display-timings { 
			native-mode = <&timing0>; 
			timing0: 800x480 { 
				clock-frequency = <0>; /* 未使用但必需 */
				hactive = <800>; 
				vactive = <480>; 
				hfront-porch = <40>; 
				hback-porch = <88>; 
				hsync-len = <0>; 
				vback-porch = <32>; 
				vfront-porch = <11>; 
				vsync-len = <1>; 
			}; 
		}; 
	};
```
