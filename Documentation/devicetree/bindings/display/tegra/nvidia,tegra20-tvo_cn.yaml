## Documentation/devicetree/bindings/display/xlnx/xlnx,zynqmp-dpsub_cn.yaml
~~~~yaml
以下是提供的 YAML 文档的中文翻译：

```yaml
# SPDX-文件许可标识符: (GPL-2.0-only 或 BSD-2-Clause)
%YAML 1.2
---
$id: http://devicetree.org/schemas/display/xlnx/xlnx,zynqmp-dpsub.yaml#
$schema: http://devicetree.org/meta-schemas/core.yaml#

标题: Xilinx ZynqMP DisplayPort 子系统

描述: |
  Xilinx ZynqMP (Zynq UltraScale+ MPSoC) 的 DisplayPort 子系统实现了基于 DisplayPort v1.2 标准的显示和音频管道。该子系统包括以下多个功能模块：

               +------------------------------------------------------------+
  +--------+   | +----------------+     +-----------+                       |
  | DPDMA  | --->|                | --> |   视频   | 视频 +-------------+ |
  | 4x 视频 |   | | 音频/视频     | --> | 渲染管道 | -+--> |             | |   +------+
  | 2x 音频 |   | | 缓冲管理器   |     |           |  |    | DisplayPort |---> | PHY0 |
  +--------+   | | 和同步控制   |     +-----------+  |    | 源控制器  | |   +------+
               | |                |     +-----------+  |    | 控制器    |---> | PHY1 |
  实时视频 --->|                | --> |   音频   | 音频 |             | |   +------+
               | |                |     | 混音器   | --+-> |             | |   +------+
  实时音频 --->|                | --> |           |  ||   +-------------+ |
               | +----------------+     +-----------+  ||                     |
               +---------------------------------------||---------------------+
                                                      vv
                                                融合视频与
                                                混合音频至可编程逻辑

  缓冲管理器与外部接口交互，例如 DMA 引擎或来自可编程逻辑的实时音频/视频流。视频渲染管道融合视频和图形层并执行颜色空间转换。音频混音器混合输入音频流。DisplayPort 源控制器处理 DisplayPort 协议并与外部 PHY 连接。
子系统支持 2 路视频和 2 路音频流，以及各种像素格式和深度，最高可达 4K@30 分辨率。
请参考 “Zynq UltraScale+ 设备技术参考手册” 
  (https://www.xilinx.com/support/documentation/user_guides/ug1085-zynq-ultrascale-trm.pdf)
获取更多详细信息
维护者:
  - Laurent Pinchart <laurent.pinchart@ideasonboard.com>

属性:
  compatible:
    常量: xlnx,zynqmp-dpsub-1.7

  reg:
    最大项数: 4
  reg-names:
    项:
      - 常量: dp
      - 常量: blend
      - 常量: av_buf
      - 常量: aud

  interrupts:
    最大项数: 1

  clocks:
    描述:
      APB 时钟和至少一个视频时钟是必须的，音频时钟是可选的
最小项数: 2
    项:
      - 描述: dp_apb_clk 是 APB 时钟
      - 描述: dp_aud_clk 是音频时钟
      - 描述:
          dp_vtc_pixel_clk_in 是非实时视频时钟（来自处理系统）
      - 描述:
          dp_live_video_in_clk 是实时视频时钟（来自可编程逻辑）
  clock-names:
    oneOf:
      - 最小项数: 2
        项:
          - 常量: dp_apb_clk
          - 枚举: [ dp_vtc_pixel_clk_in, dp_live_video_in_clk ]
          - 枚举: [ dp_vtc_pixel_clk_in, dp_live_video_in_clk ]
      - 最小项数: 3
        项:
          - 常量: dp_apb_clk
          - 常量: dp_aud_clk
          - 枚举: [ dp_vtc_pixel_clk_in, dp_live_video_in_clk ]
          - 枚举: [ dp_vtc_pixel_clk_in, dp_live_video_in_clk ]

  power-domains:
    最大项数: 1

  resets:
    最大项数: 1

  dmas:
    项:
      - 描述: 视频层，平面 0（RGB 或亮度）
      - 描述: 视频层，平面 1（U/V 或 U）
      - 描述: 视频层，平面 2（V）
      - 描述: 图形层
  dma-names:
    项:
      - 常量: vid0
      - 常量: vid1
      - 常量: vid2
      - 常量: gfx0

  phys:
    描述: DP 数据通道的 PHY
    最小项数: 1
    最大项数: 2
  phy-names:
    最小项数: 1
    项:
      - 常量: dp-phy0
      - 常量: dp-phy1

  ports:
    $ref: /schemas/graph.yaml#/properties/ports
    描述: |
      与可编程逻辑和 DisplayPort PHY 的连接。每个端口应当只有一个端点
属性:
      port@0:
        $ref: /schemas/graph.yaml#/properties/port
        描述: 来自可编程逻辑的实时视频输入

      port@1:
        $ref: /schemas/graph.yaml#/properties/port
        描述: 来自可编程逻辑的实时图形输入

      port@2:
        $ref: /schemas/graph.yaml#/properties/port
        描述: 来自可编程逻辑的实时音频输入

      port@3:
        $ref: /schemas/graph.yaml#/properties/port
        描述: 发送到可编程逻辑的融合视频输出

      port@4:
        $ref: /schemas/graph.yaml#/properties/port
        描述: 发送到可编程逻辑的混合音频输出

      port@5:
        $ref: /schemas/graph.yaml#/properties/port
        描述: DisplayPort 输出

    必需:
      - port@0
      - port@1
      - port@2
      - port@3
      - port@4
      - port@5

必需:
  - compatible
  - reg
  - reg-names
  - interrupts
  - clocks
  - clock-names
  - power-domains
  - resets
  - dmas
  - dma-names
  - phys
  - phy-names
  - ports

其他属性: false

示例:
  - |
    #include <dt-bindings/phy/phy.h>
    #include <dt-bindings/reset/xlnx-zynqmp-resets.h>

    display@fd4a0000 {
        compatible = "xlnx,zynqmp-dpsub-1.7";
        reg = <0xfd4a0000 0x1000>,
              <0xfd4aa000 0x1000>,
              <0xfd4ab000 0x1000>,
              <0xfd4ac000 0x1000>;
        reg-names = "dp", "blend", "av_buf", "aud";
        interrupts = <0 119 4>;
        interrupt-parent = <&gic>;

        clock-names = "dp_apb_clk", "dp_aud_clk", "dp_live_video_in_clk";
        clocks = <&dp_aclk>, <&clkc 17>, <&si570_1>;

        power-domains = <&pd_dp>;
        resets = <&reset ZYNQMP_RESET_DP>;

        dma-names = "vid0", "vid1", "vid2", "gfx0";
        dmas = <&xlnx_dpdma 0>,
               <&xlnx_dpdma 1>,
               <&xlnx_dpdma 2>,
               <&xlnx_dpdma 3>;

        phys = <&psgtr 1 PHY_TYPE_DP 0 3>,
               <&psgtr 0 PHY_TYPE_DP 1 3>;

        phy-names = "dp-phy0", "dp-phy1";

        ports {
            #address-cells = <1>;
            #size-cells = <0>;

            port@0 {
                reg = <0>;
            };
            port@1 {
                reg = <1>;
            };
            port@2 {
                reg = <2>;
            };
            port@3 {
                reg = <3>;
            };
            port@4 {
                reg = <4>;
            };
            port@5 {
                reg = <5>;
                dpsub_dp_out: endpoint {
                    remote-endpoint = <&dp_connector>;
                };
            };
        };
    };
..
```
```
~~~~

## Documentation/devicetree/bindings/display/xylon,logicvc-display_cn.yaml
~~~~yaml
```yaml
# SPDX-License-Identifier: (GPL-2.0 OR BSD-2-Clause)
# Copyright 2019 Bootlin
%YAML 1.2
---
$id: 'http://devicetree.org/schemas/display/xylon,logicvc-display.yaml#'
$schema: 'http://devicetree.org/meta-schemas/core.yaml#'

title: Xylon LogiCVC 显示控制器

maintainers:
  - Paul Kocialkowski <paul.kocialkowski@bootlin.com>

description: |
  Xylon LogiCVC 是一个支持多个图层的显示控制器。
  它通常作为可编程逻辑实现，并针对Xilinx Zynq-7000 SoC和Xilinx FPGA进行了优化。
  由于该控制器旨在用于FPGA中，因此大多数控制器配置发生在逻辑配置位流合成阶段。
  因此，许多设备树绑定是为了反映合成配置，并且不应进行不同的配置。
  在适用时提供了匹配的合成参数。
  图层在"layers"子节点中声明，并具有专用配置。
  在第3版控制器中，每个图层从视频内存基地址开始有固定的内存偏移和地址以供其帧缓冲区使用。而在第4版中，
  帧缓冲区通过直接内存地址进行配置。

properties:
  compatible:
    enum:
      - xylon,logicvc-3.02.a-display
      - xylon,logicvc-4.01.a-display

  reg:
    maxItems: 1

  clocks:
    minItems: 1
    maxItems: 4

  clock-names:
    minItems: 1
    items:
      # vclk是必需的，并且必须作为第一项提供
      - const: vclk
      # 其他时钟是可选的，可以按任意顺序提供
      - enum:
          - vclk2
          - lvdsclk
          - lvdsclkn
      - enum:
          - vclk2
          - lvdsclk
          - lvdsclkn
      - enum:
          - vclk2
          - lvdsclk
          - lvdsclkn

  interrupts:
    maxItems: 1

  memory-region:
    maxItems: 1

  xylon,display-interface:
    enum:
      # 平行RGB接口（C_DISPLAY_INTERFACE == 0）
      - parallel-rgb
      # ITU-T BR656接口（C_DISPLAY_INTERFACE == 1）
      - bt656
      # 4位LVDS接口（C_DISPLAY_INTERFACE == 2）
      - lvds-4bits
      # 3位LVDS接口（C_DISPLAY_INTERFACE == 4）
      - lvds-3bits
      # DVI接口（C_DISPLAY_INTERFACE == 5）
      - dvi
    description: 显示输出接口（C_DISPLAY_INTERFACE）

  xylon,display-colorspace:
    enum:
      # RGB颜色空间（C_DISPLAY_COLOR_SPACE == 0）
      - rgb
      # YUV 4:2:2颜色空间（C_DISPLAY_COLOR_SPACE == 1）
      - yuv422
      # YUV 4:4:4颜色空间（C_DISPLAY_COLOR_SPACE == 2）
      - yuv444
    description: 显示输出颜色空间（C_DISPLAY_COLOR_SPACE）
```
下面是给定内容的中文翻译：

xylon,display-depth:
    $ref: /schemas/types.yaml#/definitions/uint32
    description: 显示输出深度 (C_PIXEL_DATA_WIDTH)
xylon,row-stride:
    $ref: /schemas/types.yaml#/definitions/uint32
    description: 帧缓冲区中每行固定像素数 (C_ROW_STRIDE)
xylon,dithering:
    $ref: /schemas/types.yaml#/definitions/flag
    description: 混色模块已启用 (C_XCOLOR)

  xylon,background-layer:
    $ref: /schemas/types.yaml#/definitions/flag
    description: |
      最后一层用于显示黑色背景 (C_USE_BACKGROUND)
      必须注册该层
xylon,layers-configurable:
    $ref: /schemas/types.yaml#/definitions/flag
    description: |
      启用各层大小、位置和偏移量的配置 (C_USE_SIZE_POSITION)
layers:
    type: object

    properties:
      "#address-cells":
        const: 1

      "#size-cells":
        const: 0

    patternProperties:
      "^layer@[0-9]+$":
        type: object

        properties:
          reg:
            maxItems: 1

          xylon,layer-depth:
            $ref: /schemas/types.yaml#/definitions/uint32
            description: 层深度 (C_LAYER_X_DATA_WIDTH)
xylon,layer-colorspace:
            enum:
              # RGB颜色空间 (C_LAYER_X_TYPE == 0)
              - rgb
              # YUV打包颜色空间 (C_LAYER_X_TYPE == 0)
              - yuv
            description: 层颜色空间 (C_LAYER_X_TYPE)
xylon,layer-alpha-mode:
            enum:
              # 层级范围内的Alpha配置 (C_LAYER_X_ALPHA_MODE == 0)
              - layer
              # 每个像素的Alpha配置 (C_LAYER_X_ALPHA_MODE == 1)
              - pixel
            description: 层的Alpha模式 (C_LAYER_X_ALPHA_MODE)
xylon,layer-base-offset:
            $ref: /schemas/types.yaml#/definitions/uint32
            description: |
              从视频RAM基址 (C_VMEM_BASEADDR) 开始计算的线数偏移量 (C_LAYER_X_OFFSET)，仅适用于版本3
xylon,layer-buffer-offset:
            $ref: /schemas/types.yaml#/definitions/uint32
            description: |
              双缓冲中第二个缓冲区相对于层基址偏移量 (C_BUFFER_*_OFFSET) 的线数偏移量
下面是给定 YAML 示例的中文翻译：

```yaml
#ylon,layer-primary:
$ref: /schemas/types.yaml#/definitions/flag
description: |
  层应当作为主平面进行注册（需要且仅需一个）
additionalProperties: false

required:
  - reg
  - xylon,layer-depth
  - xylon,layer-colorspace
  - xylon,layer-alpha-mode

# 描述显示控制器层，包含描述已注册层的子节点
required:
  - "#address-cells"
  - "#size-cells"
  - layer@0

additionalProperties: false

description: |
  显示控制器层的描述，包含描述各注册层的子节点

# 端口配置
port:
$ref: /schemas/graph.yaml#/properties/port
description: |
  视频输出端口，通常连接到面板或桥接器
additionalProperties: false

# 必须字段
required:
  - compatible
  - reg
  - clocks
  - clock-names
  - interrupts
  - xylon,display-interface
  - xylon,display-colorspace
  - xylon,display-depth
  - xylon,row-stride
  - layers
  - port

# 示例
examples:
  - |
    #include <dt-bindings/interrupt-controller/irq.h>

    logicvc: logicvc@43c00000 {
      compatible = "xylon,logicvc-3.02.a", "syscon", "simple-mfd";
      reg = <0x43c00000 0x6000>;

      #address-cells = <1>;
      #size-cells = <1>;

      # 显示控制器节点
      logicvc_display: display@0 {
        compatible = "xylon,logicvc-3.02.a-display";
        reg = <0x0 0x6000>;

        memory-region = <&logicvc_cma>;

        clocks = <&logicvc_vclk 0>, <&logicvc_lvdsclk 0>;
        clock-names = "vclk", "lvdsclk";

        interrupt-parent = <&intc>;
        interrupts = <0 34 IRQ_TYPE_LEVEL_HIGH>;

        xylon,display-interface = "lvds-4bits";
        xylon,display-colorspace = "rgb";
        xylon,display-depth = <16>;
        xylon,row-stride = <1024>;

        xylon,layers-configurable;

        # 层配置
        layers {
          #address-cells = <1>;
          #size-cells = <0>;

          # 主层
          layer@0 {
            reg = <0>;
            xylon,layer-depth = <16>;
            xylon,layer-colorspace = "rgb";
            xylon,layer-alpha-mode = "layer";
            xylon,layer-base-offset = <0>;
            xylon,layer-buffer-offset = <480>;
            xylon,layer-primary;
          };

          # 子层1
          layer@1 {
            reg = <1>;
            xylon,layer-depth = <16>;
            xylon,layer-colorspace = "rgb";
            xylon,layer-alpha-mode = "layer";
            xylon,layer-base-offset = <2400>;
            xylon,layer-buffer-offset = <480>;
          };

          # 子层2
          layer@2 {
            reg = <2>;
            xylon,layer-depth = <16>;
            xylon,layer-colorspace = "rgb";
            xylon,layer-alpha-mode = "layer";
            xylon,layer-base-offset = <960>;
            xylon,layer-buffer-offset = <480>;
          };

          # 子层3
          layer@3 {
            reg = <3>;
            xylon,layer-depth = <16>;
            xylon,layer-colorspace = "rgb";
            xylon,layer-alpha-mode = "layer";
            xylon,layer-base-offset = <480>;
            xylon,layer-buffer-offset = <480>;
          };

          # 子层4
          layer@4 {
            reg = <4>;
            xylon,layer-depth = <16>;
            xylon,layer-colorspace = "rgb";
            xylon,layer-alpha-mode = "layer";
            xylon,layer-base-offset = <8192>;
            xylon,layer-buffer-offset = <480>;
          };
        };

        # 输出端口配置
        port {
          #address-cells = <1>;
          #size-cells = <0>;

          logicvc_output: endpoint@0 {
            reg = <0>;
            remote-endpoint = <&panel_input>;
          };
        };
      };
    };
```

请注意，上述翻译尽可能保持了原始 YAML 结构和内容的一致性，并对关键部分进行了中文注释。
~~~~
