## Documentation/devicetree/bindings/display/ti/ti,j721e-dss_cn.yaml
```yaml
以下是提供的 Device Tree (DT) 描述文件的中文翻译：

# SPDX-许可证标识符: (GPL-2.0 或 BSD-2-Clause)
# 版权 2019 德州仪器公司
%YAML 1.2
---
$id: http://devicetree.org/schemas/display/ti/ti,j721e-dss.yaml#
$schema: http://devicetree.org/meta-schemas/core.yaml#

标题: 德州仪器 J721E 显示子系统

维护者:
  - Jyri Sarha <jsarha@ti.com>
  - Tomi Valkeinen <tomi.valkeinen@ti.com>

描述: |
  J721E 德州仪器 Keystone 显示子系统，具有四个输出端口和四个视频平面。其中有两个全功能视频平面以及两个不支持缩放的“简易”平面。视频端口可以连接到 SoC 的 DPI 引脚或集成在 SoC 上的显示桥接器。
属性:
  compatible:
    常量: ti,j721e-dss

  reg:
    项:
      - 描述: common_m DSS 主控公共部分
      - 描述: common_s0 DSS 共享公共部分 0
      - 描述: common_s1 DSS 共享公共部分 1
      - 描述: common_s2 DSS 共享公共部分 2
      - 描述: VIDL1 简易视频平面 1
      - 描述: VIDL2 简易视频平面 2
      - 描述: VID1 视频平面 1
      - 描述: VID2 视频平面 2
      - 描述: OVR1 为 vp1 提供的叠加管理器
      - 描述: OVR2 为 vp2 提供的叠加管理器
      - 描述: OVR3 为 vp3 提供的叠加管理器
      - 描述: OVR4 为 vp4 提供的叠加管理器
      - 描述: VP1 视频端口 1
      - 描述: VP2 视频端口 2
      - 描述: VP3 视频端口 3
      - 描述: VP4 视频端口 4
      - 描述: WB 回写

  reg-names:
    项:
      - 常量: common_m
      - 常量: common_s0
      - 常量: common_s1
      - 常量: common_s2
      - 常量: vidl1
      - 常量: vidl2
      - 常量: vid1
      - 常量: vid2
      - 常量: ovr1
      - 常量: ovr2
      - 常量: ovr3
      - 常量: ovr4
      - 常量: vp1
      - 常量: vp2
      - 常量: vp3
      - 常量: vp4
      - 常量: wb

  clocks:
    项:
      - 描述: fck DSS 功能时钟
      - 描述: vp1 视频端口 1 像素时钟
      - 描述: vp2 视频端口 2 像素时钟
      - 描述: vp3 视频端口 3 像素时钟
      - 描述: vp4 视频端口 4 像素时钟

  clock-names:
    项:
      - 常量: fck
      - 常量: vp1
      - 常量: vp2
      - 常量: vp3
      - 常量: vp4

  assigned-clocks:
    最小项目数: 1
    最大项目数: 5

  assigned-clock-parents:
    最小项目数: 1
    最大项目数: 5

  interrupts:
    项:
      - 描述: common_m DSS 主控公共部分
      - 描述: common_s0 DSS 共享公共部分 0
      - 描述: common_s1 DSS 共享公共部分 1
      - 描述: common_s2 DSS 共享公共部分 2

  interrupt-names:
    项:
      - 常量: common_m
      - 常量: common_s0
      - 常量: common_s1
      - 常量: common_s2

  power-domains:
    最大项目数: 1
    描述: 关联电源域的 phandle

  dma-coherent:
    类型: 布尔值

  ports:
    $ref: /schemas/graph.yaml#/properties/ports

    属性:
      port@0:
        $ref: /schemas/graph.yaml#/properties/port
        描述:
          来自视频端口 1 的输出端口节点

      port@1:
        $ref: /schemas/graph.yaml#/properties/port
        描述:
          来自视频端口 2 的输出端口节点

      port@2:
        $ref: /schemas/graph.yaml#/properties/port
        描述:
          来自视频端口 3 的输出端口节点

      port@3:
        $ref: /schemas/graph.yaml#/properties/port
        描述:
          来自视频端口 4 的输出端口节点

  max-memory-bandwidth:
    $ref: /schemas/types.yaml#/definitions/uint32
    描述:
      输入内存（从主内存到 dispc）带宽限制，单位为每秒字节数

必需:
  - compatible
  - reg
  - reg-names
  - clocks
  - clock-names
  - interrupts
  - interrupt-names
  - ports

附加属性: false

示例:
  - |
    #include <dt-bindings/interrupt-controller/arm-gic.h>
    #include <dt-bindings/interrupt-controller/irq.h>
    #include <dt-bindings/soc/ti,sci_pm_domain.h>

    dss: dss@4a00000 {
            compatible = "ti,j721e-dss";
            reg =   <0x04a00000 0x10000>, /* common_m */
                    <0x04a10000 0x10000>, /* common_s0*/
                    <0x04b00000 0x10000>, /* common_s1*/
                    <0x04b10000 0x10000>, /* common_s2*/
                    <0x04a20000 0x10000>, /* vidl1 */
                    <0x04a30000 0x10000>, /* vidl2 */
                    <0x04a50000 0x10000>, /* vid1 */
                    <0x04a60000 0x10000>, /* vid2 */
                    <0x04a70000 0x10000>, /* ovr1 */
                    <0x04a90000 0x10000>, /* ovr2 */
                    <0x04ab0000 0x10000>, /* ovr3 */
                    <0x04ad0000 0x10000>, /* ovr4 */
                    <0x04a80000 0x10000>, /* vp1 */
                    <0x04aa0000 0x10000>, /* vp2 */
                    <0x04ac0000 0x10000>, /* vp3 */
                    <0x04ae0000 0x10000>, /* vp4 */
                    <0x04af0000 0x10000>; /* wb */
            reg-names = "common_m", "common_s0",
                    "common_s1", "common_s2",
                    "vidl1", "vidl2","vid1","vid2",
                    "ovr1", "ovr2", "ovr3", "ovr4",
                    "vp1", "vp2", "vp3", "vp4",
                    "wb";
            clocks =        <&k3_clks 152 0>,
                            <&k3_clks 152 1>,
                            <&k3_clks 152 4>,
                            <&k3_clks 152 9>,
                            <&k3_clks 152 13>;
            clock-names = "fck", "vp1", "vp2", "vp3", "vp4";
            power-domains = <&k3_pds 152 TI_SCI_PD_EXCLUSIVE>;
            interrupts =    <GIC_SPI 602 IRQ_TYPE_LEVEL_HIGH>,
                            <GIC_SPI 603 IRQ_TYPE_LEVEL_HIGH>,
                            <GIC_SPI 604 IRQ_TYPE_LEVEL_HIGH>,
                            <GIC_SPI 605 IRQ_TYPE_LEVEL_HIGH>;
            interrupt-names =       "common_m",
                                    "common_s0",
                                    "common_s1",
                                    "common_s2";
            ports {
                    #address-cells = <1>;
                    #size-cells = <0>;
                    port@0 {
                            reg = <0>;

                            dpi_out_0: endpoint {
                                    remote-endpoint = <&dp_bridge_input>;
                            };
                    };
            };
    };
```

## Documentation/devicetree/bindings/display/ti/ti,k2g-dss_cn.yaml
~~~~yaml
```yaml
# SPDX-文件许可标识符: (GPL-2.0 或 BSD-2-Clause)
# 版权所有 2019 德州仪器公司
%YAML 1.2
---
$id: http://devicetree.org/schemas/display/ti/ti,k2g-dss.yaml#
$schema: http://devicetree.org/meta-schemas/core.yaml#

title: 德州仪器 K2G 显示子系统

maintainers:
  - Jyri Sarha <jsarha@ti.com>
  - Tomi Valkeinen <tomi.valkeinen@ti.com>

description: |
  K2G DSS 是德州仪器 Keystone 显示子系统的超轻量级版本。
  它只有一个输出端口和视频平面。输出为 DPI。

properties:
  compatible:
    const: ti,k2g-dss

  reg:
    items:
      - description: cfg DSS 顶层
      - description: common 公共 DISPC
      - description: VID1 视频平面 1
      - description: OVR1 用于 vp1 的叠加管理器
      - description: VP1 视频端口 1

  reg-names:
    items:
      - const: cfg
      - const: common
      - const: vid1
      - const: ovr1
      - const: vp1

  clocks:
    items:
      - description: fck DSS 功能时钟
      - description: vp1 视频端口 1 像素时钟

  clock-names:
    items:
      - const: fck
      - const: vp1

  interrupts:
    maxItems: 1

  power-domains:
    maxItems: 1
    description: phandle 指向相关联的电源域

  port:
    $ref: /schemas/graph.yaml#/properties/port
    description:
      DSS DPI 输出端口节点

  max-memory-bandwidth:
    $ref: /schemas/types.yaml#/definitions/uint32
    description:
      输入内存（从主内存到 dispc）带宽限制，单位为每秒字节数

required:
  - compatible
  - reg
  - reg-names
  - clocks
  - clock-names
  - interrupts
  - port

additionalProperties: false

examples:
  - |
    #include <dt-bindings/interrupt-controller/arm-gic.h>
    #include <dt-bindings/interrupt-controller/irq.h>

    dss: dss@2540000 {
            compatible = "ti,k2g-dss";
            reg =   <0x02540000 0x400>,
                    <0x02550000 0x1000>,
                    <0x02557000 0x1000>,
                    <0x0255a800 0x100>,
                    <0x0255ac00 0x100>;
            reg-names = "cfg", "common", "vid1", "ovr1", "vp1";
            clocks =        <&k2g_clks 0x2 0>,
                            <&k2g_clks 0x2 1>;
            clock-names = "fck", "vp1";
            interrupts = <GIC_SPI 247 IRQ_TYPE_EDGE_RISING>;

            power-domains = <&k2g_pds 0x2>;

            max-memory-bandwidth = <230000000>;

            port {
                    dpi_out: endpoint {
                            remote-endpoint = <&sii9022_in>;
                    };
            };
    };
```
请注意，上述翻译已尽可能地保留了原有 YAML 结构，并对注释进行了翻译。
~~~~

## Documentation/devicetree/bindings/display/ti/ti,omap-dss_cn.txt
~~~~
### 德州仪器 OMAP 显示子系统
========================================

### 通用描述
-------------------

本文件是对 OMAP 显示子系统的通用绑定描述。每个 OMAP 系统级芯片（SoC）版本的具体绑定细节在各自的绑定文档中描述。
OMAP 显示子系统（DSS）硬件包括 DSS 核心、DISPC 模块以及一系列编码器模块。所有 DSS 版本都包含 DSS 核心和 DISPC，但编码器模块则有所不同。
DSS 核心是其他 DSS 模块的父级，并管理时钟路由、与 SoC 的集成等。
DISPC 是显示控制器，它从内存读取像素并输出 RGB 像素流到编码器。
编码器模块将接收到的 RGB 像素流编码为视频输出，如 HDMI、MIPI DPI 等。

### 视频端口
--------------

DSS 核心和编码器具有视频端口输出。视频端口的结构在 `Documentation/devicetree/bindings/graph.txt` 中描述，而每个编码器的端口和端点属性在 SoC 的 DSS 绑定文档中有描述。
视频端口用于描述与外部硬件（如面板或外部编码器）的连接。

### 别名
-------

板载 DTS 文件可以定义显示别名以分配类似“displayX”风格的名称给每个显示设备。如果没有定义别名，则会使用一个半随机数字作为显示设备的标识。

### 示例
-------

以下是 OMAP4 的 DSS 描述的一个简化的例子，删除了不相关的部分，该描述定义于 `omap4.dtsi` 文件中：

```dts
dss: dss@58000000 {
    compatible = "ti,omap4-dss";
    reg = <0x58000000 0x80>;
    status = "disabled";
    ti,hwmods = "dss_core";
    clocks = <&dss_dss_clk>;
    clock-names = "fck";
    #address-cells = <1>;
    #size-cells = <1>;
    ranges;

    dispc@58001000 {
        compatible = "ti,omap4-dispc";
        reg = <0x58001000 0x1000>;
        interrupts = <GIC_SPI 25 IRQ_TYPE_LEVEL_HIGH>;
        ti,hwmods = "dss_dispc";
        clocks = <&dss_dss_clk>;
        clock-names = "fck";
    };

    hdmi: encoder@58006000 {
        compatible = "ti,omap4-hdmi";
        reg = <0x58006000 0x200>,
              <0x58006200 0x100>,
              <0x58006300 0x100>,
              <0x58006400 0x1000>;
        reg-names = "wp", "pll", "phy", "core";
        interrupts = <GIC_SPI 101 IRQ_TYPE_LEVEL_HIGH>;
        status = "disabled";
        ti,hwmods = "dss_hdmi";
        clocks = <&dss_48mhz_clk>, <&dss_sys_clk>;
        clock-names = "fck", "sys_clk";
    };
};
```

这是 OMAP4 Panda 板的简化描述示例，在 `omap4-panda.dts` 文件中定义。
熊猫板具有一个DVI和一个HDMI连接器，并且该板包含一个TFP410芯片（MIPI DPI到DVI编码器）和一个TPD12S015芯片（HDMI ESD保护及电平转换器）。针对这些连接器的视频管线形成如下：

DSS核心 --(MIPI DPI)--> TFP410 --(DVI)--> DVI连接器
OMAP HDMI --(HDMI)--> TPD12S015 --(HDMI)--> HDMI连接器

/ {
	aliases {
		display0 = &dvi0;	// 显示器0对应DVI
		display1 = &hdmi0;	// 显示器1对应HDMI
	};

	tfp410: encoder@0 {	// TFP410编码器配置
		compatible = "ti,tfp410";	// 兼容性声明
		gpios = <&gpio1 0 GPIO_ACTIVE_LOW>;	// GPIO配置，用于电源下降

		pinctrl-names = "default";	// 引脚控制名
		pinctrl-0 = <&tfp410_pins>;	// 默认引脚控制配置

		ports {	// 端口配置
			#address-cells = <1>;	// 地址单元数
			#size-cells = <0>;	// 大小单元数

			port@0 {	// 端口0
				reg = <0>;	// 端口注册地址

				tfp410_in: endpoint@0 {	// 输入端点
					remote-endpoint = <&dpi_out>;	// 远程端点为DPI输出
				};
			};

			port@1 {	// 端口1
				reg = <1>;	// 端口注册地址

				tfp410_out: endpoint@0 {	// 输出端点
					remote-endpoint = <&dvi_connector_in>;	// 远程端点为DVI连接器输入
				};
			};
		};
	};

	dvi0: connector@0 {	// DVI连接器配置
		compatible = "dvi-connector";	// 兼容性声明
		label = "dvi";	// 标签

		i2c-bus = <&i2c3>;	// I2C总线配置

		port {	// 端口配置
			dvi_connector_in: endpoint {	// 输入端点
				remote-endpoint = <&tfp410_out>;	// 远程端点为TFP410输出
			};
		};
	};

	tpd12s015: encoder@1 {	// TPD12S015编码器配置
		compatible = "ti,tpd12s015";	// 兼容性声明

		pinctrl-names = "default";	// 引脚控制名
		pinctrl-0 = <&tpd12s015_pins>;	// 默认引脚控制配置

		gpios = <&gpio2 28 GPIO_ACTIVE_HIGH>,	// GPIO配置，用于CT CP HPD
			<&gpio2 9 GPIO_ACTIVE_HIGH>,	// GPIO配置，用于LS OE
			<&gpio2 31 GPIO_ACTIVE_HIGH>;	// GPIO配置，用于HPD

		ports {	// 端口配置
			#address-cells = <1>;	// 地址单元数
			#size-cells = <0>;	// 大小单元数

			port@0 {	// 端口0
				reg = <0>;	// 端口注册地址

				tpd12s015_in: endpoint@0 {	// 输入端点
					remote-endpoint = <&hdmi_out>;	// 远程端点为HDMI输出
				};
			};

			port@1 {	// 端口1
				reg = <1>;	// 端口注册地址

				tpd12s015_out: endpoint@0 {	// 输出端点
					remote-endpoint = <&hdmi_connector_in>;	// 远程端点为HDMI连接器输入
				};
			};
		};
	};

	hdmi0: connector@1 {	// HDMI连接器配置
		compatible = "hdmi-connector";	// 兼容性声明
		label = "hdmi";	// 标签

		port {	// 端口配置
			hdmi_connector_in: endpoint {	// 输入端点
				remote-endpoint = <&tpd12s015_out>;	// 远程端点为TPD12S015输出
			};
		};
	};
};

&dss {	// DSS核心配置
	status = "ok";	// 状态

	pinctrl-names = "default";	// 引脚控制名
	pinctrl-0 = <&dss_dpi_pins>;	// 默认引脚控制配置

	port {	// 端口配置
		dpi_out: endpoint {	// 输出端点
			remote-endpoint = <&tfp410_in>;	// 远程端点为TFP410输入
			data-lines = <24>;	// 数据线数量
		};
	};
};

&hdmi {	// HDMI核心配置
	status = "ok";	// 状态
	vdda-supply = <&vdac>;	// VDDA供电配置

	pinctrl-names = "default";	// 引脚控制名
	pinctrl-0 = <&dss_hdmi_pins>;	// 默认引脚控制配置

	port {	// 端口配置
		hdmi_out: endpoint {	// 输出端点
			remote-endpoint = <&tpd12s015_in>;	// 远程端点为TPD12S015输入
		};
	};
};
~~~~

## Documentation/devicetree/bindings/display/ti/ti,omap2-dss_cn.txt
```
### 德州仪器 OMAP2 显示子系统

请参阅 `Documentation/devicetree/bindings/display/ti/ti,omap-dss.txt` 获取有关 OMAP 显示子系统的通用描述。

#### DSS 核心

**必需属性：**
- `compatible`: `"ti,omap2-dss"`
- `reg`: 寄存器空间的地址和长度
- `ti,hwmods`: `"dss_core"`

**可选节点：**
- 用于 DPI 输出的视频端口

**DPI 端点必需属性：**
- `data-lines`: 使用的线路数量

#### DISPC

**必需属性：**
- `compatible`: `"ti,omap2-dispc"`
- `reg`: 寄存器空间的地址和长度
- `ti,hwmods`: `"dss_dispc"`
- `interrupts`: DISPC 中断

**可选属性：**
- `max-memory-bandwidth`: 从主内存到 DISPC 的输入内存带宽限制（每秒字节数）

#### RFBI

**必需属性：**
- `compatible`: `"ti,omap2-rfbi"`
- `reg`: 寄存器空间的地址和长度
- `ti,hwmods`: `"dss_rfbi"`

#### VENC

**必需属性：**
- `compatible`: `"ti,omap2-venc"`
- `reg`: 寄存器空间的地址和长度
- `ti,hwmods`: `"dss_venc"`
- `vdda-supply`: DAC 的电源供应

**VENC 端点必需属性：**

**必需属性：**
- `ti,invert-polarity`: 反转视频信号的极性
- `ti,channels`: 1 表示复合视频，2 表示 S-Video
```

## Documentation/devicetree/bindings/display/ti/ti,omap3-dss_cn.txt
```
### 德州仪器 OMAP3 显示子系统

请参阅 `Documentation/devicetree/bindings/display/ti/ti,omap-dss.txt` 获取关于 OMAP 显示子系统的通用描述。

#### DSS 核心

**必需属性：**
- `compatible`: `"ti,omap3-dss"`
- `reg`: 寄存器空间的地址和长度
- `ti,hwmods`: `"dss_core"`
- `clocks`: 对 `fclk` 的引用
- `clock-names`: `"fck"`

**可选节点：**
- 视频端口：
    - 端口 0: DPI 输出
    - 端口 1: SDI 输出

**DPI 终端必需属性：**
- `data-lines`: 使用的线路数

**SDI 终端必需属性：**
- `datapairs`: 使用的数据对数

#### DISPC

**必需属性：**
- `compatible`: `"ti,omap3-dispc"`
- `reg`: 寄存器空间的地址和长度
- `ti,hwmods`: `"dss_dispc"`
- `interrupts`: DISPC 中断
- `clocks`: 对 `fclk` 的引用
- `clock-names`: `"fck"`

**可选属性：**
- `max-memory-bandwidth`: 输入内存（从主内存到 DISPC）带宽限制，单位为每秒字节

#### RFBI

**必需属性：**
- `compatible`: `"ti,omap3-rfbi"`
- `reg`: 寄存器空间的地址和长度
- `ti,hwmods`: `"dss_rfbi"`
- `clocks`: 对 `fclk` 和 `iclk` 的引用
- `clock-names`: `"fck"`, `"ick"`

#### VENC

**必需属性：**
- `compatible`: `"ti,omap3-venc"`
- `reg`: 寄存器空间的地址和长度
- `ti,hwmods`: `"dss_venc"`
- `vdda-supply`: DAC 的电源供应
- `clocks`: 对 `fclk` 的引用
- `clock-names`: `"fck"`

**VENC 终端必需属性：**
- `ti,invert-polarity`: 反转视频信号的极性
- `ti,channels`: 1 表示复合视频，2 表示 S-Video

#### DSI

**必需属性：**
- `compatible`: `"ti,omap3-dsi"`
- `reg`: `'proto'`、`'phy'` 和 `'pll'` 的寄存器空间地址和长度
- `reg-names`: `"proto"`, `"phy"`, `"pll"`
- `interrupts`: DSI 中断线
- `ti,hwmods`: `"dss_dsi1"`
- `vdd-supply`: DSI 的电源供应
- `clocks`: 对 `fclk` 和 PLL 时钟的引用
- `clock-names`: `"fck"`, `"sys_clk"`

**DSI 终端必需属性：**
- `lanes`: DSI 车道的针脚编号列表：CLK+、CLK-、DATA0+、DATA0-、DATA1+、DATA1- 等
```
