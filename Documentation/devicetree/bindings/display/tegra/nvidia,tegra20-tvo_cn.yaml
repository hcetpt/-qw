## Documentation/devicetree/bindings/display/tegra/nvidia,tegra20-tvo_cn.yaml
```yaml
# SPDX-许可证标识符: (GPL-2.0-only 或 BSD-2-Clause)
%YAML 1.2
---
$id: http://devicetree.org/schemas/display/tegra/nvidia,tegra20-tvo.yaml#
$schema: http://devicetree.org/meta-schemas/core.yaml#

标题: NVIDIA Tegra 电视编码器输出

维护者:
  - Thierry Reding <thierry.reding@gmail.com>
  - Jon Hunter <jonathanh@nvidia.com>

属性:
  $nodename:
    模式: "^tvo@[0-9a-f]+$"

  compatible:
    枚举:
      - nvidia,tegra20-tvo
      - nvidia,tegra30-tvo
      - nvidia,tegra114-tvo

  reg:
    最大项数: 1

  interrupts:
    最大项数: 1

  clocks:
    项:
      - 描述: 模块时钟

  operating-points-v2: 真

  power-domains:
    项:
      - 描述: 核心电源域的 phandle

附加属性: 假

必需:
  - compatible
  - reg
  - interrupts
  - clocks

示例:
  - |
    #include <dt-bindings/clock/tegra20-car.h>
    #include <dt-bindings/interrupt-controller/arm-gic.h>

    tvo@542c0000 {
        compatible = "nvidia,tegra20-tvo";
        reg = <0x542c0000 0x00040000>;
        interrupts = <GIC_SPI 76 IRQ_TYPE_LEVEL_HIGH>;
        clocks = <&tegra_car TEGRA20_CLK_TVO>;
    };
```

## Documentation/devicetree/bindings/display/tegra/nvidia,tegra20-vi_cn.yaml
```yaml
NVIDIA Tegra 视频输入控制器

维护者:
  - Thierry Reding <thierry.reding@gmail.com>
  - Jon Hunter <jonathanh@nvidia.com>

属性:
  $nodename:
    模式: "^vi@[0-9a-f]+$"

  compatible:
    oneOf:
      - 常量: nvidia,tegra20-vi
      - 常量: nvidia,tegra30-vi
      - 常量: nvidia,tegra114-vi
      - 常量: nvidia,tegra124-vi
      - 列表:
          - 常量: nvidia,tegra132-vi
          - 常量: nvidia,tegra124-vi
      - 常量: nvidia,tegra210-vi
      - 常量: nvidia,tegra186-vi
      - 常量: nvidia,tegra194-vi

  reg:
    最大项数: 1

  interrupts:
    最大项数: 1

  clocks:
    最大项数: 1

  resets:
    项:
      - 描述: 模块复位

  reset-names:
    项:
      - 常量: vi

  iommus:
    最大项数: 1

  interconnects:
    最小项数: 4
    最大项数: 5

  interconnect-names:
    最小项数: 4
    最大项数: 5

  operating-points-v2: 真

  power-domains:
    项:
      - 描述: 指向VENC电源域的phandle

  "#address-cells":
    常量: 1

  "#size-cells":
    常量: 1

  ranges:
    最大项数: 1

  avdd-dsi-csi-supply:
    描述: DSI/CSI电源供应。必须提供1.2 V

vip:
    $ref: /schemas/display/tegra/nvidia,tegra20-vip.yaml

  ports:
    $ref: /schemas/graph.yaml#/properties/ports

    属性:
      port@0:
        $ref: /schemas/graph.yaml#/properties/port
        描述:
          来自VIP（并行输入捕获）模块的输入

模式属性:
  "^csi@[0-9a-f]+$":
    类型: 对象

附加属性: 错误

必需:
  - compatible
  - reg
  - interrupts
  - clocks

allOf:
  - 如果:
      属性:
        compatible:
          包含:
            枚举:
              - nvidia,tegra20-vi
              - nvidia,tegra30-vi
              - nvidia,tegra114-vi
              - nvidia,tegra124-vi
    那么:
      必需:
        - resets
        - reset-names
    否则:
      必需:
        - power-domains

示例:
  - |
    #include <dt-bindings/clock/tegra20-car.h>
    #include <dt-bindings/interrupt-controller/arm-gic.h>

    i2c {
        #address-cells = <1>;
        #size-cells = <0>;
        camera@48 {
            compatible = "aptina,mt9v111";
            reg = <0x48>;
            clocks = <&camera_clk>;

            port {
                mt9v111_out: endpoint {
                    remote-endpoint = <&vi_vip_in>;
                };
            };
        };
    };

    vi@54080000 {
        compatible = "nvidia,tegra20-vi";
        reg = <0x54080000 0x00040000>;
        interrupts = <GIC_SPI 69 IRQ_TYPE_LEVEL_HIGH>;
        clocks = <&tegra_car TEGRA20_CLK_VI>;
        resets = <&tegra_car 100>;
        reset-names = "vi";

        vip {
            compatible = "nvidia,tegra20-vip";
            ports {
                #address-cells = <1>;
                #size-cells = <0>;
                port@0 {
                    reg = <0>;
                    vi_vip_in: endpoint {
                        remote-endpoint = <&mt9v111_out>;
                    };
                };
                port@1 {
                    reg = <1>;
                    vi_vip_out: endpoint {
                        remote-endpoint = <&vi_in>;
                    };
                };
            };
        };

        ports {
            #address-cells = <1>;
            #size-cells = <0>;
            port@0 {
                reg = <0>;
                vi_in: endpoint {
                    remote-endpoint = <&vi_vip_out>;
                };
            };
        };
    };

  - |
    #include <dt-bindings/clock/tegra210-car.h>
    #include <dt-bindings/interrupt-controller/arm-gic.h>

    vi@54080000 {
        compatible = "nvidia,tegra210-vi";
        reg = <0x54080000 0x00000700>;
        interrupts = <GIC_SPI 69 IRQ_TYPE_LEVEL_HIGH>;
        assigned-clocks = <&tegra_car TEGRA210_CLK_VI>;
        assigned-clock-parents = <&tegra_car TEGRA210_CLK_PLL_C4_OUT0>;

        clocks = <&tegra_car TEGRA210_CLK_VI>;
        power-domains = <&pd_venc>;

        #address-cells = <1>;
        #size-cells = <1>;

        ranges = <0x0 0x54080000 0x2000>;

        csi@838 {
            compatible = "nvidia,tegra210-csi";
            reg = <0x838 0x1300>;
            assigned-clocks = <&tegra_car TEGRA210_CLK_CILAB>,
                              <&tegra_car TEGRA210_CLK_CILCD>,
                              <&tegra_car TEGRA210_CLK_CILE>,
                              <&tegra_car TEGRA210_CLK_CSI_TPG>;
            assigned-clock-parents = <&tegra_car TEGRA210_CLK_PLL_P>,
                                     <&tegra_car TEGRA210_CLK_PLL_P>,
                                     <&tegra_car TEGRA210_CLK_PLL_P>;
            assigned-clock-rates = <102000000>,
                                   <102000000>,
                                   <102000000>,
                                   <972000000>;

            clocks = <&tegra_car TEGRA210_CLK_CSI>,
                     <&tegra_car TEGRA210_CLK_CILAB>,
                     <&tegra_car TEGRA210_CLK_CILCD>,
                     <&tegra_car TEGRA210_CLK_CILE>,
                     <&tegra_car TEGRA210_CLK_CSI_TPG>;
            clock-names = "csi", "cilab", "cilcd", "cile", "csi_tpg";
            power-domains = <&pd_sor>;
        };
    };
```

## Documentation/devicetree/bindings/display/tegra/nvidia,tegra20-vip_cn.yaml
~~~~yaml
```yaml
# SPDX-文件许可标识符: (GPL-2.0-only 或 BSD-2-Clause)
%YAML 1.2
---
$id: http://devicetree.org/schemas/display/tegra/nvidia,tegra20-vip.yaml#
$schema: http://devicetree.org/meta-schemas/core.yaml#

标题: NVIDIA Tegra VIP (并行视频捕获) 控制器

维护者:
  - Luca Ceresoli <luca.ceresoli@bootlin.com>

属性:
  compatible:
    枚举:
      - nvidia,tegra20-vip

  ports:
    $ref: /schemas/graph.yaml#/properties/ports

    属性:
      port@0:
        $ref: /schemas/graph.yaml#/properties/port
        描述:
          从传感器接收视频流的端口

      port@1:
        $ref: /schemas/graph.yaml#/properties/port
        描述:
          将视频流发送到 VI 的端口

    必需:
      - port@0
      - port@1

未评估的属性: false

必需:
  - compatible
  - ports

# 参见 nvidia,tegra20-vi.yaml 以获取示例
```

请注意，此翻译尽可能保持了原文件的结构和格式，并将其内容翻译为中文。对于某些专有名词和技术术语，为了保持其准确性和一致性，仍然使用英文形式。
~~~~

## Documentation/devicetree/bindings/display/tegra/nvidia,tegra210-csi_cn.yaml
~~~~yaml
```yaml
# SPDX-文件许可人: (GPL-2.0-only 或 BSD-2-Clause)
%YAML 1.2
---
$id: http://devicetree.org/schemas/display/tegra/nvidia,tegra210-csi.yaml#
$schema: http://devicetree.org/meta-schemas/core.yaml#

title: NVIDIA Tegra CSI 控制器

maintainers:
  - Thierry Reding <thierry.reding@gmail.com>
  - Jon Hunter <jonathanh@nvidia.com>

properties:
  $nodename:
    pattern: "^csi@[0-9a-f]+$"

  compatible:
    enum:
      - nvidia,tegra210-csi

  reg:
    maxItems: 1

  clocks:
    items:
      - description: 模块时钟
      - description: A/B 车道时钟
      - description: C/D 车道时钟
      - description: E 车道时钟
      - description: 测试模式生成器时钟

  clock-names:
    items:
      - const: csi
      - const: cilab
      - const: cilcd
      - const: cile
      - const: csi_tpg

  power-domains:
    maxItems: 1

additionalProperties: false

required:
  - compatible
  - reg
  - clocks
  - clock-names
  - power-domains

# 参见 nvidia,tegra20-vi.yaml 以获取示例
```

请注意，此翻译尽量保持了原文的结构和内容。某些术语和技术细节（如 "clocks", "clock-names", "power-domains" 等）保持了英文形式，因为这些术语在中文环境中通常也使用英文表述。
~~~~

## Documentation/devicetree/bindings/display/ti/ti,am65x-dss_cn.yaml
```yaml
下面是给定内容的中文翻译：

# SPDX-许可证标识符: (GPL-2.0 或 BSD-2-Clause)
# 版权所有 2019 德州仪器公司
%YAML 1.2
---
$id: http://devicetree.org/schemas/display/ti/ti,am65x-dss.yaml#
$schema: http://devicetree.org/meta-schemas/core.yaml#

标题: 德州仪器 AM65x 显示子系统

维护者:
  - Jyri Sarha <jsarha@ti.com>
  - Tomi Valkeinen <tomi.valkeinen@ti.com>

描述: |
  AM625 和 AM65x 德州仪器 Keystone 显示子系统具有两个输出端口和两个视频平面。在 AM65x DSS 中，第一个视频端口支持 1 个 OLDI TX，在 AM625 DSS 中，第一个视频端口的输出内部路由到 2 个 OLDI TX。第二个视频端口支持 DPI 格式。第一个平面是全功能视频平面，而第二个是一个“简易平面”，不支持缩放。
属性:
  compatible:
    枚举:
      - ti,am625-dss
      - ti,am62a7-dss
      - ti,am65x-dss

  reg:
    描述:
      每个 DSS 内存区域的地址，如 SoC 的 TRM 中所描述
项:
      - 描述: 公共 DSS 寄存器区域
      - 描述: VIDL1 简易视频平面
      - 描述: VID 视频平面
      - 描述: OVR1 用于 vp1 的叠加管理器
      - 描述: OVR2 用于 vp2 的叠加管理器
      - 描述: VP1 视频端口 1
      - 描述: VP2 视频端口 2
      - 描述: common1 DSS 寄存器区域

  reg-names:
    项:
      - 常量: common
      - 常量: vidl1
      - 常量: vid
      - 常量: ovr1
      - 常量: ovr2
      - 常量: vp1
      - 常量: vp2
      - 常量: common1

  clocks:
    项:
      - 描述: fck DSS 功能时钟
      - 描述: vp1 视频端口 1 像素时钟
      - 描述: vp2 视频端口 2 像素时钟

  clock-names:
    项:
      - 常量: fck
      - 常量: vp1
      - 常量: vp2

  assigned-clocks:
    最小项数: 1
    最大项数: 3

  assigned-clock-parents:
    最小项数: 1
    最大项数: 3

  interrupts:
    最大项数: 1

  power-domains:
    最大项数: 1
    描述: 相关电源域的 phandle

  dma-coherent:
    类型: 布尔值

  ports:
    $ref: /schemas/graph.yaml#/properties/ports

    属性:
      port@0:
        $ref: /schemas/graph.yaml#/properties/port
        描述:
          对于 AM65x DSS，来自视频端口 1 的 OLDI 输出端口节点
对于 AM625 DSS，来自视频端口 1 的内部 DPI 输出端口节点
对于 AM62A7 DSS，端口在 SoC 内部被连接关闭
port@1:
        $ref: /schemas/graph.yaml#/properties/port
        描述:
          来自视频端口 2 的 DSS DPI 输出端口节点

  ti,am65x-oldi-io-ctrl:
    $ref: /schemas/types.yaml#/definitions/phandle
    描述:
      映射至 OLDI IO_CTRL 寄存器的 syscon 设备节点的 phandle
映射范围应指向 OLDI_DAT0_IO_CTRL，将其及其后的 OLDI_DAT1_IO_CTRL、OLDI_DAT2_IO_CTRL、OLDI_DAT3_IO_CTRL 和 OLDI_CLK_IO_CTRL 寄存器一起映射。此属性对于 OLDI 接口正常工作是必需的。
max-memory-bandwidth:
    $ref: /schemas/types.yaml#/definitions/uint32
    描述:
      输入内存（从主内存到 dispc）带宽限制，单位为每秒字节数

allOf:
  - 如果:
      属性:
        compatible:
          包含:
            常量: ti,am62a7-dss
    则:
      属性:
        ports:
          属性:
            port@0: false

所需:
  - compatible
  - reg
  - reg-names
  - clocks
  - clock-names
  - interrupts
  - ports

附加属性: false

示例:
  - |
    #include <dt-bindings/interrupt-controller/arm-gic.h>
    #include <dt-bindings/interrupt-controller/irq.h>
    #include <dt-bindings/soc/ti,sci_pm_domain.h>

    dss: dss@4a00000 {
            compatible = "ti,am65x-dss";
            reg =   <0x04a00000 0x1000>, /* common */
                    <0x04a02000 0x1000>, /* vidl1 */
                    <0x04a06000 0x1000>, /* vid */
                    <0x04a07000 0x1000>, /* ovr1 */
                    <0x04a08000 0x1000>, /* ovr2 */
                    <0x04a0a000 0x1000>, /* vp1 */
                    <0x04a0b000 0x1000>, /* vp2 */
                    <0x04a01000 0x1000>; /* common1 */
            reg-names = "common", "vidl1", "vid",
                    "ovr1", "ovr2", "vp1", "vp2", "common1";
            ti,am65x-oldi-io-ctrl = <&dss_oldi_io_ctrl>;
            power-domains = <&k3_pds 67 TI_SCI_PD_EXCLUSIVE>;
            clocks =        <&k3_clks 67 1>,
                            <&k3_clks 216 1>,
                            <&k3_clks 67 2>;
            clock-names = "fck", "vp1", "vp2";
            interrupts = <GIC_SPI 166 IRQ_TYPE_EDGE_RISING>;
            ports {
                    #address-cells = <1>;
                    #size-cells = <0>;
                    port@0 {
                            reg = <0>;
                            oldi_out0: endpoint {
                                    remote-endpoint = <&lcd_in0>;
                            };
                    };
            };
    };
```

## Documentation/devicetree/bindings/display/ti/ti,dra7-dss_cn.txt
```
### 德州仪器 (Texas Instruments) DRA7x 显示子系统
=====================================

请参阅 `Documentation/devicetree/bindings/display/ti/ti,omap-dss.txt` 获取关于 OMAP 显示子系统的通用描述。

#### DSS 核心
**必需属性：**
- `compatible`: `"ti,dra7-dss"`
- `reg`: 'dss' 的寄存器空间的地址和长度
- `ti,hwmods`: `"dss_core"`
- `clocks`: fclk 的句柄
- `clock-names`: `"fck"`
- `syscon`: 控制模块核心 syscon 节点的 phandle

**可选属性：**

一些 DRA7xx 系统级芯片 (SoC) 配备了一个专用视频 PLL，而有些则有两个。这些属性可用于描述视频 PLL：

- `reg`: 'pll1_clkctrl', 'pll1', 'pll2_clkctrl', 'pll2' 的寄存器空间的地址和长度
- `clocks`: video1 pll 时钟 和 video2 pll 时钟的句柄
- `clock-names`: `"video1_clk"` 和 `"video2_clk"`

**必需节点：**
- `DISPC`

**可选节点：**
- DSS 子模块: HDMI
- DPI 输出的视频端口

**DPI 端点必需属性：**
- `data-lines`: 使用的数据线数量

### DISPC
**必需属性：**
- `compatible`: `"ti,dra7-dispc"`
- `reg`: 寄存器空间的地址和长度
- `ti,hwmods`: `"dss_dispc"`
- `interrupts`: DISPC 中断
- `clocks`: fclk 的句柄
- `clock-names`: `"fck"`

**可选属性：**
- `max-memory-bandwidth`: 输入内存（从主内存到 dispc）带宽限制，以每秒字节数为单位

### HDMI
**必需属性：**
- `compatible`: `"ti,dra7-hdmi"`
- `reg`: 'wp', 'pll', 'phy', 'core' 的寄存器空间的地址和长度
- `reg-names`: "wp", "pll", "phy", "core"
- `interrupts`: HDMI 中断线
- `ti,hwmods`: `"dss_hdmi"`
- `vdda-supply`: vdda 电源供应
- `clocks`: fclk 和 pll 时钟的句柄
- `clock-names`: `"fck"`, `"sys_clk"`

**可选节点：**
- HDMI 输出的视频端口

**HDMI 端点可选属性：**
- `lanes`: HDMI 数据线的引脚列表：CLK+, CLK-, D0+, D0-, D1+, D1-, D2+, D2-。默认值为 0,1,2,3,4,5,6,7。
```
