## Documentation/devicetree/bindings/dsp/fsl,dsp_cn.yaml
~~~~yaml
下面是给定内容的中文翻译：

```yaml
# SPDX-文件许可标识符: (GPL-2.0 或 BSD-2-Clause)
%YAML 1.2
---
$id: http://devicetree.org/schemas/dsp/fsl,dsp.yaml#
$schema: http://devicetree.org/meta-schemas/core.yaml#

标题: NXP i.MX8 DSP 核心

维护者:
  - Daniel Baluta <daniel.baluta@nxp.com>
  - Shengjiu Wang <shengjiu.wang@nxp.com>

描述: |
  某些 i.MX8 系列板载有一个 DSP 核心，用于高级音频预处理和后处理。

属性:
  compatible:
    枚举:
      - fsl,imx8qxp-dsp
      - fsl,imx8qm-dsp
      - fsl,imx8mp-dsp
      - fsl,imx8ulp-dsp
      - fsl,imx8qxp-hifi4
      - fsl,imx8qm-hifi4
      - fsl,imx8mp-hifi4
      - fsl,imx8ulp-hifi4

  reg:
    最大项目数: 1

  clocks:
    项目:
      - 描述: ipg 时钟
      - 描述: ocram 时钟
      - 描述: 核心时钟
      - 描述: 调试接口时钟
      - 描述: 消息单元时钟
    最小项目数: 3

  clock-names:
    项目:
      - 常量: ipg
      - 常量: ocram
      - 常量: core
      - 常量: debug
      - 常量: mu
    最小项目数: 3

  power-domains:
    描述:
      包含在文档中定义的句柄和电源管理域规范列表（参见Documentation/devicetree/bindings/power/power_domain.txt）
    最小项目数: 1
    最大项目数: 4

  mboxes:
    描述:
      包含 <&句柄 类型 通道> 列表 —— 2个通道用于 TXDB, 2个通道用于 RXDB
      或 —— 1个通道用于 TX, 1个通道用于 RX, 1个通道用于 RXDB
      （参见mailbox/fsl,mu.txt）
    最小项目数: 3
    最大项目数: 4

  mbox-names:
    最小项目数: 3
    最大项目数: 4

  memory-region:
    描述:
      DSP 使用的系统RAM内存所对应的保留内存节点的句柄（参见bindings/reserved-memory/reserved-memory.txt）
    最小项目数: 1
    最大项目数: 4

  firmware-name:
    描述: |
      默认加载到远程处理器的固件名称

fsl,dsp-ctrl:
    $ref: /schemas/types.yaml#/definitions/phandle
    描述:
      提供处理器启用访问的 syscon 块的句柄

必需项:
  - compatible
  - reg
  - clocks
  - clock-names
  - power-domains
  - mboxes
  - mbox-names
  - memory-region

allOf:
  - 如果:
      属性:
        compatible:
          包含:
            枚举:
              - fsl,imx8qxp-dsp
              - fsl,imx8qm-dsp
              - fsl,imx8qxp-hifi4
              - fsl,imx8qm-hifi4
    那么:
      属性:
        power-domains:
          最小项目数: 4
    否则:
      属性:
        power-domains:
          最大项目数: 1

  - 如果:
      属性:
        compatible:
          包含:
            枚举:
              - fsl,imx8qxp-hifi4
              - fsl,imx8qm-hifi4
              - fsl,imx8mp-hifi4
              - fsl,imx8ulp-hifi4
    那么:
      属性:
        memory-region:
          最小项目数: 4
        mboxes:
          最大项目数: 3
        mbox-names:
          项目:
            - 常量: tx
            - 常量: rx
            - 常量: rxdb
    否则:
      属性:
        memory-region:
          最大项目数: 1
        mboxes:
          最小项目数: 4
        mbox-names:
          项目:
            - 常量: txdb0
            - 常量: txdb1
            - 常量: rxdb0
            - 常量: rxdb1

附加属性: false

示例:
  - |
    #include <dt-bindings/firmware/imx/rsrc.h>
    #include <dt-bindings/clock/imx8-clock.h>
    dsp@596e8000 {
        compatible = "fsl,imx8qxp-dsp";
        reg = <0x596e8000 0x88000>;
        clocks = <&adma_lpcg IMX_ADMA_LPCG_DSP_IPG_CLK>,
                 <&adma_lpcg IMX_ADMA_LPCG_OCRAM_IPG_CLK>,
                 <&adma_lpcg IMX_ADMA_LPCG_DSP_CORE_CLK>;
        clock-names = "ipg", "ocram", "core";
        power-domains = <&pd IMX_SC_R_MU_13A>,
                        <&pd IMX_SC_R_MU_13B>,
                        <&pd IMX_SC_R_DSP>,
                        <&pd IMX_SC_R_DSP_RAM>;
        mbox-names = "txdb0", "txdb1", "rxdb0", "rxdb1";
        mboxes = <&lsio_mu13 2 0>, <&lsio_mu13 2 1>, <&lsio_mu13 3 0>, <&lsio_mu13 3 1>;
        memory-region = <&dsp_reserved>;
    };
  - |
    #include <dt-bindings/clock/imx8mp-clock.h>
    dsp_reserved: dsp@92400000 {
      reg = <0x92400000 0x1000000>;
      no-map;
    };
    dsp_vdev0vring0: vdev0vring0@942f0000 {
      reg = <0x942f0000 0x8000>;
      no-map;
    };
    dsp_vdev0vring1: vdev0vring1@942f8000 {
      reg = <0x942f8000 0x8000>;
      no-map;
    };
    dsp_vdev0buffer: vdev0buffer@94300000 {
      compatible = "shared-dma-pool";
      reg = <0x94300000 0x100000>;
      no-map;
    };

    dsp: dsp@3b6e8000 {
      compatible = "fsl,imx8mp-hifi4";
      reg = <0x3b6e8000 0x88000>;
      clocks = <&audio_blk_ctrl IMX8MP_CLK_AUDIOMIX_DSP_ROOT>,
               <&audio_blk_ctrl IMX8MP_CLK_AUDIOMIX_OCRAMA_IPG>,
               <&audio_blk_ctrl IMX8MP_CLK_AUDIOMIX_DSP_ROOT>,
               <&audio_blk_ctrl IMX8MP_CLK_AUDIOMIX_DSPDBG_ROOT>;
      clock-names = "ipg", "ocram", "core", "debug";
      firmware-name = "imx/dsp/hifi4.bin";
      power-domains = <&audiomix_pd>;
      mbox-names = "tx", "rx", "rxdb";
      mboxes = <&mu2 0 0>,
               <&mu2 1 0>,
               <&mu2 3 0>;
      memory-region = <&dsp_vdev0buffer>, <&dsp_vdev0vring0>,
                      <&dsp_vdev0vring1>, <&dsp_reserved>;
      fsl,dsp-ctrl = <&audio_blk_ctrl>;
    };
```
```
~~~~

## Documentation/devicetree/bindings/dsp/mediatek,mt8186-dsp_cn.yaml
~~~~yaml
```yaml
# SPDX-许可证标识符: (GPL-2.0 或 BSD-2-Clause)
%YAML 1.2
---
$id: http://devicetree.org/schemas/dsp/mediatek,mt8186-dsp.yaml#
$schema: http://devicetree.org/meta-schemas/core.yaml#

标题: MediaTek mt8186 DSP 核心

维护者:
  - 沈廷瀚 <tinghan.shen@mediatek.com>

描述: |
  MediaTek mt8186 系统芯片包含一个用于
  高级音频预处理和后处理的 DSP 核心
属性:
  compatible:
    枚举:
      - mediatek,mt8186-dsp
      - mediatek,mt8188-dsp

  reg:
    项:
      - 描述: DSP 配置寄存器的地址和大小
      - 描述: DSP SRAM 的地址和大小
      - 描述: DSP 安全寄存器的地址和大小
      - 描述: DSP 总线寄存器的地址和大小

  reg-names:
    项:
      - 常量: cfg
      - 常量: sram
      - 常量: sec
      - 常量: bus

  clocks:
    项:
      - 描述: 音频 DSP 时钟的多路复用器
      - 描述: 音频 DSP 局部总线的多路复用器

  clock-names:
    项:
      - 常量: audiodsp
      - 常量: adsp_bus

  power-domains:
    最大项数: 1

  mboxes:
    项:
      - 描述: 用于接收音频 DSP 请求的邮箱
      - 描述: 用于向音频 DSP 发送请求的邮箱
mbox-names:
    项:
      - 常量: rx
      - 常量: tx

  memory-region:
    项:
      - 描述: 主机与 DSP 之间的 DMA 缓冲区
      - 描述: DSP 系统内存

必需:
  - compatible
  - reg
  - reg-names
  - clocks
  - clock-names
  - power-domains
  - mbox-names
  - mboxes

额外属性: false

示例:
  - |
    #include <dt-bindings/clock/mt8186-clk.h>
    dsp@10680000 {
        compatible = "mediatek,mt8186-dsp";
        reg = <0x10680000 0x2000>,
              <0x10800000 0x100000>,
              <0x1068b000 0x100>,
              <0x1068f000 0x1000>;
        reg-names = "cfg", "sram", "sec", "bus";
        clocks = <&topckgen CLK_TOP_AUDIODSP>,
                 <&topckgen CLK_TOP_ADSP_BUS>;
        clock-names = "audiodsp",
                      "adsp_bus";
        power-domains = <&spm 6>;
        mbox-names = "rx", "tx";
        mboxes = <&adsp_mailbox0>, <&adsp_mailbox1>;
    };
```

请注意，上述翻译尽可能地保持了原始 YAML 文件的结构，并将英文文本翻译成了中文。某些术语和技术细节（如 YAML 标签、关键字和属性名）保持不变以确保文件格式正确。
~~~~
