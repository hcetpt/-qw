## Documentation/devicetree/bindings/display/ste,mcde_cn.yaml
~~~~yaml
下面是给定的 YAML 文档的中文翻译：

```yaml
# SPDX-文件许可标识符: (GPL-2.0 或 BSD-2-Clause)
%YAML 1.2
---
$id: 'http://devicetree.org/schemas/display/ste,mcde.yaml#'
$schema: 'http://devicetree.org/meta-schemas/core.yaml#'

title: ST-Ericsson 多通道显示引擎 MCDE

maintainers:
  - Linus Walleij <linus.walleij@linaro.org>

properties:
  compatible:
    const: ste,mcde

  reg:
    maxItems: 1

  interrupts:
    maxItems: 1

  clocks:
    description: 一个包含 MCDE 时钟的数组
    items:
      - description: MCDECLK（主 MCDE 时钟）
      - description: LCDCLK（LCD 时钟）
      - description: PLLDSI（HDMI 时钟）

  clock-names:
    items:
      - const: mcde
      - const: lcd
      - const: hdmi

  resets:
    maxItems: 1

  epod-supply:
    description: 指向 EPOD 调压器的 phandle

  vana-supply:
    description: 指向模拟电压调节器的 phandle

  port:
    $ref: '/schemas/graph.yaml#/properties/port'
    description:
      一个 DPI 端口节点

  "#address-cells":
    const: 1

  "#size-cells":
    const: 1

  ranges: true

patternProperties:
  "^dsi@[0-9a-f]+$":
    description: 三个 DSI 主机适配器的子节点
    type: object
    $ref: 'dsi-controller.yaml#'

    properties:
      compatible:
        const: ste,mcde-dsi

      reg:
        maxItems: 1

      vana-supply:
        description: 指向模拟电压调节器的 phandle

      clocks:
        description: 高速和低功耗（节能）时钟的 phandle，第三个（dsi2）块上没有高速时钟，
          因此它应该只有“lp”时钟
        minItems: 1
        maxItems: 2

      clock-names:
        oneOf:
          - items:
              - const: hs
              - const: lp
          - items:
              - const: lp

    required:
      - compatible
      - reg
      - vana-supply
      - clocks
      - clock-names

    unevaluatedProperties: false

required:
  - compatible
  - reg
  - interrupts
  - clocks
  - clock-names
  - epod-supply
  - vana-supply

additionalProperties: false

examples:
  - |
    #include <dt-bindings/interrupt-controller/irq.h>
    #include <dt-bindings/interrupt-controller/arm-gic.h>
    #include <dt-bindings/mfd/dbx500-prcmu.h>
    #include <dt-bindings/gpio/gpio.h>

    mcde@a0350000 {
      compatible = "ste,mcde";
      reg = <0xa0350000 0x1000>;
      interrupts = <GIC_SPI 48 IRQ_TYPE_LEVEL_HIGH>;
      epod-supply = <&db8500_b2r2_mcde_reg>;
      vana-supply = <&ab8500_ldo_ana_reg>;
      clocks = <&prcmu_clk PRCMU_MCDECLK>,
               <&prcmu_clk PRCMU_LCDCLK>,
               <&prcmu_clk PRCMU_PLLDSI>;
      clock-names = "mcde", "lcd", "hdmi";
      #address-cells = <1>;
      #size-cells = <1>;
      ranges;

      dsi0: dsi@a0351000 {
        compatible = "ste,mcde-dsi";
        reg = <0xa0351000 0x1000>;
        vana-supply = <&ab8500_ldo_ana_reg>;
        clocks = <&prcmu_clk PRCMU_DSI0CLK>, <&prcmu_clk PRCMU_DSI0ESCCLK>;
        clock-names = "hs", "lp";
        #address-cells = <1>;
        #size-cells = <0>;

        panel@0 {
          compatible = "samsung,s6d16d0";
          reg = <0>;
          vdd1-supply = <&ab8500_ldo_aux1_reg>;
          reset-gpios = <&gpio2 1 GPIO_ACTIVE_LOW>;
        };
      };

      dsi1: dsi@a0352000 {
        compatible = "ste,mcde-dsi";
        reg = <0xa0352000 0x1000>;
        vana-supply = <&ab8500_ldo_ana_reg>;
        clocks = <&prcmu_clk PRCMU_DSI1CLK>, <&prcmu_clk PRCMU_DSI1ESCCLK>;
        clock-names = "hs", "lp";
        #address-cells = <1>;
        #size-cells = <0>;
      };

      dsi2: dsi@a0353000 {
        compatible = "ste,mcde-dsi";
        reg = <0xa0353000 0x1000>;
        vana-supply = <&ab8500_ldo_ana_reg>;
        /* 此 DSI 端口仅具有低功耗 / 节能时钟 */
        clocks = <&prcmu_clk PRCMU_DSI2ESCCLK>;
        clock-names = "lp";
        #address-cells = <1>;
        #size-cells = <0>;
      };
    };
```

请注意，由于 YAML 本身不支持注释，因此这里的例子部分保留了原始的 C 风格注释。在实际的 YAML 文件中，这些注释需要被转换为 YAML 兼容的格式或移除。
~~~~

## Documentation/devicetree/bindings/display/tegra/nvidia,tegra124-dpaux_cn.yaml
```yaml
# SPDX-License-Identifier: (GPL-2.0-only OR BSD-2-Clause)
%YAML 1.2
---
$id: http://devicetree.org/schemas/display/tegra/nvidia,tegra124-dpaux.yaml#
$schema: http://devicetree.org/meta-schemas/core.yaml#

title: NVIDIA Tegra 显示端口辅助接口

maintainers:
  - Thierry Reding <thierry.reding@gmail.com>
  - Jon Hunter <jonathanh@nvidia.com>

description: |
  Tegra 显示端口辅助 (DPAUX) 垫控制器管理两个可以分配给 DPAUX 通道或 I2C 控制器的引脚。
  当配置为显示端口辅助操作时，DPAUX 控制器还可以使用辅助通道与显示端口设备通信。

properties:
  $nodename:
    pattern: "^dpaux@[0-9a-f]+$"

  compatible:
    oneOf:
      - enum:
          - nvidia,tegra124-dpaux
          - nvidia,tegra210-dpaux
          - nvidia,tegra186-dpaux
          - nvidia,tegra194-dpaux

      - items:
          - const: nvidia,tegra132-dpaux
          - const: nvidia,tegra124-dpaux

  reg:
    maxItems: 1

  interrupts:
    maxItems: 1

  clocks:
    items:
      - description: 用于 DPAUX 硬件的时钟输入
      - description: 参考时钟

  clock-names:
    items:
      - const: dpaux
      - const: parent

  resets:
    items:
      - description: 模块复位

  reset-names:
    items:
      - const: dpaux

  power-domains:
    maxItems: 1

  i2c-bus:
    description: 列出 I2C 从设备的子节点。此子节点必须始终存在。如果没有 I2C 从设备，则应添加一个空节点。更多信息，请参阅 ../../i2c/i2c.yaml
type: object

  aux-bus:
    $ref: /schemas/display/dp-aux-bus.yaml#

  vdd-supply:
    description: 向显示端口链路供电的电源的 phandle

patternProperties:
  "^pinmux-[a-z0-9]+$":
    description:
      由于只有三种配置是可能的，因此只需要三个子节点来描述 DPAUX 垫的引脚复用选项。此外，鉴于垫功能仅适用于一组垫，子节点只需描述正在应用功能的垫组而不是单个垫。
type: object
    properties:
      groups:
        const: dpaux-io

      function:
        enum:
          - aux
          - i2c
          - off

    additionalProperties: false

    required:
      - groups
      - function

additionalProperties: false

required:
  - compatible
  - reg
  - interrupts
  - clocks
  - clock-names
  - resets
  - reset-names

examples:
  - |
    #include <dt-bindings/clock/tegra210-car.h>
    #include <dt-bindings/interrupt-controller/arm-gic.h>

    dpaux: dpaux@545c0000 {
        compatible = "nvidia,tegra210-dpaux";
        reg = <0x545c0000 0x00040000>;
        interrupts = <GIC_SPI 159 IRQ_TYPE_LEVEL_HIGH>;
        clocks = <&tegra_car TEGRA210_CLK_DPAUX>,
                 <&tegra_car TEGRA210_CLK_PLL_DP>;
        clock-names = "dpaux", "parent";
        resets = <&tegra_car 181>;
        reset-names = "dpaux";
        power-domains = <&pd_sor>;

        state_dpaux_aux: pinmux-aux {
            groups = "dpaux-io";
            function = "aux";
        };

        state_dpaux_i2c: pinmux-i2c {
            groups = "dpaux-io";
            function = "i2c";
        };

        state_dpaux_off: pinmux-off {
            groups = "dpaux-io";
            function = "off";
        };

        i2c-bus {
            #address-cells = <1>;
            #size-cells = <0>;
        };
    };
```

## Documentation/devicetree/bindings/display/tegra/nvidia,tegra124-sor_cn.yaml
```yaml
# SPDX-文件许可人: (GPL-2.0-only 或 BSD-2-Clause)
%YAML 1.2
---
$id: http://devicetree.org/schemas/display/tegra/nvidia,tegra124-sor.yaml#
$schema: http://devicetree.org/meta-schemas/core.yaml#

title: NVIDIA Tegra SOR 输出编码器

maintainers:
  - Thierry Reding <thierry.reding@gmail.com>
  - Jon Hunter <jonathanh@nvidia.com>

description: |
  串行输出资源 (SOR) 可用于驱动 HDMI、LVDS、eDP 和 DP 输出。
properties:
  $nodename:
    pattern: "^sor@[0-9a-f]+$"

  compatible:
    oneOf:
      - enum:
          - nvidia,tegra124-sor
          - nvidia,tegra210-sor
          - nvidia,tegra210-sor1
          - nvidia,tegra186-sor
          - nvidia,tegra186-sor1
          - nvidia,tegra194-sor

      - items:
          - const: nvidia,tegra132-sor
          - const: nvidia,tegra124-sor

  reg:
    maxItems: 1

  interrupts:
    maxItems: 1

  clocks:
    minItems: 5
    maxItems: 6

  clock-names:
    minItems: 5
    maxItems: 6

  resets:
    items:
      - description: 模块复位

  reset-names:
    items:
      - const: sor

  power-domains:
    maxItems: 1

  avdd-io-hdmi-dp-supply:
    description: HDMI/DP 的 I/O 供电

  vdd-hdmi-dp-pll-supply:
    description: HDMI/DP 的 PLL 供电

  hdmi-supply:
    description: +5.0V HDMI 连接器供电，对于 HDMI 是必需的

  # Tegra186 及以后版本
  nvidia,interface:
    description: SOR 接口的索引
    $ref: /schemas/types.yaml#/definitions/uint32

  nvidia,ddc-i2c-bus:
    description: 用于 DDC EDID 探测的 I2C 控制器的 phandle
    $ref: /schemas/types.yaml#/definitions/phandle

  nvidia,hpd-gpio:
    description: 规定了用于热插拔检测的 GPIO
    maxItems: 1

  nvidia,edid:
    description: 提供二进制 EDID 数据块
    $ref: /schemas/types.yaml#/definitions/uint8-array

  nvidia,panel:
    description: 显示面板的 phandle，对于 eDP 是必需的
    $ref: /schemas/types.yaml#/definitions/phandle

  nvidia,xbar-cfg:
    description: 包含交叉矩阵配置的 5 个单元格
每个 SOR 的通道通过交叉矩阵映射到由单元格值指定的端口
$ref: /schemas/types.yaml#/definitions/uint32-array

  # 当驱动 eDP 输出时是可选的
  nvidia,dpaux:
    description: 显示端口 AUX 接口的 phandle
    $ref: /schemas/types.yaml#/definitions/phandle

allOf:
  - if:
      properties:
        compatible:
          contains:
            enum:
              - nvidia,tegra186-sor
              - nvidia,tegra194-sor
    then:
      properties:
        clocks:
          items:
            - description: SOR 硬件的时钟输入
            - description: SOR 输出时钟
            - description: 像素时钟的输入
            - description: SOR 时钟的参考时钟
            - description: SOR 时钟在上电期间的安全参考时钟
            - description: SOR 端口输出时钟

        clock-names:
          items:
            - const: sor
            - enum:
                - source # 已弃用
                - out
            - const: parent
            - const: dp
            - const: safe
            - const: pad
    else:
      properties:
        clocks:
          items:
            - description: SOR 硬件的时钟输入
            - description: SOR 输出时钟
            - description: 像素时钟的输入
            - description: SOR 时钟的参考时钟
            - description: SOR 时钟在上电期间的安全参考时钟

        clock-names:
          items:
            - const: sor
            - enum:
                - source # 已弃用
                - out
            - const: parent
            - const: dp
            - const: safe

additionalProperties: false

required:
  - compatible
  - reg
  - interrupts
  - clocks
  - clock-names
  - resets
  - reset-names
  - avdd-io-hdmi-dp-supply
  - vdd-hdmi-dp-pll-supply

examples:
  - |
    #include <dt-bindings/clock/tegra210-car.h>
    #include <dt-bindings/gpio/tegra-gpio.h>
    #include <dt-bindings/interrupt-controller/arm-gic.h>

    sor0: sor@54540000 {
        compatible = "nvidia,tegra210-sor";
        reg = <0x54540000 0x00040000>;
        interrupts = <GIC_SPI 76 IRQ_TYPE_LEVEL_HIGH>;
        clocks = <&tegra_car TEGRA210_CLK_SOR0>,
                 <&tegra_car TEGRA210_CLK_SOR0_OUT>,
                 <&tegra_car TEGRA210_CLK_PLL_D_OUT0>,
                 <&tegra_car TEGRA210_CLK_PLL_DP>,
                 <&tegra_car TEGRA210_CLK_SOR_SAFE>;
        clock-names = "sor", "out", "parent", "dp", "safe";
        resets = <&tegra_car 182>;
        reset-names = "sor";
        pinctrl-0 = <&state_dpaux_aux>;
        pinctrl-1 = <&state_dpaux_i2c>;
        pinctrl-2 = <&state_dpaux_off>;
        pinctrl-names = "aux", "i2c", "off";
        power-domains = <&pd_sor>;

        avdd-io-hdmi-dp-supply = <&avdd_1v05>;
        vdd-hdmi-dp-pll-supply = <&vdd_1v8>;
        hdmi-supply = <&vdd_hdmi>;

        nvidia,ddc-i2c-bus = <&hdmi_ddc>;
        nvidia,hpd-gpio = <&gpio TEGRA_GPIO(CC, 1) GPIO_ACTIVE_LOW>;
    };
```

## Documentation/devicetree/bindings/display/tegra/nvidia,tegra124-vic_cn.yaml
```yaml
# SPDX-License-Identifier: (GPL-2.0-only OR BSD-2-Clause)
%YAML 1.2
---
$id: http://devicetree.org/schemas/display/tegra/nvidia,tegra124-vic.yaml#
$schema: http://devicetree.org/meta-schemas/core.yaml#

title: NVIDIA Tegra 视频图像合成器

maintainers:
  - Thierry Reding <thierry.reding@gmail.com>
  - Jon Hunter <jonathanh@nvidia.com>

properties:
  $nodename:
    pattern: "^vic@[0-9a-f]+$"

  compatible:
    oneOf:
      - enum:
          - nvidia,tegra124-vic
          - nvidia,tegra210-vic
          - nvidia,tegra186-vic
          - nvidia,tegra194-vic
          - nvidia,tegra234-vic

      - items:
          - const: nvidia,tegra132-vic
          - const: nvidia,tegra124-vic

  reg:
    maxItems: 1

  interrupts:
    maxItems: 1

  clocks:
    items:
      - description: 为 VIC 硬件提供的时钟输入

  clock-names:
    items:
      - const: vic

  resets:
    items:
      - description: 模块复位

  reset-names:
    items:
      - const: vic

  power-domains:
    maxItems: 1

  iommus:
    maxItems: 1

  interconnects:
    description: 描述 VIC 的互连路径；详情参见 ../interconnect/interconnect.txt
    items:
      - description: VIC 的内存读取客户端
      - description: VIC 的内存写入客户端

  interconnect-names:
    items:
      - const: dma-mem # 读取
      - const: 写入

  dma-coherent: true

additionalProperties: false
```

## Documentation/devicetree/bindings/display/tegra/nvidia,tegra186-dc_cn.yaml
```yaml
# SPDX-许可证标识符: (GPL-2.0-only 或 BSD-2-Clause)
%YAML 1.2
---
$id: http://devicetree.org/schemas/display/tegra/nvidia,tegra186-dc.yaml#
$schema: http://devicetree.org/meta-schemas/core.yaml#

标题: NVIDIA Tegra186 (及其后续版本) 显示控制器

维护者:
  - Thierry Reding <thierry.reding@gmail.com>
  - Jon Hunter <jonathanh@nvidia.com>

属性:
  $nodename:
    模式: "^display@[0-9a-f]+$"

  compatible:
    枚举:
      - nvidia,tegra186-dc
      - nvidia,tegra194-dc

  reg:
    最大项目数: 1

  interrupts:
    最大项目数: 1

  clocks:
    项目:
      - 描述: 显示控制器像素时钟

  clock-names:
    项目:
      - 常量: dc

  resets:
    项目:
      - 描述: 显示控制器复位

  reset-names:
    项目:
      - 常量: dc

  power-domains:
    最大项目数: 1

  iommus:
    最大项目数: 1

  interconnects:
    描述: 显示控制器的互连路径描述；详情请参阅 ../interconnect/interconnect.txt
interconnect-names:
    项目:
      - 常量: dma-mem # 读取-0
      - 常量: 读取-1

  nvidia,outputs:
    描述: 此显示控制器可以驱动的输出列表
$ref: /schemas/types.yaml#/definitions/phandle-array

  nvidia,head:
    描述: 显示控制器头的编号。这用于设置各种类型的输出以从指定的头接收视频数据
$ref: /schemas/types.yaml#/definitions/uint32

附加属性: false

必需:
  - compatible
  - reg
  - interrupts
  - clocks
  - clock-names
  - resets
  - reset-names
  - power-domains
  - nvidia,outputs
  - nvidia,head

# 请参阅 nvidia,tegra186-display.yaml 获取示例
```
