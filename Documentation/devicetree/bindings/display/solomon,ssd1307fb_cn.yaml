## Documentation/devicetree/bindings/display/solomon,ssd1307fb_cn.yaml
```yaml
# SPDX-许可证标识符: (GPL-2.0-only 或 BSD-2-Clause)
%YAML 1.2
---
$id: http://devicetree.org/schemas/display/solomon,ssd1307fb.yaml#
$schema: http://devicetree.org/meta-schemas/core.yaml#

title: Solomon SSD1307 OLED 控制器帧缓冲区

maintainers:
  - Maxime Ripard <mripard@kernel.org>
  - Javier Martinez Canillas <javierm@redhat.com>

properties:
  compatible:
    oneOf:
      # 过时的兼容字符串
      - enum:
          - solomon,ssd1305fb-i2c
          - solomon,ssd1306fb-i2c
          - solomon,ssd1307fb-i2c
          - solomon,ssd1309fb-i2c
        deprecated: true
      - enum:
          - sinowealth,sh1106
          - solomon,ssd1305
          - solomon,ssd1306
          - solomon,ssd1307
          - solomon,ssd1309

  pwms:
    maxItems: 1

  vbat-supply:
    description: VBAT 的电源供应

  solomon,page-offset:
    $ref: /schemas/types.yaml#/definitions/uint32
    default: 1
    description:
      屏幕映射到的页面（8像素带）偏移量

  solomon,segment-no-remap:
    type: boolean
    description:
      显示需要正常（非反转）的数据列到段映射

  solomon,col-offset:
    $ref: /schemas/types.yaml#/definitions/uint32
    default: 0
    description:
      屏幕映射到的列（COL/SEG）偏移量

  solomon,com-seq:
    type: boolean
    description:
      显示使用顺序 COM 引脚配置

  solomon,com-lrremap:
    type: boolean
    description:
      显示使用左右 COM 引脚重映射

  solomon,com-invdir:
    type: boolean
    description:
      显示使用反转 COM 引脚扫描方向

  solomon,com-offset:
    $ref: /schemas/types.yaml#/definitions/uint32
    default: 0
    description:
      连接到第一显示行的 COM 引脚编号

  solomon,prechargep1:
    $ref: /schemas/types.yaml#/definitions/uint32
    default: 2
    description:
      非选择周期（阶段 1）的长度，以时钟周期计

  solomon,prechargep2:
    $ref: /schemas/types.yaml#/definitions/uint32
    default: 2
    description:
      预充电周期（阶段 2）的长度，以时钟周期计。该值需要随着 OLED 像素电容的增加而增加

  solomon,dclk-div:
    $ref: /schemas/types.yaml#/definitions/uint32
    minimum: 1
    maximum: 16
    description:
      时钟除数。默认值取决于控制器

  solomon,dclk-frq:
    $ref: /schemas/types.yaml#/definitions/uint32
    minimum: 0
    maximum: 15
    description:
      时钟频率，较高值表示较高频率。默认值取决于控制器

  solomon,lookup-table:
    $ref: /schemas/types.yaml#/definitions/uint8-array
    maxItems: 4
    description:
      用于 BANK0 和颜色 A、B 和 C 的电流驱动脉冲宽度的 8 位值数组。每个值在 31 到 63 的范围内，对应于 32 到 64 的脉冲宽度。颜色 D 总是宽度为 64。

  solomon,area-color-enable:
    type: boolean
    description:
      显示使用颜色模式

  solomon,low-power:
    type: boolean
    description:
      显示运行在低功耗模式下

required:
  - compatible
  - reg

allOf:
  - $ref: solomon,ssd-common.yaml#

  - if:
      properties:
        compatible:
          contains:
            const: sinowealth,sh1106
    then:
      properties:
        solomon,width:
          default: 132
        solomon,height:
          default: 64
        solomon,dclk-div:
          default: 1
        solomon,dclk-frq:
          default: 5

  - if:
      properties:
        compatible:
          contains:
            enum:
              - solomon,ssd1305-i2c
              - solomon,ssd1305
    then:
      properties:
        solomon,width:
          default: 132
        solomon,height:
          default: 64
        solomon,dclk-div:
          default: 1
        solomon,dclk-frq:
          default: 7

  - if:
      properties:
        compatible:
          contains:
            enum:
              - solomon,ssd1306-i2c
              - solomon,ssd1306
    then:
      properties:
        solomon,width:
          default: 128
        solomon,height:
          default: 64
        solomon,dclk-div:
          default: 1
        solomon,dclk-frq:
          default: 8

  - if:
      properties:
        compatible:
          contains:
            enum:
              - solomon,ssd1307-i2c
              - solomon,ssd1307
    then:
      properties:
        solomon,width:
          default: 128
        solomon,height:
          default: 39
        solomon,dclk-div:
          default: 2
        solomon,dclk-frq:
          default: 12
      required:
        - pwms

  - if:
      properties:
        compatible:
          contains:
            enum:
              - solomon,ssd1309-i2c
              - solomon,ssd1309
    then:
      properties:
        solomon,width:
          default: 128
        solomon,height:
          default: 64
        solomon,dclk-div:
          default: 1
        solomon,dclk-frq:
          default: 10

unevaluatedProperties: false

examples:
  - |
    i2c {
            #address-cells = <1>;
            #size-cells = <0>;

            ssd1307_i2c: oled@3c {
                    compatible = "solomon,ssd1307";
                    reg = <0x3c>;
                    pwms = <&pwm 4 3000>;
                    reset-gpios = <&gpio2 7>;
            };

            ssd1306_i2c: oled@3d {
                    compatible = "solomon,ssd1306";
                    reg = <0x3d>;
                    pwms = <&pwm 4 3000>;
                    reset-gpios = <&gpio2 7>;
                    solomon,com-lrremap;
                    solomon,com-invdir;
                    solomon,com-offset = <32>;
                    solomon,lookup-table = /bits/ 8 <0x3f 0x3f 0x3f 0x3f>;
            };
    };
  - |
    spi {
            #address-cells = <1>;
            #size-cells = <0>;

            ssd1307_spi: oled@0 {
                    compatible = "solomon,ssd1307";
                    reg = <0x0>;
                    pwms = <&pwm 4 3000>;
                    reset-gpios = <&gpio2 7>;
                    dc-gpios = <&gpio2 8>;
                    spi-max-frequency = <10000000>;
            };

            ssd1306_spi: oled@1 {
                    compatible = "solomon,ssd1306";
                    reg = <0x1>;
                    pwms = <&pwm 4 3000>;
                    reset-gpios = <&gpio2 7>;
                    dc-gpios = <&gpio2 8>;
                    spi-max-frequency = <10000000>;
                    solomon,com-lrremap;
                    solomon,com-invdir;
                    solomon,com-offset = <32>;
                    solomon,lookup-table = /bits/ 8 <0x3f 0x3f 0x3f 0x3f>;
            };
    };
```

## Documentation/devicetree/bindings/display/solomon,ssd133x_cn.yaml
~~~~yaml
```yaml
# SPDX-许可证标识符: (GPL-2.0-only 或 BSD-2-Clause)
%YAML 1.2
---
$id: http://devicetree.org/schemas/display/solomon,ssd133x.yaml#
$schema: http://devicetree.org/meta-schemas/core.yaml#

title: Solomon SSD133x OLED 显示控制器

maintainers:
  - Javier Martinez Canillas <javierm@redhat.com>

allOf:
  - $ref: solomon,ssd-common.yaml#

properties:
  compatible:
    enum:
      - solomon,ssd1331

  solomon,width:
    default: 96

  solomon,height:
    default: 64

required:
  - compatible
  - reg

unevaluatedProperties: false

examples:
  - |
    spi {
        #address-cells = <1>;
        #size-cells = <0>;

        oled@0 {
            compatible = "solomon,ssd1331";
            reg = <0x0>;
            reset-gpios = <&gpio2 7>;
            dc-gpios = <&gpio2 8>;
            spi-max-frequency = <10000000>;
        };
    };
```

这段 YAML 文件描述了 Solomon SSD133x OLED 显示控制器的设备树规范。它定义了控制器的基本属性、兼容性、必需字段等，并提供了一个示例来说明如何在设备树中表示这类控制器。
~~~~

## Documentation/devicetree/bindings/display/sprd/sprd,display-subsystem_cn.yaml
```yaml
# SPDX-文件许可人: (GPL-2.0-only 或 BSD-2-Clause)
%YAML 1.2
---
$id: http://devicetree.org/schemas/display/sprd/sprd,display-subsystem.yaml#
$schema: http://devicetree.org/meta-schemas/core.yaml#

标题: Unisoc DRM 主设备

维护者:
  - Kevin Tang <kevin.tang@unisoc.com>

描述: |
  Unisoc DRM 主设备是一个虚拟设备，用于列出所有
  DPU 设备或其他构成图形子系统的显示接口节点。
  Unisoc 的显示流水线包含以下几个组件，如下所示：
  多个显示控制器及其对应的物理接口。
  对于不同的显示场景，dpu0 和 dpu1 可能绑定到不同的
  编码器。
  例如:
  dpu0 和 dpu1 都绑定到 DSI 实现双路 mipi-dsi 显示；
  dpu0 绑定到 DSI 作为主显示器，而 dpu1 绑定到 DP 作为外接显示器；

          +-----------------------------------------+
          |                                         |
          |                            +---------+  |
  +----+  |   +----+    +---------+    |DPHY/CPHY|  |   +------+
  |    +----->+dpu0+--->+MIPI|DSI +--->+Combo    +----->+Panel0|
  |AXI |  |   +----+    +---------+    +---------+  |   +------+
  |    |  |                  ^                      |
  |    |  |                  |                      |
  |    |  |      +-----------+                      |
  |    |  |      |                                  |
  |APB |  |   +--+-+    +-----------+    +---+      |   +------+
  |    +----->+dpu1+--->+DisplayPort+--->+PHY+--------->+Panel1|
  |    |  |   +----+    +-----------+    +---+      |   +------+
  +----+  |                                         |
          +-----------------------------------------+

属性:
  compatible:
    常量: sprd,display-subsystem

  ports:
    $ref: /schemas/types.yaml#/definitions/phandle-array
    items:
      最大项数: 1
    描述:
      应该包含指向 DPU 设备的显示接口端口的 phandle 列表
必需:
  - compatible
  - ports

附加属性: false

示例:
  - |
    display-subsystem {
        compatible = "sprd,display-subsystem";
        ports = <&dpu_out>;
    };
```

## Documentation/devicetree/bindings/display/sprd/sprd,sharkl3-dpu_cn.yaml
```yaml
# SPDX-许可证标识符: (GPL-2.0-only 或 BSD-2-Clause)
%YAML 1.2
---
$id: http://devicetree.org/schemas/display/sprd/sprd,sharkl3-dpu.yaml#
$schema: http://devicetree.org/meta-schemas/core.yaml#

标题: Unisoc Sharkl3 显示处理器单元 (DPU)

维护者:
  - Kevin Tang <kevin.tang@unisoc.com>

描述: |
  DPU（显示处理器单元）是针对Unisoc系统芯片的显示控制器，
  它将图像数据从视频内存缓冲区传输到内部LCD接口。
属性:
  compatible:
    常量: sprd,sharkl3-dpu

  reg:
    最大项数: 1

  interrupts:
    最大项数: 1

  clocks:
    最小项数: 2

  clock-names:
    项:
      - 常量: clk_src_128m
      - 常量: clk_src_384m

  power-domains:
    最大项数: 1

  iommus:
    最大项数: 1

  port:
    类型: 对象
    描述:
      端口节点，其定义了终端点，这些终端点如在
      文档/devicetree/bindings/media/video-interfaces.txt中所定义。该端口应为输出终端点，通常输出至
      关联的DSI。
必需:
  - compatible
  - reg
  - interrupts
  - clocks
  - clock-names
  - port

附加属性: false

示例:
  - |
    #include <dt-bindings/interrupt-controller/arm-gic.h>
    #include <dt-bindings/clock/sprd,sc9860-clk.h>
    dpu: dpu@63000000 {
        compatible = "sprd,sharkl3-dpu";
        reg = <0x63000000 0x1000>;
        interrupts = <GIC_SPI 46 IRQ_TYPE_LEVEL_HIGH>;
        clock-names = "clk_src_128m", "clk_src_384m";

        clocks = <&pll CLK_TWPLL_128M>,
          <&pll CLK_TWPLL_384M>;

        dpu_port: port {
            dpu_out: endpoint {
                remote-endpoint = <&dsi_in>;
            };
        };
    };
```

## Documentation/devicetree/bindings/display/sprd/sprd,sharkl3-dsi-host_cn.yaml
~~~~yaml
下面是给定内容的中文翻译：

```yaml
# SPDX-文件许可标识符: (GPL-2.0-only 或 BSD-2-Clause)
%YAML 1.2
---
$id: http://devicetree.org/schemas/display/sprd/sprd,sharkl3-dsi-host.yaml#
$schema: http://devicetree.org/meta-schemas/core.yaml#

标题: Unisoc MIPI DSI 控制器

维护者:
  - Kevin Tang <kevin.tang@unisoc.com>

属性:
  compatible:
    常量: sprd,sharkl3-dsi-host

  reg:
    最大项目数: 1

  interrupts:
    最大项目数: 2

  clocks:
    最小项目数: 1

  clock-names:
    项目:
      - 常量: clk_src_96m

  power-domains:
    最大项目数: 1

  ports:
    类型: 对象

    属性:
      "#address-cells":
        常量: 1

      "#size-cells":
        常量: 0

      port@0:
        类型: 对象
        描述:
          端口节点，其中包含端点定义，如在
          文档/devicetree/bindings/media/video-interfaces.txt中定义
          该端口应该是输入端点，通常来自
          关联的DPU
必需:
      - "#address-cells"
      - "#size-cells"
      - port@0

    额外属性: false

必需:
  - compatible
  - reg
  - interrupts
  - clocks
  - clock-names
  - ports

额外属性: false

示例:
  - |
    #include <dt-bindings/interrupt-controller/arm-gic.h>
    #include <dt-bindings/clock/sprd,sc9860-clk.h>
    dsi: dsi@63100000 {
        compatible = "sprd,sharkl3-dsi-host";
        reg = <0x63100000 0x1000>;
        interrupts = <GIC_SPI 48 IRQ_TYPE_LEVEL_HIGH>,
          <GIC_SPI 49 IRQ_TYPE_LEVEL_HIGH>;
        clock-names = "clk_src_96m";
        clocks = <&pll CLK_TWPLL_96M>;
        ports {
            #address-cells = <1>;
            #size-cells = <0>;
            port@0 {
                reg = <0>;
                dsi_in: endpoint {
                    remote-endpoint = <&dpu_out>;
                };
            };
        };
    };
```

请注意，这里的“必需”和“额外属性”是 YAML 文件结构中的关键词，表示哪些字段是必需的以及是否允许额外属性。
~~~~

## Documentation/devicetree/bindings/display/ssd1289fb_cn.txt
~~~~
* 所罗门 SSD1289 帧缓冲驱动

所需属性：
  - compatible（兼容性）：应为 "solomon,ssd1289fb"。目前唯一支持的总线是 LBC。
- reg（寄存器）：应包含 LBC 总线上控制器的地址。详细信息请参阅文档/设备树/绑定/powerpc/fsl/lbc.txt。

示例：
```
display@2,0 {
	compatible = "solomon,ssd1289fb";
	reg = <0x2 0x0000 0x0004>;
};
```
~~~~
