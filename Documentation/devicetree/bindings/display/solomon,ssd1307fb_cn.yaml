## Documentation/devicetree/bindings/display/tegra/nvidia,tegra20-dsi_cn.yaml
```yaml
以下是提供的 YAML 文件的中文翻译：

---

SPDX 许可证标识符: (GPL-2.0-only 或 BSD-2-Clause)

%YAML 1.2
---
$id: http://devicetree.org/schemas/display/tegra/nvidia,tegra20-dsi.yaml#
$schema: http://devicetree.org/meta-schemas/core.yaml#

标题: NVIDIA Tegra 显示串行接口

维护者:
  - Thierry Reding <thierry.reding@gmail.com>
  - Jon Hunter <jonathanh@nvidia.com>

属性:
  compatible:
    oneOf:
      - 枚举:
          - nvidia,tegra20-dsi
          - nvidia,tegra30-dsi
          - nvidia,tegra114-dsi
          - nvidia,tegra124-dsi
          - nvidia,tegra210-dsi
          - nvidia,tegra186-dsi

      - items:
          - 常量: nvidia,tegra132-dsi
          - 常量: nvidia,tegra124-dsi

  reg:
    最大项数: 1

  interrupts:
    最大项数: 1

  clocks:
    最小项数: 2
    最大项数: 3

  clock-names:
    最小项数: 2
    最大项数: 3

  resets:
    items:
      - 描述: 模块重置

  reset-names:
    items:
      - 常量: dsi

  operating-points-v2: true

  power-domains:
    最大项数: 1

  avdd-dsi-csi-supply:
    描述: 提供给 DSI 控制器供电的电源句柄

  nvidia,mipi-calibrate:
    描述: 应包含一个句柄和一个指定符，以指明此 DSI 输出所使用的哪些引脚需要进行校准。详情请参考 nvidia,tegra114-mipi.yaml
$ref: /schemas/types.yaml#/definitions/phandle-array

  nvidia,ddc-i2c-bus:
    描述: 用于 DDC EDID 探测的 I2C 控制器的句柄
    $ref: /schemas/types.yaml#/definitions/phandle

  nvidia,hpd-gpio:
    描述: 规定用于热插拔检测的 GPIO
    最大项数: 1

  nvidia,edid:
    描述: 提供二进制 EDID 数据块
    $ref: /schemas/types.yaml#/definitions/uint8-array

  nvidia,panel:
    描述: 显示面板的句柄
    $ref: /schemas/types.yaml#/definitions/phandle

  nvidia,ganged-mode:
    描述: 包含另一个 DSI 控制器的句柄，以便与之联合使用以支持多达 8 条数据线
    $ref: /schemas/types.yaml#/definitions/phandle

allOf:
  - $ref: ../dsi-controller.yaml#
  - 如果:
      属性:
        compatible:
          包含:
            枚举:
              - nvidia,tegra20-dsi
              - nvidia,tegra30-dsi
    然后:
      属性:
        clocks:
          items:
            - 描述: DSI 模块时钟
            - 描述: 像素时钟输入

        clock-names:
          items:
            - 常量: dsi
            - 常量: parent
    否则:
      属性:
        clocks:
          items:
            - 描述: DSI 模块时钟
            - 描述: 低功耗模块时钟
            - 描述: 像素时钟输入

        clock-names:
          items:
            - 常量: dsi
            - 常量: lp
            - 常量: parent

  - 如果:
      属性:
        compatible:
          包含:
            常量: nvidia,tegra186-dsi
    那么:
      必需:
        - interrupts

未评估属性: false

必需:
  - compatible
  - reg
  - clocks
  - clock-names
  - resets
  - reset-names

示例:
  - |
    #include <dt-bindings/clock/tegra186-clock.h>
    #include <dt-bindings/interrupt-controller/arm-gic.h>
    #include <dt-bindings/power/tegra186-powergate.h>
    #include <dt-bindings/reset/tegra186-reset.h>

    dsi@15300000 {
        compatible = "nvidia,tegra186-dsi";
        reg = <0x15300000 0x10000>;
        interrupts = <GIC_SPI 20 IRQ_TYPE_LEVEL_HIGH>;
        clocks = <&bpmp TEGRA186_CLK_DSI>,
                 <&bpmp TEGRA186_CLK_DSIA_LP>,
                 <&bpmp TEGRA186_CLK_PLLD>;
        clock-names = "dsi", "lp", "parent";
        resets = <&bpmp TEGRA186_RESET_DSI>;
        reset-names = "dsi";

        power-domains = <&bpmp TEGRA186_POWER_DOMAIN_DISP>;
    };
```

## Documentation/devicetree/bindings/display/tegra/nvidia,tegra20-gr2d_cn.yaml
~~~~yaml
```yaml
# SPDX-许可证标识符: (GPL-2.0-only 或 BSD-2-Clause)
%YAML 1.2
---
$id: http://devicetree.org/schemas/display/tegra/nvidia,tegra20-gr2d.yaml#
$schema: http://devicetree.org/meta-schemas/core.yaml#

title: NVIDIA 2D 图形引擎

维护者:
  - Thierry Reding <thierry.reding@gmail.com>
  - Jon Hunter <jonathanh@nvidia.com>

属性:
  $nodename:
    pattern: "^gr2d@[0-9a-f]+$"

  compatible:
    枚举:
      - nvidia,tegra20-gr2d
      - nvidia,tegra30-gr2d
      - nvidia,tegra114-gr2d

  reg:
    maxItems: 1

  interrupts:
    maxItems: 1

  clocks:
    项目:
      - 描述: 模块时钟

  resets:
    项目:
      - 描述: 模块复位
      - 描述: 内存客户端热刷新复位

  reset-names:
    项目:
      - 常量: 2d
      - 常量: mc

  iommus:
    maxItems: 1

  interconnects:
    maxItems: 4

  interconnect-names:
    maxItems: 4

  operating-points-v2: true

  power-domains:
    项目:
      - 描述: 指向 HEG 或核心电源域的 phandle

additionalProperties: false

示例:
  - |
    #include <dt-bindings/clock/tegra20-car.h>
    #include <dt-bindings/interrupt-controller/arm-gic.h>
    #include <dt-bindings/memory/tegra20-mc.h>

    gr2d@54140000 {
        compatible = "nvidia,tegra20-gr2d";
        reg = <0x54140000 0x00040000>;
        interrupts = <GIC_SPI 72 IRQ_TYPE_LEVEL_HIGH>;
        clocks = <&tegra_car TEGRA20_CLK_GR2D>;
        resets = <&tegra_car 21>, <&mc TEGRA20_MC_RESET_2D>;
        reset-names = "2d", "mc";
    };
```

请注意，某些术语可能没有标准的中文翻译，特别是对于技术文档。因此，这里的翻译尽可能保持了技术上的准确性。
~~~~

## Documentation/devicetree/bindings/display/tegra/nvidia,tegra20-gr3d_cn.yaml
```yaml
下面是给定 YAML 文档的中文翻译：

---

# SPDX 许可证标识符: (GPL-2.0-only 或 BSD-2-Clause)
%YAML 1.2
---
$id: http://devicetree.org/schemas/display/tegra/nvidia,tegra20-gr3d.yaml#
$schema: http://devicetree.org/meta-schemas/core.yaml#

标题: NVIDIA 3D 图形引擎

维护者:
  - Thierry Reding <thierry.reding@gmail.com>
  - Jon Hunter <jonathanh@nvidia.com>

属性:
  $nodename:
    模式: "^gr3d@[0-9a-f]+$"

  compatible:
    枚举:
      - nvidia,tegra20-gr3d
      - nvidia,tegra30-gr3d
      - nvidia,tegra114-gr3d

  reg:
    最大项数: 1

  clocks:
    最小项数: 1
    最大项数: 2

  clock-names:
    最小项数: 1
    最大项数: 2

  resets:
    最小项数: 2
    最大项数: 4

  reset-names:
    最小项数: 2
    最大项数: 4

  iommus:
    最小项数: 1
    最大项数: 2

  interconnects:
    最小项数: 4
    最大项数: 10

  interconnect-names:
    最小项数: 4
    最大项数: 10

  operating-points-v2: 真

  power-domains:
    最小项数: 1
    最大项数: 2

  power-domain-names:
    最大项数: 2

allOf:
  - 如果:
      属性:
        compatible:
          包含:
            常量: nvidia,tegra20-gr2d
    那么:
      属性:
        clocks:
          项:
            - 描述: 模块时钟

        clock-names:
          项:
            - 常量: 3d

        resets:
          项:
            - 描述: 模块复位
            - 描述: 内存客户端热刷新复位

        reset-names:
          项:
            - 常量: 3d
            - 常量: mc

        iommus:
          最大项数: 1

        interconnects:
          最小项数: 4
          最大项数: 4

        interconnect-names:
          最小项数: 4
          最大项数: 4

        power-domains:
          项:
            - 描述: 到 TD 功率域的 phandle

  - 如果:
      属性:
        compatible:
          包含:
            常量: nvidia,tegra30-gr3d
    那么:
      属性:
        clocks:
          项:
            - 描述: 主模块时钟
            - 描述: 辅助模块时钟

        clock-names:
          项:
            - 常量: 3d
            - 常量: 3d2

        resets:
          项:
            - 描述: 主模块复位
            - 描述: 辅助模块复位
            - 描述: 主内存客户端热刷新复位
            - 描述: 辅助内存客户端热刷新复位

        reset-names:
          项:
            - 常量: 3d
            - 常量: 3d2
            - 常量: mc
            - 常量: mc2

        iommus:
          最小项数: 2
          最大项数: 2

        interconnects:
          最小项数: 8
          最大项数: 8

        interconnect-names:
          最小项数: 8
          最大项数: 8

        power-domains:
          项:
            - 描述: 到 TD 功率域的 phandle
            - 描述: 到 TD2 功率域的 phandle

        power-domain-names:
          项:
            - 常量: 3d0
            - 常量: 3d1

      依赖:
        power-domains: [ power-domain-names ]

  - 如果:
      属性:
        compatible:
          包含:
            常量: nvidia,tegra114-gr2d
    那么:
      属性:
        clocks:
          项:
            - 描述: 模块时钟

        clock-names:
          项:
            - 常量: 3d

        resets:
          项:
            - 描述: 模块复位
            - 描述: 内存客户端热刷新复位

        reset-names:
          项:
            - 常量: 3d
            - 常量: mc

        iommus:
          最大项数: 1

        interconnects:
          最小项数: 10
          最大项数: 10

        interconnect-names:
          最小项数: 10
          最大项数: 10

        power-domains:
          项:
            - 描述: 到 TD 功率域的 phandle

additionalProperties: 假

示例:
  - |
    #include <dt-bindings/clock/tegra20-car.h>
    #include <dt-bindings/memory/tegra20-mc.h>

    gr3d@54180000 {
        compatible = "nvidia,tegra20-gr3d";
        reg = <0x54180000 0x00040000>;
        clocks = <&tegra_car TEGRA20_CLK_GR3D>;
        resets = <&tegra_car 24>, <&mc TEGRA20_MC_RESET_3D>;
        reset-names = "3d", "mc";
    };
```

## Documentation/devicetree/bindings/display/tegra/nvidia,tegra20-host1x_cn.yaml
```yaml
以下是给定 YAML 文档的中文翻译：

# SPDX 许可标识符: GPL-2.0-only
%YAML 1.2
---
$id: http://devicetree.org/schemas/display/tegra/nvidia,tegra20-host1x.yaml#
$schema: http://devicetree.org/meta-schemas/core.yaml#

标题: NVIDIA Tegra host1x 控制器

维护者:
  - Thierry Reding <thierry.reding@gmail.com>
  - Jon Hunter <jonathanh@nvidia.com>

描述: Host1x 的顶级节点定义了多个子节点，每个子节点代表此绑定中定义的一个 host1x 客户模块。
属性:
  compatible:
    oneOf:
      - 枚举:
          - nvidia,tegra20-host1x
          - nvidia,tegra30-host1x
          - nvidia,tegra114-host1x
          - nvidia,tegra124-host1x
          - nvidia,tegra210-host1x
          - nvidia,tegra186-host1x
          - nvidia,tegra194-host1x
          - nvidia,tegra234-host1x

      - items:
          - 常量: nvidia,tegra132-host1x
          - 常量: nvidia,tegra124-host1x

  reg:
    minItems: 1
    maxItems: 3

  reg-names:
    minItems: 1
    maxItems: 3

  interrupts:
    minItems: 1
    maxItems: 9

  interrupt-names:
    minItems: 1
    maxItems: 9

  '#address-cells':
    描述: 用于表示 host1x 地址空间中的物理基地址所用的单元格数量
    枚举: [1, 2]

  '#size-cells':
    描述: 用于表示 host1x 地址空间中地址范围大小所用的单元格数量
    枚举: [1, 2]

  ranges:
    maxItems: 1

  clocks:
    描述: 必须包含一个条目，即模块时钟。详细信息请参阅 ../clocks/clock-bindings.txt
  clock-names:
    items:
      - 常量: host1x

  resets:
    minItems: 1 # 对于 Tegra186 及以后版本，MC 重置是可选的
    items:
      - 描述: 模块重置
      - 描述: 内存客户端热刷新重置

  reset-names:
    minItems: 1 # 对于 Tegra186 及以后版本，MC 重置是可选的
    items:
      - 常量: host1x
      - 常量: mc

  iommus:
    maxItems: 1

  interconnects:
    items:
      - 描述: 供 host1x 使用的内存读取客户端

  interconnect-names:
    items:
      - 常量: dma-mem # 读取

  operating-points-v2: true

  power-domains:
    items:
      - 描述: HEG 或核心电源域的句柄

必需:
  - compatible
  - interrupts
  - interrupt-names
  - '#address-cells'
  - '#size-cells'
  - ranges
  - reg
  - clocks
  - clock-names

未评估属性:
  类型: 对象

allOf:
  - 如果:
      属性:
        compatible:
          包含:
            枚举:
              - nvidia,tegra20-host1x
              - nvidia,tegra30-host1x
              - nvidia,tegra114-host1x
              - nvidia,tegra124-host1x
              - nvidia,tegra210-host1x
    那么:
      属性:
        interrupts:
          items:
            - 描述: host1x 同步点中断
            - 描述: host1x 通用中断

        interrupt-names:
          items:
            - 常量: syncpt
            - 常量: host1x
      必需:
        - resets
        - reset-names
  - 如果:
      属性:
        compatible:
          包含:
            枚举:
              - nvidia,tegra186-host1x
              - nvidia,tegra194-host1x
    那么:
      属性:
        reg-names:
          items:
            - 常量: hypervisor
            - 常量: vm

        reg:
          items:
            - 描述: 被 hypervisor 使用的区域
            - 描述: 分配给虚拟机的区域

        resets:
          maxItems: 1

        reset-names:
          maxItems: 1

        interrupts:
          items:
            - 描述: host1x 同步点中断
            - 描述: host1x 通用中断

        interrupt-names:
          items:
            - 常量: syncpt
            - 常量: host1x

        iommu-map:
          描述: 用于内存上下文设备使用的流 ID 规范。应为从 ID 0..n 到与可用流 ID 相对应的 IOMMU 条目的映射
      必需:
        - reg-names
  - 如果:
      属性:
        compatible:
          包含:
            枚举:
              - nvidia,tegra194-host1x
    那么:
      属性:
        dma-coherent: true
  - 如果:
      属性:
        compatible:
          包含:
            枚举:
              - nvidia,tegra234-host1x
    那么:
      属性:
        reg-names:
          items:
            - 常量: common
            - 常量: hypervisor
            - 常量: vm

        reg:
          items:
            - 描述: 被 host1x 服务器使用的区域
            - 描述: 被 hypervisor 使用的区域
            - 描述: 分配给虚拟机的区域

        interrupts:
          items:
            - 描述: host1x 同步点中断 0
            - 描述: host1x 同步点中断 1
            - 描述: host1x 同步点中断 2
            - 描述: host1x 同步点中断 3
            - 描述: host1x 同步点中断 4
            - 描述: host1x 同步点中断 5
            - 描述: host1x 同步点中断 6
            - 描述: host1x 同步点中断 7
            - 描述: host1x 通用中断

        interrupt-names:
          items:
            - 常量: syncpt0
            - 常量: syncpt1
            - 常量: syncpt2
            - 常量: syncpt3
            - 常量: syncpt4
            - 常量: syncpt5
            - 常量: syncpt6
            - 常量: syncpt7
            - 常量: host1x

        iommu-map:
          描述: 用于内存上下文设备使用的流 ID 规范。应为从 ID 0..n 到与可用流 ID 相对应的 IOMMU 条目的映射
      dma-coherent: true

      必需:
        - reg-names

示例:
  - |
    #include <dt-bindings/clock/tegra20-car.h>
    #include <dt-bindings/gpio/tegra-gpio.h>
    #include <dt-bindings/memory/tegra20-mc.h>

    host1x@50000000 {
        compatible = "nvidia,tegra20-host1x";
        reg = <0x50000000 0x00024000>;
        interrupts = <0 65 0x04>, /* mpcore syncpt */
                     <0 67 0x04>; /* mpcore general */
        interrupt-names = "syncpt", "host1x";
        clocks = <&tegra_car TEGRA20_CLK_HOST1X>;
        clock-names = "host1x";
        resets = <&tegra_car 28>, <&mc TEGRA20_MC_RESET_HC>;
        reset-names = "host1x", "mc";

        #address-cells = <1>;
        #size-cells = <1>;

        ranges = <0x54000000 0x54000000 0x04000000>;

        ... (其他子节点配置)
    };

  - |
    #include <dt-bindings/clock/tegra210-car.h>
    #include <dt-bindings/interrupt-controller/arm-gic.h>
    #include <dt-bindings/memory/tegra210-mc.h>

    host1x@50000000 {
        compatible = "nvidia,tegra210-host1x";
        reg = <0x50000000 0x00024000>;
        interrupts = <GIC_SPI 64 IRQ_TYPE_LEVEL_HIGH>, /* mpcore syncpt */
                     <GIC_SPI 67 IRQ_TYPE_LEVEL_HIGH>; /* mpcore general */
        interrupt-names = "syncpt", "host1x";
        clocks = <&tegra_car TEGRA210_CLK_HOST1X>;
        clock-names = "host1x";
        resets = <&tegra_car 28>;
        reset-names = "host1x";

        #address-cells = <1>;
        #size-cells = <1>;

        ranges = <0x54000000 0x54000000 0x01000000>;
        iommus = <&mc TEGRA_SWGROUP_HC>;

        ... (其他子节点配置)
    };
```

## Documentation/devicetree/bindings/display/tegra/nvidia,tegra20-isp_cn.yaml
```yaml
# SPDX-License-Identifier: (GPL-2.0-only OR BSD-2-Clause)
%YAML 1.2
---
$id: http://devicetree.org/schemas/display/tegra/nvidia,tegra20-isp.yaml#
$schema: http://devicetree.org/meta-schemas/core.yaml#

title: NVIDIA Tegra 图像信号处理器 (ISP)

maintainers:
  - Thierry Reding <thierry.reding@gmail.com>
  - Jon Hunter <jonathanh@nvidia.com>

properties:
  compatible:
    enum:
      - nvidia,tegra20-isp
      - nvidia,tegra30-isp
      - nvidia,tegra210-isp

  reg:
    maxItems: 1

  interrupts:
    maxItems: 1

  clocks:
    items:
      - description: 模块时钟

  resets:
    items:
      - description: 模块复位

  reset-names:
    items:
      - const: isp

  iommus:
    maxItems: 1

  interconnects:
    items:
      - description: 内存写客户端

  interconnect-names:
    items:
      - const: dma-mem # 写

  power-domains:
    items:
      - description: VENC 或核心电源域的 phandle

additionalProperties: false

examples:
  - |
    #include <dt-bindings/clock/tegra20-car.h>
    #include <dt-bindings/interrupt-controller/arm-gic.h>

    isp@54100000 {
        compatible = "nvidia,tegra20-isp";
        reg = <0x54100000 0x00040000>;
        interrupts = <GIC_SPI 71 IRQ_TYPE_LEVEL_HIGH>;
        clocks = <&tegra_car TEGRA20_CLK_ISP>;
        resets = <&tegra_car 23>;
        reset-names = "isp";
    };
```
