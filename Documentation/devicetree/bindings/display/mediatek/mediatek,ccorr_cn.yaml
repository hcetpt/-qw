## Documentation/devicetree/bindings/display/mediatek/mediatek,ccorr_cn.yaml
~~~~yaml
```yaml
# SPDX-许可证标识符: (GPL-2.0-only 或 BSD-2-Clause)
%YAML 1.2
---
$id: http://devicetree.org/schemas/display/mediatek/mediatek,ccorr.yaml#
$schema: http://devicetree.org/meta-schemas/core.yaml#

标题: Mediatek 显示器颜色校正

维护者:
  - 春光 胡 <chunkuang.hu@kernel.org>
  - 菲利普·扎贝尔 <p.zabel@pengutronix.de>

描述: |
  Mediatek 显示器颜色校正，即 CCORR，可在具有不同色域的面板上重现正确的颜色。
  CCORR 设备节点必须是中央 MMSYS_CONFIG 节点的同级节点。
  关于 MMSYS_CONFIG 绑定的描述，请参阅
  文档/devicetree/bindings/arm/mediatek/mediatek,mmsys.yaml
  以获取详细信息。

属性:
  compatible:
    oneOf:
      - 枚举:
          - mediatek,mt8183-disp-ccorr
          - mediatek,mt8192-disp-ccorr
      - items:
          - 常量: mediatek,mt8365-disp-ccorr
          - 常量: mediatek,mt8183-disp-ccorr
      - items:
          - 枚举:
              - mediatek,mt8186-disp-ccorr
              - mediatek,mt8188-disp-ccorr
              - mediatek,mt8195-disp-ccorr
          - 常量: mediatek,mt8192-disp-ccorr

  reg:
    最大项目数: 1

  interrupts:
    最大项目数: 1

  power-domains:
    描述: 根据 phandle 指定的电源控制器绑定定义的 phandle 和 PM 域指定符。详情请见
      文档/devicetree/bindings/power/power-domain.yaml

时钟:
    items:
      - 描述: CCORR 时钟

  mediatek,gce-client-reg:
    描述: 客户端驱动程序的寄存器可通过 gce 配置，并通过此属性中定义的 4 个参数指定，例如 gce 的 phandle、子系统 ID、寄存器偏移量和大小。每个 GCE 子系统 ID 都映射到头文件 include/dt-bindings/gce/<chip>-gce.h 中定义的一个客户端
$ref: /schemas/types.yaml#/definitions/phandle-array
    最大项目数: 1

必需:
  - compatible
  - reg
  - interrupts
  - power-domains
  - clocks

额外属性: false

示例:
  - |
    #include <dt-bindings/interrupt-controller/arm-gic.h>
    #include <dt-bindings/clock/mt8183-clk.h>
    #include <dt-bindings/power/mt8183-power.h>
    #include <dt-bindings/gce/mt8183-gce.h>

    soc {
        #address-cells = <2>;
        #size-cells = <2>;

        ccorr0: ccorr@1400f000 {
            compatible = "mediatek,mt8183-disp-ccorr";
            reg = <0 0x1400f000 0 0x1000>;
            interrupts = <GIC_SPI 232 IRQ_TYPE_LEVEL_LOW>;
            power-domains = <&spm MT8183_POWER_DOMAIN_DISP>;
            clocks = <&mmsys CLK_MM_DISP_CCORR0>;
            mediatek,gce-client-reg = <&gce SUBSYS_1400XXXX 0xf000 0x1000>;
        };
    };
```

请注意，上述 YAML 内容已尽可能地翻译为中文，但部分专业术语和技术词汇仍保留了英文形式，以保持其准确性和技术一致性。
~~~~

## Documentation/devicetree/bindings/display/mediatek/mediatek,cec_cn.yaml
```yaml
# SPDX-许可证标识符: (GPL-2.0-only 或 BSD-2-Clause)
%YAML 1.2
---
$id: http://devicetree.org/schemas/display/mediatek/mediatek,cec.yaml#
$schema: http://devicetree.org/meta-schemas/core.yaml#

标题: Mediatek HDMI CEC 控制器

维护者:
  - CK Hu <ck.hu@mediatek.com>
  - Jitao Shi <jitao.shi@mediatek.com>

描述: |
  HDMI CEC 控制器处理热插拔检测和 CEC 通信。
属性:
  compatible:
    枚举:
      - mediatek,mt7623-cec
      - mediatek,mt8167-cec
      - mediatek,mt8173-cec

  reg:
    最大项数: 1

  interrupts:
    最大项数: 1

  clocks:
    最大项数: 1

必需:
  - compatible
  - reg
  - interrupts
  - clocks

附加属性: false

示例:
  - |
    #include <dt-bindings/clock/mt8173-clk.h>
    #include <dt-bindings/interrupt-controller/arm-gic.h>
    #include <dt-bindings/interrupt-controller/irq.h>
    cec: cec@10013000 {
        compatible = "mediatek,mt8173-cec";
        reg = <0x10013000 0xbc>;
        interrupts = <GIC_SPI 167 IRQ_TYPE_LEVEL_LOW>;
        clocks = <&infracfg CLK_INFRA_CEC>;
    };
```

## Documentation/devicetree/bindings/display/mediatek/mediatek,color_cn.yaml
```yaml
# SPDX-许可证标识符: (GPL-2.0-only 或 BSD-2-Clause)
%YAML 1.2
---
$id: http://devicetree.org/schemas/display/mediatek/mediatek,color.yaml#
$schema: http://devicetree.org/meta-schemas/core.yaml#

标题: Mediatek 显示色彩处理器

维护者:
  - 春光 胡 <chunkuang.hu@kernel.org>
  - 菲利普·扎贝尔 <p.zabel@pengutronix.de>

描述: |
  Mediatek 显示色彩处理器，即 COLOR，提供了色调、亮度和饱和度调整功能以获得更好的图像质量，并使一个面板在输出特性上与其他面板相似。
  COLOR 设备节点必须是中心 MMSYS_CONFIG 节点的同级节点。
  关于 MMSYS_CONFIG 绑定的详细描述，请参阅
  文档/devicetree/bindings/arm/mediatek/mediatek,mmsys.yaml。

属性:
  compatible:
    oneOf:
      - enum:
          - mediatek,mt2701-disp-color
          - mediatek,mt8167-disp-color
          - mediatek,mt8173-disp-color
          - mediatek,mt8195-mdp3-color
      - items:
          - enum:
              - mediatek,mt7623-disp-color
              - mediatek,mt2712-disp-color
          - const: mediatek,mt2701-disp-color
      - items:
          - enum:
              - mediatek,mt6795-disp-color
              - mediatek,mt8183-disp-color
              - mediatek,mt8186-disp-color
              - mediatek,mt8188-disp-color
              - mediatek,mt8192-disp-color
              - mediatek,mt8195-disp-color
              - mediatek,mt8365-disp-color
          - const: mediatek,mt8173-disp-color
  reg:
    maxItems: 1

  interrupts:
    maxItems: 1

  power-domains:
    描述: 由 phandle 和电源域指定符定义的电源控制器绑定中定义的句柄。详细信息请参阅
      文档/devicetree/bindings/power/power-domain.yaml
时钟:
    items:
      - 描述: COLOR 时钟

  mediatek,gce-client-reg:
    描述: 该属性定义了4个参数，允许 gce 配置客户端驱动程序的寄存器，如 gce 的 phandle、子系统 ID、寄存器偏移量和大小。每个 GCE 子系统 ID 对应于头文件 include/dt-bindings/gce/<chip>-gce.h 中定义的一个客户端
$ref: /schemas/types.yaml#/definitions/phandle-array
    maxItems: 1

必需项:
  - compatible
  - reg
  - interrupts
  - power-domains
  - clocks

附加属性: false

示例:
  - |
    #include <dt-bindings/interrupt-controller/arm-gic.h>
    #include <dt-bindings/clock/mt8173-clk.h>
    #include <dt-bindings/power/mt8173-power.h>
    #include <dt-bindings/gce/mt8173-gce.h>

    soc {
        #address-cells = <2>;
        #size-cells = <2>;

        color0: color@14013000 {
            compatible = "mediatek,mt8173-disp-color";
            reg = <0 0x14013000 0 0x1000>;
            interrupts = <GIC_SPI 187 IRQ_TYPE_LEVEL_LOW>;
            power-domains = <&scpsys MT8173_POWER_DOMAIN_MM>;
            clocks = <&mmsys CLK_MM_DISP_COLOR0>;
            mediatek,gce-client-reg = <&gce SUBSYS_1401XXXX 0x3000 0x1000>;
        };
    };
```

## Documentation/devicetree/bindings/display/mediatek/mediatek,dither_cn.yaml
```yaml
# SPDX-许可证标识符: (GPL-2.0-only 或 BSD-2-Clause)
%YAML 1.2
---
$id: http://devicetree.org/schemas/display/mediatek/mediatek,dither.yaml#
$schema: http://devicetree.org/meta-schemas/core.yaml#

标题: Mediatek 显示抖动处理器

维护者:
  - 春光 胡 <chunkuang.hu@kernel.org>
  - 菲利普·扎贝尔 <p.zabel@pengutronix.de>

描述: |
  Mediatek 显示抖动处理器，即 DITHER，通过近似无法提供的颜色以及混合匹配可用的颜色来模仿那些不可用的颜色。
DITHER 设备节点必须是中心 MMSYS_CONFIG 节点的同级节点。
关于 MMSYS_CONFIG 绑定的描述，请参见
  文档/devicetree/bindings/arm/mediatek/mediatek,mmsys.yaml
  中的详细信息。
属性:
  compatible:
    oneOf:
      - 枚举:
          - mediatek,mt8183-disp-dither
      - items:
          - 枚举:
              - mediatek,mt8186-disp-dither
              - mediatek,mt8188-disp-dither
              - mediatek,mt8192-disp-dither
              - mediatek,mt8195-disp-dither
              - mediatek,mt8365-disp-dither
          - 常量: mediatek,mt8183-disp-dither

  reg:
    最大项数: 1

  interrupts:
    最大项数: 1

  power-domains:
    描述: 根据 phandle 所指定的电源控制器绑定定义的句柄和 PM 域标识符。详情请参阅
      文档/devicetree/bindings/power/power-domain.yaml
时钟:
    items:
      - 描述: DITHER 时钟

  mediatek,gce-client-reg:
    描述: 该属性定义了4个参数的客户驱动程序寄存器，可以由 GCE 配置，如 GCE 的句柄、子系统 ID、寄存器偏移量和大小。每个 GCE 子系统 ID 都映射到头文件 include/dt-bindings/gce/<chip>-gce.h 中定义的一个客户端。
$ref: /schemas/types.yaml#/definitions/phandle-array
    最大项数: 1

必需:
  - compatible
  - reg
  - interrupts
  - power-domains
  - clocks

额外属性: false

示例:
  - |
    #include <dt-bindings/interrupt-controller/arm-gic.h>
    #include <dt-bindings/clock/mt8183-clk.h>
    #include <dt-bindings/power/mt8183-power.h>
    #include <dt-bindings/gce/mt8183-gce.h>

    soc {
        #address-cells = <2>;
        #size-cells = <2>;

        dither0: dither@14012000 {
            compatible = "mediatek,mt8183-disp-dither";
            reg = <0 0x14012000 0 0x1000>;
            interrupts = <GIC_SPI 235 IRQ_TYPE_LEVEL_LOW>;
            power-domains = <&spm MT8183_POWER_DOMAIN_DISP>;
            clocks = <&mmsys CLK_MM_DISP_DITHER0>;
            mediatek,gce-client-reg = <&gce SUBSYS_1401XXXX 0x2000 0x1000>;
        };
    };
```

## Documentation/devicetree/bindings/display/mediatek/mediatek,dp_cn.yaml
~~~~yaml
```yaml
# SPDX-许可证标识符: (GPL-2.0-only 或 BSD-2-Clause)
%YAML 1.2
---
$id: http://devicetree.org/schemas/display/mediatek/mediatek,dp.yaml#
$schema: http://devicetree.org/meta-schemas/core.yaml#

标题: MediaTek 显示端口控制器

维护者:
  - 春光 胡 <chunkuang.hu@kernel.org>
  - 世杰 施 <jitao.shi@mediatek.com>

描述: |
  MediaTek DP 和 eDP 是不同的硬件，并且有一些特性
  对于 eDP 不支持。例如，音频对于 eDP 不支持。因此，我们需要使用两种不同的兼容性来描述它们。
  此外，我们只需要启用 DP 的电源域，因此 DP 的时钟
  由其自身生成，我们没有使用其他 PLL 来生成时钟。

属性:
  compatible:
    枚举:
      - mediatek,mt8188-dp-tx
      - mediatek,mt8188-edp-tx
      - mediatek,mt8195-dp-tx
      - mediatek,mt8195-edp-tx

  reg:
    最大项数: 1

  nvmem-cells:
    最大项数: 1
    描述: 用于显示端口校准的 efuse 数据

  nvmem-cell-names:
    常量: dp_calibration_data

  power-domains:
    最大项数: 1

  interrupts:
    最大项数: 1

  ports:
    $ref: /schemas/graph.yaml#/properties/ports
    属性:
      port@0:
        $ref: /schemas/graph.yaml#/properties/port
        描述: 控制器的输入端点，通常为 dp_intf

      port@1:
        $ref: /schemas/graph.yaml#/$defs/port-base
        不评估属性: false
        描述: 控制器的输出端点
        属性:
          endpoint:
            $ref: /schemas/media/video-interfaces.yaml#
            不评估属性: false
            属性:
              data-lanes:
                描述: |
                  硬件支持的数据通道数量
                  可能的值:
                  0       - 在 IP 中启用 1 个通道
                  0 1     - 在 IP 中启用 2 个通道
                  0 1 2 3 - 在 IP 中启用 4 个通道
                  最小项数: 1
                最大项数: 4
            必须包含:
              - data-lanes

    必须包含:
      - port@0
      - port@1

  max-linkrate-mhz:
    枚举: [ 1620, 2700, 5400, 8100 ]
    描述: 硬件支持的最大链路速率
必须包含:
  - compatible
  - reg
  - interrupts
  - ports
  - max-linkrate-mhz

额外属性: false

示例:
  - |
    #include <dt-bindings/interrupt-controller/arm-gic.h>
    #include <dt-bindings/power/mt8195-power.h>
    dptx@1c600000 {
        compatible = "mediatek,mt8195-dp-tx";
        reg = <0x1c600000 0x8000>;
        power-domains = <&spm MT8195_POWER_DOMAIN_DP_TX>;
        interrupts = <GIC_SPI 458 IRQ_TYPE_LEVEL_HIGH 0>;
        max-linkrate-mhz = <8100>;

        ports {
            #address-cells = <1>;
            #size-cells = <0>;

            port@0 {
                reg = <0>;
                dptx_in: endpoint {
                    remote-endpoint = <&dp_intf0_out>;
                };
            };
            port@1 {
                reg = <1>;
                dptx_out: endpoint {
                    data-lanes = <0 1 2 3>;
                };
            };
        };
    };
```
请注意，上述翻译尽量保持了原有的格式和结构，以确保与原文的一致性。
~~~~

## Documentation/devicetree/bindings/display/mediatek/mediatek,dpi_cn.yaml
```yaml
下面是给定内容的中文翻译：

# SPDX-License-Identifier: (GPL-2.0-only OR BSD-2-Clause)
%YAML 1.2
---
$id: http://devicetree.org/schemas/display/mediatek/mediatek,dpi.yaml#
$schema: http://devicetree.org/meta-schemas/core.yaml#

标题: MediaTek DPI 和 DP_INTF 控制器

维护者:
  - CK Hu <ck.hu@mediatek.com>
  - Jitao Shi <jitao.shi@mediatek.com>

描述: |
  MediaTek DPI 和 DP_INTF 功能模块是显示子系统的接收端，通过并行输出总线提供 8 位 RGB/YUV444 或 8/10/10 位 YUV422 像素数据。

属性:
  compatible:
    oneOf:
      - enum:
          - mediatek,mt2701-dpi
          - mediatek,mt7623-dpi
          - mediatek,mt8173-dpi
          - mediatek,mt8183-dpi
          - mediatek,mt8186-dpi
          - mediatek,mt8188-dp-intf
          - mediatek,mt8192-dpi
          - mediatek,mt8195-dp-intf
      - items:
          - enum:
              - mediatek,mt6795-dpi
          - const: mediatek,mt8183-dpi
      - items:
          - enum:
              - mediatek,mt8365-dpi
          - const: mediatek,mt8192-dpi

  reg:
    maxItems: 1

  interrupts:
    maxItems: 1

  clocks:
    items:
      - 描述: 像素时钟
      - 描述: 引擎时钟
      - 描述: DPI PLL

  clock-names:
    items:
      - const: pixel
      - const: engine
      - const: pll

  pinctrl-0: true
  pinctrl-1: true

  pinctrl-names:
    items:
      - const: default
      - const: sleep

  port:
    $ref: /schemas/graph.yaml#/properties/port
    description:
      输出端口节点。此端口应连接到所连接的 HDMI、LVDS 或 DisplayPort 编码器芯片的输入端口。

必需:
  - compatible
  - reg
  - interrupts
  - clocks
  - clock-names
  - port

additionalProperties: false

示例:
  - |
    #include <dt-bindings/interrupt-controller/arm-gic.h>
    #include <dt-bindings/clock/mt8173-clk.h>

    dpi0: dpi@1401d000 {
        compatible = "mediatek,mt8173-dpi";
        reg = <0x1401d000 0x1000>;
        interrupts = <GIC_SPI 194 IRQ_TYPE_LEVEL_LOW>;
        clocks = <&mmsys CLK_MM_DPI_PIXEL>,
             <&mmsys CLK_MM_DPI_ENGINE>,
             <&apmixedsys CLK_APMIXED_TVDPLL>;
        clock-names = "pixel", "engine", "pll";
        pinctrl-names = "default", "sleep";
        pinctrl-0 = <&dpi_pin_func>;
        pinctrl-1 = <&dpi_pin_idle>;

        port {
            dpi0_out: endpoint {
                remote-endpoint = <&hdmi0_in>;
            };
        };
    };
```

## Documentation/devicetree/bindings/display/mediatek/mediatek,dsc_cn.yaml
~~~~yaml
下面是给定内容的中文翻译：

```yaml
# SPDX-文件许可标识符: (GPL-2.0-only 或 BSD-2-Clause)
%YAML 1.2
---
$id: http://devicetree.org/schemas/display/mediatek/mediatek,dsc.yaml#
$schema: http://devicetree.org/meta-schemas/core.yaml#

标题: Mediatek 显示器 DSC 控制器

维护者:
  - 春光 胡 <chunkuang.hu@kernel.org>
  - 菲利普·扎贝尔 <p.zabel@pengutronix.de>

描述: |
  DSC 标准是一种用于压缩和解压缩图像显示流的算法规范，包括压缩视频比特流的语法和语义的规范。DSC 是为具有实时压缩、传输、解压缩和显示特性的实时系统设计的。

属性:
  compatible:
    oneOf:
      - 枚举:
          - mediatek,mt8195-disp-dsc

  reg:
    最大项数: 1

  interrupts:
    最大项数: 1

  clocks:
    items:
      - 描述: DSC 外围设备时钟

  power-domains:
    描述: 根据由 phandle 指定的电源控制器绑定定义的 phandle 和电源管理域指针。详细信息请参阅 Documentation/devicetree/bindings/power/power-domain.yaml

mediatek,gce-client-reg:
    描述:
      客户端驱动程序的寄存器可以通过 GCE 使用此属性中定义的4个参数进行配置，例如 GCE 的 phandle、子系统 ID、寄存器偏移量和大小。
每个子系统 ID 都映射到显示功能块寄存器的一个基地址，该地址在 GCE 头文件 include/dt-bindings/gce/<芯片>-gce.h 中定义
$ref: /schemas/types.yaml#/definitions/phandle-array
    最大项数: 1

必需:
  - compatible
  - reg
  - interrupts
  - power-domains
  - clocks

附加属性: false

示例:
  - |
    #include <dt-bindings/interrupt-controller/arm-gic.h>
    #include <dt-bindings/clock/mt8195-clk.h>
    #include <dt-bindings/power/mt8195-power.h>
    #include <dt-bindings/gce/mt8195-gce.h>

    soc {
        #address-cells = <2>;
        #size-cells = <2>;

        dsc0: disp_dsc_wrap@1c009000 {
            compatible = "mediatek,mt8195-disp-dsc";
            reg = <0 0x1c009000 0 0x1000>;
            interrupts = <GIC_SPI 645 IRQ_TYPE_LEVEL_HIGH 0>;
            power-domains = <&spm MT8195_POWER_DOMAIN_VDOSYS0>;
            clocks = <&vdosys0 CLK_VDO0_DSC_WRAP0>;
            mediatek,gce-client-reg = <&gce1 SUBSYS_1c00XXXX 0x9000 0x1000>;
        };
    };
```
请注意，部分 YAML 格式可能无法完全符合中文习惯，因此保留了英文格式。
~~~~
