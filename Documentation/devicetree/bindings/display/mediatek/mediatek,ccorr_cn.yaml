## Documentation/devicetree/bindings/display/mediatek/mediatek,split_cn.yaml
~~~~yaml
```yaml
# SPDX-许可证标识符: (GPL-2.0-only 或 BSD-2-Clause)
%YAML 1.2
---
$id: http://devicetree.org/schemas/display/mediatek/mediatek,split.yaml#
$schema: http://devicetree.org/meta-schemas/core.yaml#

标题: Mediatek 显示分割

维护者:
  - 春光 胡 <chunkuang.hu@kernel.org>
  - 菲利普·扎贝尔 <p.zabel@pengutronix.de>

描述: |
  Mediatek 显示分割，即 SPLIT，用于将流分成两个编码器。
  SPLIT 设备节点必须是中心 MMSYS_CONFIG 节点的同级节点。
  关于 MMSYS_CONFIG 绑定的详细说明，请参阅
  文档/devicetree/bindings/arm/mediatek/mediatek,mmsys.yaml

属性:
  compatible:
    oneOf:
      - 枚举:
          - mediatek,mt8173-disp-split
          - mediatek,mt8195-mdp3-split
      - items:
          - 常量: mediatek,mt6795-disp-split
          - 常量: mediatek,mt8173-disp-split

  reg:
    maxItems: 1

  interrupts:
    maxItems: 1

  power-domains:
    描述: 根据 phandle 所指定的电源控制器绑定定义的 phandle 和 PM 域指定符。详情请参见
      文档/devicetree/bindings/power/power-domain.yaml
  mediatek,gce-client-reg:
    描述:
      由 GCE 设置的显示功能块寄存器。共有 4 个参数，例如 GCE 节点、子系统 ID、偏移量和寄存器大小。映射到显示功能块寄存器的子系统 ID 在每个芯片的 GCE 头文件
      include/dt-bindings/gce/<chip>-gce.h 中定义
$ref: /schemas/types.yaml#/definitions/phandle-array
    items:
      items:
        - 描述: GCE 的 phandle
        - 描述: GCE 子系统 ID
        - 描述: 寄存器偏移量
        - 描述: 寄存器大小
    maxItems: 1

  clocks:
    items:
      - 描述: SPLIT 时钟

必需:
  - compatible
  - reg
  - power-domains
  - clocks

allOf:
  - 如果:
      属性:
        compatible:
          包含:
            常量: mediatek,mt8195-mdp3-split

    那么:
      必需:
        - mediatek,gce-client-reg

额外属性: false

示例:
  - |
    #include <dt-bindings/clock/mt8173-clk.h>
    #include <dt-bindings/power/mt8173-power.h>

    soc {
        #address-cells = <2>;
        #size-cells = <2>;

        split0: split@14018000 {
            compatible = "mediatek,mt8173-disp-split";
            reg = <0 0x14018000 0 0x1000>;
            power-domains = <&spm MT8173_POWER_DOMAIN_MM>;
            clocks = <&mmsys CLK_MM_DISP_SPLIT0>;
        };
    };
```

注意：以上内容已尽可能地翻译为中文，并保持了原文件的结构和格式。部分专业术语和技术表达可能没有标准的中文对应词，因此保留了英文形式。
~~~~

## Documentation/devicetree/bindings/display/mediatek/mediatek,ufoe_cn.yaml
~~~~yaml
```yaml
# SPDX-文件许可标识符: (GPL-2.0-only 或 BSD-2-Clause)
%YAML 1.2
---
$id: http://devicetree.org/schemas/display/mediatek/mediatek,ufoe.yaml#
$schema: http://devicetree.org/meta-schemas/core.yaml#

标题: Mediatek 显示器 UFOe

维护者:
  - 春光 胡 <chunkuang.hu@kernel.org>
  - 菲利普·扎贝尔 <p.zabel@pengutronix.de>

描述: |
  Mediatek 显示器 UFOe 指的是统一帧优化引擎。
  UFOe 可以降低 DSI 端口的数据速率，从而可能减少功耗。
  UFOe 设备节点必须与中心 MMSYS_CONFIG 节点同级。
  关于 MMSYS_CONFIG 绑定的描述，请参阅
  文档/devicetree/bindings/arm/mediatek/mediatek,mmsys.yaml 中的详细信息。

属性:
  compatible:
    oneOf:
      - 枚举:
          - mediatek,mt8173-disp-ufoe
      - 项:
          - 常量: mediatek,mt6795-disp-ufoe
          - 常量: mediatek,mt8173-disp-ufoe

  reg:
    最大项数: 1

  interrupts:
    最大项数: 1

  power-domains:
    描述: 根据由 phandle 指定的电源控制器绑定定义的 phandle 和 PM 域指定符。详情请见
      文档/devicetree/bindings/power/power-domain.yaml

时钟:
    项:
      - 描述: UFOe 时钟

必需:
  - compatible
  - reg
  - interrupts
  - power-domains
  - clocks

额外属性: false

示例:
  - |
    #include <dt-bindings/interrupt-controller/arm-gic.h>
    #include <dt-bindings/clock/mt8173-clk.h>
    #include <dt-bindings/power/mt8173-power.h>
    soc {
        #address-cells = <2>;
        #size-cells = <2>;

        ufoe@1401a000 {
            compatible = "mediatek,mt8173-disp-ufoe";
            reg = <0 0x1401a000 0 0x1000>;
            interrupts = <GIC_SPI 191 IRQ_TYPE_LEVEL_LOW>;
            power-domains = <&scpsys MT8173_POWER_DOMAIN_MM>;
            clocks = <&mmsys CLK_MM_DISP_UFOE>;
        };
    };
```

请注意，上述翻译尽量保持了原文件的格式和结构，并将英文内容翻译成了中文。部分技术术语在中文中可能没有直接对应的词汇，因此采用了直译的方式。
~~~~

## Documentation/devicetree/bindings/display/mediatek/mediatek,wdma_cn.yaml
```yaml
# SPDX-许可证标识符: (GPL-2.0-only 或 BSD-2-Clause)
%YAML 1.2
---
$id: http://devicetree.org/schemas/display/mediatek/mediatek,wdma.yaml#
$schema: http://devicetree.org/meta-schemas/core.yaml#

标题: Mediatek 写直接内存访问

维护者:
  - 春光 胡 <chunkuang.hu@kernel.org>
  - 菲利普·扎贝尔 <p.zabel@pengutronix.de>

描述: |
  Mediatek 写直接内存访问(WDMA)组件用于将数据写入DMA。
  WDMA 设备节点必须是中央 MMSYS_CONFIG 节点的同级节点。
  关于 MMSYS_CONFIG 绑定的详细说明，请参阅
  文档/devicetree/bindings/arm/mediatek/mediatek,mmsys.yaml。

属性:
  compatible:
    oneOf:
      - 枚举:
          - mediatek,mt8173-disp-wdma
      - 项:
          - 常量: mediatek,mt6795-disp-wdma
          - 常量: mediatek,mt8173-disp-wdma

  reg:
    最大项数: 1

  interrupts:
    最大项数: 1

  power-domains:
    描述: 根据由 phandle 指定的电源控制器绑定定义的 phandle 和 PM 域指定符。详情请参阅
      文档/devicetree/bindings/power/power-domain.yaml

时钟:
    项:
      - 描述: WDMA 时钟

  iommus:
    描述:
      此属性应指向带有主端口参数的相应 IOMMU 块，具体细节请参见
      文档/devicetree/bindings/iommu/mediatek,iommu.yaml

mediatek,gce-client-reg:
    描述: 客户端驱动程序的寄存器可通过 gce 配置，此属性中定义了四个参数，例如 gce 的 phandle、子系统 ID、寄存器偏移量和大小。每个 GCE 子系统 ID 都映射到头文件 include/dt-bindings/gce/<chip>-gce.h 中定义的一个客户端
$ref: /schemas/types.yaml#/definitions/phandle-array
    最大项数: 1

必需:
  - compatible
  - reg
  - interrupts
  - power-domains
  - clocks
  - iommus

附加属性: false

示例:
  - |
    #include <dt-bindings/interrupt-controller/arm-gic.h>
    #include <dt-bindings/clock/mt8173-clk.h>
    #include <dt-bindings/power/mt8173-power.h>
    #include <dt-bindings/gce/mt8173-gce.h>
    #include <dt-bindings/memory/mt8173-larb-port.h>

    soc {
        #address-cells = <2>;
        #size-cells = <2>;

        wdma0: wdma@14011000 {
            compatible = "mediatek,mt8173-disp-wdma";
            reg = <0 0x14011000 0 0x1000>;
            interrupts = <GIC_SPI 185 IRQ_TYPE_LEVEL_LOW>;
            power-domains = <&scpsys MT8173_POWER_DOMAIN_MM>;
            clocks = <&mmsys CLK_MM_DISP_WDMA0>;
            iommus = <&iommu M4U_PORT_DISP_WDMA0>;
            mediatek,gce-client-reg = <&gce SUBSYS_1401XXXX 0x1000 0x1000>;
        };
    };
```

## Documentation/devicetree/bindings/display/mipi-dsi-bus_cn.txt
~~~~
MIPI DSI（显示串行接口）总线
==========================================

MIPI 显示串行接口指定了一个串行总线及协议，用于主机与最多四个外围设备之间的通信。本文档将定义在设备树中表示DSI总线所使用的语法。本文档仅描述DSI总线特有的属性或在DSI总线的上下文中定义现有的标准属性。
每个DSI主机提供一条DSI总线。DSI主机控制器节点包含一系列表征该总线特性的属性。子节点则描述该总线上各个外围设备。
以下假设只有一个外围设备连接到DSI主机。经验表明，对于大多数配置情况这是正确的。
DSI主机
========

除了标准属性以及由DSI主机的父总线定义的属性外，下列属性适用于代表DSI主机的节点：
必需属性：
- #address-cells：表示总线上地址所需的单元格数量。DSI外围设备通过2位虚拟通道号进行寻址，因此单个总线上最多可以寻址4个设备。因此，此属性的值应为1。
- #size-cells：应当是0。存在一些特殊情况，使用其他值可能是有意义的，详情见下文。
可选属性：
- clock-master：布尔值。如果主机与其他DSI主机一起使用以驱动同一外围设备，则应当启用此属性。支持此类配置的硬件通常需要两个总线上的数据由同一个时钟驱动。仅控制该时钟的DSI主机实例应该包含此属性。
DSI外围设备
==============

具有DSI作为控制总线，或者没有控制总线的外围设备
------------------------------------------------------

具有DSI总线作为主要控制总线的外围设备，或者虽无控制总线但使用DSI总线传输像素数据的外围设备，被表示为DSI主机节点的子节点。此处描述的属性适用于所有DSI外围设备，但个别绑定可能希望定义额外的、特定于设备的属性。
必需属性：
- reg：DSI外围设备的虚拟通道号。必须位于0至3的范围内。
一些DSI外设对不止一个虚拟通道作出响应。在这种情况下，可以选择两种表示方式：
- `reg` 属性可以有多个条目，每个该外设响应的虚拟通道对应一个条目。
- 如果外设响应的虚拟通道是连续的，可以将 `#size-cells` 设置为1。`reg` 属性中的每个条目的第一个单元是第一个虚拟通道的编号，第二个单元是连续虚拟通道的数量。

具有不同控制总线的外设
------------------------

有些外设有I2C/SPI（或某些非DSI总线）作为主要控制总线，但也连接到DSI总线（主要用于数据路径）。这种外设与DSI主机之间的连接可以通过图绑定[1]、[2]来表示。

支持双通道DSI的外设
----------------------

对于带宽需求较高的外设，可以连接到两个DSI总线上。每个DSI总线/通道驱动一部分像素数据（通常是显示屏每一行的左半部分或右半部分，或者偶数行或奇数行）。
应使用图绑定来表示连接到这类外设的多个DSI总线。每个DSI主机的输出端点可以链接到DSI外设的输入端点。

示例
----

- (1)、(2) 和 (3) 是DSI主机和外设在DSI总线上的示例，具有不同的虚拟通道配置。
- (4) 是一个通过of-graph绑定连接到DSI主机的I2C控制总线上的外设的示例。
- (5) 是一个使用I2C作为其主要控制总线的双通道DSI外设由两个DSI主机驱动的示例。

1)
```
dsi-host {
	..
#address-cells = <1>;
	#size-cells = <0>;

	/* 外设响应虚拟通道 0 */
	peripheral@0 {
		compatible = "...";
		reg = <0>;
	};

	..
}
```

在这个示例中，`dsi-host` 表示DSI主机节点，并且有一个外设（`peripheral@0`）连接到它。`reg` 属性中的值 `<0>` 表示这个外设响应虚拟通道 0。
Here are the translations for the provided Device Tree fragments:

2)
```yaml
dsi-host {
    ..
#address-cells = <1>;
    #size-cells = <0>;

    /* 外设响应虚拟通道 0 和 2 */
    peripheral@0 {
        compatible = "...";
        reg = <0, 2>;
    };

    ..
};
```

3)
```yaml
dsi-host {
    ..
#address-cells = <1>;
    #size-cells = <1>;

    /* 外设响应虚拟通道 1、2 和 3 */
    peripheral@1 {
        compatible = "...";
        reg = <1 3>;
    };

    ..
};
```

4)
```yaml
i2c-host {
    ..
dsi-bridge@35 {
        compatible = "...";
        reg = <0x35>;

        ports {
            ..
port {
                bridge_mipi_in: endpoint {
                    remote-endpoint = <&host_mipi_out>;
                };
            };
        };
    };
};

dsi-host {
    ..
ports {
        ..
port {
            host_mipi_out: endpoint {
                remote-endpoint = <&bridge_mipi_in>;
            };
        };
    };
};
```

5)
```yaml
i2c-host {
    dsi-bridge@35 {
        compatible = "...";
        reg = <0x35>;

        ports {
            #address-cells = <1>;
            #size-cells = <0>;

            port@0 {
                reg = <0>;
                dsi0_in: endpoint {
                    remote-endpoint = <&dsi0_out>;
                };
            };

            port@1 {
                reg = <1>;
                dsi1_in: endpoint {
                    remote-endpoint = <&dsi1_out>;
                };
            };
        };
    };
};

dsi0-host {
    ..
/*
     * 这个 DSI 实例为两个主机控制器提供时钟信号
     */
    clock-master;

    ports {
        ..
```
Please note that the last fragment is incomplete in your original text, so the translation also ends with the incomplete part. If you have more details or need further clarification, feel free to ask!
这段配置似乎是用在设备树（Device Tree）中的描述，用于定义硬件连接关系。下面是对这段配置的中文翻译：

```
{
  端口 {
    dsi0_out: 终端点 {
      远程终端点 = <&dsi0_in>;
    };
  };
};

{
  dsi1-主机 {
    ...
  端口 {
    ...
    端口 {
      dsi1_out: 终端点 {
        远程终端点 = <&dsi1_in>;
      };
    };
  };
  };
}
```

简单解释一下：
- `port`：表示一个物理端口。
- `endpoint`：表示一个终端点或端点。
- `remote-endpoint`：表示与当前终端点相对应的另一个终端点。
- `dsi0_out` 和 `dsi1_out`：表示输出方向的终端点名称。
- `dsi0_in` 和 `dsi1_in`：表示输入方向的终端点名称。

这意味着 `dsi0_out` 与 `dsi0_in` 是一对相互连接的终端点，而 `dsi1_out` 与 `dsi1_in` 同样是另一对相互连接的终端点。
~~~~

## Documentation/devicetree/bindings/display/msm/dp-controller_cn.yaml
~~~~yaml
以下是提供的 YAML 文件翻译成中文：

```yaml
# SPDX 许可证标识符: (GPL-2.0-only 或 BSD-2-Clause)
%YAML 1.2
---
$id: http://devicetree.org/schemas/display/msm/dp-controller.yaml#
$schema: http://devicetree.org/meta-schemas/core.yaml#

标题: MSM 显示端口控制器

维护者:
  - 库吉·谢 <quic_khsieh@quicinc.com>

描述: |
  设备树绑定适用于与 VESA 显示端口接口规范兼容的 MSM 目标上的 DisplayPort 主控制器

属性:
  compatible:
    oneOf:
      - 枚举:
          - qcom,sc7180-dp
          - qcom,sc7280-dp
          - qcom,sc7280-edp
          - qcom,sc8180x-dp
          - qcom,sc8180x-edp
          - qcom,sc8280xp-dp
          - qcom,sc8280xp-edp
          - qcom,sdm845-dp
          - qcom,sm8350-dp
          - qcom,sm8650-dp
      - 项:
          - 枚举:
              - qcom,sm6350-dp
              - qcom,sm8150-dp
              - qcom,sm8250-dp
              - qcom,sm8450-dp
              - qcom,sm8550-dp
          - 常量: qcom,sm8350-dp

  reg:
    minItems: 4
    项:
      - 描述: AHB 寄存器块
      - 描述: 辅助寄存器块
      - 描述: 链路寄存器块
      - 描述: P0 寄存器块
      - 描述: P1 寄存器块

  interrupts:
    maxItems: 1

  clocks:
    项:
      - 描述: 启用寄存器访问的 AHB 时钟
      - 描述: 显示端口 AUX 时钟
      - 描述: 显示端口链路时钟
      - 描述: DP 和 PHY 之间的链路接口时钟
      - 描述: 显示端口像素时钟

  clock-names:
    项:
      - 常量: core_iface
      - 常量: core_aux
      - 常量: ctrl_link
      - 常量: ctrl_link_iface
      - 常量: stream_pixel

  assigned-clocks:
    项:
      - 描述: 链路时钟源
      - 描述: 像素时钟源

  assigned-clock-parents:
    项:
      - 描述: PHY 0 父级
      - 描述: PHY 1 父级

  phys:
    maxItems: 1

  phy-names:
    项:
      - 常量: dp

  operating-points-v2: true

  opp-table:
    类型: 对象

  power-domains:
    maxItems: 1

  aux-bus:
    $ref: /schemas/display/dp-aux-bus.yaml#

  data-lanes:
    $ref: /schemas/types.yaml#/definitions/uint32-array
    过时: true
    minItems: 1
    maxItems: 4
    项:
      最大值: 3

  "#sound-dai-cells":
    常量: 0

  vdda-0p9-supply:
    过时: true
  vdda-1p2-supply:
    过时: true

  ports:
    $ref: /schemas/graph.yaml#/properties/ports
    属性:
      port@0:
        $ref: /schemas/graph.yaml#/properties/port
        描述: 控制器的输入端点

      port@1:
        $ref: /schemas/graph.yaml#/$defs/port-base
        不评估属性: false
        描述: 控制器的输出端点
        属性:
          endpoint:
            $ref: /schemas/media/video-interfaces.yaml#
            不评估属性: false
            属性:
              data-lanes:
                minItems: 1
                maxItems: 4
                项:
                  枚举: [ 0, 1, 2, 3 ]

              link-frequencies:
                minItems: 1
                maxItems: 4
                项:
                  枚举: [ 1620000000, 2700000000, 5400000000, 8100000000 ]

    必需:
      - port@0
      - port@1

必需:
  - compatible
  - reg
  - interrupts
  - clocks
  - clock-names
  - phys
  - phy-names
  - power-domains
  - ports

allOf:
  # 辅助总线在 DP 控制器上不存在
  # 音频输出仅存在于 DP 输出上
  # p1 区域存在于 DP 上，但不在 eDP 上
  - 如果:
      属性:
        compatible:
          包含:
            枚举:
              - qcom,sc7280-edp
              - qcom,sc8180x-edp
              - qcom,sc8280xp-edp
    那么:
      属性:
        "#sound-dai-cells": false
    否则:
      属性:
        aux-bus: false
        reg:
          minItems: 5
      必需:
        - "#sound-dai-cells"

额外属性: false

示例:
  - |
    #include <dt-bindings/interrupt-controller/arm-gic.h>
    #include <dt-bindings/clock/qcom,dispcc-sc7180.h>
    #include <dt-bindings/power/qcom-rpmpd.h>

    displayport-controller@ae90000 {
        compatible = "qcom,sc7180-dp";
        reg = <0xae90000 0x200>,
              <0xae90200 0x200>,
              <0xae90400 0xc00>,
              <0xae91000 0x400>,
              <0xae91400 0x400>;
        interrupt-parent = <&mdss>;
        interrupts = <12>;
        clocks = <&dispcc DISP_CC_MDSS_AHB_CLK>,
                 <&dispcc DISP_CC_MDSS_DP_AUX_CLK>,
                 <&dispcc DISP_CC_MDSS_DP_LINK_CLK>,
                 <&dispcc DISP_CC_MDSS_DP_LINK_INTF_CLK>,
                 <&dispcc DISP_CC_MDSS_DP_PIXEL_CLK>;
        clock-names = "core_iface", "core_aux",
                      "ctrl_link",
                      "ctrl_link_iface", "stream_pixel";

        assigned-clocks = <&dispcc DISP_CC_MDSS_DP_LINK_CLK_SRC>,
                          <&dispcc DISP_CC_MDSS_DP_PIXEL_CLK_SRC>;

        assigned-clock-parents = <&dp_phy 0>, <&dp_phy 1>;

        phys = <&dp_phy>;
        phy-names = "dp";

        #sound-dai-cells = <0>;

        power-domains = <&rpmhpd SC7180_CX>;

        ports {
            #address-cells = <1>;
            #size-cells = <0>;

            port@0 {
                reg = <0>;
                endpoint {
                    remote-endpoint = <&dpu_intf0_out>;
                };
            };

            port@1 {
                reg = <1>;
                endpoint {
                    remote-endpoint = <&typec>;
                    data-lanes = <0 1>;
                    link-frequencies = /bits/ 64 <1620000000 2700000000 5400000000 8100000000>;
                };
            };
        };
    };
..
```

请注意，由于 YAML 语法和某些特殊符号（如 `-`、`:` 等）在中文中的表示可能与英文不同，上述翻译中这些特殊符号仍使用英文格式。此外，一些专有名词（例如 `qcom,sc7180-dp`）直接保留原样，因为它们是特定于技术文档的术语。
~~~~
