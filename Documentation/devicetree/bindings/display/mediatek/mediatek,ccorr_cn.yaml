## Documentation/devicetree/bindings/display/mediatek/mediatek,dsi_cn.yaml
```yaml
下面是给定内容的中文翻译：

# SPDX-文件许可人: (GPL-2.0-only 或 BSD-2-Clause)
%YAML 1.2
---
$id: http://devicetree.org/schemas/display/mediatek/mediatek,dsi.yaml#
$schema: http://devicetree.org/meta-schemas/core.yaml#

标题: MediaTek DSI 控制器

维护者:
  - 春光 胡 <chunkuang.hu@kernel.org>
  - 菲利普·扎贝尔 <p.zabel@pengutronix.de>
  - 施继涛 <jitao.shi@mediatek.com>

描述: |
  MediaTek DSI 功能模块是显示子系统的接收端，可以驱动多达 4 路的 MIPI DSI 输出。两个 DSI 可以同步用于双通道输出。
allOf:
  - $ref: /schemas/display/dsi-controller.yaml#

属性:
  compatible:
    oneOf:
      - 枚举:
          - mediatek,mt2701-dsi
          - mediatek,mt7623-dsi
          - mediatek,mt8167-dsi
          - mediatek,mt8173-dsi
          - mediatek,mt8183-dsi
          - mediatek,mt8186-dsi
          - mediatek,mt8188-dsi
      - 项:
          - 枚举:
              - mediatek,mt6795-dsi
          - 常量: mediatek,mt8173-dsi
      - 项:
          - 枚举:
              - mediatek,mt8195-dsi
              - mediatek,mt8365-dsi
          - 常量: mediatek,mt8183-dsi

  reg:
    最大项数: 1

  interrupts:
    最大项数: 1

  power-domains:
    最大项数: 1

  clocks:
    项:
      - 描述: 引擎时钟
      - 描述: 数字时钟
      - 描述: 高速时钟

  clock-names:
    项:
      - 常量: engine
      - 常量: digital
      - 常量: hs

  resets:
    最大项数: 1

  phys:
    最大项数: 1

  phy-names:
    项:
      - 常量: dphy

  port:
    $ref: /schemas/graph.yaml#/properties/port
    描述:
      输出端口节点。此端口应连接到所接 DSI 面板或 DSI 到 eDP 编码器芯片的输入端口。
所需项:
  - compatible
  - reg
  - interrupts
  - power-domains
  - clocks
  - clock-names
  - phys
  - phy-names
  - port

未评估属性: false

示例:
  - |
    #include <dt-bindings/clock/mt8183-clk.h>
    #include <dt-bindings/interrupt-controller/arm-gic.h>
    #include <dt-bindings/interrupt-controller/irq.h>
    #include <dt-bindings/power/mt8183-power.h>
    #include <dt-bindings/phy/phy.h>
    #include <dt-bindings/reset/mt8183-resets.h>

    soc {
        #address-cells = <2>;
        #size-cells = <2>;

        dsi0: dsi@14014000 {
            compatible = "mediatek,mt8183-dsi";
            reg = <0 0x14014000 0 0x1000>;
            interrupts = <GIC_SPI 236 IRQ_TYPE_LEVEL_LOW>;
            power-domains = <&spm MT8183_POWER_DOMAIN_DISP>;
            clocks = <&mmsys CLK_MM_DSI0_MM>,
                <&mmsys CLK_MM_DSI0_IF>,
                <&mipi_tx0>;
            clock-names = "engine", "digital", "hs";
            resets = <&mmsys MT8183_MMSYS_SW0_RST_B_DISP_DSI0>;
            phys = <&mipi_tx0>;
            phy-names = "dphy";
            port {
                dsi0_out: endpoint {
                    remote-endpoint = <&panel_in>;
                };
            };
        };
    };
```

## Documentation/devicetree/bindings/display/mediatek/mediatek,ethdr_cn.yaml
```yaml
# SPDX-文件许可人: (GPL-2.0-only 或 BSD-2-Clause)
%YAML 1.2
---
$id: http://devicetree.org/schemas/display/mediatek/mediatek,ethdr.yaml#
$schema: http://devicetree.org/meta-schemas/core.yaml#

标题: MediaTek Ethdr 设备

维护者:
  - 春光 胡 <chunkuang.hu@kernel.org>
  - Philipp Zabel <p.zabel@pengutronix.de>

描述:
  ETHDR（ET 高动态范围）是 MediaTek 内置的 HDR 引擎，专为外部显示路径中的 HDR 视频和图形转换设计。
  它处理多种 HDR 输入类型，并执行色调映射、色彩空间/色彩格式转换，然后组合不同的图层，
  将所需的 HDR 或 SDR 信号输出到后续显示路径。
  此引擎由两个视频前端、两个图形前端、一个视频后端和一个混合器组成。ETHDR 包含两个 DMA 功能块：DS 和 ADL。
  这两个功能块在垂直消隐期间从 DRAM 读取预先编程的寄存器并将其设置到硬件中。

属性:
  compatible:
    oneOf:
      - 常量: mediatek,mt8195-disp-ethdr
      - items:
          - 常量: mediatek,mt8188-disp-ethdr
          - 常量: mediatek,mt8195-disp-ethdr

  reg:
    maxItems: 7

  reg-names:
    items:
      - 常量: mixer
      - 常量: vdo_fe0
      - 常量: vdo_fe1
      - 常量: gfx_fe0
      - 常量: gfx_fe1
      - 常量: vdo_be
      - 常量: adl_ds

  interrupts:
    maxItems: 1

  iommus:
    minItems: 1
    maxItems: 2

  clocks:
    items:
      - 描述: 混合器时钟
      - 描述: 视频前端 0 时钟
      - 描述: 视频前端 1 时钟
      - 描述: 图形前端 0 时钟
      - 描述: 图形前端 1 时钟
      - 描述: 视频后端时钟
      - 描述: 自动下载和菜单加载时钟
      - 描述: 视频前端 0 异步时钟
      - 描述: 视频前端 1 异步时钟
      - 描述: 图形前端 0 异步时钟
      - 描述: 图形前端 1 异步时钟
      - 描述: 视频后端异步时钟
      - 描述: ethdr 顶层时钟

  clock-names:
    items:
      - 常量: mixer
      - 常量: vdo_fe0
      - 常量: vdo_fe1
      - 常量: gfx_fe0
      - 常量: gfx_fe1
      - 常量: vdo_be
      - 常量: adl_ds
      - 常量: vdo_fe0_async
      - 常量: vdo_fe1_async
      - 常量: gfx_fe0_async
      - 常量: gfx_fe1_async
      - 常量: vdo_be_async
      - 常量: ethdr_top

  power-domains:
    maxItems: 1

  resets:
    items:
      - 描述: 视频前端 0 异步复位
      - 描述: 视频前端 1 异步复位
      - 描述: 图形前端 0 异步复位
      - 描述: 图形前端 1 异步复位
      - 描述: 视频后端异步复位

  reset-names:
    items:
      - 常量: vdo_fe0_async
      - 常量: vdo_fe1_async
      - 常量: gfx_fe0_async
      - 常量: gfx_fe1_async
      - 常量: vdo_be_async

  mediatek,gce-client-reg:
    $ref: /schemas/types.yaml#/definitions/phandle-array
    minItems: 1
    maxItems: 7
    描述: 由 gce 设置的显示功能模块的寄存器
    此属性中有 4 个参数：gce 节点、子系统 ID、偏移量和寄存器大小。子系统 ID 在每个芯片的 gce 头文件中定义
    include/dt-bindings/gce/<chip>-gce.h，映射到显示功能模块的寄存器

必需:
  - compatible
  - reg
  - clocks
  - clock-names
  - interrupts
  - power-domains
  - resets
  - mediatek,gce-client-reg

额外属性: false

示例:
  - |
    #include <dt-bindings/interrupt-controller/arm-gic.h>
    #include <dt-bindings/clock/mt8195-clk.h>
    #include <dt-bindings/gce/mt8195-gce.h>
    #include <dt-bindings/memory/mt8195-memory-port.h>
    #include <dt-bindings/power/mt8195-power.h>
    #include <dt-bindings/reset/mt8195-resets.h>

    soc {
        #address-cells = <2>;
        #size-cells = <2>;

        hdr-engine@1c114000 {
                compatible = "mediatek,mt8195-disp-ethdr";
                reg = <0 0x1c114000 0 0x1000>,
                      <0 0x1c115000 0 0x1000>,
                      <0 0x1c117000 0 0x1000>,
                      <0 0x1c119000 0 0x1000>,
                      <0 0x1c11a000 0 0x1000>,
                      <0 0x1c11b000 0 0x1000>,
                      <0 0x1c11c000 0 0x1000>;
                reg-names = "mixer", "vdo_fe0", "vdo_fe1", "gfx_fe0", "gfx_fe1",
                            "vdo_be", "adl_ds";
                mediatek,gce-client-reg = <&gce0 SUBSYS_1c11XXXX 0x4000 0x1000>,
                                          <&gce0 SUBSYS_1c11XXXX 0x5000 0x1000>,
                                          <&gce0 SUBSYS_1c11XXXX 0x7000 0x1000>,
                                          <&gce0 SUBSYS_1c11XXXX 0x9000 0x1000>,
                                          <&gce0 SUBSYS_1c11XXXX 0xa000 0x1000>,
                                          <&gce0 SUBSYS_1c11XXXX 0xb000 0x1000>,
                                          <&gce0 SUBSYS_1c11XXXX 0xc000 0x1000>;
                clocks = <&vdosys1 CLK_VDO1_DISP_MIXER>,
                         <&vdosys1 CLK_VDO1_HDR_VDO_FE0>,
                         <&vdosys1 CLK_VDO1_HDR_VDO_FE1>,
                         <&vdosys1 CLK_VDO1_HDR_GFX_FE0>,
                         <&vdosys1 CLK_VDO1_HDR_GFX_FE1>,
                         <&vdosys1 CLK_VDO1_HDR_VDO_BE>,
                         <&vdosys1 CLK_VDO1_26M_SLOW>,
                         <&vdosys1 CLK_VDO1_HDR_VDO_FE0_DL_ASYNC>,
                         <&vdosys1 CLK_VDO1_HDR_VDO_FE1_DL_ASYNC>,
                         <&vdosys1 CLK_VDO1_HDR_GFX_FE0_DL_ASYNC>,
                         <&vdosys1 CLK_VDO1_HDR_GFX_FE1_DL_ASYNC>,
                         <&vdosys1 CLK_VDO1_HDR_VDO_BE_DL_ASYNC>,
                         <&topckgen CLK_TOP_ETHDR>;
                clock-names = "mixer", "vdo_fe0", "vdo_fe1", "gfx_fe0", "gfx_fe1",
                              "vdo_be", "adl_ds", "vdo_fe0_async", "vdo_fe1_async",
                              "gfx_fe0_async", "gfx_fe1_async","vdo_be_async",
                              "ethdr_top";
                power-domains = <&spm MT8195_POWER_DOMAIN_VDOSYS1>;
                iommus = <&iommu_vpp M4U_PORT_L3_HDR_DS>,
                         <&iommu_vpp M4U_PORT_L3_HDR_ADL>;
                interrupts = <GIC_SPI 517 IRQ_TYPE_LEVEL_HIGH 0>; /* disp mixer */
                resets = <&vdosys1 MT8195_VDOSYS1_SW1_RST_B_HDR_VDO_FE0_DL_ASYNC>,
                         <&vdosys1 MT8195_VDOSYS1_SW1_RST_B_HDR_VDO_FE1_DL_ASYNC>,
                         <&vdosys1 MT8195_VDOSYS1_SW1_RST_B_HDR_GFX_FE0_DL_ASYNC>,
                         <&vdosys1 MT8195_VDOSYS1_SW1_RST_B_HDR_GFX_FE1_DL_ASYNC>,
                         <&vdosys1 MT8195_VDOSYS1_SW1_RST_B_HDR_VDO_BE_DL_ASYNC>;
                reset-names = "vdo_fe0_async", "vdo_fe1_async", "gfx_fe0_async",
                              "gfx_fe1_async", "vdo_be_async";
        };
    };
..
```

## Documentation/devicetree/bindings/display/mediatek/mediatek,gamma_cn.yaml
```yaml
# SPDX-许可证标识符: (GPL-2.0-only 或 BSD-2-Clause)
%YAML 1.2
---
$id: http://devicetree.org/schemas/display/mediatek/mediatek,gamma.yaml#
$schema: http://devicetree.org/meta-schemas/core.yaml#

标题: Mediatek 显示器伽玛校正

维护者:
  - 春光 胡 <chunkuang.hu@kernel.org>
  - 菲利普·扎贝尔 <p.zabel@pengutronix.de>

描述: |
  Mediatek 显示器伽玛校正，即 GAMMA，提供了一种非线性操作，用于调整显示系统中的亮度。
  GAMMA 设备节点必须是中心 MMSYS_CONFIG 节点的同级节点。
  关于 MMSYS_CONFIG 绑定的描述，请参阅
  文档/devicetree/bindings/arm/mediatek/mediatek,mmsys.yaml
  以获取详细信息。
属性:
  compatible:
    oneOf:
      - enum:
          - mediatek,mt8173-disp-gamma
          - mediatek,mt8183-disp-gamma
          - mediatek,mt8195-disp-gamma
      - items:
          - enum:
              - mediatek,mt6795-disp-gamma
          - const: mediatek,mt8173-disp-gamma
      - items:
          - enum:
              - mediatek,mt8186-disp-gamma
              - mediatek,mt8188-disp-gamma
              - mediatek,mt8192-disp-gamma
              - mediatek,mt8195-disp-gamma
              - mediatek,mt8365-disp-gamma
          - const: mediatek,mt8183-disp-gamma
      - items:
          - enum:
              - mediatek,mt8188-disp-gamma
          - const: mediatek,mt8195-disp-gamma

  reg:
    maxItems: 1

  interrupts:
    maxItems: 1

  power-domains:
    描述: 根据由 phandle 指定的电源控制器绑定定义的 phandle 和 PM 域标识符。详情请参阅
      文档/devicetree/bindings/power/power-domain.yaml
时钟:
    items:
      - 描述: GAMMA 时钟

  mediatek,gce-client-reg:
    描述: 客户端驱动程序的寄存器可以由 gce 配置，并通过此属性中定义的4个参数来指定，例如 gce 的 phandle、子系统 ID、寄存器偏移量和大小。每个 GCE 子系统 ID 都映射到头文件 include/dt-bindings/gce/<chip>-gce.h 中定义的一个客户端。
$ref: /schemas/types.yaml#/definitions/phandle-array
    maxItems: 1

必需:
  - compatible
  - reg
  - interrupts
  - power-domains
  - clocks

附加属性: false

示例:
  - |
    #include <dt-bindings/interrupt-controller/arm-gic.h>
    #include <dt-bindings/clock/mt8173-clk.h>
    #include <dt-bindings/power/mt8173-power.h>
    #include <dt-bindings/gce/mt8173-gce.h>

    soc {
        #address-cells = <2>;
        #size-cells = <2>;

        gamma@14016000 {
            compatible = "mediatek,mt8173-disp-gamma";
            reg = <0 0x14016000 0 0x1000>;
            interrupts = <GIC_SPI 190 IRQ_TYPE_LEVEL_LOW>;
            power-domains = <&scpsys MT8173_POWER_DOMAIN_MM>;
            clocks = <&mmsys CLK_MM_DISP_GAMMA>;
            mediatek,gce-client-reg = <&gce SUBSYS_1401XXXX 0x6000 0x1000>;
        };
    };
```

## Documentation/devicetree/bindings/display/mediatek/mediatek,hdmi-ddc_cn.yaml
```yaml
# SPDX-许可证标识符: (GPL-2.0-only 或 BSD-2-Clause)
%YAML 1.2
---
$id: http://devicetree.org/schemas/display/mediatek/mediatek,hdmi-ddc.yaml#
$schema: http://devicetree.org/meta-schemas/core.yaml#

标题: Mediatek HDMI DDC

维护者:
  - CK Hu <ck.hu@mediatek.com>
  - Jitao shi <jitao.shi@mediatek.com>

描述: |
  HDMI DDC I2C 控制器用于与 HDMI DDC 引脚接口。

属性:
  compatible:
    枚举:
      - mediatek,mt7623-hdmi-ddc
      - mediatek,mt8167-hdmi-ddc
      - mediatek,mt8173-hdmi-ddc

  reg:
    最大项目数: 1

  interrupts:
    最大项目数: 1

  clocks:
    最大项目数: 1

  clock-names:
    项目:
      - 常量: ddc-i2c

必需:
  - compatible
  - reg
  - interrupts
  - clocks
  - clock-names

额外属性: false

示例:
  - |
    #include <dt-bindings/clock/mt8173-clk.h>
    #include <dt-bindings/interrupt-controller/arm-gic.h>
    #include <dt-bindings/interrupt-controller/irq.h>
    hdmi_ddc0: i2c@11012000 {
        compatible = "mediatek,mt8173-hdmi-ddc";
        reg = <0x11012000 0x1c>;
        interrupts = <GIC_SPI 81 IRQ_TYPE_LEVEL_LOW>;
        clocks = <&pericfg CLK_PERI_I2C5>;
        clock-names = "ddc-i2c";
    };
```

## Documentation/devicetree/bindings/display/mediatek/mediatek,hdmi_cn.yaml
```yaml
下面是给定内容的中文翻译：

# SPDX-许可证标识符: (GPL-2.0-only 或 BSD-2-Clause)
%YAML 1.2
---
$id: http://devicetree.org/schemas/display/mediatek/mediatek,hdmi.yaml#
$schema: http://devicetree.org/meta-schemas/core.yaml#

标题: 联发科技HDMI编码器

维护者:
  - 陈科 <ck.hu@mediatek.com>
  - 石继涛 <jitao.shi@mediatek.com>

描述: |
  联发科技HDMI编码器可以从其并行输入生成HDMI 1.4a或MHL 2.0信号。

属性:
  compatible:
    枚举:
      - mediatek,mt2701-hdmi
      - mediatek,mt7623-hdmi
      - mediatek,mt8167-hdmi
      - mediatek,mt8173-hdmi

  reg:
    最大项数: 1

  interrupts:
    最大项数: 1

  clocks:
    项目:
      - 描述: 像素时钟
      - 描述: HDMI PLL
      - 描述: 比特时钟
      - 描述: S/PDIF时钟

  clock-names:
    项目:
      - 常量: pixel
      - 常量: pll
      - 常量: bclk
      - 常量: spdif

  phys:
    最大项数: 1

  phy-names:
    项目:
      - 常量: hdmi

  mediatek,syscon-hdmi:
    $ref: /schemas/types.yaml#/definitions/phandle-array
    项目:
      - 项目:
          - 描述: 系统配置寄存器的phandle
          - 描述: 系统配置寄存器中的寄存器偏移量
    描述: |
      系统配置寄存器的phandle链接和寄存器偏移量

端口:
    $ref: /schemas/graph.yaml#/properties/ports

    属性:
      port@0:
        $ref: /schemas/graph.yaml#/properties/port
        描述: |
          输入端口节点。此端口应连接到DPI输出端口。
      port@1:
        $ref: /schemas/graph.yaml#/properties/port
        描述: |
          输出端口节点。此端口应连接到包含ddc-i2c-bus属性的连接器节点的输入端口，
          或连接到外接桥接芯片（如SlimPort发射器）的输入端口。

必需:
  - port@0
  - port@1

必需:
  - compatible
  - reg
  - interrupts
  - clocks
  - clock-names
  - phys
  - phy-names
  - mediatek,syscon-hdmi
  - ports

附加属性: false

示例:
  - |
    #include <dt-bindings/clock/mt8173-clk.h>
    #include <dt-bindings/interrupt-controller/arm-gic.h>
    #include <dt-bindings/interrupt-controller/irq.h>
    hdmi0: hdmi@14025000 {
        compatible = "mediatek,mt8173-hdmi";
        reg = <0x14025000 0x400>;
        interrupts = <GIC_SPI 206 IRQ_TYPE_LEVEL_LOW>;
        clocks = <&mmsys CLK_MM_HDMI_PIXEL>,
             <&mmsys CLK_MM_HDMI_PLLCK>,
             <&mmsys CLK_MM_HDMI_AUDIO>,
             <&mmsys CLK_MM_HDMI_SPDIF>;
        clock-names = "pixel", "pll", "bclk", "spdif";
        pinctrl-names = "default";
        pinctrl-0 = <&hdmi_pin>;
        phys = <&hdmi_phy>;
        phy-names = "hdmi";
        mediatek,syscon-hdmi = <&mmsys 0x900>;

        ports {
          #address-cells = <1>;
          #size-cells = <0>;

          port@0 {
            reg = <0>;

            hdmi0_in: endpoint {
              remote-endpoint = <&dpi0_out>;
            };
          };

          port@1 {
            reg = <1>;

            hdmi0_out: endpoint {
              remote-endpoint = <&hdmi_con_in>;
            };
          };
        };
    };
```
