## Documentation/devicetree/bindings/display/mediatek/mediatek,merge_cn.yaml
```yaml
下面是给定内容的中文翻译：

# SPDX-文件许可标识符: (GPL-2.0-only 或 BSD-2-Clause)
%YAML 1.2
---
$id: http://devicetree.org/schemas/display/mediatek/mediatek,merge.yaml#
$schema: http://devicetree.org/meta-schemas/core.yaml#

标题: 联发科显示合并模块

维护者:
  - 春光 胡 <chunkuang.hu@kernel.org>
  - 菲利普·扎贝尔 <p.zabel@pengutronix.de>

描述: |
  联发科显示合并模块，即MERGE，用于将两条按行分片的输入合并为一条并排输出。
  MERGE 设备节点必须是中央 MMSYS_CONFIG 节点的同级节点。
  关于 MMSYS_CONFIG 绑定的描述，请参见
  文档/devicetree/bindings/arm/mediatek/mediatek,mmsys.yaml
  获取详细信息。

属性:
  compatible:
    oneOf:
      - 枚举:
          - mediatek,mt8173-disp-merge
          - mediatek,mt8195-disp-merge
          - mediatek,mt8195-mdp3-merge
      - 项:
          - 常量: mediatek,mt6795-disp-merge
          - 常量: mediatek,mt8173-disp-merge
      - 项:
          - 常量: mediatek,mt8188-disp-merge
          - 常量: mediatek,mt8195-disp-merge

  reg:
    最大项目数: 1

  interrupts:
    最大项目数: 1

  power-domains:
    描述: 由电源控制器绑定定义的句柄和电源域指定符。详情请见
      文档/devicetree/bindings/power/power-domain.yaml

时钟:
    最小项目数: 1
    最大项目数: 2

  clock-names:
    oneOf:
      - 项:
          - 常量: merge
      - 项:
          - 常量: merge
          - 常量: merge_async

  mediatek,merge-fifo-en:
    描述:
      启用合并FIFO的设置主要为了确保后端面板显示数据不会出现欠流情况，需要在FIFO中保留一些额外的数据。
      根据合并FIFO的设置，当检测到水位不足时，它会触发RDMA发送超速和预超速命令给SMI以加快数据传输速率。
类型: 布尔值

  mediatek,merge-mute:
    描述: 支持静音功能。静音合并输出的内容。
类型: 布尔值

  mediatek,gce-client-reg:
    描述: 客户端驱动程序的寄存器可以通过GCE配置，该属性定义了4个参数，如GCE的句柄、子系统ID、寄存器偏移量和大小。每个GCE子系统ID映射到头文件 include/dt-bindings/gce/<芯片>-gce.h 中定义的一个客户端。
$ref: /schemas/types.yaml#/definitions/phandle-array
    最大项目数: 1

  resets:
    描述: 重置控制器
      详情请见文档/devicetree/bindings/reset/reset.txt
最大项目数: 1

必需:
  - compatible
  - reg
  - power-domains
  - clocks

附加属性: false

示例:
  - |
    #include <dt-bindings/interrupt-controller/arm-gic.h>
    #include <dt-bindings/clock/mt8173-clk.h>
    #include <dt-bindings/power/mt8173-power.h>

    soc {
        #address-cells = <2>;
        #size-cells = <2>;

        merge@14017000 {
            compatible = "mediatek,mt8173-disp-merge";
            reg = <0 0x14017000 0 0x1000>;
            power-domains = <&spm MT8173_POWER_DOMAIN_MM>;
            clocks = <&mmsys CLK_MM_DISP_MERGE>;
            clock-names = "merge";
        };
    };
```

## Documentation/devicetree/bindings/display/mediatek/mediatek,od_cn.yaml
```yaml
# SPDX-License-Identifier: (GPL-2.0-only OR BSD-2-Clause)
%YAML 1.2
---
$id: http://devicetree.org/schemas/display/mediatek/mediatek,od.yaml#
$schema: http://devicetree.org/meta-schemas/core.yaml#

标题: Mediatek 显示过驱

维护者:
  - 春光 胡 <chunkuang.hu@kernel.org>
  - 菲利普·扎贝尔 <p.zabel@pengutronix.de>

描述: |
  Mediatek 显示过驱，即 OD，通过增加连续帧间像素的过渡值来使 LCD 运转得更快。
OD 设备节点必须是中央 MMSYS_CONFIG 节点的同级节点。
关于 MMSYS_CONFIG 绑定的描述，请参阅
  文档/devicetree/bindings/arm/mediatek/mediatek,mmsys.yaml
  以获取详细信息。

属性:
  compatible:
    oneOf:
      - 枚举:
          - mediatek,mt2712-disp-od
          - mediatek,mt8173-disp-od
      - items:
          - 常量: mediatek,mt6795-disp-od
          - 常量: mediatek,mt8173-disp-od

  reg:
    最大项数: 1

  interrupts:
    最大项数: 1

  clocks:
    items:
      - 描述: OD 时钟

必需:
  - compatible
  - reg
  - clocks

额外属性: false

示例:
  - |
    #include <dt-bindings/clock/mt8173-clk.h>

    soc {
        #address-cells = <2>;
        #size-cells = <2>;

        od@14023000 {
            compatible = "mediatek,mt8173-disp-od";
            reg = <0 0x14023000 0 0x1000>;
            clocks = <&mmsys CLK_MM_DISP_OD>;
        };
    };
```

## Documentation/devicetree/bindings/display/mediatek/mediatek,ovl-2l_cn.yaml
```yaml
# SPDX-License-Identifier: (GPL-2.0-only OR BSD-2-Clause)
%YAML 1.2
---
$id: http://devicetree.org/schemas/display/mediatek/mediatek,ovl-2l.yaml#
$schema: http://devicetree.org/meta-schemas/core.yaml#

title: 联发科技显示叠加2层

maintainers:
  - 春光·胡 <chunkuang.hu@kernel.org>
  - 菲利普·扎贝尔 <p.zabel@pengutronix.de>

description: |
  联发科技显示叠加2层，即OVL-2L，为OVL提供了额外的两层。
  OVL-2L设备节点必须是中心MMSYS_CONFIG节点的同级节点。
  关于MMSYS_CONFIG绑定的描述，请参阅
  文档/devicetree/bindings/arm/mediatek/mediatek,mmsys.yaml以获取详细信息。

properties:
  compatible:
    oneOf:
      - enum:
          - mediatek,mt8183-disp-ovl-2l
          - mediatek,mt8192-disp-ovl-2l
      - items:
          - enum:
              - mediatek,mt8186-disp-ovl-2l
          - const: mediatek,mt8192-disp-ovl-2l

  reg:
    maxItems: 1

  interrupts:
    maxItems: 1

  power-domains:
    description: 根据由phandle指定的电源控制器的绑定定义的phandle和PM域标识符。详情请参阅
      文档/devicetree/bindings/power/power-domain.yaml

clocks:
    items:
      - description: OVL-2L时钟

  iommus:
    description:
      此属性应指向带有主端口参数的相应IOMMU块，详情请参阅文档/devicetree/bindings/iommu/mediatek,iommu.yaml

mediatek,gce-client-reg:
    description: 客户端驱动程序的寄存器可以由gce通过此属性中定义的4个参数进行配置，例如gce的phandle、子系统ID、寄存器偏移量和大小。每个GCE子系统ID映射到头文件include/dt-bindings/gce/<chip>-gce.h中定义的一个客户端

$ref: /schemas/types.yaml#/definitions/phandle-array
    maxItems: 1

required:
  - compatible
  - reg
  - interrupts
  - power-domains
  - clocks
  - iommus

additionalProperties: false

examples:
  - |
    #include <dt-bindings/interrupt-controller/arm-gic.h>
    #include <dt-bindings/clock/mt8183-clk.h>
    #include <dt-bindings/power/mt8183-power.h>
    #include <dt-bindings/gce/mt8183-gce.h>
    #include <dt-bindings/memory/mt8183-larb-port.h>

    soc {
        #address-cells = <2>;
        #size-cells = <2>;

        ovl_2l0: ovl@14009000 {
            compatible = "mediatek,mt8183-disp-ovl-2l";
            reg = <0 0x14009000 0 0x1000>;
            interrupts = <GIC_SPI 226 IRQ_TYPE_LEVEL_LOW>;
            power-domains = <&spm MT8183_POWER_DOMAIN_DISP>;
            clocks = <&mmsys CLK_MM_DISP_OVL0_2L>;
            iommus = <&iommu M4U_PORT_DISP_2L_OVL0_LARB0>;
            mediatek,gce-client-reg = <&gce SUBSYS_1400XXXX 0x9000 0x1000>;
        };
    };
```

## Documentation/devicetree/bindings/display/mediatek/mediatek,ovl_cn.yaml
~~~~yaml
以下是提供的 YAML 文件的中文翻译：

```yaml
# SPDX-文件许可标识符: (GPL-2.0-only 或 BSD-2-Clause)
%YAML 1.2
---
$id: http://devicetree.org/schemas/display/mediatek/mediatek,ovl.yaml#
$schema: http://devicetree.org/meta-schemas/core.yaml#

标题: Mediatek 显示覆盖层

维护者:
  - 春光 胡 <chunkuang.hu@kernel.org>
  - 菲利普·扎贝尔 <p.zabel@pengutronix.de>

描述: |
  Mediatek 显示覆盖层（即 OVL）可以从内存中进行 Alpha 混合。
  OVL 设备节点必须是中心 MMSYS_CONFIG 节点的同级节点。
  关于 MMSYS_CONFIG 绑定的详细信息，请参阅
  文档/devicetree/bindings/arm/mediatek/mediatek,mmsys.yaml

属性:
  compatible:
    oneOf:
      - 枚举:
          - mediatek,mt2701-disp-ovl
          - mediatek,mt8173-disp-ovl
          - mediatek,mt8183-disp-ovl
          - mediatek,mt8192-disp-ovl
          - mediatek,mt8195-mdp3-ovl
      - 项目:
          - 枚举:
              - mediatek,mt7623-disp-ovl
              - mediatek,mt2712-disp-ovl
          - 常量: mediatek,mt2701-disp-ovl
      - 项目:
          - 枚举:
              - mediatek,mt6795-disp-ovl
          - 常量: mediatek,mt8173-disp-ovl
      - 项目:
          - 枚举:
              - mediatek,mt8188-disp-ovl
              - mediatek,mt8195-disp-ovl
          - 常量: mediatek,mt8183-disp-ovl
      - 项目:
          - 枚举:
              - mediatek,mt8186-disp-ovl
              - mediatek,mt8365-disp-ovl
          - 常量: mediatek,mt8192-disp-ovl

  reg:
    最大项数: 1

  interrupts:
    最大项数: 1

  power-domains:
    描述: 由 phandle 和电源域指定符定义，具体见绑定中所指的电源控制器。请参阅
      文档/devicetree/bindings/power/power-domain.yaml 获取详细信息。

时钟:
    项目:
      - 描述: OVL 时钟

  iommus:
    描述:
      此属性应指向具有主端口参数的相应 IOMMU 块，请参阅文档/devicetree/bindings/iommu/mediatek,iommu.yaml 获取详细信息。

mediatek,gce-client-reg:
    描述: 客户端驱动程序寄存器可通过此属性中定义的4个参数由 GCE 配置，例如 GCE 的 phandle、子系统 ID、寄存器偏移量和大小。每个 GCE 子系统 ID 映射到头文件 include/dt-bindings/gce/<chip>-gce.h 中定义的一个客户端。
$ref: /schemas/types.yaml#/definitions/phandle-array
    最大项数: 1

必需:
  - compatible
  - reg
  - interrupts
  - power-domains
  - 时钟
  - iommus

其他属性: false

示例:
  - |
    #include <dt-bindings/interrupt-controller/arm-gic.h>
    #include <dt-bindings/clock/mt8173-clk.h>
    #include <dt-bindings/power/mt8173-power.h>
    #include <dt-bindings/gce/mt8173-gce.h>
    #include <dt-bindings/memory/mt8173-larb-port.h>

    soc {
        #address-cells = <2>;
        #size-cells = <2>;

        ovl0: ovl@1400c000 {
            compatible = "mediatek,mt8173-disp-ovl";
            reg = <0 0x1400c000 0 0x1000>;
            interrupts = <GIC_SPI 180 IRQ_TYPE_LEVEL_LOW>;
            power-domains = <&scpsys MT8173_POWER_DOMAIN_MM>;
            clocks = <&mmsys CLK_MM_DISP_OVL0>;
            iommus = <&iommu M4U_PORT_DISP_OVL0>;
            mediatek,gce-client-reg = <&gce SUBSYS_1400XXXX 0xc000 0x1000>;
        };
    };
```

请注意，由于 YAML 格式和语法的限制，某些部分可能无法完全按照原始格式进行直接翻译。此外，一些英文缩写和技术术语在中文环境中通常仍然使用其英文形式。
~~~~

## Documentation/devicetree/bindings/display/mediatek/mediatek,padding_cn.yaml
```yaml
# SPDX-许可证标识符: (GPL-2.0-only 或 BSD-2-Clause)
%YAML 1.2
---
$id: http://devicetree.org/schemas/display/mediatek/mediatek,padding.yaml#
$schema: http://devicetree.org/meta-schemas/core.yaml#

标题: MediaTek 显示填充

维护者:
  - 春光 胡 <chunkuang.hu@kernel.org>
  - 菲利普·扎贝尔 <p.zabel@pengutronix.de>

描述:
  填充提供了一种能力，可以在指定颜色的情况下向图层的宽度和高度添加像素。由于硬件设计，VDOSYS1 中的混合器要求图层的宽度为2像素对齐，或者当启用 ETHDR 时为4像素对齐，我们需要填充来处理奇数宽度。
请注意，即使填充处于旁路模式，寄存器中的设置也必须被清零，否则可能会出现未定义的行为。

属性:
  compatible:
    枚举:
      - mediatek,mt8188-disp-padding
      - mediatek,mt8195-mdp3-padding

  reg:
    最大项数: 1

  power-domains:
    最大项数: 1

  clocks:
    项:
      - 描述: 填充的时钟

  mediatek,gce-client-reg:
    描述:
      GCE（全局命令引擎）是一个多核微处理器，它帮助其客户端执行命令而无需中断 CPU。此属性描述了由4个字段组成的 GCE 客户端信息：
1. GCE 的 phandle（可能存在多个 GCE 处理器）
      2. 在 dt-binding 中定义的子系统 ID，类似于用户 ID
         （请参阅 include/dt-bindings/gce/<芯片>-gce.h）
      3. 您所在的子系统的基地址偏移量
      4. 客户端所需的寄存器大小
    $ref: /schemas/types.yaml#/definitions/phandle-array
    项:
      项:
        - 描述: GCE 的 phandle
        - 描述: 在 dt-binding 中定义的子系统 ID
        - 描述: 子系统的基地址偏移量
        - 描述: 寄存器大小
    最大项数: 1

必需:
  - compatible
  - reg
  - power-domains
  - clocks
  - mediatek,gce-client-reg

额外属性: false

示例:
  - |
    #include <dt-bindings/interrupt-controller/arm-gic.h>
    #include <dt-bindings/clock/mediatek,mt8188-clk.h>
    #include <dt-bindings/power/mediatek,mt8188-power.h>
    #include <dt-bindings/gce/mt8195-gce.h>

    soc {
        #address-cells = <2>;
        #size-cells = <2>;

        padding0: padding@1c11d000 {
            compatible = "mediatek,mt8188-disp-padding";
            reg = <0 0x1c11d000 0 0x1000>;
            clocks = <&vdosys1 CLK_VDO1_PADDING0>;
            power-domains = <&spm MT8188_POWER_DOMAIN_VDOSYS1>;
            mediatek,gce-client-reg = <&gce0 SUBSYS_1c11XXXX 0xd000 0x1000>;
        };
    };
```

## Documentation/devicetree/bindings/display/mediatek/mediatek,postmask_cn.yaml
```yaml
# SPDX-许可证标识符: (GPL-2.0-only 或 BSD-2-Clause)
%YAML 1.2
---
$id: http://devicetree.org/schemas/display/mediatek/mediatek,postmask.yaml#
$schema: http://devicetree.org/meta-schemas/core.yaml#

标题: Mediatek 显示器 Postmask

维护者:
  - 春光 胡 <chunkuang.hu@kernel.org>
  - 菲利普·扎贝尔 <p.zabel@pengutronix.de>

描述: |
  Mediatek 显示器 Postmask，即 POSTMASK，提供圆角图案生成功能。
  POSTMASK 设备节点必须是中心 MMSYS_CONFIG 节点的同级节点。
  对于 MMSYS_CONFIG 绑定的描述，请参阅
  文档/devicetree/bindings/arm/mediatek/mediatek,mmsys.yaml
  获取详细信息。

属性:
  compatible:
    oneOf:
      - 枚举:
          - mediatek,mt8192-disp-postmask
      - items:
          - 枚举:
              - mediatek,mt8186-disp-postmask
              - mediatek,mt8188-disp-postmask
          - 常量: mediatek,mt8192-disp-postmask

  reg:
    maxItems: 1

  interrupts:
    maxItems: 1

  power-domains:
    描述: 根据 phandle 所指定的电源控制器绑定定义的句柄和 PM 域规范。详情请见
      文档/devicetree/bindings/power/power-domain.yaml
时钟:
    items:
      - 描述: POSTMASK 时钟

  mediatek,gce-client-reg:
    描述: 客户端驱动程序的寄存器可以通过 gce 进行配置，并且在这个属性中定义了 4 个参数，例如 gce 的句柄、子系统 ID、寄存器偏移量和大小。每个 GCE 子系统 ID 都映射到一个在头文件 include/dt-bindings/gce/<芯片>-gce.h 中定义的客户端
$ref: /schemas/types.yaml#/definitions/phandle-array
    maxItems: 1

必需:
  - compatible
  - reg
  - interrupts
  - power-domains
  - clocks

额外属性: false

示例:
  - |
    #include <dt-bindings/interrupt-controller/arm-gic.h>
    #include <dt-bindings/clock/mt8192-clk.h>
    #include <dt-bindings/power/mt8192-power.h>
    #include <dt-bindings/gce/mt8192-gce.h>

    soc {
        #address-cells = <2>;
        #size-cells = <2>;

        postmask0: postmask@1400d000 {
            compatible = "mediatek,mt8192-disp-postmask";
            reg = <0 0x1400d000 0 0x1000>;
            interrupts = <GIC_SPI 262 IRQ_TYPE_LEVEL_HIGH 0>;
            power-domains = <&scpsys MT8192_POWER_DOMAIN_DISP>;
            clocks = <&mmsys CLK_MM_DISP_POSTMASK0>;
            mediatek,gce-client-reg = <&gce SUBSYS_1400XXXX 0xd000 0x1000>;
        };
    };
```

## Documentation/devicetree/bindings/display/mediatek/mediatek,rdma_cn.yaml
```yaml
# SPDX-License-Identifier: (GPL-2.0-only OR BSD-2-Clause)
%YAML 1.2
---
$id: http://devicetree.org/schemas/display/mediatek/mediatek,rdma.yaml#
$schema: http://devicetree.org/meta-schemas/core.yaml#

标题: Mediatek 读取直接内存访问

维护者:
  - 春光 胡 <chunkuang.hu@kernel.org>
  - 菲利普·扎贝尔 <p.zabel@pengutronix.de>

描述: |
  Mediatek 读取直接内存访问 (RDMA) 组件用于将数据读入 DMA。它为后端面板驱动程序（如 DSI、DPI 和 DP_INTF）提供实时数据。
  它包含一个行缓冲区来存储足够的像素数据。
  RDMA 设备节点必须是中心 MMSYS_CONFIG 节点的同级节点。
  关于 MMSYS_CONFIG 绑定的详细信息，请参阅
  文档/devicetree/bindings/arm/mediatek/mediatek,mmsys.yaml。

属性:
  compatible:
    oneOf:
      - 枚举:
          - mediatek,mt2701-disp-rdma
          - mediatek,mt8173-disp-rdma
          - mediatek,mt8183-disp-rdma
          - mediatek,mt8195-disp-rdma
      - 项目:
          - 枚举:
              - mediatek,mt8188-disp-rdma
          - 常量: mediatek,mt8195-disp-rdma
      - 项目:
          - 枚举:
              - mediatek,mt7623-disp-rdma
              - mediatek,mt2712-disp-rdma
          - 常量: mediatek,mt2701-disp-rdma
      - 项目:
          - 枚举:
              - mediatek,mt6795-disp-rdma
          - 常量: mediatek,mt8173-disp-rdma
      - 项目:
          - 枚举:
              - mediatek,mt8186-disp-rdma
              - mediatek,mt8192-disp-rdma
              - mediatek,mt8365-disp-rdma
          - 常量: mediatek,mt8183-disp-rdma

  reg:
    最大项数: 1

  interrupts:
    最大项数: 1

  power-domains:
    描述: 根据由 phandle 指定的电源控制器绑定定义的 phandle 和 PM 域标识符。详情请见
      文档/devicetree/bindings/power/power-domain.yaml

时钟:
    项目:
      - 描述: RDMA 时钟

  iommus:
    描述:
      此属性应指向具有主端口作为参数的相应 IOMMU 块，详情请参阅文档/devicetree/bindings/iommu/mediatek,iommu.yaml

mediatek,rdma-fifo-size:
    描述:
      即使在同一 SOC 中，RDMA FIFO 大小也可能不同，在相应的 RDMA 中添加此属性
      下面的值是硬件数据表中定义的最大值
      mediatek,rdma-fifo-size 的 mt8173-rdma0 是 8K
      mediatek,rdma-fifo-size 的 mt8183-rdma0 是 5K
      mediatek,rdma-fifo-size 的 mt8183-rdma1 是 2K
    $ref: /schemas/types.yaml#/definitions/uint32
    枚举: [8192, 5120, 2048]

  mediatek,gce-client-reg:
    描述: 可以通过 GCE 使用此属性中定义的 4 个参数配置客户端驱动程序的寄存器，例如 GCE 的 phandle、子系统 ID、寄存器偏移量和大小。每个 GCE 子系统 ID 都映射到在头文件 include/dt-bindings/gce/<chip>-gce.h 中定义的客户端
$ref: /schemas/types.yaml#/definitions/phandle-array
    最大项数: 1

必需:
  - compatible
  - reg
  - interrupts
  - power-domains
  - 时钟
  - iommus

附加属性: false

示例:
  - |
    #include <dt-bindings/interrupt-controller/arm-gic.h>
    #include <dt-bindings/clock/mt8173-clk.h>
    #include <dt-bindings/power/mt8173-power.h>
    #include <dt-bindings/gce/mt8173-gce.h>
    #include <dt-bindings/memory/mt8173-larb-port.h>

    soc {
        #address-cells = <2>;
        #size-cells = <2>;

        rdma0: rdma@1400e000 {
            compatible = "mediatek,mt8173-disp-rdma";
            reg = <0 0x1400e000 0 0x1000>;
            interrupts = <GIC_SPI 182 IRQ_TYPE_LEVEL_LOW>;
            power-domains = <&scpsys MT8173_POWER_DOMAIN_MM>;
            clocks = <&mmsys CLK_MM_DISP_RDMA0>;
            iommus = <&iommu M4U_PORT_DISP_RDMA0>;
            mediatek,rdma-fifo-size = <8192>;
            mediatek,gce-client-reg = <&gce SUBSYS_1400XXXX 0xe000 0x1000>;
        };
    };
```
