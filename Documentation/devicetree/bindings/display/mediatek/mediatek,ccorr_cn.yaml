## Documentation/devicetree/bindings/display/msm/dpu-common_cn.yaml
~~~~yaml
```yaml
# YAML 1.2
---
$id: http://devicetree.org/schemas/display/msm/dpu-common.yaml#
$schema: http://devicetree.org/meta-schemas/core.yaml#

title: 高通显示DPU通用属性

maintainers:
  - Krishna Manikandan <quic_mkrishn@quicinc.com>
  - Dmitry Baryshkov <dmitry.baryshkov@linaro.org>
  - Rob Clark <robdclark@gmail.com>

description: |
  针对高通DPU显示控制器的通用属性
# 默认情况下不要选择此配置，否则它也会被所有 display-controller@ 节点选中
select:
  false

properties:
  $nodename:
    pattern: '^display-controller@[0-9a-f]+$'

  interrupts:
    maxItems: 1

  power-domains:
    maxItems: 1

  operating-points-v2: true
  opp-table:
    type: object

  ports:
    $ref: /schemas/graph.yaml#/properties/ports
    description: |
      包含从DPU设备输出端口的列表。这些端口连接到DPU硬件外部的接口，
      例如DSI、DP等。
patternProperties:
      "^port@[0-9a-f]+$":
        $ref: /schemas/graph.yaml#/properties/port

    # 至少需要一个端口
    required:
      - port@0

required:
  - interrupts
  - power-domains
  - operating-points-v2
  - ports

additionalProperties: true
```

请注意，上述翻译将英文原文转换为中文，并尽量保持了原有的结构和格式。在某些地方，如注释部分，为了使语句更加自然流畅，进行了适当的调整。
~~~~
