## Documentation/devicetree/bindings/leds/backlight/ti,lm3509_cn.yaml
~~~~yaml
下面是给定文档的中文翻译：

```yaml
# SPDX-License-Identifier: (GPL-2.0 OR BSD-2-Clause)
%YAML 1.2
---
$id: http://devicetree.org/schemas/leds/backlight/ti,lm3509.yaml#
$schema: http://devicetree.org/meta-schemas/core.yaml#

title: TI LM3509 高效白光LED及/或OLED显示屏升压转换器

maintainers:
  - Patrick Gansterer <paroga@paroga.com>

description:
  LM3509 电流模式升压转换器提供两个独立输出。
更多信息请参见: https://www.ti.com/product/LM3509

properties:
  compatible:
    const: ti,lm3509

  reg:
    maxItems: 1

  "#address-cells":
    const: 1

  "#size-cells":
    const: 0

  reset-gpios:
    maxItems: 1

  ti,brightness-rate-of-change-us:
    description: 亮度变化速率（微秒）
    enum: [51, 13000, 26000, 52000]

  ti,oled-mode:
    description: 启用OLED模式
    type: boolean

patternProperties:
  "^led@[01]$":
    type: object
    description: 连接LED串的属性
$ref: common.yaml#

    properties:
      reg:
        description:
          用于编程两个电流阱的控制寄存器
LM3509有两个寄存器（BMAIN和BSUB），在这个属性中表示为0或1。两个电流阱可以使用这两个寄存器独立控制，或者配置寄存器BMAIN来通过led-sources属性同时控制两个电流阱
        minimum: 0
        maximum: 1

      label: true

      led-sources:
        minItems: 1
        maxItems: 2
        items:
          minimum: 0
          maximum: 1

      default-brightness:
        minimum: 0
        maximum: 31
        default: 18

      max-brightness:
        minimum: 0
        maximum: 31
        default: 31

    required:
      - reg

    additionalProperties: false

required:
  - compatible
  - reg

additionalProperties: false

examples:
  - |
    #include <dt-bindings/gpio/gpio.h>
    i2c {
        #address-cells = <1>;
        #size-cells = <0>;

        backlight@36 {
            compatible = "ti,lm3509";
            reg = <0x36>;
            reset-gpios = <&gpio2 5 GPIO_ACTIVE_LOW>;

            ti,oled-mode;
            ti,brightness-rate-of-change-us = <52000>;

            #address-cells = <1>;
            #size-cells = <0>;

            led@0 {
                reg = <0>;
                led-sources = <0 1>;
                label = "lcd-backlight";
                default-brightness = <12>;
                max-brightness = <31>;
            };
        };
    };
  - |
    i2c {
        #address-cells = <1>;
        #size-cells = <0>;

        backlight@36 {
            compatible = "ti,lm3509";
            reg = <0x36>;

            #address-cells = <1>;
            #size-cells = <0>;

            led@0 {
                reg = <0>;
                default-brightness = <12>;
            };

            led@1 {
                reg = <1>;
                default-brightness = <15>;
            };
        };
    };
```

请注意，此翻译保留了原始 YAML 格式和结构，并将描述性文本翻译成了中文。
~~~~

## Documentation/devicetree/bindings/leds/backlight/tps65217-backlight_cn.txt
~~~~
TPS65217 系列稳压器

TPS65217 芯片包含一个升压转换器和电流阱，可用于驱动 LED 作为背光使用。
所需属性：
- compatible: "ti,tps65217"
- reg: I2C 从设备地址
- backlight: 用于指定 TPS65217 中 WLED1 和 WLED2 线的节点
- isel: 选择位，有效值：1 表示 ISEL1（低电平）和 2 表示 ISEL2（高电平）
- fdim: PWM 调光频率，有效值：100、200、500、1000
- default-brightness: 有效值：0-100

每个稳压器都使用标准的稳压器绑定定义。
示例：

```plaintext
tps: tps@24 {
    reg = <0x24>;
    compatible = "ti,tps65217";
    backlight {
        isel = <1>;  /* 1 - ISET1, 2 - ISET2 */
        fdim = <100>; /* TPS65217_BL_FDIM_100HZ */
        default-brightness = <50>;
    };
};
```

这段代码描述了如何在设备树中配置一个 TPS65217 芯片，以便能够正确地控制其背光功能。
~~~~

## Documentation/devicetree/bindings/leds/backlight/zii,rave-sp-backlight_cn.txt
~~~~
Zodiac Inflight Innovations RAVE 监控处理器 (SP) 背光绑定

RAVE SP 背光设备是一个“MFD cell”类型的设备，对应于 RAVE 监控处理器的背光功能。预期其设备树节点将作为父级 RAVE SP 设备节点（如在 `Documentation/devicetree/bindings/mfd/zii,rave-sp.txt` 中所记录）的子节点指定。

必需属性：

- compatible：应为 "zii,rave-sp-backlight"

示例：

``` 
rave-sp { 
	compatible = "zii,rave-sp-rdu1"; 
	current-speed = <38400>; 

	backlight { 
		compatible = "zii,rave-sp-backlight"; 
	}; 
}
```

这段示例代码表示了一个名为 `rave-sp` 的设备节点，它包含了一个子节点 `backlight`。父节点具有兼容性 `"zii,rave-sp-rdu1"` 并指定了当前速度为 38400。子节点 `backlight` 具有兼容性 `"zii,rave-sp-backlight"`，表示这是 RAVE 监控处理器的背光控制部分。
~~~~

## Documentation/devicetree/bindings/leds/common_cn.yaml
~~~~yaml
# SPDX-许可证标识符: GPL-2.0-only
%YAML 1.2
---
$id: http://devicetree.org/schemas/leds/common.yaml#
$schema: http://devicetree.org/meta-schemas/core.yaml#

标题: 公共LED属性

维护者:
  - Jacek Anaszewski <jacek.anaszewski@gmail.com>
  - Pavel Machek <pavel@ucw.cz>

描述:
  LED和闪光LED设备提供了与电流调节器相同的基功能，但增加了LED和闪光LED特有的功能，如闪烁模式、闪光超时、闪光故障和外部闪光触发模式。许多LED设备暴露了多个电流输出，这些输出可以连接到一个或多个独立的LED组件上。由于连接方式会影响LED设备的初始化过程，因此LED组件必须与LED设备绑定紧密相关。它们由父级LED设备绑定的子节点表示。
属性:
  led-sources:
    描述:
      LED所连接的设备电流输出列表。这些输出通过在LED设备绑定文档中定义的数字进行标识
$ref: /schemas/types.yaml#/definitions/uint32-array

  function:
    描述:
      LED的功能。请使用头文件include/dt-bindings/leds/common.h中定义的以LED_FUNCTION_*为前缀的定义之一。如果没有匹配的LED_FUNCTION可用，请添加一个新的定义
$ref: /schemas/types.yaml#/definitions/string

  color:
    描述:
      LED的颜色。请使用头文件include/dt-bindings/leds/common.h中定义的以LED_COLOR_ID_*为前缀的定义之一。如果没有匹配的LED_COLOR_ID可用，请添加一个新的定义
$ref: /schemas/types.yaml#/definitions/uint32
    最小值: 0
    最大值: 14

  function-enumerator:
    描述:
      当需要多个相同功能的实例，仅通过序号区分时使用的整数
$ref: /schemas/types.yaml#/definitions/uint32

  label:
    描述:
      此LED的标签。如果省略，则从节点名称（排除单元地址）获取标签。它必须唯一地标识一个设备，即没有其他LED类设备可以分配相同的标签。此属性已废弃 - 请改用'function'和'color'属性。当此属性存在时，function-enumerator无效
default-state:
    描述:
      LED的初始状态。如果LED已经处于打开或关闭状态，并且default-state属性设置为相同的值，则不应产生任何瞬变，即LED不会短暂地关闭（或打开）。"keep"设置将保持LED在其当前状态，而不会产生瞬变
这段 YAML 配置描述了与 LED 控制相关的设备树属性。以下是翻译成中文的版本：

```yaml
# 定义一个字符串类型
$ref: /schemas/types.yaml#/definitions/string
# 枚举值
enum:
  - on
  - off
  - keep
# 默认值
default: off

# Linux 中的默认触发器参数
linux,default-trigger:
  description:
    如果存在此参数，则是一个定义分配给 LED 的触发器的字符串。
$ref: /schemas/types.yaml#/definitions/string

# 可能的触发器枚举值
oneOf:
  - enum:
    # LED 将作为背光，由帧缓冲系统控制
    - backlight
    # LED 打开（参见 “default-state” 属性）
    - default-on
    # LED “双闪”，基于负载平均率
    - heartbeat
    # LED 指示磁盘活动
    - disk-activity
    # LED 指示磁盘读取活动
    - disk-read
    # LED 指示磁盘写入活动
    - disk-write
    # LED 以固定的、可配置的速度闪烁
    - timer
    # LED 根据一个软件定时器改变亮度持续指定时间（需要 “led-pattern” 属性）
    - pattern
    # LED 指示麦克风静音状态
    - audio-micmute
    # LED 指示音频静音状态
    - audio-mute
    # LED 指示蓝牙电源状态
    - bluetooth-power
    # LED 指示摄像头闪光状态
    - flash
    # LED 表示键盘大写锁定状态
    - kbd-capslock
    # LED 指示 MTD 内存活动
    - mtd
    # LED 指示 NAND 内存活动（已废弃），在新实现中使用 "mtd"
    - nand-disk
    # LED 没有分配触发器。这是默认模式，如果未设置触发器
    - none
    # LED 指示摄像头手电筒状态
    - torch
    # LED 指示 USB 设备活动
    - usb-gadget
    # LED 指示 USB 主机活动
    - usb-host
    # LED 指示 USB 端口状态
    - usbport
  # LED 由 CPU 活动触发
  - pattern: "^cpu[0-9]*$"
  # LED 由蓝牙活动触发
  - pattern: "^hci[0-9]+-power$"
  # LED 由 SD/MMC 活动触发
  - pattern: "^mmc[0-9]+$"
  # LED 由 WLAN 活动触发
  - pattern: "^phy[0-9]+tx$"

# LED 模式
led-pattern:
  description: |
    某些触发器的默认模式所对应的整数数组
    每个触发器可能以不同的方式解析此属性：
      - one-shot: 两个数字分别表示打开延迟和关闭延迟（单位：毫秒），
      - timer: 两个数字分别表示打开延迟和关闭延迟（单位：毫秒），
      - pattern: 模式由一系列元组给出，其中包含亮度和持续时间（单位：毫秒）。确切格式描述在：
      Documentation/devicetree/bindings/leds/leds-trigger-pattern.txt
$ref: /schemas/types.yaml#/definitions/uint32-matrix
items:
  minItems: 2
  maxItems: 2

# LED 最大微安电流
led-max-microamp:
  description:
    LED 供电的最大电流（单位：微安）。此属性对于可能会因电流过大而损坏硬件风险的板卡配置是必需的。
    对于具有可配置电流的闪光 LED 控制器，在非闪光模式（如手电筒或指示灯）下，此属性对于 LED 是必须的。
$ref: /schemas/types.yaml#/definitions/uint32

# 最大亮度
max-brightness:
  description:
    通常，最大亮度由硬件决定，不需要此属性。此属性用于设置软件限制。
    LED 可能会因为过于明亮而受损或者因为特定系统中的限制（如安装条件）而导致损害。
    注意此标志主要用于 PWM-LED，因为无法将亮度映射到电流。其他控制器的驱动程序应该使用 led-max-microamp。
$ref: /schemas/types.yaml#/definitions/uint32

# 恐慌指示器
panic-indicator:
  description:
    此属性指明 LED 在可能的情况下应被用作恐慌指示器。
type: boolean

# 关机时保留状态
retain-state-shutdown:
  description:
    此属性指明 LED 在系统关机时不应被关闭或更改。
type: boolean

# 触发源列表
trigger-sources:
  description: |
    应该用作触发此 LED 活动的源设备列表。某些 LED 可以与特定设备相关联，并且应该以某种方式指示其状态。例如，USB 2.0 LED 可能会对 USB 2.0 端口中的设备作出反应。
```

以上内容定义了设备树中与 LED 控制相关的属性及其描述。这些属性可用于配置 LED 的行为、亮度、触发器等。
Another common example is a switch or router with multiple Ethernet ports, each of them having its own LED assigned (assuming they are not hardwired). In such cases, this property should contain the phandle(s) of the related source device(s).

Another example is a GPIO line that will be monitored and mirror the state of the line (with or without inversion flags) to the LED.

In many cases, an LED can be related to more than one device (e.g., one USB LED versus multiple USB ports). Each source should be represented by a node in the device tree and be referenced by a phandle and a set of phandle arguments. The length of the arguments should be specified by the `#trigger-source-cells` property in the source node.
$ref: /schemas/types.yaml#/definitions/phandle-array

  * `active-low`:  
    Type: boolean  
    Description:  
      Makes the LED active low. To turn the LED ON, the line needs to be set to low voltage instead of high.
  * `inactive-high-impedance`:  
    Type: boolean  
    Description:  
      Sets the LED to high-impedance mode to turn the LED OFF. The LED might also describe this mode as tristate.

**Required properties for flash LED child nodes:**
  * `flash-max-microamp`:  
    Description:  
      Maximum flash LED supply current in microamperes. Required for flash LED nodes with configurable current.
  * `flash-max-timeout-us`:  
    Description:  
      Maximum timeout in microseconds after which the flash LED is turned off. Required for flash LED nodes with configurable timeout.

Additional properties are allowed.

**Examples:**

  1. 
    ```yaml
    #include <dt-bindings/gpio/gpio.h>
    #include <dt-bindings/leds/common.h>

    led-controller {
        compatible = "gpio-leds";

        led-0 {
            function = LED_FUNCTION_STATUS;
            linux,default-trigger = "heartbeat";
            gpios = <&gpio0 0 GPIO_ACTIVE_HIGH>;
        };

        led-1 {
            function = LED_FUNCTION_USB;
            gpios = <&gpio0 1 GPIO_ACTIVE_HIGH>;
            trigger-sources = <&ohci_port1>, <&ehci_port1>;
        };
    };
    ```

  2. 
    ```yaml
    #include <dt-bindings/leds/common.h>

    led-controller {
        compatible = "maxim,max77693-led";

        led {
            function = LED_FUNCTION_FLASH;
            color = <LED_COLOR_ID_WHITE>;
            led-sources = <0>, <1>;
            led-max-microamp = <50000>;
            flash-max-microamp = <320000>;
            flash-max-timeout-us = <500000>;
        };
    };
    ```

  3. 
    ```yaml
    #include <dt-bindings/leds/common.h>

    i2c {
        #address-cells = <1>;
        #size-cells = <0>;

        led-controller@30 {
            compatible = "panasonic,an30259a";
            reg = <0x30>;
            #address-cells = <1>;
            #size-cells = <0>;

            led@1 {
                reg = <1>;
                linux,default-trigger = "heartbeat";
                function = LED_FUNCTION_INDICATOR;
                function-enumerator = <1>;
            };

            led@2 {
                reg = <2>;
                function = LED_FUNCTION_INDICATOR;
                function-enumerator = <2>;
            };

            led@3 {
                reg = <3>;
                function = LED_FUNCTION_INDICATOR;
                function-enumerator = <3>;
            };
        };
    };
    ```
  
..
~~~~

## Documentation/devicetree/bindings/leds/cznic,turris-omnia-leds_cn.yaml
```yaml
# SPDX-许可证标识符: GPL-2.0-only 或 BSD-2-Clause
%YAML 1.2
---
$id: http://devicetree.org/schemas/leds/cznic,turris-omnia-leds.yaml#
$schema: http://devicetree.org/meta-schemas/core.yaml#

标题: CZ.NIC 的 Turris Omnia LED 驱动程序

维护者:
  - Marek Behún <kabel@kernel.org>

描述:
  本模块为 Turris Omnia 路由器前面板上找到的 RGB LED 提供支持。该路由器上有 12 个 RGB LED，这些 LED 通过一个与 I2C 总线通信的微控制器进行控制。每个 LED 都被描述为此 I2C 设备的一个子节点。
属性:
  compatible:
    常量: cznic,turris-omnia-leds

  reg:
    描述: 微控制器的 I2C 从地址
最大项数: 1

  "#address-cells":
    常量: 1

  "#size-cells":
    常量: 0

模式属性:
  "^multi-led@[0-9a-b]$":
    类型: 对象
    $ref: leds-class-multicolor.yaml#
    未评估属性: false

    描述:
      此节点表示 Turris Omnia 上的一个 RGB LED 设备
由于此控制器仅支持 RGB LED，因此无需为子通道添加子节点
属性:
      reg:
        最小值: 0
        最大值: 11
        描述:
          此属性标识 Turris Omnia 路由器前面板上的一个 LED
必需:
      - reg

附加属性: false

示例:
  - |

    #include <dt-bindings/leds/common.h>

    i2c {
        #address-cells = <1>;
        #size-cells = <0>;

        led-controller@2b {
            compatible = "cznic,turris-omnia-leds";
            reg = <0x2b>;
            #address-cells = <1>;
            #size-cells = <0>;

            multi-led@0 {
                /*
                 * 无需添加子节点，此控制器仅支持 RGB LED
*/
                reg = <0>;
                color = <LED_COLOR_ID_MULTI>;
                function = LED_FUNCTION_POWER;
                linux,default-trigger = "heartbeat";
            };

            multi-led@a {
                reg = <0xa>;
                color = <LED_COLOR_ID_MULTI>;
                function = LED_FUNCTION_INDICATOR;
                function-enumerator = <1>;
            };
        };
    };

..
```

## Documentation/devicetree/bindings/leds/irled/gpio-ir-tx_cn.yaml
~~~~yaml
```yaml
# SPDX-文件许可标识符: GPL-2.0-only 或 BSD-2-Clause
%YAML 1.2
---
$id: http://devicetree.org/schemas/leds/irled/gpio-ir-tx.yaml#
$schema: http://devicetree.org/meta-schemas/core.yaml#

title: 通过 GPIO 引脚连接的红外线 LED

maintainers:
  - Sean Young <sean@mess.org>

description:
  通过 GPIO 引脚连接的红外线 LED，用于作为遥控器发射器

properties:
  compatible:
    const: gpio-ir-tx

  gpios:
    maxItems: 1

required:
  - compatible
  - gpios

additionalProperties: false

examples:
  - |
    #include <dt-bindings/gpio/gpio.h>

    irled {
        compatible = "gpio-ir-tx";
        gpios = <&gpio1 2 GPIO_ACTIVE_HIGH>;
    };
```

此段代码定义了一个设备树 (Device Tree) 的 YAML 格式配置文件，用于描述通过 GPIO 引脚连接的红外线 LED。它被用作遥控器发射器，并且指定了必须的兼容性和 GPIO 配置。
~~~~

## Documentation/devicetree/bindings/leds/irled/ir-spi-led_cn.yaml
~~~~yaml
```yaml
# SPDX-许可证标识符: GPL-2.0-only 或 BSD-2-Clause
%YAML 1.2
---
$id: http://devicetree.org/schemas/leds/irled/ir-spi-led.yaml#
$schema: http://devicetree.org/meta-schemas/core.yaml#

title: 通过 SPI 总线连接的红外 LED

maintainers:
  - Sean Young <sean@mess.org>

description:
  红外 LED 开关连接到 SPI 设备的 MOSI 线上，数据通过该线传输
allOf:
  - $ref: /schemas/spi/spi-peripheral-props.yaml#

properties:
  compatible:
    const: ir-spi-led

  reg:
    maxItems: 1

  duty-cycle:
    $ref: /schemas/types.yaml#/definitions/uint8
    enum: [50, 60, 70, 75, 80, 90]
    description:
      在一个周期内信号处于活动状态的百分比
  led-active-low:
    type: boolean
    description:
      输出通过非门被取反
  power-supply: true

required:
  - compatible
  - reg

unevaluatedProperties: false

examples:
  - |
    spi {
        #address-cells = <1>;
        #size-cells = <0>;

        irled@0 {
            compatible = "ir-spi-led";
            reg = <0x0>;

            duty-cycle = /bits/ 8 <60>;
            led-active-low;
            power-supply = <&irda_regulator>;
            spi-max-frequency = <5000000>;
        };
    };
```

这个 Device Tree 配置描述了一个通过 SPI (Serial Peripheral Interface) 总线控制的红外 LED。配置中包含了 LED 的兼容性声明、寄存器地址、占空比设置、是否为低电平有效以及电源供应等信息。
~~~~

## Documentation/devicetree/bindings/leds/irled/pwm-ir-tx_cn.yaml
```yaml
# SPDX-许可证标识符: GPL-2.0-only 或 BSD-2-Clause
%YAML 1.2
---
$id: http://devicetree.org/schemas/leds/irled/pwm-ir-tx.yaml#
$schema: http://devicetree.org/meta-schemas/core.yaml#

title: 通过PWM引脚连接的红外线LED

maintainers:
  - Sean Young <sean@mess.org>

description:
  通过PWM引脚连接的红外线LED，该引脚用作遥控器发射器

属性:
  compatible:
    oneOf:
      - 常量: pwm-ir-tx
      - 常量: nokia,n900-ir
        已废弃: true

  pwms:
    最大项数: 1

必需:
  - compatible
  - pwms

附加属性: false

示例:
  - |
    irled {
        compatible = "pwm-ir-tx";
        pwms = <&pwm0 0 10000000>;
    };
```
