## Documentation/devicetree/bindings/leds/leds-el15203000_cn.txt
~~~~
起重机商品系统 - EL15203000 LED 驱动器
--------------------------------------------------

此 LED 板（也称为红色 LED 板）广泛应用于由起重机商品系统生产的咖啡自动售货机。该板管理 3 个 LED，并支持为特定 LED 预定义的闪烁模式。
售卖区域 LED 用符号 'V'（十六进制码 0x56）编码，没有硬件级别的闪烁模式。
屏幕灯管 LED 包围自动售货机屏幕，并用符号 'S'（十六进制码 0x53）编码。支持呼吸式的闪烁模式。
水管 LED 用符号 'P'（十六进制码 0x50）编码，实际上由 5 个 LED 组成，在协议中像一个 LED 一样暴露。支持以下模式：
- 瀑布模式
- 反向瀑布模式
- 弹跳模式
- 反向弹跳模式

必需属性：
- compatible: "crane,el15203000"
- #address-cells: 必须为 1
- #size-cells: 必须为 0

属性规则在文档 `Documentation/devicetree/bindings/spi/spi-bus.txt` 中描述。特别是，“reg”和“spi-max-frequency”属性必须给出。
可选的 LED 子节点属性：
- function:
    查看文档 `Documentation/devicetree/bindings/leds/common.txt`
- color:
    查看文档 `Documentation/devicetree/bindings/leds/common.txt`

示例
-------

```text
#include <dt-bindings/leds/common.h>

led-controller@0 {
	compatible = "crane,el15203000";
	reg = <0>;
	spi-max-frequency = <50000>;
	#address-cells = <1>;
	#size-cells = <0>;

	/* 水管 */
	led@50 {
		reg = <0x50>;
		function = "pipe";
		color = <LED_COLOR_ID_RED>;
	};

	/* 屏幕边框 */
	led@53 {
		reg = <0x53>;
		function = "screen";
		color = <LED_COLOR_ID_RED>;
	};

	/* 售卖区域 */
	led@56 {
		reg = <0x56>;
		function = "vend";
		color = <LED_COLOR_ID_RED>;
	};
};
```
~~~~

## Documentation/devicetree/bindings/leds/leds-gpio_cn.yaml
```yaml
# SPDX-许可证标识符: GPL-2.0-only
%YAML 1.2
---
$id: http://devicetree.org/schemas/leds/leds-gpio.yaml#
$schema: http://devicetree.org/meta-schemas/core.yaml#

标题: 连接到GPIO线的LED

维护者:
  - Jacek Anaszewski <jacek.anaszewski@gmail.com>
  - Pavel Machek <pavel@ucw.cz>

描述:
  每个LED都作为gpio-leds设备的一个子节点表示。每个节点的名字代表了相应的LED的名字。
属性:
  compatible:
    常量: gpio-leds

模式属性:
  # 首选的形式是以下这种，但也可以退回到在节点名称中的任何位置仅使用'led'，以至少捕获一些子节点
"^(led-[0-9a-f]$|led)":
    类型: 对象
    $ref: common.yaml#
    不评估的属性: false

    属性:
      gpios:
        最大项数: 1

      retain-state-suspended:
        描述:
          暂停状态可以被保留。例如充电LED的GPIO
类型: 布尔值

      retain-state-shutdown:
        描述:
          在关机时保留LED的状态。对于BMC系统很有用，例如当主机仍然运行而BMC重启时
类型: 布尔值

    必需:
      - gpios

额外属性: false

示例:
  - |

    #include <dt-bindings/gpio/gpio.h>
    #include <dt-bindings/leds/common.h>

    leds {
        compatible = "gpio-leds";
        led-0 {
            gpios = <&mcu_pio 0 GPIO_ACTIVE_LOW>;
            linux,default-trigger = "disk-activity";
            function = LED_FUNCTION_DISK;
        };

        led-1 {
            gpios = <&mcu_pio 1 GPIO_ACTIVE_HIGH>;
            /* 如果BIOS检测到硬件故障，则保持LED亮起 */
            default-state = "keep";
            function = LED_FUNCTION_FAULT;
        };
    };

    run-control {
        compatible = "gpio-leds";
        led-0 {
            gpios = <&mpc8572 6 GPIO_ACTIVE_HIGH>;
            color = <LED_COLOR_ID_RED>;
            default-state = "off";
        };
        led-1 {
            gpios = <&mpc8572 7 GPIO_ACTIVE_HIGH>;
            color = <LED_COLOR_ID_GREEN>;
            default-state = "on";
        };
    };
```

## Documentation/devicetree/bindings/leds/leds-group-multicolor_cn.yaml
```yaml
下面是给定内容的中文翻译：

# SPDX-许可证标识符: (GPL-2.0-only 或 BSD-2-Clause)
%YAML 1.2
---
$id: http://devicetree.org/schemas/leds/leds-group-multicolor.yaml#
$schema: http://devicetree.org/meta-schemas/core.yaml#

标题: 由单色LED构成的多色LED

维护者:
  - Jean-Jacques Hiblot <jjhiblot@traphandler.com>

描述: |
  该驱动程序使用多色LED类将多个单色LED组合为一个多色LED。

属性:
  compatible:
    常量: leds-group-multicolor

  leds:
    描述:
      一个单色LED的数组
    $ref: /schemas/types.yaml#/definitions/phandle-array

必需:
  - leds

allOf:
  - $ref: leds-class-multicolor.yaml#

未评估的属性: false

示例:
  - |
    #include <dt-bindings/gpio/gpio.h>
    #include <dt-bindings/leds/common.h>

    单色-leds {
        compatible = "gpio-leds";

        led0: led-0 {
            gpios = <&mcu_pio 0 GPIO_ACTIVE_LOW>;
            color = <LED_COLOR_ID_RED>;
        };

        led1: led-1 {
            gpios = <&mcu_pio 1 GPIO_ACTIVE_HIGH>;
            color = <LED_COLOR_ID_GREEN>;
        };

        led2: led-2 {
            gpios = <&mcu_pio 2 GPIO_ACTIVE_HIGH>;
            color = <LED_COLOR_ID_BLUE>;
        };
    };

    多色-led {
        compatible = "leds-group-multicolor";
        color = <LED_COLOR_ID_RGB>;
        function = LED_FUNCTION_INDICATOR;
        leds = <&led0>, <&led1>, <&led2>;
    };
```

## Documentation/devicetree/bindings/leds/leds-is31fl32xx_cn.txt
~~~~
### ISSI IS31FL32xx 和 Si-En SN32xx LED 驱动器的设备树绑定

IS31FL32xx/SN32xx 系列 LED 驱动器是带有多个恒流通道的 I²C 设备，每个通道具有独立的 256 级 PWM 控制。每个 LED 在设备中表示为一个子节点。

#### 必需属性：
- `compatible`：必须是以下之一：
    - `issi,is31fl3236`
    - `issi,is31fl3235`
    - `issi,is31fl3218`
    - `issi,is31fl3216`
    - `si-en,sn3218`
    - `si-en,sn3216`
- `reg`：I²C 从设备地址
- `address-cells`：必须为 1
- `size-cells`：必须为 0

#### LED 子节点属性：
- `reg`：LED 通道编号（1 至 N）
- `label`：（可选）
  参见文档 `/Documentation/devicetree/bindings/leds/common.txt`
- `linux,default-trigger`：（可选）
  参见文档 `/Documentation/devicetree/bindings/leds/common.txt`

#### 示例：

```devicetree
is31fl3236: led-controller@3c {
    compatible = "issi,is31fl3236";
    reg = <0x3c>;
    #address-cells = <1>;
    #size-cells = <0>;

    led@1 {
        reg = <1>;
        label = "EB:blue:usr0";
    };
    led@2 {
        reg = <2>;
        label = "EB:blue:usr1";
    };
    ..
    led@36 {
        reg = <36>;
        label = "EB:blue:usr35";
    };
};
```

#### 更多产品信息请参阅以下链接：
- [ISSI 官方网站](http://www.issi.com/US/product-analog-fxled-driver.shtml)
- [Si-En 官方网站](http://www.si-en.com/product.asp?parentid=890)
~~~~

## Documentation/devicetree/bindings/leds/leds-lgm_cn.yaml
~~~~yaml
下面是给定 YAML 文档的中文翻译：

```yaml
# SPDX-文件许可标识符: (GPL-2.0-only 或 BSD-2-Clause)
%YAML 1.2
---
$id: http://devicetree.org/schemas/leds/leds-lgm.yaml#
$schema: http://devicetree.org/meta-schemas/core.yaml#

标题: Intel Lightning Mountain (LGM) 系统级芯片 LED 串行移位输出（SSO）控制器驱动程序

维护者:
  - Zhu, Yi Xin <Yixin.zhu@intel.com>
  - Amireddy Mallikarjuna Reddy <mallikarjunax.reddy@intel.com>

属性:
  compatible:
    常量: intel,lgm-ssoled

  reg:
    最大项数: 1

  clocks:
    最大项数: 2

  clock-names:
    项:
      - 常量: sso
      - 常量: fpid

  gpio-controller: true

  '#gpio-cells':
    常量: 2

  ngpios:
    最小值: 0
    最大值: 32
    描述:
      该控制器提供的 GPIO 数量
intel,sso-update-rate-hz:
    描述:
      SOUT 的闪烁频率，单位为赫兹 (Hz)
led-controller:
    类型: 对象
    描述:
      此子节点必须包含每个 LED 的一个子节点
additionalProperties: false

    属性:
      '#address-cells':
        常量: 1

      '#size-cells':
        常量: 0

    符合模式的属性:
      "^led@[0-2]$":
        $ref: common.yaml#
        unevaluatedProperties: false

        属性:
          reg:
            描述: LED 的索引
最小值: 0
            最大值: 2

          led-gpios:
            最大项数: 1

          intel,sso-hw-trigger:
            类型: 布尔
            描述: 此属性表示由硬件驱动或控制 LED
intel,sso-hw-blink:
            类型: 布尔
            描述: 此属性表示启用由硬件控制 LED 的闪烁
intel,sso-blink-rate-hz:
            描述: LED 硬件闪烁频率
retain-state-suspended:
            类型: 布尔
            描述: LED 的挂起状态可以保留
retain-state-shutdown:
            类型: 布尔
            描述: 关机时保留 LED 的状态
必需:
  - compatible
  - reg
  - clocks
  - clock-names
  - "#gpio-cells"
  - gpio-controller

additionalProperties: false

示例:
  - |
    #include <dt-bindings/clock/intel,lgm-clk.h>
    #include <dt-bindings/leds/common.h>

    ssogpio: ssogpio@e0d40000 {
      compatible = "intel,lgm-ssoled";
      reg = <0xE0D40000 0x2E4>;
      gpio-controller;
      #gpio-cells = <2>;
      ngpios = <32>;
      pinctrl-names = "default";
      pinctrl-0 = <&pinctrl_ledc>;
      clocks = <&cgu0 LGM_GCLK_LEDC0>, <&afeclk>;
      clock-names = "sso", "fpid";
      intel,sso-update-rate-hz = <250000>;

      led-controller {
        #address-cells = <1>;
        #size-cells = <0>;

        led@0 {
          reg = <0>;
          function = "gphy";
          color = <LED_COLOR_ID_GREEN>;
          led-gpios = <&ssogpio 0 0>;
        };

        led@2 {
          reg = <2>;
          function = LED_FUNCTION_POWER;
          color = <LED_COLOR_ID_GREEN>;
          led-gpios = <&ssogpio 23 0>;
        };
      };
    };
```

请注意，上述翻译尽可能保持了原 YAML 文件的结构和格式。
~~~~

## Documentation/devicetree/bindings/leds/leds-lm3532_cn.txt
~~~~
* 德州仪器 (Texas Instruments) - LM3532 白色 LED 驱动器，具备环境光感应功能
LM3532 提供了三个高压、低压侧电流阱。该器件可通过一个与 I2C 兼容的接口进行编程，并且每个通道都有独立的电流控制。自适应电流调节方法允许每个电流阱有不同的 LED 电流，从而适用于各种背光和键盘应用。
LM3532 的主要特性包括双环境光传感器输入（每个都有 32 个内部电压设置电阻）、8 位对数和线性亮度控制、双外部 PWM 亮度控制输入以及高达 1000:1 的调光比，同时还支持可编程渐显和渐隐设置。

**必需属性：**
- `compatible` ： `"ti,lm3532"`
- `reg` ：I2C 从设备地址
- `#address-cells` ：1
- `#size-cells` ：0

**可选属性：**
- `enable-gpios` ：用于启用（高电平有效）/禁用设备的 GPIO 引脚
- `ramp-up-us` - 设备从开启到达初始目标设定点后，从一个电流设定值到另一个电流设定值的运行时间斜坡率/步骤
- `ramp-down-us` - 设备从开启到达初始目标设定点后，从一个电流设定值到另一个电流设定值的运行时间斜坡率/步骤
斜坡设置范围：8us - 65536us

**如果使用 ALS 模式，则有以下可选属性：**
- `ti,als-vmin` - 最小 ALS 电压（以伏特为单位）
- `ti,als-vmax` - 最大 ALS 电压（以伏特为单位），根据数据手册最大 ALS 电压为 2V，最小为 0V
- `ti,als1-imp-sel` - ALS1 阻抗电阻选择（以欧姆为单位）
- `ti,als2-imp-sel` - ALS2 阻抗电阻选择（以欧姆为单位）
阻抗选择范围：37000 欧姆 - 1190 欧姆；高于 37k 欧姆的值将被设置为“高阻抗”设置
- `ti,als-avrg-time-us` - 确定设备需要平均两个 ALS 输入的时间长度。仅在输入模式为 `LM3532_ALS_INPUT_AVRG` 时使用
范围：17920us - 2293760us
- `ti,als-input-mode` - 确定设备如何使用连接的 ALS 设备
0x00 - ALS1 和 ALS2 输入平均
0x01 - ALS1 输入
0x02 - ALS2 输入
0x03 - ALS1 和 ALS2 中的最大值

**必需的子节点属性：**
- `reg` ：指示 LED 串受哪个控制银行控制
- `led-sources` ：参见 `Documentation/devicetree/bindings/leds/common.txt`
- `ti,led-mode` ：定义 LED 串是手动控制还是由 ALS 控制
0x00 - LED 串通过全量程亮度控制寄存器经 I2C 控制
0x01 - LED 串由 ALS 控制

**可选的 LED 子节点属性：**
- `label` ：参见 `Documentation/devicetree/bindings/leds/common.txt`
- `linux,default-trigger` ：参见 `Documentation/devicetree/bindings/leds/common.txt`
- `led-max-microamp` ：定义每个控制银行的全量程电流值。范围是从 5000uA 到 29800uA，以 800uA 递增

**示例：**
```device-tree
led-controller@38 {
    compatible = "ti,lm3532";
    #address-cells = <1>;
    #size-cells = <0>;
    reg = <0x38>;

    enable-gpios = <&gpio6 12 GPIO_ACTIVE_HIGH>;
    ramp-up-us = <1024>;
    ramp-down-us = <65536>;

    ti,als-vmin = <0>;
    ti,als-vmax = <2000>;
    ti,als1-imp-sel = <4110>;
    ti,als2-imp-sel = <2180>;
    ti,als-avrg-time-us = <17920>;
    ti,als-input-mode = <0x00>;

    led@0 {
        reg = <0>;
        led-sources = <2>;
        ti,led-mode = <1>;
        led-max-microamp = <21800>;
        label = ":backlight";
        linux,default-trigger = "backlight";
    };

    led@1 {
        reg = <1>;
        led-sources = <1>;
        ti,led-mode = <0>;
        label = ":kbd_backlight";
    };
};
```

如需更多信息，请参阅以下链接：
https://www.ti.com/product/LM3532
~~~~
