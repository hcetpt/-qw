## Documentation/devicetree/bindings/leds/leds-bcm6328_cn.yaml
~~~~yaml
# SPDX-许可证标识符: GPL-2.0-only 或 BSD-2-Clause
%YAML 1.2
---
$id: http://devicetree.org/schemas/leds/leds-bcm6328.yaml#
$schema: http://devicetree.org/meta-schemas/core.yaml#

标题: 与 Broadcom BCM6328 控制器相连的 LED

维护者:
  - Álvaro Fernández Rojas <noltari@gmail.com>

描述: |
  此控制器存在于 BCM6318、BCM6328、BCM6362 和 BCM63268 中。
  在这些 SoC 中，可以将 LED 作为 GPIO 或通过硬件进行控制。
  然而，在某些设备上存在串行 LED（连接到 74x164 控制器的 LED），
  这些 LED 可以通过软件（将 74x164 导出为 spi-gpio。参见
  文档/devicetree/bindings/gpio/fairchild,74hc595.yaml）或使用此驱动程序通过硬件进行控制。
  其中一些串行 LED 是通过硬件控制的（例如，以太网 LED），将 74x164 导出为 spi-gpio 会阻止这些 LED 的硬件控制，
  因此唯一的选择是使用此驱动程序来保持它们正常工作。
  BCM6328 LED 控制器有一个 HWDIS 寄存器，用于控制一个 LED 是否由硬件信号而不是 MODE 寄存器值控制，
  其中 0 表示启用硬件控制，1 表示禁用硬件控制。这通常是硬件到 LED 信号的 1:1 映射，
  但通过活动/链接寄存器，您可以在一定程度上控制 LED 的重定向（如后文 brcm,link-signal-sources 中所述）。
  即使 LED 是通过硬件控制的，您仍然可以让它闪烁或点亮，除非硬件决定将其点亮，否则无法关闭。
  因此，由硬件控制的 LED 不注册为 LED 类别设备。
  每个 LED 作为一个子节点表示在 brcm,bcm6328-leds 设备属性中。

属性:
  compatible:
    常量: brcm,bcm6328-leds

  reg:
    最大项数: 1

  brcm,serial-leds:
    类型: 布尔值
    描述: 启用串行 LED

  brcm,serial-mux:
    类型: 布尔值
    描述: 启用串行 LED 多路复用

  brcm,serial-clk-low:
    类型: 布尔值
    描述: 使时钟信号处于低电平有效

  brcm,serial-dat-low:
    类型: 布尔值
    描述: 使数据信号处于低电平有效
下面是给定内容的中文翻译：

### `brcm,serial-shift-inv`:
- **类型**: 布尔值
- **描述**: 反转串行LED移位方向

### `#address-cells`:
- **常量**: 1

### `#size-cells`:
- **常量**: 0

### `patternProperties`:
- **`"@[a-f0-9]+$"`**:
  - **类型**: 对象
  - **$ref**: common.yaml
  - **属性**:
    - `reg`:
      - **项**:
        - **最大值**: 23
      - **描述**: LED引脚编号（仅0到23号LED有效）

### `brcm,hardware-controlled`:
- **类型**: 布尔值
- **描述**: 使这个LED由硬件控制

### `brcm,link-signal-sources`:
- **$ref**: `/schemas/types.yaml#/definitions/uint32-array`
- **最小项数**: 1
- **最大项数**: 4
- **描述**:
  - 硬件链路信号源数组。最多四个链路硬件信号可以复用到这些LED上。仅对0到7号LED有效，其中0到3号LED信号可复用到0到3号LED上，4到7号信号可复用到4到7号LED上。一个信号可以复用到多个LED，一个LED也可以有多个源信号。

### `brcm,activity-signal-sources`:
- **$ref**: `/schemas/types.yaml#/definitions/uint32-array`
- **最小项数**: 1
- **最大项数**: 4
- **描述**:
  - 硬件活动信号源数组。最多四个活动硬件信号可以复用到这些LED上。仅对0到7号LED有效，其中0到3号LED信号可复用到0到3号LED上，4到7号信号可复用到4到7号LED上。一个信号可以复用到多个LED，一个LED也可以有多个源信号。

### 示例:

#### BCM6328 的 4 个 EPHY LED:
```yaml
/* BCM6328 的 4 个 EPHY LED */
led-controller@10000800 {
    compatible = "brcm,bcm6328-leds";
    #address-cells = <1>;
    #size-cells = <0>;
    reg = <0x10000800 0x24>;

    alarm_red@2 {
        reg = <2>;
        active-low;
        label = "红:报警";
    };

    inet_green@3 {
        reg = <3>;
        active-low;
        label = "绿:网络";
    };

    power_green@4 {
        reg = <4>;
        active-low;
        label = "绿:电源";
        default-state = "开";
    };

    ephy0_spd@17 {
        reg = <17>;
        brcm,hardware-controlled;
    };

    ephy1_spd@18 {
        reg = <18>;
        brcm,hardware-controlled;
    };

    ephy2_spd@19 {
        reg = <19>;
        brcm,hardware-controlled;
    };

    ephy3_spd@20 {
        reg = <20>;
        brcm,hardware-controlled;
    };
};
```

#### BCM63268 的串行/GPHY0 LED:
```yaml
/* BCM63268 的串行/GPHY0 LED */
led-controller@10001900 {
    compatible = "brcm,bcm6328-leds";
    #address-cells = <1>;
    #size-cells = <0>;
    reg = <0x10001900 0x24>;
    brcm,serial-leds;
    brcm,serial-dat-low;
    brcm,serial-shift-inv;

    gphy0_spd0@0 {
        reg = <0>;
        brcm,hardware-controlled;
        brcm,link-signal-sources = <0>;
    };

    gphy0_spd1@1 {
        reg = <1>;
        brcm,hardware-controlled;
        brcm,link-signal-sources = <1>;
    };

    inet_red@2 {
        reg = <2>;
        active-low;
        label = "红:网络";
    };

    dsl_green@3 {
        reg = <3>;
        active-low;
        label = "绿:DSL";
    };

    usb_green@4 {
        reg = <4>;
        active-low;
        label = "绿:USB";
    };

    wps_green@7 {
        reg = <7>;
        active-low;
        label = "绿:WPS";
    };

    inet_green@8 {
        reg = <8>;
        active-low;
        label = "绿:网络";
    };

    ephy0_act@9 {
        reg = <9>;
        brcm,hardware-controlled;
    };

    ephy1_act@10 {
        reg = <10>;
        brcm,hardware-controlled;
    };

    ephy2_act@11 {
        reg = <11>;
        brcm,hardware-controlled;
    };

    gphy0_act@12 {
        reg = <12>;
        brcm,hardware-controlled;
    };

    ephy0_spd@13 {
        reg = <13>;
        brcm,hardware-controlled;
    };

    ephy1_spd@14 {
        reg = <14>;
        brcm,hardware-controlled;
    };

    ephy2_spd@15 {
        reg = <15>;
        brcm,hardware-controlled;
    };

    power_green@20 {
        reg = <20>;
        active-low;
        label = "绿:电源";
        default-state = "开";
    };
};
```

#### BCM6362 每个 EPHY 一个 LED:
```yaml
/* BCM6362 每个 EPHY 一个 LED */
led-controller@10001900 {
    compatible = "brcm,bcm6328-leds";
    #address-cells = <1>;
    #size-cells = <0>;
    reg = <0x10001900 0x24>;

    usb@0 {
        reg = <0>;
        brcm,hardware-controlled;
        brcm,link-signal-sources = <0>;
        brcm,activity-signal-sources = <0>;
        /* USB 链接/活动路由至 USB LED */
    };

    inet@1 {
        reg = <1>;
        brcm,hardware-controlled;
        brcm,activity-signal-sources = <1>;
        /* INET 活动路由至 INET LED */
    };

    ephy0@4 {
        reg = <4>;
        brcm,hardware-controlled;
        brcm,link-signal-sources = <4>;
        /* EPHY0 链接路由至 EPHY0 LED */
    };

    ephy1@5 {
        reg = <5>;
        brcm,hardware-controlled;
        brcm,link-signal-sources = <5>;
        /* EPHY1 链接路由至 EPHY1 LED */
    };

    ephy2@6 {
        reg = <6>;
        brcm,hardware-controlled;
        brcm,link-signal-sources = <6>;
        /* EPHY2 链接路由至 EPHY2 LED */
    };

    ephy3@7 {
        reg = <7>;
        brcm,hardware-controlled;
        brcm,link-signal-sources = <7>;
        /* EPHY3 链接路由至 EPHY3 LED */
    };

    power_green@20 {
        reg = <20>;
        active-low;
        label = "绿:电源";
        default-state = "开";
    };
};
```

#### BCM6362 所有 EPHY 共享一个 LED:
```yaml
/* BCM6362 所有 EPHY 共享一个 LED */
led-controller@10001900 {
    compatible = "brcm,bcm6328-leds";
    #address-cells = <1>;
    #size-cells = <0>;
    reg = <0x10001900 0x24>;

    usb@0 {
        reg = <0>;
        brcm,hardware-controlled;
        brcm,link-signal-sources = <0 1>;
        brcm,activity-signal-sources = <0 1>;
        /* USB/INET 链接/活动路由至 USB LED */
    };

    ephy@4 {
        reg = <4>;
        brcm,hardware-controlled;
        brcm,link-signal-sources = <4 5 6 7>;
        /* EPHY0/1/2/3 链接路由至 EPHY0 LED */
    };

    power_green@20 {
        reg = <20>;
        active-low;
        label = "绿:电源";
        default-state = "开";
    };
};
```

#### BCM6362 EPHY LED 交换:
```yaml
/* BCM6362 EPHY LED 交换 */
led-controller@10001900 {
    compatible = "brcm,bcm6328-leds";
    #address-cells = <1>;
    #size-cells = <0>;
    reg = <0x10001900 0x24>;

    usb@0 {
        reg = <0>;
        brcm,hardware-controlled;
        brcm,link-signal-sources = <0>;
        brcm,activity-signal-sources = <0 1>;
        /* USB 链接/活动和 INET 活动路由至 USB LED */
    };

    ephy0@4 {
        reg = <4>;
        brcm,hardware-controlled;
        brcm,link-signal-sources = <7>;
        /* EPHY3 链接路由至 EPHY0 LED */
    };

    ephy1@5 {
        reg = <5>;
        brcm,hardware-controlled;
        brcm,link-signal-sources = <6>;
        /* EPHY2 链接路由至 EPHY1 LED */
    };

    ephy2@6 {
        reg = <6>;
        brcm,hardware-controlled;
        brcm,link-signal-sources = <5>;
        /* EPHY1 链接路由至 EPHY2 LED */
    };

    ephy3@7 {
        reg = <7>;
        brcm,hardware-controlled;
        brcm,link-signal-sources = <4>;
        /* EPHY0 链接路由至 EPHY3 LED */
    };

    power_green@20 {
        reg = <20>;
        active-low;
        label = "绿:电源";
        default-state = "开";
    };
};
```
~~~~

## Documentation/devicetree/bindings/leds/leds-bcm6358_cn.txt
~~~~
连接到 Broadcom BCM6358 控制器的 LED

此控制器存在于 BCM6358 和 BCM6368 中。
在这些系统级芯片 (SoC) 中，有串行 LED（连接到 74x164 控制器的 LED），
这些 LED 可以通过软件进行控制（将 74x164 导出为 spi-gpio，
参见文档/devicetree/bindings/gpio/fairchild,74hc595.yaml），或者
使用本驱动程序通过硬件进行控制。
必需属性：
  - compatible：应为 "brcm,bcm6358-leds"
  - #address-cells ：必须是 1
  - #size-cells ：必须是 0
  - reg ：BCM6358 LED 控制器地址和大小
可选属性：
  - brcm,clk-div ：SCK 信号分频器。可能的值为 1、2、4 和 8
默认值：1
  - brcm,clk-dat-low ：布尔值，使时钟和数据信号处于低电平有效
默认值：false

每个 LED 都作为 brcm,bcm6358-leds 设备的一个子节点表示。
### LED 子节点所需属性：
- `reg`：LED引脚编号（仅0至31的LED有效）

### LED 子节点可选属性：
- `label`：参见 `Documentation/devicetree/bindings/leds/common.txt`
- `default-state`：参见 `Documentation/devicetree/bindings/leds/common.txt`
- `linux,default-trigger`：参见 `Documentation/devicetree/bindings/leds/common.txt`

### 示例：

#### 场景1：BCM6358
```devicetree
leds0: led-controller@fffe00d0 { // LED控制器地址为fffe00d0
    compatible = "brcm,bcm6358-leds"; // 兼容性声明
    #address-cells = <1>; // 地址单元数量
    #size-cells = <0>; // 大小单元数量
    reg = <0xfffe00d0 0x8>; // 注册器地址和大小

    alarm_white { // 报警白色LED
        reg = <0>; // 引脚编号为0
        active-low; // 激活状态为低电平
        label = "white:alarm"; // 标签
    };
    tv_white { // 电视白色LED
        reg = <2>; // 引脚编号为2
        active-low; // 激活状态为低电平
        label = "white:tv"; // 标签
    };
    tel_white { // 电话白色LED
        reg = <3>; // 引脚编号为3
        active-low; // 激活状态为低电平
        label = "white:tel"; // 标签
    };
    adsl_white { // ADSL白色LED
        reg = <4>; // 引脚编号为4
        active-low; // 激活状态为低电平
        label = "white:adsl"; // 标签
    };
};
```

#### 场景2：BCM6368
```devicetree
leds0: led-controller@100000d0 { // LED控制器地址为100000d0
    compatible = "brcm,bcm6358-leds"; // 兼容性声明
    #address-cells = <1>; // 地址单元数量
    #size-cells = <0>; // 大小单元数量
    reg = <0x100000d0 0x8>; // 注册器地址和大小
    brcm,pol-low; // 极性设置为低
    brcm,clk-div = <4>; // 时钟分频设置为4

    power_red { // 电源红色LED
        reg = <0>; // 引脚编号为0
        active-low; // 激活状态为低电平
        label = "red:power"; // 标签
    };
    power_green { // 电源绿色LED
        reg = <1>; // 引脚编号为1
        active-low; // 激活状态为低电平
        label = "green:power"; // 标签
        default-state = "on"; // 默认状态为开启
    };
    power_blue { // 电源蓝色LED
        reg = <2>; // 引脚编号为2
        label = "blue:power"; // 标签
    };
    broadband_red { // 宽带红色LED
        reg = <3>; // 引脚编号为3
        active-low; // 激活状态为低电平
        label = "red:broadband"; // 标签
    };
    broadband_green { // 宽带绿色LED
        reg = <4>; // 引脚编号为4
        label = "green:broadband"; // 标签
    };
    broadband_blue { // 宽带蓝色LED
        reg = <5>; // 引脚编号为5
        active-low; // 激活状态为低电平
        label = "blue:broadband"; // 标签
    };
    wireless_red { // 无线红色LED
        reg = <6>; // 引脚编号为6
        active-low; // 激活状态为低电平
        label = "red:wireless"; // 标签
    };
    wireless_green { // 无线绿色LED
        reg = <7>; // 引脚编号为7
        active-low; // 激活状态为低电平
        label = "green:wireless"; // 标签
    };
    wireless_blue { // 无线蓝色LED
        reg = <8>; // 引脚编号为8
        label = "blue:wireless"; // 标签
    };
    phone_red { // 电话红色LED
        reg = <9>; // 引脚编号为9
        active-low; // 激活状态为低电平
        label = "red:phone"; // 标签
    };
    phone_green { // 电话绿色LED
        reg = <10>; // 引脚编号为10
        active-low; // 激活状态为低电平
        label = "green:phone"; // 标签
    };
    phone_blue { // 电话蓝色LED
        reg = <11>; // 引脚编号为11
        label = "blue:phone"; // 标签
    };
    upgrading_red { // 升级红色LED
        reg = <12>; // 引脚编号为12
        active-low; // 激活状态为低电平
        label = "red:upgrading"; // 标签
    };
    upgrading_green { // 升级绿色LED
        reg = <13>; // 引脚编号为13
        active-low; // 激活状态为低电平
        label = "green:upgrading"; // 标签
    };
    upgrading_blue { // 升级蓝色LED
        reg = <14>; // 引脚编号为14
        label = "blue:upgrading"; // 标签
    };
};
```
~~~~

## Documentation/devicetree/bindings/leds/leds-class-multicolor_cn.yaml
```yaml
# SPDX-许可证标识符: (GPL-2.0-only 或 BSD-2-Clause)
%YAML 1.2
---
$id: http://devicetree.org/schemas/leds/leds-class-multicolor.yaml#
$schema: http://devicetree.org/meta-schemas/core.yaml#

title: 多色LED类的通用属性
maintainers:
  - Andrew Davis <afd@ti.com>

description: |
  多色LED的绑定展示了如何描述集成多色LED元件（如RGB、RGBW、RGBWA-UV等）或独立LED的当前输出，以实现逻辑分组的多色LED模块。这是通过在单色LED绑定上添加多LED节点层来实现的。
  本文件中定义的节点和属性是多色LED类独有的。通用的LED节点和属性从本文档目录中的common.yaml继承而来。
properties:
  $nodename:
    pattern: "^multi-led(@[0-9a-f])?$"

  color:
    description: |
      对于多色LED支持，此属性应定义为LED_COLOR_ID_RGB或LED_COLOR_ID_MULTI，这些可以在include/linux/leds/common.h找到。
enum: [ 8, 9 ]

required:
  - color

allOf:
  - $ref: common.yaml#

additionalProperties: true

..
```

## Documentation/devicetree/bindings/leds/leds-cpcap_cn.txt
~~~~
Motorola CPCAP PMIC LED 模块

此模块是 CPCAP 的一部分。关于整个芯片的更多详细信息，请参阅 `Documentation/devicetree/bindings/mfd/motorola-cpcap.txt`。
所需节点属性：
- compatible（兼容性）：应当为以下之一
   * "motorola,cpcap-led-mdl"		（主显示屏照明）
   * "motorola,cpcap-led-kl"		（键盘照明）
   * "motorola,cpcap-led-adl"		（辅助显示屏照明）
   * "motorola,cpcap-led-red"		（红色三极管）
   * "motorola,cpcap-led-green"		（绿色三极管）
   * "motorola,cpcap-led-blue"		（蓝色三极管）
   * "motorola,cpcap-led-cf"		（摄像头闪光灯）
   * "motorola,cpcap-led-bt"		（蓝牙指示灯）
   * "motorola,cpcap-led-cp"		（摄像头隐私指示灯）
- label（标签）：请参见 `Documentation/devicetree/bindings/leds/common.txt`
- vdd-supply（电源供应）：指向 LED 供电调节器的 phandle

示例：

```devicetree
&cpcap {
	cpcap_led_red: red-led {
		compatible = "motorola,cpcap-led-red";
		label = "cpcap:red";
		vdd-supply = <&sw5>;
	};
};
```

这段文档描述了如何在设备树中配置 Motorola CPCAP PMIC 中的 LED 控制器，并给出了一个具体的例子，展示了如何为红色 LED 进行配置。
~~~~

## Documentation/devicetree/bindings/leds/leds-cr0014114_cn.txt
~~~~
Crane Merchandising System - cr0014114 LED 驱动器

此 LED 板被广泛应用于 Crane Merchandising Systems 生产的自动售货机中。
必需属性：
- compatible: "crane,cr0014114"

属性规则在文档 `Documentation/devicetree/bindings/spi/spi-bus.txt` 中描述。特别是，“reg”和“spi-max-frequency”属性必须给出。
LED 子节点属性：
- function :
    参见 `Documentation/devicetree/bindings/leds/common.txt`
- color :
    参见 `Documentation/devicetree/bindings/leds/common.txt`
- label :
    参见 `Documentation/devicetree/bindings/leds/common.txt`（已废弃）
- linux,default-trigger : （可选）
    参见 `Documentation/devicetree/bindings/leds/common.txt`

示例
------

``` 
#include <dt-bindings/leds/common.h>

led-controller@0 {
	compatible = "crane,cr0014114";
	reg = <0>;
	spi-max-frequency = <50000>;
	#address-cells = <1>;
	#size-cells = <0>;

	led@0 {
		reg = <0>;
		function = "coin";
		color = <LED_COLOR_ID_RED>;
	};
	led@1 {
		reg = <1>;
		function = "coin";
		color = <LED_COLOR_ID_GREEN>;
	};
	led@2 {
		reg = <2>;
		function = "coin";
		color = <LED_COLOR_ID_BLUE>;
	};
	led@3 {
		reg = <3>;
		function = "bill";
		color = <LED_COLOR_ID_RED>;
	};
	led@4 {
		reg = <4>;
		function = "bill";
		color = <LED_COLOR_ID_GREEN>;
	};
	led@5 {
		reg = <5>;
		function = "bill";
		color = <LED_COLOR_ID_BLUE>;
	};
	...
};
```
~~~~
