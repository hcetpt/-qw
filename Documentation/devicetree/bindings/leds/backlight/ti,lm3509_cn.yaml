## Documentation/devicetree/bindings/leds/issi,is31fl319x_cn.yaml
```yaml
下面是给定内容的中文翻译：

# SPDX-文件许可标识符: (GPL-2.0-only 或 BSD-2-Clause)
%YAML 1.2
---
$id: http://devicetree.org/schemas/leds/issi,is31fl319x.yaml#
$schema: http://devicetree.org/meta-schemas/core.yaml#

标题: ISSI LED 控制器适用于 IS31FL319{0,1,3,6,9}

维护者:
  - 文森特·克内希特 <vincent.knecht@mailoo.org>

描述: |
  IS31FL319X 是带 I2C 接口的 LED 控制器。
  之前称为 Si-En SN319{0,1,3,6,9}。
  更多产品信息请参见以下链接：
    https://lumissil.com/assets/pdf/core/IS31FL3190_DS.pdf
    https://lumissil.com/assets/pdf/core/IS31FL3191_DS.pdf
    https://lumissil.com/assets/pdf/core/IS31FL3193_DS.pdf
    https://lumissil.com/assets/pdf/core/IS31FL3196_DS.pdf
    https://lumissil.com/assets/pdf/core/IS31FL3199_DS.pdf

属性:
  compatible:
    枚举:
      - issi,is31fl3190
      - issi,is31fl3191
      - issi,is31fl3193
      - issi,is31fl3196
      - issi,is31fl3199
      - si-en,sn3190
      - si-en,sn3191
      - si-en,sn3193
      - si-en,sn3196
      - si-en,sn3199

  reg:
    最大项数: 1

  shutdown-gpios:
    最大项数: 1
    描述: 与 SDB 引脚相连的 GPIO

  audio-gain-db:
    $ref: /schemas/types.yaml#/definitions/uint32
    默认值: 0
    描述: 外部模拟调制输入的音频增益选择
    枚举: [0, 3, 6, 9, 12, 15, 18, 21]

  "#address-cells":
    常量: 1

  "#size-cells":
    常量: 0

模式匹配属性:
  "^led@[1-9]$":
    类型: 对象
    $ref: common.yaml#
    不评估属性: false

    属性:
      reg:
        描述: LED 的索引
        最小值: 1
        最大值: 9

      led-max-microamp:
        描述: 
          注意，驱动程序将采用所有 LED 限制中的最低值，
          因为芯片只有一个全局设置。由于 PWM 特性，
          较低的亮度是通过减少脉冲的占空比来实现的，
          而不是电流，这将始终具有等于 led-max-microamp 的峰值值。

所有符合:
  - 如果:
      属性:
        compatible:
          包含:
            枚举:
              - issi,is31fl3190
              - issi,is31fl3191
              - issi,is31fl3193
              - si-en,sn3190
              - si-en,sn3191
              - si-en,sn3193
    那么:
      属性:
        reg:
          枚举: [0x68, 0x69, 0x6a, 0x6b]

        audio-gain-db: false

      模式匹配属性:
        "^led@[1-9]$":
          属性:
            led-max-microamp:
              默认值: 42000
              枚举: [5000, 10000, 17500, 30000, 42000]
    否则:
      属性:
        reg:
          枚举: [0x64, 0x65, 0x66, 0x67]

      模式匹配属性:
        "^led@[1-9]$":
          属性:
            led-max-microamp:
              默认值: 20000
              枚举: [5000, 10000, 15000, 20000, 25000, 30000, 35000, 40000]
  - 如果:
      属性:
        compatible:
          包含:
            枚举:
              - issi,is31fl3190
              - issi,is31fl3191
              - si-en,sn3190
              - si-en,sn3191
    那么:
      模式匹配属性:
        "^led@[1-9]$":
          属性:
            reg:
              最大值: 1
  - 如果:
      属性:
        compatible:
          包含:
            枚举:
              - issi,is31fl3193
              - si-en,sn3193
    那么:
      模式匹配属性:
        "^led@[1-9]$":
          属性:
            reg:
              最大值: 3
  - 如果:
      属性:
        compatible:
          包含:
            枚举:
              - issi,is31fl3196
              - si-en,sn3196
    那么:
      模式匹配属性:
        "^led@[1-9]$":
          属性:
            reg:
              最大值: 6

必需:
  - compatible
  - reg
  - "#address-cells"
  - "#size-cells"

额外属性: false

示例:
  - |
    #include <dt-bindings/gpio/gpio.h>
    #include <dt-bindings/leds/common.h>

    i2c {
        #address-cells = <1>;
        #size-cells = <0>;

        led-controller@65 {
            compatible = "issi,is31fl3196";
            reg = <0x65>;
            #address-cells = <1>;
            #size-cells = <0>;

            shutdown-gpios = <&gpio0 11 GPIO_ACTIVE_HIGH>;

            led@1 {
                reg = <1>;
                label = "red:aux";
                led-max-microamp = <10000>;
            };

            led@5 {
                reg = <5>;
                label = "green:power";
                linux,default-trigger = "default-on";
            };
        };
    };
..
```

## Documentation/devicetree/bindings/leds/kinetic,ktd202x_cn.yaml
```yaml
下面是给定内容的中文翻译：

# SPDX-许可证标识符: (GPL-2.0-only 或 BSD-2-Clause)
%YAML 1.2
---
$id: http://devicetree.org/schemas/leds/kinetic,ktd202x.yaml#
$schema: http://devicetree.org/meta-schemas/core.yaml#

标题: Kinetic KTD2026/7 RGB/白光 LED 驱动器

维护者:
  - André Apitzsch <git@apitzsch.eu>

描述: |
  KTD2026/7 是一款带有 I2C 接口的 RGB/白光 LED 驱动器。
  数据手册可在以下位置找到：
    https://www.kinet-ic.com/uploads/KTD2026-7-04h.pdf

属性:
  compatible:
    枚举:
      - kinetic,ktd2026
      - kinetic,ktd2027

  reg:
    最大项数: 1

  vin-supply:
    描述: 为 "VIN" 引脚供电的稳压器
  vio-supply:
    描述: 为 I/O 线路拉高提供电源的稳压器
注意，此稳压器并非直接连接至 KTD2026，但对状态 ("ST") 和 I2C 线路的正常工作至关重要
"#address-cells":
    常量: 1

  "#size-cells":
    常量: 0

  multi-led:
    类型: 对象
    $ref: leds-class-multicolor.yaml#
    不评估属性: false

    属性:
      "#address-cells":
        常量: 1

      "#size-cells":
        常量: 0

    符合正则表达式的属性:
      "^led@[0-3]$":
        类型: 对象
        $ref: common.yaml#
        不评估属性: false

        属性:
          reg:
            描述: LED 的索引
            最小值: 0
            最大值: 3

        必需:
          - reg
          - color

    必需:
      - "#address-cells"
      - "#size-cells"

符合正则表达式的属性:
  "^led@[0-3]$":
    类型: 对象
    $ref: common.yaml#
    不评估属性: false

    属性:
      reg:
        描述: LED 的索引
        最小值: 0
        最大值: 3

    必需:
      - reg

必需:
  - compatible
  - reg
  - "#address-cells"
  - "#size-cells"

额外属性: false

示例:
  - |
    #include <dt-bindings/leds/common.h>

    i2c {
        #address-cells = <1>;
        #size-cells = <0>;

        led-controller@30 {
            compatible = "kinetic,ktd2026";
            reg = <0x30>;
            #address-cells = <1>;
            #size-cells = <0>;

            vin-supply = <&pm8916_l17>;
            vio-supply = <&pm8916_l6>;

            led@0 {
                reg = <0>;
                function = LED_FUNCTION_STATUS;
                color = <LED_COLOR_ID_RED>;
            };

            led@1 {
                reg = <1>;
                function = LED_FUNCTION_STATUS;
                color = <LED_COLOR_ID_GREEN>;
            };

            led@2 {
                reg = <2>;
                function = LED_FUNCTION_STATUS;
                color = <LED_COLOR_ID_BLUE>;
            };
        };
    };
  - |
    #include <dt-bindings/leds/common.h>

    i2c {
        #address-cells = <1>;
        #size-cells = <0>;

        led-controller@30 {
            compatible = "kinetic,ktd2026";
            reg = <0x30>;
            #address-cells = <1>;
            #size-cells = <0>;

            vin-supply = <&pm8916_l17>;
            vio-supply = <&pm8916_l6>;

            multi-led {
                color = <LED_COLOR_ID_RGB>;
                function = LED_FUNCTION_STATUS;

                #address-cells = <1>;
                #size-cells = <0>;

                led@0 {
                    reg = <0>;
                    color = <LED_COLOR_ID_RED>;
                };

                led@1 {
                    reg = <1>;
                    color = <LED_COLOR_ID_GREEN>;
                };

                led@2 {
                    reg = <2>;
                    color = <LED_COLOR_ID_BLUE>;
                };
            };
        };
    };
```

## Documentation/devicetree/bindings/leds/kinetic,ktd2692_cn.yaml
~~~~yaml
# SPDX-许可证标识符: (GPL-2.0-only 或 BSD-2-Clause)
%YAML 1.2
---
$id: http://devicetree.org/schemas/leds/kinetic,ktd2692.yaml#
$schema: http://devicetree.org/meta-schemas/core.yaml#

标题: Kinetic Technologies 的 KTD2692 闪光 LED 驱动器

维护者:
  - Markuss Broks <markuss.broks@gmail.com>

描述: |
  KTD2692 是适用于高功率闪光 LED 的理想电源解决方案。
  它使用 ExpressWire 单线编程以实现最大的灵活性。
  通过 CTRL 引脚的 ExpressWire 接口可以控制 LED 的开关和 IC 的启用/禁用，
  电影（最大为闪光电流的 1/3）/ 闪光模式电流、闪光超时、LVP（低压保护）等。
  此外，当 AUX 引脚在 CTRL 引脚处于高电平时被拉高，
  LED 电流将逐渐增加到闪光模式的电流水平。

属性:
  compatible:
    常量: kinetic,ktd2692

  ctrl-gpios:
    maxItems: 1
    描述: 与 CTRL 引脚相连的 GPIO 的指定
  aux-gpios:
    maxItems: 1
    描述: 与 AUX 引脚相连的 GPIO 的指定
  vin-supply:
    描述: LED 供电（2.7V 到 5.5V）
  led:
    类型: 对象
    $ref: common.yaml#
    描述: LED 的属性
属性:
      function: 真
      color: 真
      flash-max-timeout-us:
        描述: 闪光 LED 最大超时时间
  led-max-microamp:
        最大值: 300000
        描述: 定时器保护的最小阈值在内部定义（最大 300mA）
这段文本包含了设备树 (Device Tree) 的描述，用于配置一个特定的 LED 闪存模块。以下是翻译后的中文版本：

```plaintext
flash-max-microamp:
        maximum: 300000
        description: 闪光 LED 最大电流
          公式 - I(μA) = 15000000 / Rset
additionalProperties: false

required:
  - compatible
  - ctrl-gpios
  - led

additionalProperties: false

examples:
  - |
    #include <dt-bindings/gpio/gpio.h>
    #include <dt-bindings/leds/common.h>

    ktd2692 {
      compatible = "kinetic,ktd2692";  // 兼容性属性
      ctrl-gpios = <&gpc0 1 0>;  // 控制 GPIO 属性
      aux-gpios = <&gpc0 2 0>;  // 辅助 GPIO 属性
      vin-supply = <&vbat>;  // 供电属性

      led {  // LED 节点
        function = LED_FUNCTION_FLASH;  // 功能属性：闪光
        color = <LED_COLOR_ID_WHITE>;  // 颜色属性：白色
        flash-max-timeout-us = <250000>;  // 闪光最大超时时间（微秒）
        flash-max-microamp = <150000>;  // 闪光最大电流（微安）
        led-max-microamp = <25000>;  // LED 最大电流（微安）
      };
    };

```

### 翻译说明

- `flash-max-microamp`: 闪光 LED 的最大电流。
- `maximum`: 该属性的最大值为 300000 微安。
- `description`: 描述了如何计算最大电流。
- `Formula - I(μA) = 15000000 / Rset`: 通过给定的电阻值 `Rset` 来计算最大电流。
- `additionalProperties: false`: 表明没有额外的属性可以添加到此节点。
- `required`: 列出了必须存在的属性。
- `examples`: 提供了一个示例，展示了如何在设备树中配置这个 LED 模块。

请注意，这里的 `compatible`, `ctrl-gpios`, `aux-gpios`, 和 `vin-supply` 是配置 LED 模块所需的必要属性。`led` 节点内定义了与 LED 相关的具体配置信息。
~~~~

## Documentation/devicetree/bindings/leds/leds-aw2013_cn.yaml
```yaml
下面是给定内容的中文翻译：

# SPDX-文件许可标识符: (GPL-2.0-only 或 BSD-2-Clause)
%YAML 1.2
---
$id: http://devicetree.org/schemas/leds/leds-aw2013.yaml#
$schema: http://devicetree.org/meta-schemas/core.yaml#

标题: AWINIC AW2013 三通道 LED 驱动器

维护者:
  - 尼基塔·特拉夫金 <nikitos.tr@gmail.com>

描述: |
  AW2013 是一款具有 I2C 接口的三通道 LED 驱动器。它能够通过 PWM 输出控制 LED 的亮度。
属性:
  compatible:
    常量: awinic,aw2013

  reg:
    最大项目数: 1

  interrupts:
    最大项目数: 1
    描述: 开漏、低电平有效的中断引脚 "INTN"
用于报告操作完成（上电，LED 呼吸效果）
vcc-supply:
    描述: 向 "VCC" 引脚供电的稳压器
vio-supply:
    描述: 为 I/O 线路的上拉提供电源的稳压器
"VIO1" 在数据手册典型应用电路示例中
需要注意的是，该稳压器并非直接连接至 AW2013，但对于中断和 I2C 线路的正常工作是必需的
"#address-cells":
    常量: 1

  "#size-cells":
    常量: 0

模式匹配属性:
  "^led@[0-2]$":
    类型: 对象
    $ref: common.yaml#
    不评估的属性: false

    属性:
      reg:
        描述: LED 的索引
最小值: 0
        最大值: 2

必需:
  - compatible
  - reg
  - "#address-cells"
  - "#size-cells"

附加属性: false

示例:
  - |
    #include <dt-bindings/gpio/gpio.h>
    #include <dt-bindings/interrupt-controller/irq.h>
    #include <dt-bindings/leds/common.h>

    i2c {
        #address-cells = <1>;
        #size-cells = <0>;

        led-controller@45 {
            compatible = "awinic,aw2013";
            reg = <0x45>;
            interrupts = <42 IRQ_TYPE_LEVEL_LOW>;
            #address-cells = <1>;
            #size-cells = <0>;

            vcc-supply = <&pm8916_l17>;

            led@0 {
                reg = <0>;
                led-max-microamp = <5000>;
                function = LED_FUNCTION_INDICATOR;
                color = <LED_COLOR_ID_RED>;
            };

            led@1 {
                reg = <1>;
                led-max-microamp = <5000>;
                function = LED_FUNCTION_INDICATOR;
                color = <LED_COLOR_ID_GREEN>;
            };

            led@2 {
                reg = <2>;
                led-max-microamp = <5000>;
                function = LED_FUNCTION_INDICATOR;
                color = <LED_COLOR_ID_BLUE>;
            };
        };
    };
..
```

## Documentation/devicetree/bindings/leds/leds-bcm63138_cn.yaml
```yaml
# SPDX-许可证标识符: GPL-2.0-only 或 BSD-2-Clause
%YAML 1.2
---
$id: http://devicetree.org/schemas/leds/leds-bcm63138.yaml#
$schema: http://devicetree.org/meta-schemas/core.yaml#

title: Broadcom 的 BCM63138 LED 控制器

maintainers:
  - Rafał Miłecki <rafal@milecki.pl>

description: |
  这个 LED 控制器最初在 BCM63138 中使用，后来在 BCM4908、BCM6848、BCM6858、BCM63138、BCM63148、BCM63381 和 BCM68360 系统芯片中重用。
  它支持最多 32 个 LED，这些 LED 可以并联或串联连接。它还包括对硬件闪烁的有限支持。
  对于串联连接的 LED 的绑定尚未进行文档记录。

properties:
  compatible:
    oneOf:
      - items:
          - enum:
              - brcm,bcm4908-leds
              - brcm,bcm6848-leds
              - brcm,bcm6858-leds
              - brcm,bcm63148-leds
              - brcm,bcm63381-leds
              - brcm,bcm68360-leds
          - const: brcm,bcm63138-leds
      - const: brcm,bcm63138-leds

  reg:
    maxItems: 1

  "#address-cells":
    const: 1

  "#size-cells":
    const: 0

patternProperties:
  "^led@[a-f0-9]+$":
    type: object

    $ref: common.yaml#

    properties:
      reg:
        maxItems: 1
        description: LED 引脚编号

    required:
      - reg

    unevaluatedProperties: false

required:
  - reg
  - "#address-cells"
  - "#size-cells"

additionalProperties: false

examples:
  - |
    #include <dt-bindings/leds/common.h>

    leds@ff800800 {
        compatible = "brcm,bcm4908-leds", "brcm,bcm63138-leds";
        reg = <0xff800800 0xdc>;

        #address-cells = <1>;
        #size-cells = <0>;

        led@0 {
            reg = <0x0>;
            function = LED_FUNCTION_POWER;
            color = <LED_COLOR_ID_GREEN>;
            default-state = "on";
        };

        led@3 {
            reg = <0x3>;
            function = LED_FUNCTION_STATUS;
            color = <LED_COLOR_ID_GREEN>;
            active-low;
        };
    };
```
