## Documentation/devicetree/bindings/leds/leds-lp55xx_cn.yaml
```yaml
以下是给定内容的中文翻译：

# SPDX-许可证标识符: (GPL-2.0-only 或 BSD-2-Clause)
%YAML 1.2
---
$id: http://devicetree.org/schemas/leds/leds-lp55xx.yaml#
$schema: http://devicetree.org/meta-schemas/core.yaml#

标题: TI/National Semiconductor LP55xx 和 LP8501 LED 驱动器

维护者:
  - Jacek Anaszewski <jacek.anaszewski@gmail.com>
  - Pavel Machek <pavel@ucw.cz>

描述: |
  适用于 TI/National Semiconductor LP55xx 和 LP8501 多通道 LED 驱动器的绑定。
对于更多产品信息，请参见以下链接：
    https://www.ti.com/lit/gpn/lp5521
    https://www.ti.com/lit/gpn/lp5523
    https://www.ti.com/lit/gpn/lp55231
    https://www.ti.com/lit/gpn/lp5562
    https://www.ti.com/lit/gpn/lp8501

属性:
  compatible:
    枚举:
      - national,lp5521
      - national,lp5523
      - ti,lp55231
      - ti,lp5562
      - ti,lp5569
      - ti,lp8501

  reg:
    最大项数: 1
    描述: I2C 从设备地址

  clock-mode:
    $ref: /schemas/types.yaml#/definitions/uint8
    描述: |
      输入时钟模式
    枚举:
      - 0 # 自动模式
      - 1 # 内部
      - 2 # 外部

  enable-gpios:
    最大项数: 1
    描述: |
      连接到芯片使能引脚的 GPIO

  label: true

  pwr-sel:
    $ref: /schemas/types.yaml#/definitions/uint8
    描述: |
      LP8501 特有属性。输出通道的电源选择
    枚举:
      - 0 # D1~9 连接到 VDD
      - 1 # D1~6 连接到 VDD，D7~9 连接到 VOUT
      - 2 # D1~6 连接到 VOUT，D7~9 连接到 VDD
      - 3 # D1~9 连接到 VOUT

  '#address-cells':
    常量: 1

  '#size-cells':
    常量: 0

  ti,charge-pump-mode:
    描述:
      根据 <dt-bindings/leds/leds-lp55xx.h> 定义设置内部电荷泵的工作模式
    $ref: /schemas/types.yaml#/definitions/uint32
    默认值: 3 # 自动
    最大值: 3

patternProperties:
  '^multi-led@[0-8]$':
    类型: 对象
    $ref: leds-class-multicolor.yaml#
    不评估的属性: false

    属性:
      reg:
        最大值: 8

      '#address-cells':
        常量: 1

      '#size-cells':
        常量: 0

    patternProperties:
      "^led@[0-8]$":
        类型: 对象
        $ref: common.yaml#
        不评估的属性: false

        属性:
          led-cur:
            $ref: /schemas/types.yaml#/definitions/uint8
            描述: |
              每个 LED 通道的电流设置（mA x10，如果未连接 LED 则为 0）
            最小值: 0
            最大值: 255

          max-cur:
            $ref: /schemas/types.yaml#/definitions/uint8
            描述: 每个 LED 通道的最大电流
            最大值: 8

        必需:
          - reg

  "^led@[0-8]$":
    类型: 对象
    $ref: common.yaml#
    不评估的属性: false

    属性:
      led-cur:
        $ref: /schemas/types.yaml#/definitions/uint8
        描述: |
          每个 LED 通道的电流设置（mA x10，如果未连接 LED 则为 0）
        最小值: 0
        最大值: 255

      max-cur:
        $ref: /schemas/types.yaml#/definitions/uint8
        描述: 每个 LED 通道的最大电流
        最大值: 8

      reg:
        描述: |
          LED 的输出通道。这是基于零的通道标识符，而数据手册中的标识符是基于一的。
          将 reg 值输出到 LED 输出编号
        枚举:
          - 0 # LED 输出 D1
          - 1 # LED 输出 D2
          - 2 # LED 输出 D3
          - 3 # LED 输出 D4
          - 4 # LED 输出 D5
          - 5 # LED 输出 D6
          - 6 # LED 输出 D7
          - 7 # LED 输出 D8
          - 8 # LED 输出 D9

      chan-name:
        $ref: /schemas/types.yaml#/definitions/string
        描述: 通道名称

if:
  not:
    属性:
      compatible:
        包含:
          常量: ti,lp8501
then:
  属性:
    pwr-sel: false

必需:
  - compatible
  - reg

额外属性: false

示例:
  - |
    #include <dt-bindings/leds/common.h>
    #include <dt-bindings/leds/leds-lp55xx.h>

    i2c {
        #address-cells = <1>;
        #size-cells = <0>;

        led-controller@32 {
            #address-cells = <1>;
            #size-cells = <0>;
            compatible = "ti,lp8501";
            reg = <0x32>;
            clock-mode = /bits/ 8 <2>;
            pwr-sel = /bits/ 8 <3>;	/* D1~9 连接到 VOUT */
            ti,charge-pump-mode = <LP55XX_CP_BYPASS>;

            led@0 {
                reg = <0>;
                chan-name = "d1";
                led-cur = /bits/ 8 <0x14>;
                max-cur = /bits/ 8 <0x20>;
            };

            led@1 {
                reg = <1>;
                chan-name = "d2";
                led-cur = /bits/ 8 <0x14>;
                max-cur = /bits/ 8 <0x20>;
            };

            led@2 {
                reg = <2>;
                chan-name = "d3";
                led-cur = /bits/ 8 <0x14>;
                max-cur = /bits/ 8 <0x20>;
            };

            led@3 {
                reg = <3>;
                chan-name = "d4";
                led-cur = /bits/ 8 <0x14>;
                max-cur = /bits/ 8 <0x20>;
            };

            led@4 {
                reg = <4>;
                chan-name = "d5";
                led-cur = /bits/ 8 <0x14>;
                max-cur = /bits/ 8 <0x20>;
            };

            led@5 {
                reg = <5>;
                chan-name = "d6";
                led-cur = /bits/ 8 <0x14>;
                max-cur = /bits/ 8 <0x20>;
            };

            led@6 {
                reg = <6>;
                chan-name = "d7";
                led-cur = /bits/ 8 <0x14>;
                max-cur = /bits/ 8 <0x20>;
            };

            led@7 {
                reg = <7>;
                chan-name = "d8";
                led-cur = /bits/ 8 <0x14>;
                max-cur = /bits/ 8 <0x20>;
            };

            led@8 {
                reg = <8>;
                chan-name = "d9";
                led-cur = /bits/ 8 <0x14>;
                max-cur = /bits/ 8 <0x20>;
            };
        };

        led-controller@33 {
            #address-cells = <1>;
            #size-cells = <0>;
            compatible = "national,lp5523";
            reg = <0x33>;
            clock-mode = /bits/ 8 <0>;

            multi-led@2 {
                #address-cells = <1>;
                #size-cells = <0>;
                reg = <0x2>;
                color = <LED_COLOR_ID_RGB>;
                function = LED_FUNCTION_STANDBY;
                linux,default-trigger = "heartbeat";

                led@0 {
                    led-cur = /bits/ 8 <50>;
                    max-cur = /bits/ 8 <100>;
                    reg = <0x0>;
                    color = <LED_COLOR_ID_GREEN>;
                };

                led@1 {
                    led-cur = /bits/ 8 <50>;
                    max-cur = /bits/ 8 <100>;
                    reg = <0x1>;
                    color = <LED_COLOR_ID_BLUE>;
                };

                led@6 {
                    led-cur = /bits/ 8 <50>;
                    max-cur = /bits/ 8 <100>;
                    reg = <0x6>;
                    color = <LED_COLOR_ID_RED>;
                };
            };
        };
    };
```

## Documentation/devicetree/bindings/leds/leds-lp8860_cn.txt
~~~~
* 德州仪器 - LP8860 四通道 LED 驱动器

LP8860-Q1 是一款高效率的 LED 驱动器，带有升压控制器。它具有 4 个高精度电流阱，这些电流阱可以通过脉冲宽度调制（PWM）输入信号、SPI/I²C 主控器或两者共同控制。

必需属性：
    - compatible: 
        "ti,lp8860"
    - reg: I²C 从设备地址
    - #address-cells: 1
    - #size-cells: 0

可选属性：
    - enable-gpios: 用于启用（高电平有效）/禁用设备的 GPIO 引脚
    - vled-supply: LED 供电

必需的子节点属性：
    - reg: 0

可选的子节点属性：
    - function: 参见文档/devicetree/bindings/leds/common.txt
    - color: 参见文档/devicetree/bindings/leds/common.txt
    - label: 参见文档/devicetree/bindings/leds/common.txt （已废弃）
    - linux,default-trigger: 参见文档/devicetree/bindings/leds/common.txt

示例：

```dtb
#include <dt-bindings/leds/common.h>

led-controller@2d {
	compatible = "ti,lp8860";
	#address-cells = <1>;
	#size-cells = <0>;
	reg = <0x2d>;
	enable-gpios = <&gpio1 28 GPIO_ACTIVE_HIGH>;
	vled-supply = <&vbatt>;

	led@0 {
		reg = <0>;
		function = LED_FUNCTION_BACKLIGHT;
		color = <LED_COLOR_ID_WHITE>;
		linux,default-trigger = "backlight";
	};
};
```

欲了解更多产品信息，请参阅以下链接：
https://www.ti.com/product/lp8860-q1
~~~~

## Documentation/devicetree/bindings/leds/leds-lt3593_cn.txt
~~~~
Linear Technologies LT3593 LED 控制器的绑定说明：

必需属性：
- compatible：应设置为 "lltc,lt3593"
- lltc,ctrl-gpios：指向与芯片的 'CTRL' 引脚相连的 GPIO 的句柄

硬件仅支持一个 LED。此 LED 的属性在设备节点中的子节点中进行配置。

可选子节点属性：
- function：参见 Documentation/devicetree/bindings/leds/common.txt
- color：参见 Documentation/devicetree/bindings/leds/common.txt
- label：LED 的标签。如果没有给出，则 LED 将被命名为 "lt3595::"（已弃用）
- linux,default-trigger：LED 的默认触发器
参见 Documentation/devicetree/bindings/leds/common.txt
- default-state：LED 的初始状态
参见 Documentation/devicetree/bindings/leds/common.txt

如果设计中存在多个此类芯片，每个芯片都需要由其自己的设备节点处理。

示例：

```dtb
#include <dt-bindings/leds/common.h>

led-controller {
	compatible = "lltc,lt3593";
	lltc,ctrl-gpios = <&gpio 0 GPIO_ACTIVE_HIGH>;

	led {
		function = LED_FUNCTION_BACKLIGHT;
		color = <LED_COLOR_ID_WHITE>;
		default-state = "on";
	};
};
```

在这个示例中，我们定义了一个与 Linear Technologies LT3593 LED 控制器兼容的设备节点。该节点包含一个子节点 `led`，用于配置 LED 的功能、颜色和初始状态。此外，通过 `lltc,ctrl-gpios` 属性指定了与控制器 'CTRL' 引脚相连的 GPIO。
~~~~

## Documentation/devicetree/bindings/leds/leds-max77650_cn.yaml
```yaml
# SPDX-文件许可人: GPL-2.0
%YAML 1.2
---
$id: http://devicetree.org/schemas/leds/leds-max77650.yaml#
$schema: http://devicetree.org/meta-schemas/core.yaml#

title: Maxim Integrated 的 MAX77650 PMIC LED 驱动器
maintainers:
  - Bartosz Golaszewski <bgolaszewski@baylibre.com>

description: |
  本模块是 MAX77650 MFD 设备的一部分。更多详情请参见
  文档/devicetree/bindings/mfd/max77650.yaml
  LED 控制器在设备树中表示为 PMIC 节点的子节点。
  此设备具有三个电流阱。
properties:
  compatible:
    const: maxim,max77650-led

  "#address-cells":
    const: 1

  "#size-cells":
    const: 0

patternProperties:
  "^led@[0-2]$":
    $ref: common.yaml#
    unevaluatedProperties: false

    properties:
      reg:
        description:
          LED 的索引
minimum: 0
        maximum: 2

required:
  - compatible
  - "#address-cells"
  - "#size-cells"
additionalProperties: false
```

## Documentation/devicetree/bindings/leds/leds-mt6323_cn.txt
~~~~
MT6323 LED 控制器是 MT6323 PMIC 提供的子功能，因此 LED 控制器被定义为由 MT6323 PMIC 控制器提供的功能节点的子节点。MT6323 PMIC 控制器作为一种使用共享总线（称为 PMIC 包装器）的多功能设备 (MFD)，允许每个子功能访问远程 MT6323 PMIC 硬件。

对于 MT6323 MFD 绑定，请参阅：
`Documentation/devicetree/bindings/mfd/mt6397.txt`

对于 MediaTek PMIC 包装器绑定，请参阅：
`Documentation/devicetree/bindings/soc/mediatek/mediatek,pwrap.yaml`

必需属性：
- `compatible`：必须为以下之一
  - `"mediatek,mt6323-led"`
  - `"mediatek,mt6331-led"`
  - `"mediatek,mt6332-led"`
- `address-cells`：必须为 1
- `size-cells`：必须为 0

每个 LED 以子节点的形式表示，该子节点描述了每个 LED 的初始行为，并且当前仅支持四个 LED 子节点。
对于 LED 子节点的必需属性：
- `reg`：LED 通道编号（0..3）

对于 LED 子节点的可选属性：
- `label`：请参阅 `Documentation/devicetree/bindings/leds/common.txt`
- `linux,default-trigger`：请参阅 `Documentation/devicetree/bindings/leds/common.txt`
- `default-state`：请参阅 `Documentation/devicetree/bindings/leds/common.txt`

示例：

```text
mt6323: pmic {
	compatible = "mediatek,mt6323";

	..

mt6323led: leds {
		compatible = "mediatek,mt6323-led";
		#address-cells = <1>;
		#size-cells = <0>;

		led@0 {
			reg = <0>;
			label = "LED0";
			linux,default-trigger = "timer";
			default-state = "on";
		};
		led@1 {
			reg = <1>;
			label = "LED1";
			default-state = "off";
		};
		led@2 {
			reg = <2>;
			label = "LED2";
			default-state = "on";
		};
	};
};
```

这个示例展示了如何在 Device Tree 中配置 MT6323 PMIC 的 LED 控制器及其 LED 子节点。每个 LED 都有其特定的配置，用于初始化 LED 的行为。
~~~~

## Documentation/devicetree/bindings/leds/leds-mt6360_cn.yaml
```yaml
下面是给定 YAML 文档的中文翻译：

# SPDX-许可证标识符: (GPL-2.0-only 或 BSD-2-Clause)
%YAML 1.2
---
$id: http://devicetree.org/schemas/leds/leds-mt6360.yaml#
$schema: http://devicetree.org/meta-schemas/core.yaml#

title: MediaTek 集成 MT6360 PMIC 的 LED 驱动程序
maintainers:
  - Gene Chen <gene_chen@richtek.com>

description: |
  本模块是 MT6360 MFD 设备的一部分
请参阅 Documentation/devicetree/bindings/mfd/mediatek,mt6360.yaml
  添加 MT6360 LED 驱动程序，支持双通道闪光灯（具备手电筒/频闪模式）及四通道 RGB 灯光（支持寄存器/闪光/呼吸模式）

properties:
  compatible:
    const: mediatek,mt6360-led

  "#address-cells":
    const: 1

  "#size-cells":
    const: 0

patternProperties:
  "^multi-led@[0-5]$":
    type: object
    $ref: leds-class-multicolor.yaml#
    unevaluatedProperties: false

    properties:
      reg:
        description: LED 的索引
enum:
          - 0 # LED 输出 ISINK1
          - 1 # LED 输出 ISINK2
          - 2 # LED 输出 ISINK3
          - 3 # LED 输出 ISINKML
          - 4 # LED 输出 FLASH1
          - 5 # LED 输出 FLASH2

      "#address-cells":
        const: 1

      "#size-cells":
        const: 0

    patternProperties:
      "^led@[0-2]$":
        type: object
        $ref: common.yaml#
        unevaluatedProperties: false

        properties:
          reg:
            enum: [0, 1, 2]

        required:
          - reg
          - color

    required:
      - reg
      - "#address-cells"
      - "#size-cells"

  "^led@[0-5]$":
    type: object
    $ref: common.yaml#
    unevaluatedProperties: false
    description:
      单个 LED 的属性
properties:
      reg:
        enum: [0, 1, 2, 3, 4, 5]

required:
  - compatible
  - "#address-cells"
  - "#size-cells"

additionalProperties: false

examples:
  - |
   #include <dt-bindings/leds/common.h>
   led-controller {
     compatible = "mediatek,mt6360-led";
     #address-cells = <1>;
     #size-cells = <0>;

     multi-led@0 {
       reg = <0>;
       function = LED_FUNCTION_INDICATOR;
       color = <LED_COLOR_ID_RGB>;
       led-max-microamp = <24000>;
       #address-cells = <1>;
       #size-cells = <0>;
       led@0 {
         reg = <0>;
         color = <LED_COLOR_ID_RED>;
       };
       led@1 {
         reg = <1>;
         color = <LED_COLOR_ID_GREEN>;
       };
       led@2 {
         reg = <2>;
         color = <LED_COLOR_ID_BLUE>;
       };
     };
     led@3 {
       reg = <3>;
       function = LED_FUNCTION_INDICATOR;
       color = <LED_COLOR_ID_WHITE>;
       led-max-microamp = <150000>;
     };
     led@4 {
       reg = <4>;
       function = LED_FUNCTION_FLASH;
       color = <LED_COLOR_ID_WHITE>;
       function-enumerator = <1>;
       led-max-microamp = <200000>;
       flash-max-microamp = <500000>;
       flash-max-timeout-us = <1024000>;
     };
     led@5 {
       reg = <5>;
       function = LED_FUNCTION_FLASH;
       color = <LED_COLOR_ID_WHITE>;
       function-enumerator = <2>;
       led-max-microamp = <200000>;
       flash-max-microamp = <500000>;
       flash-max-timeout-us = <1024000>;
     };
   };

  - |

   led-controller {
     compatible = "mediatek,mt6360-led";
     #address-cells = <1>;
     #size-cells = <0>;

     led@0 {
       reg = <0>;
       function = LED_FUNCTION_INDICATOR;
       color = <LED_COLOR_ID_RED>;
       led-max-microamp = <24000>;
     };
     led@1 {
       reg = <1>;
       function = LED_FUNCTION_INDICATOR;
       color = <LED_COLOR_ID_GREEN>;
       led-max-microamp = <24000>;
     };
     led@2 {
       reg = <2>;
       function = LED_FUNCTION_INDICATOR;
       color = <LED_COLOR_ID_BLUE>;
       led-max-microamp = <24000>;
     };
     led@3 {
       reg = <3>;
       function = LED_FUNCTION_INDICATOR;
       color = <LED_COLOR_ID_WHITE>;
       led-max-microamp = <150000>;
     };
     led@4 {
       reg = <4>;
       function = LED_FUNCTION_FLASH;
       color = <LED_COLOR_ID_WHITE>;
       function-enumerator = <1>;
       led-max-microamp = <200000>;
       flash-max-microamp = <500000>;
       flash-max-timeout-us = <1024000>;
     };
     led@5 {
       reg = <5>;
       function = LED_FUNCTION_FLASH;
       color = <LED_COLOR_ID_WHITE>;
       function-enumerator = <2>;
       led-max-microamp = <200000>;
       flash-max-microamp = <500000>;
       flash-max-timeout-us = <1024000>;
     };
   };
```
