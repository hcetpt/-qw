## Documentation/devicetree/bindings/leds/leds-netxbig_cn.txt
```
### 绑定用于 LaCie/Seagate 某些主板上的 CPLD LED（GPIO 扩展总线）（示例：2Big/5Big Network v2，2Big NAS）

**所需属性：**
- `compatible`: `"lacie,netxbig-leds"`
- `gpio-ext`: GPIO扩展总线的Phandle

**可选属性：**
- `timers`: 定时器数组。每个定时器条目由三个整数表示：
  - 模式（GPIO扩展总线）
  - `delay_on`: 开启延迟
  - `delay_off`: 关闭延迟

**每个 LED 作为 netxbig-leds 设备的子节点表示**

**必需的子节点属性：**
- `mode-addr`: GPIO扩展总线上模式寄存器地址
- `mode-val`: 模式到值的映射。每个条目由两个整数表示：
  - 一种模式和相应的GPIO扩展总线上的值
- `bright-addr`: GPIO扩展总线上亮度寄存器地址
- `max-brightness`: 最大亮度值

**可选的子节点属性：**
- `label`: 此LED的名称。如果省略，则从节点名称中获取标签。
在Linux中，default-trigger: 分配给LED的触发器。
示例：

netxbig-leds {
	兼容 = "lacie,netxbig-leds";

	gpio-ext = &gpio_ext;

	定时器 = <NETXBIG_LED_TIMER1 500 500 
		  NETXBIG_LED_TIMER2 500 1000>;

	蓝光-电源 {
		标签 = "netxbig:blue:power";
		模式地址 = <0>;
		模式值 = <NETXBIG_LED_OFF 0 
			    NETXBIG_LED_ON 1 
			    NETXBIG_LED_TIMER1 3 
			    NETXBIG_LED_TIMER2 7>;
		亮度地址 = <1>;
		最大亮度 = <7>;
	};
	红光-电源 {
		标签 = "netxbig:red:power";
		模式地址 = <0>;
		模式值 = <NETXBIG_LED_OFF 0 
			    NETXBIG_LED_ON 2 
			    NETXBIG_LED_TIMER1 4>;
		亮度地址 = <1>;
		最大亮度 = <7>;
	};
	蓝光-SATA0 {
		标签 = "netxbig:blue:sata0";
		模式地址 = <3>;
		模式值 = <NETXBIG_LED_OFF 0 
			    NETXBIG_LED_ON 7 
			    NETXBIG_LED_SATA 1 
			    NETXBIG_LED_TIMER1 3>;
		亮度地址 = <2>;
		最大亮度 = <7>;
	};
	红光-SATA0 {
		标签 = "netxbig:red:sata0";
		模式地址 = <3>;
		模式值 = <NETXBIG_LED_OFF 0 
			    NETXBIG_LED_ON 2 
			    NETXBIG_LED_TIMER1 4>;
		亮度地址 = <2>;
		最大亮度 = <7>;
	};
	蓝光-SATA1 {
		标签 = "netxbig:blue:sata1";
		模式地址 = <4>;
		模式值 = <NETXBIG_LED_OFF 0 
			    NETXBIG_LED_ON 7 
			    NETXBIG_LED_SATA 1 
			    NETXBIG_LED_TIMER1 3>;
		亮度地址 = <2>;
		最大亮度 = <7>;
	};
	红光-SATA1 {
		标签 = "netxbig:red:sata1";
		模式地址 = <4>;
		模式值 = <NETXBIG_LED_OFF 0 
			    NETXBIG_LED_ON 2 
			    NETXBIG_LED_TIMER1 4>;
		亮度地址 = <2>;
		最大亮度 = <7>;
	};
};

请注意，“兼容”、“定时器”等关键词在此上下文中保持英文形式，因为这些是特定的技术术语。其他部分已经翻译成中文。
```

## Documentation/devicetree/bindings/leds/leds-ns2_cn.txt
~~~~
在Network Space v2（及其父型号）上找到的双GPIO LED绑定。

必需属性：
- `compatible`: `"lacie,ns2-leds"`
每个LED都作为`ns2-leds`设备的一个子节点表示。

必需的子节点属性：
- `cmd-gpio`: 命令LED的GPIO。请参阅OF设备树GPIO规范。
- `slow-gpio`: 慢速LED的GPIO。请参阅OF设备树GPIO规范。
- `modes-map`: LED模式（关闭、打开或SATA活动闪烁）与相应的`cmd-gpio/slow-gpio`值之间的映射。应给出所有GPIO值组合，以避免在驱动程序探测时出现未知模式。

可选子节点属性：
- `label`: 此LED的名称。如果省略，则从节点名称中获取标签。
- `linux,default-trigger`: 分配给LED的触发器

示例：

```dts
#include <dt-bindings/leds/leds-ns2.h>

ns2-leds {
	compatible = "lacie,ns2-leds";

	blue-sata {
		label = "ns2:blue:sata";
		slow-gpio = <&gpio0 29 0>;
		cmd-gpio = <&gpio0 30 0>;
		modes-map = <NS_V2_LED_OFF  0 1
			     NS_V2_LED_ON   1 0
			     NS_V2_LED_ON   0 0
			     NS_V2_LED_SATA 1 1>;
	};
};
```

这段配置描述了一个针对Network Space v2的双GPIO LED的Device Tree片段。其中定义了一个名为`blue-sata`的LED，它具有命令和慢速两种GPIO设置，并且定义了不同模式下的GPIO状态。
~~~~

## Documentation/devicetree/bindings/leds/leds-pca955x_cn.txt
~~~~
NXP - pca955x LED 驱动器

PCA955x 系列芯片是 I2C LED 闪烁器，其未用于控制 LED 的引脚可以用作通用输入/输出(GPIO)。GPIO 引脚可以是输入或输出，并且输出引脚也可以通过脉冲宽度进行控制。
必需的属性：
- compatible：应为以下之一：
    "nxp,pca9550"
    "nxp,pca9551"
    "nxp,pca9552"
    "ibm,pca9552"
    "nxp,pca9553"
- #address-cells：必须为 1
- #size-cells：必须为 0
- reg：I2C 从设备地址。取决于型号

可选属性：
- gpio-controller：允许将引脚用作 GPIO
- #gpio-cells：必须为 2
- gpio-line-names：定义 GPIO 线路的名称

LED 子节点属性：
- reg ：LED 线路编号
    从 0 到 1 对于 pca9550
    从 0 到 7 对于 pca9551
    从 0 到 15 对于 pca9552
    从 0 到 3 对于 pca9553
- type：（可选）可以为
    PCA955X_TYPE_NONE
    PCA955X_TYPE_LED
    PCA955X_TYPE_GPIO
    参见 dt-bindings/leds/leds-pca955x.h （默认为 LED）
- label ：（可选）
    参见 Documentation/devicetree/bindings/leds/common.txt
- linux,default-trigger ：（可选）
    参见 Documentation/devicetree/bindings/leds/common.txt

示例：

```text
pca9552: pca9552@60 {
	compatible = "nxp,pca9552";
	#address-cells = <1>;
	#size-cells = <0>;
	reg = <0x60>;

	gpio-controller;
	#gpio-cells = <2>;
	gpio-line-names = "GPIO12", "GPIO13", "GPIO14", "GPIO15";

	gpio@12 {
		reg = <12>;
		type = <PCA955X_TYPE_GPIO>;
	};
	gpio@13 {
		reg = <13>;
		type = <PCA955X_TYPE_GPIO>;
	};
	gpio@14 {
		reg = <14>;
		type = <PCA955X_TYPE_GPIO>;
	};
	gpio@15 {
		reg = <15>;
		type = <PCA955X_TYPE_GPIO>;
	};

	led@0 {
		label = "red:power";
		linux,default-trigger = "default-on";
		reg = <0>;
		type = <PCA955X_TYPE_LED>;
	};
	led@1 {
		label = "green:power";
		reg = <1>;
		type = <PCA955X_TYPE_LED>;
	};
	led@2 {
		label = "pca9552:yellow";
		reg = <2>;
		type = <PCA955X_TYPE_LED>;
	};
	led@3 {
		label = "pca9552:white";
		reg = <3>;
		type = <PCA955X_TYPE_LED>;
	};
};
```
以上是一个设备树片段示例，展示了如何配置一个 PCA9552 芯片及其相关的 GPIO 和 LED。
~~~~

## Documentation/devicetree/bindings/leds/leds-powernv_cn.txt
~~~~
IBM Power Systems 中 LED 的设备树绑定
-------------------------------------------------

必需属性：
- compatible：应为 "ibm,opal-v3-led"
- led-mode：应为 "lightpath" 或 "guidinglight"
每个 FRU/机箱的位置代码必须以子节点的形式表示。
子节点的必需属性：
- led-types：支持的 LED 类型（注意/标识/故障），以字符串数组形式提供

示例：

```
leds {
	compatible = "ibm,opal-v3-led";
	led-mode = "lightpath";

	U78C9.001.RST0027-P1-C1 {
		led-types = "identify", "fault";
	};
	...
};
```
~~~~

## Documentation/devicetree/bindings/leds/leds-pwm-multicolor_cn.yaml
```yaml
# SPDX-许可证标识符: (GPL-2.0-only 或 BSD-2-Clause)
%YAML 1.2
---
$id: http://devicetree.org/schemas/leds/leds-pwm-multicolor.yaml#
$schema: http://devicetree.org/meta-schemas/core.yaml#

title: 连接到PWM的多色LED

maintainers:
  - Sven Schwermer <sven.schwermer@disruptive-technologies.com>

description: |
  此驱动程序将多个单色PWM LED组合成一个多色LED，使用多色LED类
properties:
  compatible:
    const: pwm-leds-multicolor

  multi-led:
    类型: 对象
    $ref: leds-class-multicolor.yaml#
    unevaluatedProperties: false

    properties:
      max-brightness:
        description:
          LED可能的最大亮度
        $ref: /schemas/types.yaml#/definitions/uint32

    patternProperties:
      "^led-[0-9a-z]+$":
        类型: 对象
        $ref: common.yaml#

        additionalProperties: false

        properties:
          pwms:
            maxItems: 1

          pwm-names: true

          active-low: true

          color: true

        required:
          - pwms
          - color

required:
  - compatible

additionalProperties: false

examples:
  - |
    #include <dt-bindings/leds/common.h>

    led-controller {
        compatible = "pwm-leds-multicolor";

        multi-led {
            color = <LED_COLOR_ID_RGB>;
            function = LED_FUNCTION_INDICATOR;
            max-brightness = <65535>;

            led-red {
                pwms = <&pwm1 0 1000000>;
                color = <LED_COLOR_ID_RED>;
            };

            led-green {
                pwms = <&pwm2 0 1000000>;
                color = <LED_COLOR_ID_GREEN>;
            };

            led-blue {
                pwms = <&pwm3 0 1000000>;
                color = <LED_COLOR_ID_BLUE>;
            };
        };
    };

..
```

## Documentation/devicetree/bindings/leds/leds-pwm_cn.yaml
```yaml
# SPDX-许可证标识符: (GPL-2.0-only 或 BSD-2-Clause)
%YAML 1.2
---
$id: http://devicetree.org/schemas/leds/leds-pwm.yaml#
$schema: http://devicetree.org/meta-schemas/core.yaml#

标题: 连接到PWM的LED

维护者:
  - Pavel Machek <pavel@ucw.cz>

描述:
  每个LED都作为一个子节点表示在pwm-leds设备下。每个
  节点的名字代表了相应的LED的名字。
属性:
  compatible:
    常量: pwm-leds

模式属性:
  "^led(-[0-9a-f]+)?$":
    类型: 对象
    $ref: common.yaml#
    未评估属性: false

    属性:
      pwms:
        最大项目数: 1

      pwm-names: true

      max-brightness:
        描述:
          LED可能的最大亮度
        $ref: /schemas/types.yaml#/definitions/uint32

    必须包含:
      - pwms
      - max-brightness

额外属性: false

示例:
  - |

    #include <dt-bindings/leds/common.h>

    led-controller {
        compatible = "pwm-leds";

        led-1 {
            label = "omap4::keypad";
            pwms = <&twl_pwm 0 7812500>;
            max-brightness = <127>;
        };

        led-2 {
            color = <LED_COLOR_ID_GREEN>;
            function = LED_FUNCTION_CHARGING;
            pwms = <&twl_pwmled 0 7812500>;
            max-brightness = <255>;
        };
    };
```

## Documentation/devicetree/bindings/leds/leds-qcom-lpg_cn.yaml
```yaml
以下是给定 YAML 文档的中文翻译：

# SPDX 许可标识符: (GPL-2.0-only 或 BSD-2-Clause)
%YAML 1.2
---
$id: http://devicetree.org/schemas/leds/leds-qcom-lpg.yaml#
$schema: http://devicetree.org/meta-schemas/core.yaml#

标题: 高通光脉冲发生器

维护者:
  - Bjorn Andersson <bjorn.andersson@linaro.org>

描述: >
  高通光脉冲发生器由三个不同的硬件模块组成；
  包括带有查找表（LUT）的斜坡生成器、光脉冲发生器和三通道电流源。这些模块广泛应用于一系列高通电源管理集成电路（PMIC）中。

属性:
  compatible:
    oneOf:
      - 枚举:
          - qcom,pm660l-lpg
          - qcom,pm8150b-lpg
          - qcom,pm8150l-lpg
          - qcom,pm8350c-pwm
          - qcom,pm8916-pwm
          - qcom,pm8941-lpg
          - qcom,pm8994-lpg
          - qcom,pmc8180c-lpg
          - qcom,pmi632-lpg
          - qcom,pmi8950-pwm
          - qcom,pmi8994-lpg
          - qcom,pmi8998-lpg
          - qcom,pmk8550-pwm
      - 项:
          - 枚举:
              - qcom,pm6150l-lpg
          - 常量: qcom,pm8150l-lpg
      - 项:
          - 枚举:
              - qcom,pm8550-pwm
          - 常量: qcom,pm8350c-pwm

  "#pwm-cells":
    常量: 2

  "#address-cells":
    常量: 1

  "#size-cells":
    常量: 0

  qcom,power-source:
    $ref: /schemas/types.yaml#/definitions/uint32
    描述:
      用于驱动输出的电源源，如数据手册中定义。
      如果存在TRILED块，则应指定。
    枚举: [0, 1, 3]

  qcom,dtest:
    $ref: /schemas/types.yaml#/definitions/uint32-matrix
    描述: >
      整数对列表，其中每一对表示特定通道应连接的dtest线以及标志，这些标志定义了值如何输出，如数据手册中定义。对的数量应与通道数量相同。
    项:
      - 描述: 要连接的dtest线
      - 描述: 连接的标志

  nvmem:
    描述: >
      此属性对于支持PPG的PMIC是必需的，即当PMIC将LPG每通道数据和模式LUT存储在SDAM模块中而不是LUT外围设备中时。对于像PM8350C这样的PMIC，每通道数据和模式LUT被分离到两个SDAM模块中。在这种情况下，需要指定两个SDAM模块的phandle。
    最小项: 1
    最大项: 2

  nvmem-names:
    最小项: 1
    项:
      - 常量: lpg_chan_sdam
      - 常量: lut_sdam

  qcom,pbs:
    $ref: /schemas/types.yaml#/definitions/phandle
    描述: >
      高通可编程启动序列节点（PBS）的phandle。
      PBS节点用于触发支持单SDAM PPG的PMIC中的LPG模式序列。

multi-led:
    类型: 对象
    $ref: leds-class-multicolor.yaml#
    未评估属性: false

    属性:
      "#address-cells":
        常量: 1

      "#size-cells":
        常量: 0

    符合模式的属性:
      "^led@[0-9a-f]$":
        类型: 对象
        $ref: common.yaml#
        未评估属性: false

        属性:
          reg:
            最大项: 1

        必需:
          - reg

符合模式的属性:
  "^led@[0-9a-f]$":
    类型: 对象
    $ref: common.yaml#
    未评估属性: false

    属性:
      reg:
        最大项: 1

    必需:
      - reg

必需:
  - compatible

附加属性: false

allOf:
  - 如果:
      属性:
        compatible:
          包含:
            枚举:
              - qcom,pm660l-lpg
              - qcom,pm8150b-lpg
              - qcom,pm8150l-lpg
              - qcom,pm8916-pwm
              - qcom,pm8941-lpg
              - qcom,pm8994-lpg
              - qcom,pmc8180c-lpg
              - qcom,pmi8950-pwm
              - qcom,pmi8994-lpg
              - qcom,pmi8998-lpg
              - qcom,pmk8550-pwm
    然后:
      属性:
        nvmem: false
        nvmem-names: false

  - 如果:
      属性:
        compatible:
          包含:
            常量: qcom,pmi632-lpg
    然后:
      属性:
        nvmem:
          最大项: 1
        nvmem-names:
          最大项: 1

  - 如果:
      属性:
        compatible:
          包含:
            枚举:
              - qcom,pm8350c-pwm
    然后:
      属性:
        nvmem:
          最小项: 2
        nvmem-names:
          最小项: 2

示例:
  - |
    #include <dt-bindings/leds/common.h>

    led-controller {
      compatible = "qcom,pmi8994-lpg";

      #address-cells = <1>;
      #size-cells = <0>;

      qcom,power-source = <1>;

      qcom,dtest = <0 0>,
                   <0 0>,
                   <0 0>,
                   <4 1>;

      led@1 {
        reg = <1>;
        color = <LED_COLOR_ID_GREEN>;
        function = LED_FUNCTION_INDICATOR;
        function-enumerator = <1>;
      };

      led@2 {
        reg = <2>;
        color = <LED_COLOR_ID_GREEN>;
        function = LED_FUNCTION_INDICATOR;
        function-enumerator = <0>;
        default-state = "on";
      };

      led@3 {
        reg = <3>;
        color = <LED_COLOR_ID_GREEN>;
        function = LED_FUNCTION_INDICATOR;
        function-enumerator = <2>;
      };

      led@4 {
        reg = <4>;
        color = <LED_COLOR_ID_GREEN>;
        function = LED_FUNCTION_INDICATOR;
        function-enumerator = <3>;
      };
    };
  - |
    #include <dt-bindings/leds/common.h>

    led-controller {
      compatible = "qcom,pmi8994-lpg";

      #address-cells = <1>;
      #size-cells = <0>;

      qcom,power-source = <1>;

      multi-led {
        color = <LED_COLOR_ID_RGB>;
        function = LED_FUNCTION_STATUS;

        #address-cells = <1>;
        #size-cells = <0>;

        led@1 {
          reg = <1>;
          color = <LED_COLOR_ID_RED>;
        };

        led@2 {
          reg = <2>;
          color = <LED_COLOR_ID_GREEN>;
        };

        led@3 {
          reg = <3>;
          color = <LED_COLOR_ID_BLUE>;
        };
      };
    };
  - |
    pwm-controller {
      compatible = "qcom,pm8916-pwm";
      #pwm-cells = <2>;
    };
  - |
    #include <dt-bindings/leds/common.h>

    led-controller {
      compatible = "qcom,pmi632-lpg";
      #address-cells = <1>;
      #size-cells = <0>;
      #pwm-cells = <2>;
      nvmem-names = "lpg_chan_sdam";
      nvmem = <&pmi632_sdam_7>;
      qcom,pbs = <&pmi632_pbs_client3>;

      led@1 {
        reg = <1>;
        color = <LED_COLOR_ID_RED>;
        label = "red";
      };

      led@2 {
        reg = <2>;
        color = <LED_COLOR_ID_GREEN>;
        label = "green";
      };

      led@3 {
        reg = <3>;
        color = <LED_COLOR_ID_BLUE>;
        label = "blue";
      };
    };
```

## Documentation/devicetree/bindings/leds/leds-rt4505_cn.yaml
~~~~yaml
```yaml
# SPDX-许可证标识符: (GPL-2.0-only 或 BSD-2-Clause)
%YAML 1.2
---
$id: http://devicetree.org/schemas/leds/leds-rt4505.yaml#
$schema: http://devicetree.org/meta-schemas/core.yaml#

title: Richtek RT4505 单通道 LED 驱动器

maintainers:
  - ChiYuan Huang <cy_huang@richtek.com>

description: |
  RT4505 是一款闪光 LED 驱动器，可以支持高达 375mA 和 1.5A 的电流，
  分别用于手电筒模式和闪光模式。
  数据手册可以在以下链接找到：
    https://www.richtek.com/assets/product_file/RT4505/DS4505-02.pdf

properties:
  compatible:
    const: richtek,rt4505

  reg:
    description: 控制器的 I2C 从设备地址
  maxItems: 1

  led:
    type: object
    $ref: common.yaml#
    unevaluatedProperties: false

required:
  - compatible
  - reg

additionalProperties: false

examples:
  - |
    #include <dt-bindings/leds/common.h>

    i2c {
      #address-cells = <1>;
      #size-cells = <0>;

      led-controller@63 {
        compatible = "richtek,rt4505";
        reg = <0x63>;

        rt4505_flash: led {
          function = LED_FUNCTION_FLASH;
          color = <LED_COLOR_ID_WHITE>;
          led-max-microamp = <375000>;
          flash-max-microamp = <1500000>;
          flash-max-timeout-us = <800000>;
        };
      };
    };
```

此文档描述了Richtek RT4505单通道LED驱动器的Device Tree规范，并给出了一个示例。
~~~~

## Documentation/devicetree/bindings/leds/leds-sc27xx-bltc_cn.txt
~~~~
连接到展讯SC27XX电源管理集成电路（PMIC）呼吸灯控制器的LED

SC27xx呼吸灯控制器支持3个输出：
红色LED、绿色LED和蓝色LED。每个LED都可以在普通
脉冲宽度调制（PWM）模式或呼吸灯模式下工作。
必需属性：
- compatible：应为"sprd,sc2731-bltc"
- #address-cells：必须是1
- #size-cells：必须是0
- reg：指定控制器地址
必需的子属性：
- reg：此LED所连接的端口
可选的子属性：
- function：参见文档/devicetree/bindings/leds/common.txt
- color：参见文档/devicetree/bindings/leds/common.txt
- label：参见文档/devicetree/bindings/leds/common.txt（已废弃）
示例：

```
led-controller@200 {
	compatible = "sprd,sc2731-bltc";
	#address-cells = <1>;
	#size-cells = <0>;
	reg = <0x200>;

	led@0 {
		color = <LED_COLOR_ID_RED>;
		reg = <0x0>;
	};

	led@1 {
		color = <LED_COLOR_ID_GREEN>;
		reg = <0x1>;
	};

	led@2 {
		color = <LED_COLOR_ID_BLUE>;
		reg = <0x2>;
	};
};
```
~~~~
