## Documentation/devicetree/bindings/leds/leds-lm3601x_cn.txt
~~~~
* 德州仪器 (Texas Instruments) - LM3601X 单 LED 闪光驱动器

LM3601X 是超小型 LED 闪光驱动器，提供了高度的可调节性。
所需属性：
    - compatible（兼容）: 可以是以下之一
        "ti,lm36010"
        "ti,lm36011"
    - reg：I2C 从设备地址
    - #address-cells（地址单元数量）: 1
    - #size-cells（大小单元数量）: 0

所需子属性：
    - reg：0 - 表示红外模式
        1 - 表示手电筒（白光 LED）模式

对于 LED 闪光灯子节点所需属性：
    请参阅文档/devicetree/bindings/leds/common.txt
    - flash-max-microamp（最大闪光电流）: 范围为 11mA 至 1.5A
    - flash-max-timeout-us（最大闪光超时时间）: 范围为 40ms 至 1600ms
    - led-max-microamp（最大 LED 电流）: 范围为 2.4mA 至 376mA

可选子属性：
    - function（功能）: 请参阅文档/devicetree/bindings/leds/common.txt
    - color（颜色）: 请参阅文档/devicetree/bindings/leds/common.txt
    - label（标签）: 请参阅文档/devicetree/bindings/leds/common.txt（已弃用）

示例：

```device-tree
#include <dt-bindings/leds/common.h>

led-controller@64 {
	compatible = "ti,lm36010";
	#address-cells = <1>;
	#size-cells = <0>;
	reg = <0x64>;

	led@0 {
		reg = <1>;
		function = LED_FUNCTION_TORCH;
		color = <LED_COLOR_ID_WHITE>;
		led-max-microamp = <376000>;
		flash-max-microamp = <1500000>;
		flash-max-timeout-us = <1600000>;
	};
};
```

如需了解更多产品信息，请访问以下链接：
https://www.ti.com/product/LM36010  
https://www.ti.com/product/LM36011
~~~~

## Documentation/devicetree/bindings/leds/leds-lm36274_cn.txt
```
Texas Instruments LM36274 是一款集成的四通道白光 LED (WLED) 驱动器和 LCD 偏置电源。背光升压电路可以为四个并联的 LED 串供电，总输出电压最高可达 29V。通过 I²C 总线或逻辑电平脉冲宽度调制 (PWM) 输入可编程设置 11 位的 LED 电流，范围从 60 μA 到 30 mA。

关于主设备属性的文档，请参考：
Documentation/devicetree/bindings/mfd/ti-lmu.txt

关于稳压器属性的文档，请参考：
Documentation/devicetree/bindings/regulator/lm363x-regulator.txt

必需的背光属性包括：
- compatible: 
    "ti,lm36274-backlight"
- reg : 0
- #address-cells : 1
- #size-cells : 0
- led-sources : 指示将启用哪些 LED 串
   数值范围从 0 到 3，源编号从 0 开始，因此 LED 串的编号为源编号值加 1

可选的背光属性包括：
- label : 请参阅 Documentation/devicetree/bindings/leds/common.txt
- linux,default-trigger : 请参阅 Documentation/devicetree/bindings/leds/common.txt

示例：

HVLED 串 1 和 3 由控制银行 A 控制，HVLED 串 2 由控制银行 B 控制。
lm36274@11 {
	compatible = "ti,lm36274";
	#address-cells = <1>;
	#size-cells = <0>;
	reg = <0x11>;

	enable-gpios = <&gpio1 28 GPIO_ACTIVE_HIGH>;

	regulators {
		#address-cells = <1>;
		#size-cells = <0>;
		compatible = "ti,lm363x-regulator";

		enable-gpios = <&pioC 0 GPIO_ACTIVE_HIGH>,
			       <&pioC 1 GPIO_ACTIVE_HIGH>;

		vboost {
			regulator-name = "lcd_boost";
			regulator-min-microvolt = <4000000>;
			regulator-max-microvolt = <7150000>;
			regulator-always-on;
		};

		vpos {
			regulator-name = "lcd_vpos";
			regulator-min-microvolt = <4000000>;
			regulator-max-microvolt = <6500000>;
		};

		vneg {
			regulator-name = "lcd_vneg";
			regulator-min-microvolt = <4000000>;
			regulator-max-microvolt = <6500000>;
		};
	};

	backlight {
		#address-cells = <1>;
		#size-cells = <0>;
		compatible = "ti,lm36274-backlight";

		led@0 {
			reg = <0>;
			led-sources = <0 2>;
			label = "white:backlight_cluster";
			linux,default-trigger = "backlight";
		};
	};
};

如需了解更多产品信息，请访问以下链接：
https://www.ti.com/lit/ds/symlink/lm36274.pdf
```

## Documentation/devicetree/bindings/leds/leds-lm3692x_cn.txt
~~~~
* 德州仪器 (Texas Instruments) - LM3692x 高效白光LED驱动器

LM3692x 是一款超紧凑型、高效率的白光LED驱动器，专为LCD显示屏背光设计。LM36922与LM36923的主要区别在于它们支持的LED串数量不同：LM36922支持两串LED，而LM36923支持三串LED。
必需属性：
    - compatible:
        "ti,lm36922"
        "ti,lm36923"
    - reg : I2C从机地址
    - #address-cells : 1
    - #size-cells : 0

可选属性：
    - enable-gpios : 用于启用/禁用设备的GPIO引脚
    - vled-supply : LED供电
    - ti,ovp-microvolt: 过压保护（单位微伏），可以设置为17000000、21000000、25000000或29000000。如果未指定ti,ovp-microvolt，则默认值为29000000
必需的子节点属性：
    - reg : 
        0 - 启用所有LED同步路径
        1 - 启用LED1同步
        2 - 启用LED2同步
        3 - 启用LED3同步（仅LM36923）

可选的子节点属性：
    - function : 请参阅文档/devicetree/bindings/leds/common.txt
    - color : 请参阅文档/devicetree/bindings/leds/common.txt
    - label : 请参阅文档/devicetree/bindings/leds/common.txt（已废弃）
    - linux,default-trigger : 请参阅文档/devicetree/bindings/leds/common.txt
    - led-max-microamp : 请参阅文档/devicetree/bindings/leds/common.txt

示例：

```dtb
#include <dt-bindings/leds/common.h>

led-controller@36 {
	compatible = "ti,lm3692x";
	reg = <0x36>;
	#address-cells = <1>;
	#size-cells = <0>;

	enable-gpios = <&gpio1 28 GPIO_ACTIVE_HIGH>;
	vled-supply = <&vbatt>;
	ti,ovp-microvolt = <29000000>;

	led@0 {
		reg = <0>;
		function = LED_FUNCTION_BACKLIGHT;
		color = <LED_COLOR_ID_WHITE>;
		linux,default-trigger = "backlight";
		led-max-microamp = <20000>;
	};
};
```

欲了解更多信息，请访问以下链接：
https://www.ti.com/lit/ds/snvsa29/snvsa29.pdf
~~~~

## Documentation/devicetree/bindings/leds/leds-lm3697_cn.txt
~~~~
* 德州仪器 (Texas Instruments) - LM3697 高效白光 LED 驱动器

LM3697 11 位 LED 驱动器为单串、双串或三串 LED 提供高性能的背光调光功能，同时可实现高达 90% 的效率。该器件适用于显示屏和键盘照明。

必需属性：
    - compatible: 
        "ti,lm3697"
    - reg : I2C 从设备地址
    - #address-cells : 1
    - #size-cells : 0

可选属性：
    - enable-gpios : 用于启用/禁用设备的 GPIO 引脚
    - vled-supply : LED 供电

必需子节点属性：
    - reg : 
        0 - LED 由 A 银行控制
        1 - LED 由 B 银行控制
    - led-sources : 指示哪个高压 LED 串与哪个控制银行相关联。这是基于零的属性，即
            HVLED1 = 0, HVLED2 = 1, HVLED3 = 2
有关更多信息，请参阅文档/devicetree/bindings/leds/common.txt

可选子节点属性：
    - ti,brightness-resolution - 请参阅文档/devicetree/bindings/mfd/ti-lmu.txt
    - ramp-up-us: 请参阅文档/devicetree/bindings/mfd/ti-lmu.txt
    - ramp-down-us: 请参阅文档/devicetree/bindings/mfd/ti-lmu.txt
    - label : 请参阅文档/devicetree/bindings/leds/common.txt
    - linux,default-trigger : 请参阅文档/devicetree/bindings/leds/common.txt

示例：

高压 LED 串 1 和 3 由控制银行 A 控制，而高压 LED 串 2 由控制银行 B 控制。
```
led-controller@36 {
    compatible = "ti,lm3697";
    #address-cells = <1>;
    #size-cells = <0>;
    reg = <0x36>;

    enable-gpios = <&gpio1 28 GPIO_ACTIVE_HIGH>;
    vled-supply = <&vbatt>;

    led@0 {
        reg = <0>;
        led-sources = <0 2>;
        ti,brightness-resolution = <2047>;
        ramp-up-us = <5000>;
        ramp-down-us = <1000>;
        label = "white:first_backlight_cluster";
        linux,default-trigger = "backlight";
    };

    led@1 {
        reg = <1>;
        led-sources = <1>;
        ti,brightness-resolution = <255>;
        ramp-up-us = <500>;
        ramp-down-us = <1000>;
        label = "white:second_backlight_cluster";
        linux,default-trigger = "backlight";
    };
}
```

欲了解更多信息，请访问以下链接：
https://www.ti.com/lit/ds/symlink/lm3697.pdf
~~~~

## Documentation/devicetree/bindings/leds/leds-lp50xx_cn.yaml
```yaml
# SPDX-文件许可人: (GPL-2.0-only 或 BSD-2-Clause)
%YAML 1.2
---
$id: http://devicetree.org/schemas/leds/leds-lp50xx.yaml#
$schema: http://devicetree.org/meta-schemas/core.yaml#

title: 德州仪器 LP50XX RGB LED 驱动器
maintainers:
  - Andrew Davis <afd@ti.com>

description: |
  LP50XX 是多通道、I2C RGB LED 驱动器，可以将 RGB LED 分组为 LED 组或单独控制它们。
  这些 RGB LED 驱动器之间的区别在于支持的 RGB 模块数量。
  更多产品信息请参阅以下链接：
  https://www.ti.com/lit/ds/symlink/lp5012.pdf
  https://www.ti.com/lit/ds/symlink/lp5024.pdf
  https://www.ti.com/lit/ds/symlink/lp5036.pdf

properties:
  compatible:
    enum:
      - ti,lp5009
      - ti,lp5012
      - ti,lp5018
      - ti,lp5024
      - ti,lp5030
      - ti,lp5036

  reg:
    maxItems: 1
    description:
      I2C 从设备地址
      lp5009/12 - 0x14, 0x15, 0x16, 0x17
      lp5018/24 - 0x28, 0x29, 0x2a, 0x2b
      lp5030/36 - 0x30, 0x31, 0x32, 0x33

  enable-gpios:
    maxItems: 1
    description: 用于启用/禁用设备的 GPIO 引脚
vled-supply:
    description: LED 电源
'#address-cells':
    const: 1

  '#size-cells':
    const: 0

patternProperties:
  '^multi-led@[0-9a-f]$':
    type: object
    $ref: leds-class-multicolor.yaml#
    unevaluatedProperties: false

    properties:
      reg:
        minItems: 1
        maxItems: 12
        description:
          此属性表示在子节点上使用的 LED 模块编号（s）。
          LED 模块可以单独使用或分组到模块库中。
'#address-cells':
        const: 1

      '#size-cells':
        const: 0

    patternProperties:
      "^led@[0-9a-f]+$":
        type: object
        $ref: common.yaml#
        unevaluatedProperties: false

        properties:
          reg:
            maxItems: 1

        required:
          - reg

required:
  - compatible
  - reg

additionalProperties: false

examples:
  - |
    #include <dt-bindings/gpio/gpio.h>
    #include <dt-bindings/leds/common.h>

    i2c {
        #address-cells = <1>;
        #size-cells = <0>;

        led-controller@14 {
            compatible = "ti,lp5009";
            reg = <0x14>;
            #address-cells = <1>;
            #size-cells = <0>;
            enable-gpios = <&gpio1 16>;

            multi-led@1 {
                #address-cells = <1>;
                #size-cells = <0>;
                reg = <0x1>;
                color = <LED_COLOR_ID_RGB>;
                function = LED_FUNCTION_CHARGING;

                led@0 {
                     reg = <0x0>;
                     color = <LED_COLOR_ID_RED>;
                };

                led@1 {
                     reg = <0x1>;
                     color = <LED_COLOR_ID_GREEN>;
                };

                led@2 {
                     reg = <0x2>;
                     color = <LED_COLOR_ID_BLUE>;
                };
            };

            multi-led@3 {
                #address-cells = <1>;
                #size-cells = <0>;
                reg = <0x3>, <0x4>, <0x5>;
                color = <LED_COLOR_ID_RGB>;
                function = LED_FUNCTION_STANDBY;

                led@3 {
                    reg = <0x3>;
                    color = <LED_COLOR_ID_RED>;
                };

                led@4 {
                    reg = <0x4>;
                    color = <LED_COLOR_ID_GREEN>;
                };

                led@5 {
                    reg = <0x5>;
                    color = <LED_COLOR_ID_BLUE>;
                };
            };
        };
    };
```
