## Documentation/devicetree/bindings/leds/leds-sgm3140_cn.yaml
~~~~yaml
```yaml
# SPDX-许可证标识符: (GPL-2.0-only 或 BSD-2-Clause)
%YAML 1.2
---
$id: http://devicetree.org/schemas/leds/leds-sgm3140.yaml#
$schema: http://devicetree.org/meta-schemas/core.yaml#

title: SGMICRO SGM3140 500mA 降压/升压 充电泵 LED 驱动器

maintainers:
  - Luca Weiss <luca@z3ntu.xyz>

description: |
  SGM3140 是一个受电流调节的充电泵，它可以为闪光和手电筒模式调节两个电流水平。
数据手册可以在以下位置找到：
    http://www.sg-micro.com/uploads/soft/20190626/1561535688.pdf

properties:
  compatible:
    enum:
      - ocs,ocp8110
      - richtek,rt5033-led
      - sgmicro,sgm3140

  enable-gpios:
    maxItems: 1
    description: 连接到 'EN' 引脚
  flash-gpios:
    maxItems: 1
    description: 连接到 'FLASH' 引脚
  vin-supply:
    description: 向 'VIN' 引脚供电的稳压器
  led:
    type: object
    $ref: common.yaml#
    unevaluatedProperties: false

required:
  - compatible
  - flash-gpios
  - enable-gpios

additionalProperties: false

examples:
  - |
    #include <dt-bindings/gpio/gpio.h>
    #include <dt-bindings/leds/common.h>

    led-controller {
        compatible = "sgmicro,sgm3140";
        flash-gpios = <&pio 3 24 GPIO_ACTIVE_HIGH>; /* PD24 */
        enable-gpios = <&pio 2 3 GPIO_ACTIVE_HIGH>; /* PC3 */
        vin-supply = <&reg_dcdc1>;

        sgm3140_flash: led {
            function = LED_FUNCTION_FLASH;
            color = <LED_COLOR_ID_WHITE>;
            flash-max-timeout-us = <250000>;
        };
    };
```
~~~~

## Documentation/devicetree/bindings/leds/leds-spi-byte_cn.txt
~~~~
* 单字节 SPI LED 设备驱动程序
该驱动程序可用于具有非常简单的 SPI 协议的控制器：
- 一个 LED 由 MOSI 上的一个字节控制
- 字节的值给出了两个值之间的亮度（最低到最高）
- 不需要返回值（无需 MISO 信号）

最低和最高的亮度值取决于设备，因此也取决于兼容字符串。
根据兼容字符串，某些特殊功能（如硬件加速闪烁）也可能得到支持。
目前，该驱动程序仅支持一个 LED。LED 的属性在设备节点下的子节点中配置。

必需的属性：
- 兼容性：应为以下之一
   * "ubnt,acb-spi-led"		基于微控制器（SONiX 8F26E611LA）的设备
				例如，在Ubiquiti airCube ISP中使用

在文档 `Documentation/devicetree/bindings/spi/spi-bus.txt` 中描述了属性规则。

LED 子节点属性：
- 标签（label）：
	参见文档 `Documentation/devicetree/bindings/leds/common.txt`
- 默认状态（default-state）：
	参见文档 `Documentation/devicetree/bindings/leds/common.txt`
	仅支持 "on" 和 "off"

示例：

```
led-controller@0 {
	compatible = "ubnt,acb-spi-led";
	reg = <0>;
	spi-max-frequency = <100000>;

	led {
		label = "white:status";
		default-state = "on";
	};
};
```
~~~~

## Documentation/devicetree/bindings/leds/leds-tlc591xx_cn.txt
~~~~
连接到 TLC59116 或 TLC59108 的 LED

所需属性：
- compatible：应为 "ti,tlc59116" 或 "ti,tlc59108"
- #address-cells：必须是 1
- #size-cells：必须是 0
- reg：通常为 0x68

每个 LED 作为 ti,tlc59116 的子节点表示。
请参阅文档/设备树/绑定/LEDs/common.txt

LED 子节点属性：
- reg：LED 线路编号，范围从 0 到 15（对于 TLC59116）或 0 到 7（对于 TLC59108）
- label：（可选）LED 名称
- linux,default-trigger ：（可选）

示例：

```plaintext
tlc59116@68 {
	#address-cells = <1>;
	#size-cells = <0>;
	compatible = "ti,tlc59116";
	reg = <0x68>;

	wan@0 {
		label = "wrt1900ac:amber:wan";
		reg = <0x0>;
	};

	2g@2 {
		label = "wrt1900ac:white:2g";
		reg = <0x2>;
	};

	alive@9 {
		label = "wrt1900ac:green:alive";
		reg = <0x9>;
		linux,default_trigger = "heartbeat";
	};
};
```

这个配置示例展示了如何定义一个与 TLC59116 LED 驱动器相连的 LED 组。其中，`tlc59116@68` 是主节点，它包含了几个子节点，每个子节点代表一个 LED，并且每个 LED 都有自己的 `reg` 属性来指定其线路编号。此外，还可以为 LED 指定一个可选的 `label` 和触发器 `linux,default_trigger`。
~~~~

## Documentation/devicetree/bindings/leds/maxim,max77693_cn.yaml
~~~~yaml
```yaml
# SPDX-许可证标识符: GPL-2.0-only 或 BSD-2-Clause
%YAML 1.2
---
$id: http://devicetree.org/schemas/leds/maxim,max77693.yaml#
$schema: http://devicetree.org/meta-schemas/core.yaml#

title: Maxim MAX77693 MicroUSB 和伴侣电源管理集成电路 (PMIC) LED

maintainers:
  - Krzysztof Kozlowski <krzk@kernel.org>

description: |
  这是针对 Maxim MAX77693 MicroUSB 集成电路 (MUIC) 的设备树绑定的一部分。
  有两个可用的 LED 输出 —— FLED1 和 FLED2。它们可以分别控制单独的 LED，
  或者可以连接在一起以将单一连接 LED 的最大电流加倍。一个 LED 由一个子节点表示。
  请参阅 Documentation/devicetree/bindings/mfd/maxim,max77693.yaml 获取更多信息和示例。

properties:
  compatible:
    const: maxim,max77693-led

  maxim,boost-mode:
    description:
      在升压模式下，该设备可以在两个输出上产生最多 1.2A 的总电流。
      每个输出的最大电流减少到 625mA。如果没有明确启用，则升压设置默认为 LEDS_BOOST_FIXED，
      当使用两个电流源时。
      请参见 include/dt-bindings/leds/common.h 中的 LEDS_BOOST_*。
    $ref: /schemas/types.yaml#/definitions/uint32
    enum: [0, 1, 2]

  maxim,boost-mvout:
    description: |
      升压模块的输出电压（毫伏）。
      有效值：3300 - 5500，每 25 步进（向下取整）。
    $ref: /schemas/types.yaml#/definitions/uint32
    minimum: 3300
    maximum: 5500
    default: 3300

  maxim,mvsys-min:
    description: |
      低输入电压水平（毫伏）。如果芯片估计系统电压可能因闪光灯消耗而降至此水平以下，则不会触发闪光。
      有效值：2400 - 3400，每 33 步进（向下取整）。
    $ref: /schemas/types.yaml#/definitions/uint32
    minimum: 2400
    maximum: 3400
    default: 2400

patternProperties:
  "^([a-z]+-)?led[01]?$":
    type: object
    $ref: common.yaml#
    unevaluatedProperties: false

    properties:
      led-sources:
        allOf:
          - minItems: 1
            maxItems: 2
            items:
              minimum: 0
              maximum: 1

      led-max-microamp:
        description: |
          连接到一个 FLED 输出的 LED 的有效值：
            15625 - 250000，每 15625 步进（向下取整）。
          连接到两个 FLED 输出的 LED 的有效值：
            15625 - 500000，每 15625 步进（向下取整）。

      flash-max-microamp:
        description: |
          连接到一个 FLED 输出的单个 LED 的有效值（必须关闭升压模式）：
            15625 - 1000000，每 15625 步进（向下取整）。
          连接到两个 FLED 输出的单个 LED 的有效值：
            15625 - 1250000，每 15625 步进（向下取整）。
          两个 LED 的情况下的有效值：
            15625 - 625000，每 15625 步进（向下取整）。

      flash-max-timeout-us:
        description: |
          有效值：62500 - 1000000，每 62500 步进（向下取整）。
        minimum: 62500
        maximum: 1000000

    required:
      - flash-max-microamp
      - flash-max-timeout-us
      - led-max-microamp
      - led-sources

required:
  - compatible

additionalProperties: false
```
以上是您提供的 YAML 文档的中文翻译。请注意，某些专有名词和技术术语未被翻译，因为它们在中文环境中通常仍使用其英文形式。
~~~~
