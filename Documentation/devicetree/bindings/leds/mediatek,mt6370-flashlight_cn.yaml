## Documentation/devicetree/bindings/leds/register-bit-led_cn.yaml
```yaml
# SPDX-许可证标识符: (GPL-2.0-only 或 BSD-2-Clause)
%YAML 1.2
---
$id: http://devicetree.org/schemas/leds/register-bit-led.yaml#
$schema: http://devicetree.org/meta-schemas/core.yaml#

标题: 注册位 LED

维护者:
  - Linus Walleij <linus.walleij@linaro.org>

描述: |+
  注册位 LED 用于与 syscon 多功能设备一起工作，在特定寄存器中的单个位可以打开/关闭一个 LED。注册位 LED 作为 syscon 设备的子节点出现，并带有正确的兼容字符串。
关于 syscon 绑定，请参阅：
  文档/devicetree/bindings/mfd/syscon.yaml

allOf:
  - $ref: /schemas/leds/common.yaml#

属性:
  $nodename:
    描述:
      单元地址形式为 @<寄存器地址>,<位偏移>
    模式: '^led@[0-9a-f]+,[0-9a-f]{1,2}$'

  compatible:
    常量: register-bit-led

  reg:
    描述:
      寄存器地址和大小
    最大项数: 1

  mask:
    描述:
      控制此 LED 的寄存器中该位的掩码
    $ref: /schemas/types.yaml#/definitions/uint32
    枚举:
      [ 0x1, 0x2, 0x4, 0x8, 0x10, 0x20, 0x40, 0x80, 0x100, 0x200, 0x400, 0x800,
        0x1000, 0x2000, 0x4000, 0x8000, 0x10000, 0x20000, 0x40000, 0x80000,
        0x100000, 0x200000, 0x400000, 0x800000, 0x1000000, 0x2000000, 0x4000000,
        0x8000000, 0x10000000, 0x20000000, 0x40000000, 0x80000000 ]

  offset:
    描述:
      控制此 LED 的寄存器的偏移量
    $ref: /schemas/types.yaml#/definitions/uint32
    过时: true

必需:
  - compatible
  - mask
  - reg

未评估属性: false

示例:
  - |

    syscon@10000000 {
        compatible = "arm,realview-pb1176-syscon", "syscon", "simple-mfd";
        reg = <0x10000000 0x1000>;
        #address-cells = <1>;
        #size-cells = <1>;
        ranges = <0x0 0x10000000 0x1000>;

        led@8,0 {
            compatible = "register-bit-led";
            reg = <0x08 0x04>;
            offset = <0x08>;
            mask = <0x01>;
            label = "versatile:0";
            linux,default-trigger = "heartbeat";
            default-state = "on";
        };
        led@8,1 {
            compatible = "register-bit-led";
            reg = <0x08 0x04>;
            offset = <0x08>;
            mask = <0x02>;
            label = "versatile:1";
            default-state = "off";
        };
        led@8,2 {
            compatible = "register-bit-led";
            reg = <0x08 0x04>;
            offset = <0x08>;
            mask = <0x04>;
            label = "versatile:2";
            default-state = "off";
        };
    };
..
```

## Documentation/devicetree/bindings/leds/regulator-led_cn.yaml
```yaml
# SPDX-许可证标识符: (GPL-2.0-only 或 BSD-2-Clause)
%YAML 1.2
---
$id: http://devicetree.org/schemas/leds/regulator-led.yaml#
$schema: http://devicetree.org/meta-schemas/core.yaml#

title: 电压调节器控制的 LED

maintainers:
  - Linus Walleij <linus.walleij@linaro.org>

description: |
  由单个电压调节器供电的 LED 可以通过启用或禁用该调节器来打开或关闭。
  可用的亮度设置将根据调节器上的可用电压进行推断，并且任何关于电压或电流的约束都需要在调节器上指定。
allOf:
  - $ref: common.yaml#

properties:
  $nodename:
    pattern: '^led.*$'

  compatible:
    const: regulator-led

  vled-supply:
    description:
      控制 LED 电流的电压调节器
    function: true
  color: true
  linux,default-trigger: true
  default-state: true

required:
  - compatible
  - vled-supply

additionalProperties: false

examples:
  - |
    #include <dt-bindings/leds/common.h>

    led-heartbeat {
        compatible = "regulator-led";
        vled-supply = <&regulator>;
        function = LED_FUNCTION_STATUS;
        color = <LED_COLOR_ID_BLUE>;
        linux,default-trigger = "heartbeat";
    };
```

## Documentation/devicetree/bindings/leds/richtek,rt8515_cn.yaml
```yaml
# SPDX-文件许可人: (GPL-2.0-only 或 BSD-2-Clause)
%YAML 1.2
---
$id: http://devicetree.org/schemas/leds/richtek,rt8515.yaml#
$schema: http://devicetree.org/meta-schemas/core.yaml#

title: Richtek RT8515 1.5A 双通道 LED 驱动器

maintainers:
  - Linus Walleij <linus.walleij@linaro.org>

description: |
  Richtek RT8515 是一款双通道（两种模式）的 LED 驱动器，支持驱动白色 LED 在闪光或手电筒模式下工作。每个模式的最大电流由硬件中的两个电阻 RFS 和 RTS 定义。
properties:
  compatible:
    const: richtek,rt8515

  enf-gpios:
    maxItems: 1
    description: 连接到“ENF”（启用闪光）引脚的连接
  ent-gpios:
    maxItems: 1
    description: 连接到“ENT”（启用手电筒）引脚的连接
  richtek,rfs-ohms:
    minimum: 7680
    maximum: 367000
    description: RFS 电阻的阻值。该电阻限制了最大闪光电流。此属性必须设置以使 flash-max-microamp 属性生效，RFS 电阻定义了闪光 LED 的调光设置（亮度）范围
  richtek,rts-ohms:
    minimum: 7680
    maximum: 367000
    description: RTS 电阻的阻值。该电阻限制了最大手电筒电流。此属性必须设置以使 torch-max-microamp 属性生效，RTS 电阻定义了手电筒 LED 的调光设置（亮度）范围
  led:
    type: object
    $ref: common.yaml#
    properties:
      function: true
      color: true
      flash-max-timeout-us: true

      flash-max-microamp:
        maximum: 700000
        description: 闪光模式下的最大电流是通过将 RFS 电阻接地硬连线到组件中。最大硬件电流设置根据公式 Imax = 5500 / RFS 计算。允许的最低电阻值为 7.86 kOhm，给出绝对最大电流为 700mA。通过在设备树中设置此属性，您可以进一步限制最大电流低于硬件限制。这需要定义 RFS，因为它定义了最大范围
      led-max-microamp:
        maximum: 700000
        description: 手电筒模式下的最大电流是通过将 RTS 电阻接地硬连线到组件中。最大硬件电流设置根据公式 Imax = 5500 / RTS 计算。允许的最低电阻值为 7.86 kOhm，给出绝对最大电流为 700mA。通过在设备树中设置此属性，您可以进一步限制最大电流低于硬件限制。这需要定义 RTS，因为它定义了最大范围
additionalProperties: false

required:
  - compatible
  - ent-gpios
  - enf-gpios
  - led

additionalProperties: false

examples:
  - |
    #include <dt-bindings/gpio/gpio.h>
    #include <dt-bindings/leds/common.h>

    led-controller {
        compatible = "richtek,rt8515";
        enf-gpios = <&gpio4 12 GPIO_ACTIVE_HIGH>;
        ent-gpios = <&gpio4 13 GPIO_ACTIVE_HIGH>;
        richtek,rfs-ohms = <16000>;
        richtek,rts-ohms = <100000>;

        led {
            function = LED_FUNCTION_FLASH;
            color = <LED_COLOR_ID_WHITE>;
            flash-max-timeout-us = <250000>;
            flash-max-microamp = <150000>;
            led-max-microamp = <25000>;
        };
    };
```

## Documentation/devicetree/bindings/leds/rohm,bd2606mvv_cn.yaml
```yaml
# SPDX-许可证标识符: GPL-2.0-only 或 BSD-2-Clause
%YAML 1.2
---
$id: http://devicetree.org/schemas/leds/rohm,bd2606mvv.yaml#
$schema: http://devicetree.org/meta-schemas/core.yaml#

标题: ROHM BD2606MVV LED 控制器

维护者:
  - 安德烈亚斯·凯姆纳德 <andreas@kemnade.info>

描述:
  BD2606 MVV 是一款通过 I2C 连接的可编程 LED 控制器，可以驱动 6 条独立线路。每条线路都可以单独开关，但亮度设置是在它们的配对之间共享的。
数据手册可在以下位置获取:
  https://fscdn.rohm.com/en/products/databook/datasheet/ic/power/led_driver/bd2606mvv_1-e.pdf

属性:
  compatible:
    常量: rohm,bd2606mvv

  reg:
    最大项数: 1

  "#address-cells":
    常量: 1

  "#size-cells":
    常量: 0

  enable-gpios:
    最大项数: 1
    描述: 用于启用/禁用设备的 GPIO 引脚
模式属性:
  "^led@[0-5]$":
    类型: 对象
    $ref: common.yaml#
    未评估属性: false

    属性:
      reg:
        最小值: 0
        最大值: 5

    必需:
      - reg

额外属性: false

示例:
  - |
    #include <dt-bindings/leds/common.h>

    i2c {
        #address-cells = <1>;
        #size-cells = <0>;

        led-controller@66 {
            compatible = "rohm,bd2606mvv";
            reg = <0x66>;
            #address-cells = <1>;
            #size-cells = <0>;

            led@0 {
                reg = <0x0>;
                color = <LED_COLOR_ID_RED>;
                function = LED_FUNCTION_POWER;
            };

            led@2 {
                reg = <0x2>;
                color = <LED_COLOR_ID_WHITE>;
                function = LED_FUNCTION_STATUS;
            };
        };
    };

..
```

## Documentation/devicetree/bindings/leds/rohm,bd71828-leds_cn.yaml
```yaml
# SPDX-许可证标识符: GPL-2.0-only 或 BSD-2-Clause
%YAML 1.2
---
$id: http://devicetree.org/schemas/leds/rohm,bd71828-leds.yaml#
$schema: http://devicetree.org/meta-schemas/core.yaml#

title: ROHM BD71828 电源管理集成电路 LED 驱动器

maintainers:
  - Matti Vaittinen <mazziesaccount@gmail.com>

description: |
  本模块是 ROHM BD71828 多功能设备的一部分。更多详细信息请参见
  文档/devicetree/bindings/mfd/rohm,bd71828-pmic.yaml。
  LED 控制器在设备树中表示为 PMIC 节点的子节点。
  设备有两个 LED 输出，在数据手册中分别称为 GRNLED 和 AMBLED。

properties:
  compatible:
    const: rohm,bd71828-leds

patternProperties:
  "^led-[1-2]$":
    $ref: common.yaml#
    unevaluatedProperties: false

    properties:
      rohm,led-compatible:
        description: LED 标识字符串
        $ref: /schemas/types.yaml#/definitions/string
        enum:
          - bd71828-ambled
          - bd71828-grnled

required:
  - compatible
additionalProperties: false

..
```

## Documentation/devicetree/bindings/leds/silergy,sy7802_cn.yaml
```yaml
下面是给定内容的中文翻译：

# SPDX-文件许可标识符: (GPL-2.0-only 或 BSD-2-Clause)
%YAML 1.2
---
$id: http://devicetree.org/schemas/leds/silergy,sy7802.yaml#
$schema: http://devicetree.org/meta-schemas/core.yaml#

标题: Silergy SY7802 1800mA 升压电荷泵 LED 驱动器

维护者:
  - André Apitzsch <git@apitzsch.eu>

描述: |
  SY7802 是一款电流调节型电荷泵，它可以为闪光模式和手电筒模式调节两个电流水平。
  SY7802 是一款大电流同步升压转换器，具有双通道高边电流源。每个通道可以提供 900mA 的电流。

属性:
  compatible:
    枚举:
      - silergy,sy7802

  reg:
    最大项数: 1

  enable-gpios:
    最大项数: 1
    描述: 连接到 'EN' 引脚
  flash-gpios:
    最大项数: 1
    描述: 连接到 'FLEN' 引脚
  vin-supply:
    描述: 向 'VIN' 引脚供电的稳压器
  "#address-cells":
    常量: 1

  "#size-cells":
    常量: 0

  patternProperties:
    "^led@[0-1]$":
      类型: 对象
      $ref: common.yaml#
      不评估属性: false

      属性:
        reg:
          描述: LED 的索引
          最小值: 0
          最大值: 1

        led-sources:
          最少项数: 1
          最大项数: 2
          项:
            最小值: 0
            最大值: 1

      必需:
        - reg
        - led-sources

必需:
  - compatible
  - reg
  - "#address-cells"
  - "#size-cells"
  - enable-gpios

额外属性: false

示例:
  - |
    #include <dt-bindings/gpio/gpio.h>
    #include <dt-bindings/leds/common.h>

    i2c {
        #address-cells = <1>;
        #size-cells = <0>;

        flash-led-controller@53 {
            compatible = "silergy,sy7802";
            reg = <0x53>;
            #address-cells = <1>;
            #size-cells = <0>;

            enable-gpios = <&tlmm 16 GPIO_ACTIVE_HIGH>;

            led@0 {
                reg = <0>;
                function = LED_FUNCTION_FLASH;
                color = <LED_COLOR_ID_WHITE>;
                led-sources = <0>, <1>;
            };
        };
    };
```

## Documentation/devicetree/bindings/leds/skyworks,aat1290_cn.yaml
~~~~yaml
```yaml
# SPDX-许可证标识符: GPL-2.0-only 或 BSD-2-Clause
%YAML 1.2
---
$id: http://devicetree.org/schemas/leds/skyworks,aat1290.yaml#
$schema: http://devicetree.org/meta-schemas/core.yaml#

title: Skyworks Solutions, Inc. AAT1290 闪光灯电流调节器

maintainers:
  - Jacek Anaszewski <jacek.anaszewski@gmail.com>
  - Krzysztof Kozlowski <krzk@kernel.org>

description: |
  该设备通过两个引脚进行控制：FL_EN 和 EN_SET。当这两个引脚分别置高时，可以启用闪光灯和电影模式（最大为闪光电流的一半）。为了增加选择闪光信号源（例如，CPU或相机传感器）的能力，需要一个额外的开关，该开关独立于闪光芯片。此开关由引脚控制。
properties:
  compatible:
    const: skyworks,aat1290

  enset-gpios:
    maxItems: 1
    description: EN_SET 引脚

  flen-gpios:
    maxItems: 1
    description: FL_EN 引脚

  led:
    $ref: common.yaml#
    unevaluatedProperties: false

    properties:
      led-max-microamp: true

      flash-max-microamp:
        description: |
          最大闪光灯供电电流可以通过以下公式计算：I = 1A * 162 kOhm / Rset

      flash-max-timeout-us:
        description: |
          最大闪光超时时间可以通过以下公式计算：T = 8.82 * 10^9 * Ct
required:
  - flash-max-microamp
  - flash-max-timeout-us
  - led-max-microamp

  pinctrl-names:
    items:
      - const: default
      - const: host
      - const: isp

  pinctrl-0: true
  pinctrl-1: true
  pinctrl-2: true

required:
  - compatible
  - enset-gpios
  - flen-gpios
  - led

additionalProperties: false

examples:
  - |
    #include <dt-bindings/gpio/gpio.h>
    #include <dt-bindings/leds/common.h>

    // Ct = 220 nF, Rset = 160 kOhm
    led-controller {
        compatible = "skyworks,aat1290";
        flen-gpios = <&gpj1 1 GPIO_ACTIVE_HIGH>;
        enset-gpios = <&gpj1 2 GPIO_ACTIVE_HIGH>;

        pinctrl-names = "default", "host", "isp";
        pinctrl-0 = <&camera_flash_host>;
        pinctrl-1 = <&camera_flash_host>;
        pinctrl-2 = <&camera_flash_isp>;

        led {
            function = LED_FUNCTION_FLASH;
            color = <LED_COLOR_ID_WHITE>;
            led-max-microamp = <520833>;
            flash-max-microamp = <1012500>;
            flash-max-timeout-us = <1940000>;
        };
    };
```
请注意，`flash-max-timeout-us` 和 `flash-max-microamp` 在描述部分的翻译中缺少了必要的换行符，这可能会影响阅读的清晰度。在实际文档中，请确保这些长句正确地使用了换行符。
~~~~

## Documentation/devicetree/bindings/leds/ti,tca6507_cn.yaml
```yaml
下面是给定内容的中文翻译：

---

# SPDX-文件许可标识符: GPL-2.0-only
%YAML 1.2
---
$id: http://devicetree.org/schemas/leds/ti,tca6507.yaml#
$schema: http://devicetree.org/meta-schemas/core.yaml#

标题: TCA6507 LED 和 GPIO 控制器

维护者:
  - NeilBrown <neilb@suse.de>

描述:
  TCA6507 是一个通过 I2C 连接的可编程 LED 控制器，可以驱动 7 条独立的线路，既可以将其保持在低电平，也可以通过脉宽调制的方式对其脉冲。
属性:
  compatible:
    常量: ti,tca6507

  reg:
    描述: 控制器的 I2C 从地址
最大项数: 1

  "#address-cells":
    常量: 1

  "#size-cells":
    常量: 0

  gpio-controller: 真

  "#gpio-cells":
    常量: 2

  gpio-line-names: 真

模式属性:
  "^led@[0-6]$":
    类型: 对象
    $ref: common.yaml#
    未评估属性: 假

    属性:
      reg:
        最小值: 0
        最大值: 6

    必需:
      - reg

  "^gpio@[0-6]$":
    类型: 对象

    属性:
      compatible:
        常量: gpio

      reg:
        最小值: 0
        最大值: 6

    额外属性: 假

    必需:
      - reg
      - compatible

如果:
  模式属性:
    "^gpio@[0-6]$":
      类型: 对象
      属性:
        compatible:
          包含:
            常量: gpio
然后:
  必需:
    - gpio-controller
    - "#gpio-cells"

额外属性: 假

示例:
  - |

    #include <dt-bindings/gpio/gpio.h>
    #include <dt-bindings/leds/common.h>

    i2c {
        #address-cells = <1>;
        #size-cells = <0>;

        led-controller@45 {
            compatible = "ti,tca6507";
            #address-cells = <1>;
            #size-cells = <0>;
            reg = <0x45>;

            gpio-controller;
            #gpio-cells = <2>;

            gpio-line-names = "wifi_reset@6";

            led@0 {
                label = "gta04:red:aux";
                reg = <0x0>;
            };

            led@1 {
                label = "gta04:green:aux";
                reg = <0x1>;
            };

            led@3 {
                reg = <0x3>;
                color = <LED_COLOR_ID_RED>;
                function = LED_FUNCTION_POWER;
                linux,default-trigger = "default-on";
            };

            led@4 {
                color = <LED_COLOR_ID_GREEN>;
                function = LED_FUNCTION_POWER;
                reg = <0x4>;
            };

            gpio@6 {
                compatible = "gpio";
                reg = <0x6>;
            };
        };
    };

..
```

## Documentation/devicetree/bindings/loongarch/cpus_cn.yaml
```yaml
下面是给定内容的中文翻译：

# SPDX-许可证标识符: (GPL-2.0-only 或 BSD-2-Clause)
%YAML 1.2
---
$id: http://devicetree.org/schemas/loongarch/cpus.yaml#
$schema: http://devicetree.org/meta-schemas/core.yaml#

标题: 龙芯CPU核心

维护者:
  - 周彬彬 <zhoubinbin@loongson.cn>

描述:
  本文档描述了支持FDT的龙芯CPU核心列表，通过“cpus”节点描述系统中的CPU布局。
全部应满足:
  - $ref: /schemas/cpu.yaml#

属性:
  兼容性:
    枚举:
      - loongson,la264
      - loongson,la364

  reg:
    最大项数: 1

  时钟:
    最大项数: 1

必需:
  - 兼容性
  - reg
  - 时钟

未评估属性: false

示例:
  - |
    #include <dt-bindings/clock/loongson,ls2k-clk.h>

    cpus {
        #size-cells = <0>;
        #address-cells = <1>;

        cpu@0 {
            compatible = "loongson,la264";
            device_type = "cpu";
            reg = <0>;
            clocks = <&clk LOONGSON2_NODE_CLK>;
        };

        cpu@1 {
            compatible = "loongson,la264";
            device_type = "cpu";
            reg = <1>;
            clocks = <&clk LOONGSON2_NODE_CLK>;
        };
    };
```

## Documentation/devicetree/bindings/loongarch/loongson_cn.yaml
```yaml
# SPDX-许可证标识符: (GPL-2.0-only 或 BSD-2-Clause)
%YAML 1.2
---
$id: http://devicetree.org/schemas/loongarch/loongson.yaml#
$schema: http://devicetree.org/meta-schemas/core.yaml#

标题: 基于龙芯处理器的系统板

维护者:
  - 周彬彬 <zhoubinbin@loongson.cn>

属性:
  $nodename:
    const: '/'
  compatible:
    oneOf:
      - 描述: 基于龙芯-2K0500 处理器的板卡
        items:
          - const: loongson,ls2k0500-ref
          - const: loongson,ls2k0500

      - 描述: 基于龙芯-2K1000 处理器的板卡
        items:
          - const: loongson,ls2k1000-ref
          - const: loongson,ls2k1000

      - 描述: 基于龙芯-2K2000 处理器的板卡
        items:
          - const: loongson,ls2k2000-ref
          - const: loongson,ls2k2000

additionalProperties: true

..
```
