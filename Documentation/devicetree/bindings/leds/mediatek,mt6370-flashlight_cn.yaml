## Documentation/devicetree/bindings/leds/mediatek,mt6370-flashlight_cn.yaml
~~~~yaml
```yaml
# SPDX-文件许可标识: (GPL-2.0-only 或 BSD-2-Clause)
%YAML 1.2
---
$id: http://devicetree.org/schemas/leds/mediatek,mt6370-flashlight.yaml#
$schema: http://devicetree.org/meta-schemas/core.yaml#

title: 来自联发科技集成的 MT6370 PMIC 的闪光灯驱动程序
maintainers:
  - Alice Chen <alice_chen@richtek.com>

description: |
  本模块是 MT6370 MFD 设备的一部分。
  添加 MT6370 闪光灯驱动程序，支持两通道闪光灯以及手电筒/闪光模式。

properties:
  compatible:
    const: mediatek,mt6370-flashlight

  "#address-cells":
    const: 1

  "#size-cells":
    const: 0

patternProperties:
  "^led@[0-1]$":
    type: object
    $ref: common.yaml#
    unevaluatedProperties: false

    properties:
      reg:
        enum: [0, 1]

required:
  - compatible
  - "#address-cells"
  - "#size-cells"

additionalProperties: false
```

请注意，某些部分如 `^led@[0-1]$` 是正则表达式，用于匹配以 `led@0` 或 `led@1` 开头的属性。`$ref: common.yaml#` 表示该部分引用了 `common.yaml` 文件中的定义。
~~~~

## Documentation/devicetree/bindings/leds/mediatek,mt6370-indicator_cn.yaml
~~~~yaml
```yaml
# SPDX-文件许可标识: (GPL-2.0-only 或 BSD-2-Clause)
%YAML 1.2
---
$id: http://devicetree.org/schemas/leds/mediatek,mt6370-indicator.yaml#
$schema: http://devicetree.org/meta-schemas/core.yaml#

title: 来自联发科技的 MT6370 PMIC 的 LED 驱动程序
maintainers:
  - Alice Chen <alice_chen@richtek.com>

description: |
  本模块是 MT6370 MFD 设备的一部分。
  添加 MT6370 LED 驱动，包括对 4 通道 RGB LED 的支持、寄存器/PWM/呼吸模式。

properties:
  compatible:
    const: mediatek,mt6370-indicator

  "#address-cells":
    const: 1

  "#size-cells":
    const: 0

patternProperties:
  "^multi-led@[0-3]$":
    type: object
    $ref: leds-class-multicolor.yaml#
    unevaluatedProperties: false

    properties:
      reg:
        enum: [0, 1, 2, 3]

      "#address-cells":
        const: 1

      "#size-cells":
        const: 0

    patternProperties:
      "^led@[0-2]$":
        type: object
        $ref: common.yaml#
        unevaluatedProperties: false

        properties:
          reg:
            enum: [0, 1, 2]

        required:
          - reg
          - color

    required:
      - reg
      - color
      - "#address-cells"
      - "#size-cells"

  "^led@[0-3]$":
    type: object
    $ref: common.yaml#
    unevaluatedProperties: false

    properties:
      reg:
        enum: [0, 1, 2, 3]

    required:
      - reg
      - color

required:
  - compatible
  - "#address-cells"
  - "#size-cells"

additionalProperties: false
```

请注意，由于 YAML 文件的特殊性，上述翻译尽可能保持了原文件的结构和格式。对于一些专有名词和术语（如`$schema`），没有进行翻译以保持其原有的含义。
~~~~

## Documentation/devicetree/bindings/leds/nxp,pca953x_cn.yaml
```yaml
# SPDX-文件许可人: (GPL-2.0-only 或 BSD-2-Clause)
%YAML 1.2
---
$id: http://devicetree.org/schemas/leds/nxp,pca953x.yaml#
$schema: http://devicetree.org/meta-schemas/core.yaml#

标题: NXP PCA9532 LED 调光器

维护者:
  - Riku Voipio <riku.voipio@iki.fi>

描述: |
  PCA9532 系列是针对调光 LED 进行优化的 SMBus I/O 扩展器。
  PWM 支持 256 个步骤。
  更多产品信息请参见以下链接：
    https://www.nxp.com/docs/en/data-sheet/PCA9532.pdf

属性:
  compatible:
    枚举:
      - nxp,pca9530
      - nxp,pca9531
      - nxp,pca9532
      - nxp,pca9533

  reg:
    maxItems: 1

  gpio-controller: true

  gpio-line-names:
    minItems: 1
    maxItems: 16

  '#gpio-cells':
    常量: 2

模式属性:
  "^led-[0-9a-z]+$":
    类型: 对象
    $ref: common.yaml#
    unevaluatedProperties: false

    属性:
      type:
        描述: |
          输出配置，参见 include/dt-bindings/leds/leds-pca9532.h
        $ref: /schemas/types.yaml#/definitions/uint32
        默认值: 0
        最小值: 0
        最大值: 4

必需:
  - compatible
  - reg

额外属性: false

示例:
  - |
    #include <dt-bindings/leds/leds-pca9532.h>

    i2c {
        #address-cells = <1>;
        #size-cells = <0>;

        led-controller@62 {
            compatible = "nxp,pca9533";
            reg = <0x62>;

            led-1 {
                label = "pca:red:power";
                type = <PCA9532_TYPE_LED>;
            };

            led-2 {
                label = "pca:green:power";
                type = <PCA9532_TYPE_LED>;
            };

            led-3 {
                type = <PCA9532_TYPE_LED>;
                default-state = "on";
            };

            led-4 {
                type = <PCA9532_TYPE_LED>;
                default-state = "keep";
            };
        };
    };

..
```

## Documentation/devicetree/bindings/leds/nxp,pca963x_cn.yaml
```yaml
# SPDX-许可证标识符: GPL-2.0-only 或 BSD-2-Clause
%YAML 1.2
---
$id: http://devicetree.org/schemas/leds/nxp,pca963x.yaml#
$schema: http://devicetree.org/meta-schemas/core.yaml#

标题: NXP PCA963x LED 控制器

维护者:
  - Laurent Pinchart <laurent.pinchart@ideasonboard.com>

描述: |
  NXP PCA963x 是用于通过 I2C 控制的 LED 驱动器，特别针对
  红色/绿色/蓝色/琥珀色 (RGBA) 颜色混合应用进行了优化。每个 LED
  都可以独立控制，并且拥有自己的脉冲宽度调制 (PWM) 控制器。
数据手册可从以下网址获取:

  - https://www.nxp.com/docs/en/data-sheet/PCA9632.pdf
  - https://www.nxp.com/docs/en/data-sheet/PCA9633.pdf
  - https://www.nxp.com/docs/en/data-sheet/PCA9634.pdf
  - https://www.nxp.com/docs/en/data-sheet/PCA9635.pdf

属性:
  compatible:
    枚举:
      - nxp,pca9632
      - nxp,pca9633
      - nxp,pca9634
      - nxp,pca9635

  reg:
    最大项数: 1

  "#address-cells":
    常量: 1

  "#size-cells":
    常量: 0

  nxp,hw-blink:
    类型: 布尔值
    描述:
      使用硬件闪烁而非软件闪烁

  nxp,inverted-out:
    类型: 布尔值
    描述:
      反转生成的 PWM 的极性

  nxp,period-scale:
    $ref: /schemas/types.yaml#/definitions/uint32
    描述:
      在某些配置下，芯片的闪烁速度比预期快。此参数提供了一个缩放比例（固定点，小数除以 1000）
      作为补偿，例如 1300=1.3倍 和 750=0.75倍

  nxp,totem-pole:
    类型: 布尔值
    描述:
      使用图腾柱 (推挽) 而非开漏 (pca9632 默认为开漏，新芯片默认为图腾柱)

模式属性:
  "^led@[0-9a-f]+$":
    类型: 对象
    $ref: common.yaml#
    未评估属性: false

    属性:
      reg:
        最小值: 0

    必需:
      - reg

allOf:
  - 如果:
      属性:
        compatible:
          包含:
            枚举:
              - nxp,pca9632
              - nxp,pca9633
    那么:
      模式属性:
        "^led@[0-9a-f]+$":
          属性:
            reg:
              最大值: 3
    否则:
      模式属性:
        "^led@[0-9a-f]+$":
          属性:
            reg:
              最大值: 7

额外属性: false

示例:
  - |
    #include <dt-bindings/leds/common.h>

    i2c {
        #address-cells = <1>;
        #size-cells = <0>;

        led-controller@62 {
            compatible = "nxp,pca9632";
            reg = <0x62>;
            #address-cells = <1>;
            #size-cells = <0>;

            led@0 {
                    reg = <0>;
                    color = <LED_COLOR_ID_RED>;
                    function = LED_FUNCTION_STATUS;
            };

            led@1 {
                    reg = <1>;
                    color = <LED_COLOR_ID_GREEN>;
                    function = LED_FUNCTION_STATUS;
            };

            led@2 {
                    reg = <2>;
                    color = <LED_COLOR_ID_BLUE>;
                    function = LED_FUNCTION_STATUS;
            };

            led@3 {
                    reg = <3>;
                    color = <LED_COLOR_ID_WHITE>;
                    function = LED_FUNCTION_STATUS;
            };
        };
    };
```

## Documentation/devicetree/bindings/leds/nxp,pca995x_cn.yaml
```yaml
# SPDX-许可证标识符: GPL-2.0-only 或 BSD-2-Clause
%YAML 1.2
---
$id: http://devicetree.org/schemas/leds/nxp,pca995x.yaml#
$schema: http://devicetree.org/meta-schemas/core.yaml#

标题: NXP PCA995x LED 控制器

维护者:
  - Isai Gaspar <isaiezequiel.gaspar@nxp.com>
  - Marek Vasut <marex@denx.de>

描述:
  NXP PCA9952/PCA9955B 是通过 I2C 连接的可编程 LED 控制器，可以驱动 16 条独立线路。每条线路都可以单独开关，并且可以通过独立的 PWM 控制亮度。
数据手册可在以下位置获取：
  https://www.nxp.com/docs/en/data-sheet/PCA9952_PCA9955.pdf
  https://www.nxp.com/docs/en/data-sheet/PCA9955B.pdf

属性:
  compatible:
    枚举:
      - nxp,pca9952
      - nxp,pca9955b

  reg:
    maxItems: 1

  "#address-cells":
    常量: 1

  "#size-cells":
    常量: 0

模式属性:
  "^led@[0-9a-f]+$":
    类型: 对象
    $ref: common.yaml#
    未评估属性: false

    属性:
      reg:
        最小值: 0
        最大值: 15

    必需:
      - reg

额外属性: false

示例:
  - |
    #include <dt-bindings/leds/common.h>

    i2c {
        #address-cells = <1>;
        #size-cells = <0>;

        led-controller@1 {
            compatible = "nxp,pca9955b";
            reg = <0x01>;
            #address-cells = <1>;
            #size-cells = <0>;

            led@0 {
                reg = <0x0>;
                color = <LED_COLOR_ID_RED>;
                function = LED_FUNCTION_POWER;
            };

            led@2 {
                reg = <0x2>;
                color = <LED_COLOR_ID_WHITE>;
                function = LED_FUNCTION_STATUS;
            };
        };
    };
```

## Documentation/devicetree/bindings/leds/onnn,ncp5623_cn.yaml
~~~~yaml
```yaml
# SPDX-许可证标识符: (GPL-2.0-only 或 BSD-2-Clause)
%YAML 1.2
---
$id: http://devicetree.org/schemas/leds/onnn,ncp5623.yaml#
$schema: http://devicetree.org/meta-schemas/core.yaml#

title: ON 半导体 NCP5623 多 LED 驱动器

maintainers:
  - Abdel Alkuor <alkuor@gmail.com>

description:
  NCP5623 三输出 I2C 控制 LED 驱动器
https://www.onsemi.com/pdf/datasheet/ncp5623-d.pdf

properties:
  compatible:
    enum:
      - onnn,ncp5623

  reg:
    const: 0x38

  multi-led:
    type: object
    $ref: leds-class-multicolor.yaml#
    unevaluatedProperties: false

    properties:
      "#address-cells":
        const: 1

      "#size-cells":
        const: 0

    patternProperties:
      "^led@[0-2]$":
        type: object
        $ref: common.yaml#
        unevaluatedProperties: false

        properties:
          reg:
            minimum: 0
            maximum: 2

        required:
          - reg
          - color

    required:
      - "#address-cells"
      - "#size-cells"

required:
  - compatible
  - reg
  - multi-led

additionalProperties: false

examples:
  - |
    #include <dt-bindings/leds/common.h>

    i2c {
        #address-cells = <1>;
        #size-cells = <0>;

        led-controller@38 {
            compatible = "onnn,ncp5623";
            reg = <0x38>;

            multi-led {
                color = <LED_COLOR_ID_RGB>;

                #address-cells = <1>;
                #size-cells = <0>;

                led@0 {
                    reg = <0>;
                    color = <LED_COLOR_ID_RED>;
                };

                led@1 {
                    reg = <1>;
                    color = <LED_COLOR_ID_GREEN>;
                };

                led@2 {
                    reg = <2>;
                    color = <LED_COLOR_ID_BLUE>;
                };
            };
        };
    };
```

以上是将原文翻译成中文的 YAML 格式文件。请注意，某些英文缩写和专有名词保持了原文的形式，以避免歧义或技术上的错误。
~~~~

## Documentation/devicetree/bindings/leds/panasonic,an30259a_cn.yaml
```yaml
# SPDX-许可证标识符: GPL-2.0
%YAML 1.2
---
$id: http://devicetree.org/schemas/leds/panasonic,an30259a.yaml#
$schema: http://devicetree.org/meta-schemas/core.yaml#

标题: Panasonic AN30259A 三通道 LED 控制器

维护者:
  - Iskren Chernev <me@iskren.info>

描述:
  AN30259A 是一个 LED 控制器，能够独立驱动三个 LED。
它支持恒流输出和斜率电流输出模式。该芯片通过 I2C 连接。

属性:
  compatible:
    常量: panasonic,an30259a

  reg:
    最大项数: 1

  interrupts:
    最大项数: 1

  "#address-cells":
    常量: 1

  "#size-cells":
    常量: 0

模式属性:
  "^led@[1-3]$":
    $ref: common.yaml#
    不评估属性: false

    属性:
      reg:
        枚举: [ 1, 2, 3 ]

必需:
  - compatible
  - reg
  - "#address-cells"
  - "#size-cells"

额外属性: false

示例:
  - |
    #include <dt-bindings/leds/common.h>

    i2c {
        #address-cells = <1>;
        #size-cells = <0>;

        led-controller@30 {
            compatible = "panasonic,an30259a";
            reg = <0x30>;
            #address-cells = <1>;
            #size-cells = <0>;

            led@1 {
                reg = <1>;
                linux,default-trigger = "heartbeat";
                function = LED_FUNCTION_INDICATOR;
                color = <LED_COLOR_ID_RED>;
            };

            led@2 {
                reg = <2>;
                function = LED_FUNCTION_INDICATOR;
                color = <LED_COLOR_ID_GREEN>;
            };

            led@3 {
                reg = <3>;
                function = LED_FUNCTION_INDICATOR;
                color = <LED_COLOR_ID_BLUE>;
            };
        };
    };
..
```

## Documentation/devicetree/bindings/leds/qcom,pm8058-led_cn.yaml
```yaml
# SPDX-许可证标识符: GPL-2.0-only 或 BSD-2-Clause
%YAML 1.2
---
$id: http://devicetree.org/schemas/leds/qcom,pm8058-led.yaml#
$schema: http://devicetree.org/meta-schemas/core.yaml#

title: 高通 PM8058 PMIC LED

maintainers:
  - Krzysztof Kozlowski <krzysztof.kozlowski@linaro.org>

description: |
  高通 PM8058 包含一个 LED 模块，支持最多六个 LED：三个普通 LED、两个“闪光”LED 和一个“键盘背光”LED。名称被引用是因为有时这些 LED 驱动器被用于与闪光或键盘背光完全不同的用途：它们的名字更像是建议而不是硬性规定使用场景。
硬件上，不同类型的 LED 支持稍有不同的输出电流。
“闪光”LED 不需要充电，也不支持外部触发；它们只是强大的 LED 驱动器。
allOf:
  - $ref: common.yaml#

properties:
  compatible:
    enum:
      - qcom,pm8058-led
      - qcom,pm8058-keypad-led
      - qcom,pm8058-flash-led

  reg:
    maxItems: 1

required:
  - compatible
  - reg

unevaluatedProperties: false

examples:
  - |
    #include <dt-bindings/leds/common.h>

    pmic {
        #address-cells = <1>;
        #size-cells = <0>;

        led@131 {
            compatible = "qcom,pm8058-led";
            reg = <0x131>;
            label = "pm8058:red";
            color = <LED_COLOR_ID_RED>;
            default-state = "off";
        };
    };
```

## Documentation/devicetree/bindings/leds/qcom,spmi-flash-led_cn.yaml
```yaml
# SPDX-文件许可人: (GPL-2.0-only 或 BSD-2-Clause)
%YAML 1.2
---
$id: http://devicetree.org/schemas/leds/qcom,spmi-flash-led.yaml#
$schema: http://devicetree.org/meta-schemas/core.yaml#

标题: 高通技术公司 PMIC 内部的闪光灯 LED 设备

维护者:
  - 吴丰林 <quic_fenglinw@quicinc.com>

描述: |
  闪光灯 LED 控制器存在于某些高通技术公司的电源管理集成电路(PMIC)中。
  闪光灯 LED 模块可以支持不同数量的 LED 通道，例如 3 或 4 个。它们之间有一些不同的寄存器，
  但都可以支持每个通道最大 1.5A 的电流，并且还支持将两个通道组合在一起以提供最大 2A 的电流。
  电流会在每个通道上对称分配，并且会同时启用和禁用。

属性:
  compatible:
    items:
      - 枚举:
          - qcom,pm6150l-flash-led
          - qcom,pm8150c-flash-led
          - qcom,pm8150l-flash-led
          - qcom,pm8350c-flash-led
          - qcom,pm8550-flash-led
          - qcom,pmi8998-flash-led
      - 常量: qcom,spmi-flash-led

  reg:
    maxItems: 1

模式属性:
  "^led-[0-3]$":
    类型: 对象
    $ref: common.yaml#
    不评估属性: false
    描述:
      表示连接到闪光灯 LED 通道输出的实际 LED 组件

属性:
      led-sources:
        描述:
          连接到实际 LED 的闪光灯 LED 通道的硬件索引
        全部:
          - 最小项: 1
            最大项: 2
            项:
              枚举: [1, 2, 3, 4]

      led-max-microamp:
        任一:
          - 最小值: 5000
            最大值: 500000
            倍数: 5000
          - 最小值: 10000
            最大值: 1000000
            倍数: 10000

      flash-max-microamp:
        任一:
          - 最小值: 12500
            最大值: 1500000
            倍数: 12500
          - 最小值: 25000
            最大值: 2000000
            倍数: 25000

      flash-max-timeout-us:
        最小值: 10000
        最大值: 1280000
        倍数: 10000

    必需:
      - led-sources
      - led-max-microamp

必需:
  - compatible
  - reg

额外属性: false

示例:
  - |
    #include <dt-bindings/leds/common.h>

    pmic {
        #address-cells = <1>;
        #size-cells = <0>;

        led-controller@ee00 {
            compatible = "qcom,pm8350c-flash-led", "qcom,spmi-flash-led";
            reg = <0xee00>;

            led-0 {
                function = LED_FUNCTION_FLASH;
                color = <LED_COLOR_ID_WHITE>;
                led-sources = <1>, <4>;
                led-max-microamp = <300000>;
                flash-max-microamp = <2000000>;
                flash-max-timeout-us = <1280000>;
                function-enumerator = <0>;
            };

            led-1 {
                function = LED_FUNCTION_FLASH;
                color = <LED_COLOR_ID_YELLOW>;
                led-sources = <2>, <3>;
                led-max-microamp = <300000>;
                flash-max-microamp = <2000000>;
                flash-max-timeout-us = <1280000>;
                function-enumerator = <1>;
            };
        };
    };
```
