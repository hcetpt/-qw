## Documentation/devicetree/bindings/mfd/88pm860x_cn.txt
~~~~
* Marvell 88PM860x 电源管理IC

所需父设备属性：
- compatible（兼容性）: "marvell,88pm860x"
- reg（寄存器）: 88pm860x 芯片的I2C从地址
- interrupts（中断）: 88pm860x 芯片的IRQ线
- interrupt-controller（中断控制器）: 描述88pm860x作为一个中断控制器（有自己的域）
- #interrupt-cells（中断单元数量）: 应为1
- 单元是88pm860x本地IRQ编号

可选父设备属性：
- marvell,88pm860x-irq-read-clr: 表示中断状态是否通过读取清除
- marvell,88pm860x-slave-addr: 88pm860x 是双芯片解决方案。<reg> 存储一个芯片的I2C地址，而此属性存储另一个芯片的I2C地址

88pm860x 包含一组庞大且多样的子设备：

设备			 Supply Names	 描述
------			 ------------	 -----------
88pm860x-onkey		:		: 开关键
88pm860x-rtc		:		: 实时时钟
88pm8607		:		: 稳压器
88pm860x-backlight	:		: 背光
88pm860x-led		:		: LED灯
88pm860x-touch		:		: 触摸屏

示例：

```text
pmic: 88pm860x@34 { // pmic代表电源管理IC
	compatible = "marvell,88pm860x"; // 兼容性标识
	reg = <0x34>; // I2C从地址
	interrupts = <4>; // IRQ线
	interrupt-parent = <&intc>; // 中断父节点
	interrupt-controller; // 中断控制器声明
	#interrupt-cells = <1>; // 中断单元数量

	marvell,88pm860x-irq-read-clr; // 中断状态是否通过读取清除
	marvell,88pm860x-slave-addr = <0x11>; // 第二个芯片的I2C从地址

	regulators { // 稳压器配置
		BUCK1 { // BUCK1稳压器
			regulator-min-microvolt = <1000000>; // 最小输出电压（微伏特）
			regulator-max-microvolt = <1500000>; // 最大输出电压（微伏特）
			regulator-boot-on; // 在启动时启用
			regulator-always-on; // 始终启用
		};
		LDO1 { // LDO1稳压器
			regulator-min-microvolt = <1200000>; // 最小输出电压（微伏特）
			regulator-max-microvolt = <2800000>; // 最大输出电压（微伏特）
			regulator-boot-on; // 在启动时启用
			regulator-always-on; // 始终启用
		};
	};
	rtc { // 实时时钟配置
		marvell,88pm860x-vrtc = <1>; // 使用实时时钟电源
	};
	touch { // 触摸屏配置
		marvell,88pm860x-gpadc-prebias = <1>; // GPADC预偏置设置
		marvell,88pm860x-gpadc-slot-cycle = <1>; // GPADC槽周期设置
		marvell,88pm860x-tsi-prebias = <6>; // TSI预偏置设置
		marvell,88pm860x-pen-prebias = <16>; // 笔尖预偏置设置
		marvell,88pm860x-pen-prechg = <2>; // 笔尖预充电设置
		marvell,88pm860x-resistor-X = <300>; // X轴电阻设置
	};
	backlights { // 背光配置
		backlight-0 { // 第一个背光
			marvell,88pm860x-iset = <4>; // 电流设置
			marvell,88pm860x-pwm = <3>; // PWM通道
		};
		backlight-2 { // 第二个背光
		};
	};
	leds { // LED配置
		led0-red { // 红色LED
			marvell,88pm860x-iset = <12>; // 电流设置
		};
		led0-green { // 绿色LED
			marvell,88pm860x-iset = <12>; // 电流设置
		};
		led0-blue { // 蓝色LED
			marvell,88pm860x-iset = <12>; // 电流设置
		};
	};
};
```
~~~~

## Documentation/devicetree/bindings/mfd/act8945a_cn.txt
~~~~
### Device Tree 绑定：Active-Semi ACT8945A 多功能设备驱动

**必需的属性:**
- `compatible`: "active-semi,act8945a"
- `reg`: ACT8945A 芯片的 I2C 从地址

该芯片暴露了两个子设备:
- **稳压器**: 请参阅 ../regulator/act8945a-regulator.txt
- **充电器**: 请参阅 ../power/act8945a-charger.txt

**示例:**
```dtl
pmic@5b { // I2C 地址为 0x5b 的电源管理 IC
    compatible = "active-semi,act8945a"; // 兼容性字符串
    reg = <0x5b>; // I2C 地址

    active-semi,vsel-high; // 高电压选择

    regulators { // 稳压器配置
        vdd_1v35_reg: REG_DCDC1 { // DC-DC 转换器 1，输出 1.35V
            regulator-name = "VDD_1V35";
            regulator-min-microvolt = <1350000>; // 最小输出电压（微伏）
            regulator-max-microvolt = <1350000>; // 最大输出电压（微伏）
            regulator-always-on; // 始终开启
        };

        vdd_1v2_reg: REG_DCDC2 { // DC-DC 转换器 2，输出范围 1.1V 至 1.3V
            regulator-name = "VDD_1V2";
            regulator-min-microvolt = <1100000>;
            regulator-max-microvolt = <1300000>;
            regulator-always-on;
        };

        vdd_3v3_reg: REG_DCDC3 { // DC-DC 转换器 3，输出 3.3V
            regulator-name = "VDD_3V3";
            regulator-min-microvolt = <3300000>;
            regulator-max-microvolt = <3300000>;
            regulator-always-on;
        };

        vdd_fuse_reg: REG_LDO1 { // LDO 稳压器 1，输出 2.5V
            regulator-name = "VDD_FUSE";
            regulator-min-microvolt = <2500000>;
            regulator-max-microvolt = <2500000>;
            regulator-always-on;
        };

        vdd_3v3_lp_reg: REG_LDO2 { // LDO 稳压器 2，输出 3.3V
            regulator-name = "VDD_3V3_LP";
            regulator-min-microvolt = <3300000>;
            regulator-max-microvolt = <3300000>;
            regulator-always-on;
        };

        vdd_led_reg: REG_LDO3 { // LDO 稳压器 3，输出 3.3V
            regulator-name = "VDD_LED";
            regulator-min-microvolt = <3300000>;
            regulator-max-microvolt = <3300000>;
            regulator-always-on;
        };

        vdd_sdhc_1v8_reg: REG_LDO4 { // LDO 稳压器 4，输出 1.8V
            regulator-name = "VDD_SDHC_1V8";
            regulator-min-microvolt = <1800000>;
            regulator-max-microvolt = <1800000>;
            regulator-always-on;
        };
    };

    charger { // 充电器配置
        compatible = "active-semi,act8945a-charger"; // 充电器兼容性字符串
        pinctrl-names = "default"; // 引脚控制名称
        pinctrl-0 = <&pinctrl_charger_chglev &pinctrl_charger_lbo &pinctrl_charger_irq>; // 引脚控制配置
        interrupt-parent = <&pioA>; // 中断父节点
        interrupts = <45 IRQ_TYPE_LEVEL_LOW>; // 中断配置

        active-semi,chglev-gpios = <&pioA 12 GPIO_ACTIVE_HIGH>; // 充电状态 GPIO
        active-semi,lbo-gpios = <&pioA 72 GPIO_ACTIVE_LOW>; // 低电量 GPIO
        active-semi,input-voltage-threshold-microvolt = <6600>; // 输入电压阈值（毫伏）
        active-semi,precondition-timeout = <40>; // 预条件超时时间（秒）
        active-semi,total-timeout = <3>; // 总超时时间（秒）
    };
};
```
这个示例展示了如何在 Device Tree 中配置一个使用 Active-Semi ACT8945A 芯片的电源管理 IC。包括了稳压器和充电器的具体配置。
~~~~

## Documentation/devicetree/bindings/mfd/actions,atc260x_cn.yaml
```yaml
下面是给定内容的中文翻译：

# SPDX-许可证标识符: (GPL-2.0-only 或 BSD-2-Clause)
%YAML 1.2
---
$id: http://devicetree.org/schemas/mfd/actions,atc260x.yaml#
$schema: http://devicetree.org/meta-schemas/core.yaml#

标题: Actions Semi ATC260x 电源管理集成电路

维护者:
  - Manivannan Sadhasivam <manivannan.sadhasivam@linaro.org>
  - Cristian Ciocaltea <cristian.ciocaltea@gmail.com>

描述: |
  ATC260x 系列 PMIC 集成了音频编解码器、电源管理、实时时钟、红外线
  和 GPIO 控制器模块。目前仅支持 ATC2603C 和 ATC2609A 芯片变体与电源管理
  相关的功能（即稳压器和系统自动关机/重启）。
  ATC2603C 包括 3 个可编程 DC-DC 转换器，9 个可编程 LDO 稳压器和 1 个固定 LDO 稳压器
  ATC2609A 包括 5 个可编程 DC-DC 转换器和 10 个可编程 LDO 稳压器
allOf:
  - $ref: /schemas/input/input.yaml

属性:
  compatible:
    枚举:
      - actions,atc2603c
      - actions,atc2609a

  reg:
    maxItems: 1

  interrupts:
    maxItems: 1

  reset-time-sec:
    描述: |
      设备自动复位时按键需按下的持续时间（秒）。硬件默认值为 8 秒。使用 0 来禁用此功能
    枚举: [0, 6, 8, 10, 12]

  regulators:
    类型: 对象
    描述: |
      指定稳压器的子节点列表，根据芯片变体不同：
      * ATC2603C: dcdc[1-3], ldo[1-3,5-8,11,12], switchldo1
      * ATC2609A: dcdc[0-4], ldo[0-9]

    属性:
      compatible:
        枚举:
          - actions,atc2603c-regulator
          - actions,atc2609a-regulator

      switchldo1:
        类型: 对象
        $ref: /schemas/regulator/regulator.yaml

        属性:
          regulator-name: true
          regulator-boot-on: true
          regulator-always-on: true
          regulator-min-microvolt: true
          regulator-max-microvolt: true
          regulator-allow-bypass: true
          regulator-active-discharge: true

        additionalProperties: false

    patternProperties:
      "^(dcdc[0-4]|ldo[0-9]|ldo1[1-2]|switchldo1)-supply$":
        描述: ATC260x 电压稳压器供电

      "^(dcdc[0-4]|ldo[0-9]|ldo1[1-2])$":
        类型: 对象
        $ref: /schemas/regulator/regulator.yaml

        属性:
          regulator-name: true
          regulator-boot-on: true
          regulator-always-on: true
          regulator-min-microvolt: true
          regulator-max-microvolt: true
          regulator-allow-bypass: true

        additionalProperties: false

    allOf:
      - 如果:
          属性:
            compatible:
              contains:
                常量: actions,atc2603c-regulator
        则:
          patternProperties:
            "^(dcdc[0,4]|ldo[0,4,9])(-supply)?$": false

            "^(ldo|dcdc)":
              属性:
                regulator-allow-bypass: false
      - 如果:
          属性:
            compatible:
              contains:
                常量: actions,atc2609a-regulator
        则:
          patternProperties:
            "^(ldo1[1-2]|switchldo1)(-supply)?$": false

            "^(dcdc|ldo[3-9])":
              属性:
                regulator-allow-bypass: false

    必须包含:
      - compatible

    additionalProperties: false

additionalProperties: false

必须包含:
  - compatible
  - reg
  - interrupts

示例:
  - |
    #include <dt-bindings/interrupt-controller/arm-gic.h>
    i2c {
        #address-cells = <1>;
        #size-cells = <0>;

        pmic@65 {
            compatible = "actions,atc2603c";
            reg = <0x65>;
            interrupt-parent = <&sirq>;
            interrupts = <2 IRQ_TYPE_LEVEL_HIGH>;

            reset-time-sec = <6>;

            regulators {
                compatible = "actions,atc2603c-regulator";

                dcdc1-supply = <&reg_5v0>;
                dcdc3-supply = <&reg_5v0>;
                ldo5-supply = <&reg_5v0>;
                switchldo1-supply = <&vcc>;

                vdd_cpu: dcdc1 {
                    regulator-name = "VDD_CPU";
                    regulator-min-microvolt = <700000>;
                    regulator-max-microvolt = <1400000>;
                    regulator-always-on;
                };

                vcc: dcdc3 {
                    regulator-name = "VCC";
                    regulator-min-microvolt = <2600000>;
                    regulator-max-microvolt = <3300000>;
                    regulator-always-on;
                };

                vcc_3v1: ldo5 {
                    regulator-name = "VCC_3V1";
                    regulator-min-microvolt = <2600000>;
                    regulator-max-microvolt = <3300000>;
                };

                sd_vcc: switchldo1 {
                    regulator-name = "SD_VCC";
                    regulator-min-microvolt = <3000000>;
                    regulator-max-microvolt = <3300000>;
                    regulator-always-on;
                    regulator-boot-on;
                };
            };
        };
    };
```

## Documentation/devicetree/bindings/mfd/adi,max77541_cn.yaml
```yaml
# SPDX-文件许可人: GPL-2.0-only 或 BSD-2-Clause
%YAML 1.2
---
$id: http://devicetree.org/schemas/mfd/adi,max77541.yaml#
$schema: http://devicetree.org/meta-schemas/core.yaml#

title: ADI 的 MAX77540/MAX77541 电源管理 IC

maintainers:
  - Okan Sahin <okan.sahin@analog.com>

description: |
  MAX77540 是一款带有 2 个降压稳压器的电源管理 IC。
  MAX77541 是一款带有 2 个降压稳压器和 1 个模数转换器 (ADC) 的电源管理 IC。

properties:
  compatible:
    enum:
      - adi,max77540
      - adi,max77541

  reg:
    maxItems: 1

  interrupts:
    maxItems: 1

  regulators:
    $ref: /schemas/regulator/adi,max77541-regulator.yaml#

required:
  - compatible
  - reg
  - interrupts

additionalProperties: false

examples:
  - |
    #include <dt-bindings/interrupt-controller/irq.h>

    i2c {
        #address-cells = <1>;
        #size-cells = <0>;

        pmic@69 {
            compatible = "adi,max77541";
            reg = <0x69>;
            interrupt-parent = <&gpio>;
            interrupts = <16 IRQ_TYPE_EDGE_FALLING>;

            regulators {
                buck1 {
                    regulator-min-microvolt = <500000>;
                    regulator-max-microvolt = <5200000>;
                    regulator-boot-on;
                    regulator-always-on;
                };
                buck2 {
                    regulator-min-microvolt = <500000>;
                    regulator-max-microvolt = <5200000>;
                    regulator-boot-on;
                    regulator-always-on;
                };
            };
        };
    };
```

## Documentation/devicetree/bindings/mfd/allwinner,sun4i-a10-ts_cn.yaml
```yaml
# SPDX-许可证标识符: GPL-2.0
%YAML 1.2
---
$id: http://devicetree.org/schemas/mfd/allwinner,sun4i-a10-ts.yaml#
$schema: http://devicetree.org/meta-schemas/core.yaml#

标题: Allwinner A10 电阻式触摸屏控制器

维护者:
  - 陈宇蔡 <wens@csie.org>
  - 马克西姆·里帕德 <mripard@kernel.org>

属性:
  "#thermal-sensor-cells":
    常量: 0

  compatible:
    枚举:
      - allwinner,sun4i-a10-ts
      - allwinner,sun5i-a13-ts
      - allwinner,sun6i-a31-ts

  reg:
    最大项数: 1

  interrupts:
    最大项数: 1

  allwinner,ts-attached:
    $ref: /schemas/types.yaml#/definitions/flag
    描述: 触摸屏连接到了控制器上

  allwinner,tp-sensitive-adjust:
    $ref: /schemas/types.yaml#/definitions/uint32
    最小值: 0
    最大值: 15
    默认: 15

    描述: 下笔检测的灵敏度

  allwinner,filter-type:
    $ref: /schemas/types.yaml#/definitions/uint32
    最小值: 0
    最大值: 3
    默认: 1

    描述: |
      选择中值和平均滤波器。用于中值/平均滤波器的样本:
        0: 4/2
        1: 5/3
        2: 8/4
        3: 16/8

必需:
  - "#thermal-sensor-cells"
  - compatible
  - reg
  - interrupts

额外属性: false

示例:
  - |
    rtp: rtp@1c25000 {
        compatible = "allwinner,sun4i-a10-ts";
        reg = <0x01c25000 0x100>;
        interrupts = <29>;
        allwinner,ts-attached;
        #thermal-sensor-cells = <0>;
        /* 敏感/嘈杂的触摸面板 */
        allwinner,tp-sensitive-adjust = <0>;
        allwinner,filter-type = <3>;
    };
```
