## Documentation/devicetree/bindings/thermal/thermal-idle_cn.yaml
```yaml
# SPDX-License-Identifier: (GPL-2.0-only OR BSD-2-Clause)
# Copyright 2020 Linaro Ltd
%YAML 1.2
---
$id: http://devicetree.org/schemas/thermal/thermal-idle.yaml#
$schema: http://devicetree.org/meta-schemas/core.yaml#

标题: 热闲置冷却设备

维护者:
  - Daniel Lezcano <daniel.lezcano@linaro.org>

描述: |
  热闲置冷却设备允许系统通过注入空闲周期来被动地
  控制设备的温度，迫使它降温。
此绑定描述了热闲置节点
属性:
  $nodename:
    常量: thermal-idle
    描述: |
      热闲置节点描述了用于高效降低所连接热区域温度的
      空闲冷却设备的特性
'#cooling-cells':
    常量: 2
    描述: |
      必须为2，以指定在冷却映射中使用的最小和最大冷却状态。第一个单元是所需的最小冷却状态，
      第二个单元是所需的最高冷却状态
duration-us:
    描述: |
      设备应该降温的空闲持续时间（微秒）
exit-latency-us:
    描述: |
      为设备注入的空闲状态的退出延迟约束（微秒）。这是选择一个空闲状态时要应用的延迟约束
所需:
  - '#cooling-cells'

额外属性: false

示例:
  - |
    /{
        #include <dt-bindings/thermal/thermal.h>

        compatible = "foo";
        model = "foo";
        #address-cells = <1>;
        #size-cells = <1>;

        // 示例：将大核上的空闲冷却设备与cpufreq冷却设备结合使用
        cpus {
            #address-cells = <2>;
            #size-cells = <0>;

            /* ... */

            cpu_b0: cpu@100 {
                device_type = "cpu";
                compatible = "arm,cortex-a72";
                reg = <0x0 0x100>;
                enable-method = "psci";
                capacity-dmips-mhz = <1024>;
                dynamic-power-coefficient = <436>;
                #cooling-cells = <2>; /* 最小值后跟最大值 */
                cpu-idle-states = <&CPU_SLEEP>, <&CLUSTER_SLEEP>;
                cpu_b0_therm: thermal-idle {
                    #cooling-cells = <2>;
                    duration-us = <10000>;
                    exit-latency-us = <500>;
                };
            };

            cpu_b1: cpu@101 {
                device_type = "cpu";
                compatible = "arm,cortex-a72";
                reg = <0x0 0x101>;
                enable-method = "psci";
                capacity-dmips-mhz = <1024>;
                dynamic-power-coefficient = <436>;
                #cooling-cells = <2>; /* 最小值后跟最大值 */
                cpu-idle-states = <&CPU_SLEEP>, <&CLUSTER_SLEEP>;
                cpu_b1_therm: thermal-idle {
                    #cooling-cells = <2>;
                    duration-us = <10000>;
                    exit-latency-us = <500>;
                };
            };

            /* ... */

        };

        /* ... */

        thermal_zones {
            cpu_thermal: cpu {
                polling-delay-passive = <100>;
                polling-delay = <1000>;

                /* ... */

                trips {
                    cpu_alert0: cpu_alert0 {
                        temperature = <65000>;
                        hysteresis = <2000>;
                        type = "passive";
                    };

                    cpu_alert1: cpu_alert1 {
                        temperature = <70000>;
                        hysteresis = <2000>;
                        type = "passive";
                    };

                    cpu_alert2: cpu_alert2 {
                        temperature = <75000>;
                        hysteresis = <2000>;
                        type = "passive";
                    };

                    cpu_crit: cpu_crit {
                        temperature = <95000>;
                        hysteresis = <2000>;
                        type = "critical";
                    };
                };

                cooling-maps {
                    map0 {
                        trip = <&cpu_alert1>;
                        cooling-device = <&cpu_b0_therm 0 15 >,
                                         <&cpu_b1_therm 0 15>;
                    };

                    map1 {
                        trip = <&cpu_alert2>;
                        cooling-device = <&cpu_b0 THERMAL_NO_LIMIT THERMAL_NO_LIMIT>,
                                         <&cpu_b1 THERMAL_NO_LIMIT THERMAL_NO_LIMIT>;
                    };
                };
            };
        };
    };
```

## Documentation/devicetree/bindings/thermal/thermal-sensor_cn.yaml
~~~~yaml
```yaml
# SPDX-许可证标识符: (GPL-2.0)
# 版权所有 2020 Linaro 有限公司
%YAML 1.2
---
$id: http://devicetree.org/schemas/thermal/thermal-sensor.yaml#
$schema: http://devicetree.org/meta-schemas/core.yaml#

标题: 温度传感器

维护者:
  - Amit Kucheria <amitk@kernel.org>

描述: |
  设备树中的热管理是通过描述传感器硬件和所需软件抽象的热区来实现的，以采取适当措施缓解过热问题。
以下节点类型用于在设备树中完全描述一个热管理系统：
   - 温度传感器: 测量温度的设备，具有特定于SoC的绑定
   - 冷却设备: 用于被动或主动散热的设备
   - 热区: 包含以下节点类型的容器，用于描述平台的所有热数据

  本绑定描述了温度传感器
温度传感器设备在热区提供温度感应功能。典型的设备是I2C ADC转换器和带隙。温度传感器设备可以控制一个或多个内部传感器
属性:
  "#thermal-sensor-cells":
    描述:
      用于唯一识别IC内的温度传感器实例。在仅有一个传感器的节点上将是0，在包含多个内部传感器的节点上至少为1
枚举: [0, 1]

必需:
  - "#thermal-sensor-cells"

其他属性: true

示例:
  - |
    #include <dt-bindings/interrupt-controller/arm-gic.h>

    // 示例 1: SDM845 TSENS
    soc: soc {
            #address-cells = <2>;
            #size-cells = <2>;

            /* ... */

            tsens0: thermal-sensor@c263000 {
                    compatible = "qcom,sdm845-tsens", "qcom,tsens-v2";
                    reg = <0 0x0c263000 0 0x1ff>, /* TM */
                          <0 0x0c222000 0 0x1ff>; /* SROT */
                    #qcom,sensors = <13>;
                    interrupts = <GIC_SPI 506 IRQ_TYPE_LEVEL_HIGH>,
                                 <GIC_SPI 508 IRQ_TYPE_LEVEL_HIGH>;
                    interrupt-names = "uplow", "critical";
                    #thermal-sensor-cells = <1>;
            };

            tsens1: thermal-sensor@c265000 {
                    compatible = "qcom,sdm845-tsens", "qcom,tsens-v2";
                    reg = <0 0x0c265000 0 0x1ff>, /* TM */
                          <0 0x0c223000 0 0x1ff>; /* SROT */
                    #qcom,sensors = <8>;
                    interrupts = <GIC_SPI 507 IRQ_TYPE_LEVEL_HIGH>,
                                 <GIC_SPI 509 IRQ_TYPE_LEVEL_HIGH>;
                    interrupt-names = "uplow", "critical";
                    #thermal-sensor-cells = <1>;
            };
    };
..
```
~~~~

## Documentation/devicetree/bindings/thermal/thermal-zones_cn.yaml
~~~~yaml
# SPDX-许可证标识符: (GPL-2.0)
# 版权所有 2020 Linaro 有限公司
%YAML 1.2
---
$id: http://devicetree.org/schemas/thermal/thermal-zones.yaml#
$schema: http://devicetree.org/meta-schemas/base.yaml#

标题: 温度区域

维护者:
  - Daniel Lezcano <daniel.lezcano@linaro.org>

描述: |
  设备树中的热管理是通过描述传感器硬件和用于采取适当措施以缓解热过载所需的冷却设备和温度区域的软件抽象来实现的。
  以下节点类型用于在设备树中完全描述一个热管理系统：
   - 温度传感器: 测量温度的设备，具有特定于SoC的绑定
   - 冷却设备: 用于被动或主动散热的设备
   - 温度区域: 包含以下节点类型的容器，用于描述平台的所有温度数据

  此绑定描述了温度区域
温度区域的轮询延迟属性与两种情况下最大 dT/dt（温度随时间变化率）绑定：
    1. 当被动冷却被激活时（polling-delay-passive）
    2. 当只需要监控该区域（polling-delay）或者当主动冷却被激活时
最大 dT/dt 高度取决于硬件功耗和散热能力。应选择这些延迟以考虑所述最大 dT/dt，以防止设备在轮询之间意外跨越多个阈值边界。选择正确的轮询延迟可以避免让设备处于可能损坏硅结构并缩短硅寿命的温度范围内。

属性:
  $nodename:
    常量: thermal-zones
    描述:
      为了使用热框架管理来自系统中各个温度区域的输入以缓解热过载情况，需要一个 /thermal-zones 节点。它不代表系统中的实际设备，而是作为链接温度传感器设备、关于温度阈值的平台数据以及当温度越过这些阈值时要采取的缓解措施的容器。

模式属性:
  # 根据Linux内核要求，节点名称大小有限制 - 总共19个字符（参见THERMAL_NAME_LENGTH，包括终止NUL字节）:
  "^[a-zA-Z][a-zA-Z0-9\\-]{1,10}-thermal$":
    类型: 对象
    描述:
      每个温度区域节点包含有关如何频繁检查的信息、负责报告此区域温度的传感器、一个子节点包含此区域的各种阈值点以及一个子节点包含所有区域的冷却映射。

属性:
      polling-delay:
        $ref: /schemas/types.yaml#/definitions/uint32
        描述:
          在检查此温度区域时等待的最大毫秒数。将其设置为0将禁用由热框架设置的轮询定时器，并假设此区域内的热传感器支持中断。
polling-delay-passive:
        $ref: /schemas/types.yaml#/definitions/uint32
        描述:
          在进行被动冷却时检查此温度区域时等待的最大毫秒数。将其设置为0将禁用由热框架设置的轮询定时器，并假设此区域内的热传感器支持中断。
critical-action:
        $ref: /schemas/types.yaml#/definitions/string
        描述: |
          达到临界温度后操作系统应执行的操作
默认情况下，系统会以安全操作进行关机以防止对硬件造成损害，如果未设置该属性。

关机操作应当始终作为默认和首选的操作。
谨慎选择“重启”，因为硬件可能处于热应力状态，
从而导致无限循环重启，这可能会对硬件造成损害。
确保固件/引导加载程序会作为最后一道防线并接管热控制。

枚举：
          - 关机
          - 重启

      热传感器:
        $ref: /schemas/types.yaml#/definitions/phandle-array
        maxItems: 1
        描述:
          监控此热区域的热传感器句柄和传感器标识符
系数:
        $ref: /schemas/types.yaml#/definitions/uint32-array
        描述:
          包含此热区域中列出的所有传感器的线性方程系数的整数数组
所使用的线性方程如下，
            z = c0 * x0 + c1 * x1 + ... + c(n-1) * x(n-1) + cn
          其中 c0, c1, .., cn 是系数
若未指定此属性，则系数默认为 1。这些系数是有序的，并通过传感器ID与传感器匹配。额外的系数被视为常量偏移。

可持续功率:
        $ref: /schemas/types.yaml#/definitions/uint32
        描述:
          在期望的控制温度下，此热区域可以消散的可持续功率（以毫瓦为单位）的估计值。作为参考，4英寸手机的可持续功率通常为2000毫瓦，而10英寸平板电脑的可持续功率约为4500毫瓦。
阈值:
        类型: 对象
        描述:
          此节点描述了一组温度域中的点，在这些点上，热框架需要采取行动。需要采取的行动在另一个名为冷却映射的节点中定义。
The provided YAML snippet describes a schema for defining thermal management configurations, including temperature thresholds (trips) and cooling strategies (cooling maps). Here's the translation into Chinese:

`patternProperties`:
          `"^[a-zA-Z][a-zA-Z0-9\\-_]{0,63}$"`:
            类型: 对象

            属性:
              temperature:
                引用: /schemas/types.yaml#/definitions/int32
                最小值: -273000
                最大值: 200000
                描述:
                  一个整数，表示触发温度（以毫摄氏度为单位）
hysteresis:
                引用: /schemas/types.yaml#/definitions/uint32
                描述:
                  一个无符号整数，表示相对于上述触发温度的迟滞差值（同样以毫摄氏度为单位）。由框架启动的任何冷却措施都将保持到温度降至（触发温度 - 迟滞差值）以下。这可以避免一种情况，即在移除冷却措施后不久，触发条件就会被频繁触发。
type:
                引用: /schemas/types.yaml#/definitions/string
                枚举:
                  - active   # 启用主动冷却，例如风扇
                  - passive  # 启用被动冷却，例如限制CPU性能
                  - hot      # 向驱动程序发送通知
                  - critical # 向驱动程序发送通知，并触发系统关闭
                描述: |
                  有四种有效的触发类型：active、passive、hot 和 critical
Critical 触发类型用于设置硬件变得不稳定时的最大温度阈值，底层固件甚至可能触发重启。达到 critical 阈值会触发系统关闭。
Hot 触发类型可用于向热驱动程序发送通知（如果注册了 .notify 回调）。采取何种行动由驱动程序决定。
Passive 触发类型可用于降低硬件速度，例如以较低频率运行 CPU、GPU 或总线。
Active 触发类型可用于控制其他硬件以帮助冷却，例如加快或减慢风扇的速度。

            必需属性:
              - temperature
              - hysteresis
              - type
            不允许额外属性: false

        不允许额外属性: false

      cooling-maps:
        类型: 对象
        不允许额外属性: false
        描述:
          此节点描述当热区域越过在 trips 节点中描述的某个温度阈值时要采取的动作。该动作采用触发点与目标冷却设备状态之间的映射关系的形式。
`patternProperties`:
          `"^map[-a-zA-Z0-9]*$"`:
            类型: 对象

            属性:
              trip:
                引用: /schemas/types.yaml#/definitions/phandle
                描述:
                  此热区域内的触发点节点的 phandle
cooling-device:
                引用: /schemas/types.yaml#/definitions/phandle-array
                描述:
                  冷却设备 phandle 的列表以及每个冷却设备的最小和最大冷却状态指定符。在冷却设备 phandle 限制指定符中使用 THERMAL_NO_LIMIT (-1UL) 常量可以让框架自动使用该冷却设备的最小和最大冷却状态。
This appears to be a snippet from a Device Tree (DT) configuration file, which is used to describe hardware properties and connectivity for devices in embedded systems, particularly those using Linux. Below is a translation of the provided code into Chinese, along with an explanation of key terms:

```yaml
# contribution:
$ref: /schemas/types.yaml#/definitions/uint32
description:
  冷却贡献指的是被引用的冷却设备在指定的温度阈值下对所属热区的冷却贡献度。该贡献度是热区内所有冷却贡献度总和的一个比例。
required:
  - trip
  - cooling-device
additionalProperties: false

required:
  - thermal-sensors

additionalProperties: false

additionalProperties: false

examples:
  - |
    #include <dt-bindings/interrupt-controller/arm-gic.h>
    #include <dt-bindings/thermal/thermal.h>

    // 示例 1: SDM845 温度传感器
    soc {
        #address-cells = <2>;
        #size-cells = <2>;

        /* ... */

        tsens0: thermal-sensor@c263000 {
            compatible = "qcom,sdm845-tsens", "qcom,tsens-v2";
            reg = <0 0x0c263000 0 0x1ff>, /* TM */
                  <0 0x0c222000 0 0x1ff>; /* SROT */
            #qcom,sensors = <13>;
            interrupts = <GIC_SPI 506 IRQ_TYPE_LEVEL_HIGH>,
                         <GIC_SPI 508 IRQ_TYPE_LEVEL_HIGH>;
            interrupt-names = "uplow", "critical";
            #thermal-sensor-cells = <1>;
        };

        tsens1: thermal-sensor@c265000 {
            compatible = "qcom,sdm845-tsens", "qcom,tsens-v2";
            reg = <0 0x0c265000 0 0x1ff>, /* TM */
                  <0 0x0c223000 0 0x1ff>; /* SROT */
            #qcom,sensors = <8>;
            interrupts = <GIC_SPI 507 IRQ_TYPE_LEVEL_HIGH>,
                         <GIC_SPI 509 IRQ_TYPE_LEVEL_HIGH>;
            interrupt-names = "uplow", "critical";
            #thermal-sensor-cells = <1>;
        };
    };

    /* ... */

    thermal-zones {
        cpu0-thermal {
            polling-delay-passive = <250>;
            polling-delay = <1000>;

            thermal-sensors = <&tsens0 1>;

            trips {
                cpu0_alert0: trip-point0 {
                    temperature = <90000>;
                    hysteresis = <2000>;
                    type = "passive";
                };

                cpu0_alert1: trip-point1 {
                    temperature = <95000>;
                    hysteresis = <2000>;
                    type = "passive";
                };

                cpu0_crit: cpu_crit {
                    temperature = <110000>;
                    hysteresis = <1000>;
                    type = "critical";
                };
            };

            cooling-maps {
                map0 {
                    trip = <&cpu0_alert0>;
                    /* 对应到OPP表中的1400MHz */
                    cooling-device = <&CPU0 3 3>, <&CPU1 3 3>,
                                     <&CPU2 3 3>, <&CPU3 3 3>;
                };

                map1 {
                    trip = <&cpu0_alert1>;
                    /* 对应到OPP表中的1000MHz */
                    cooling-device = <&CPU0 5 5>, <&CPU1 5 5>,
                                     <&CPU2 5 5>, <&CPU3 5 5>;
                };
            };
        };

        /* ... */

        cluster0-thermal {
            polling-delay-passive = <250>;
            polling-delay = <1000>;

            thermal-sensors = <&tsens0 5>;

            trips {
                cluster0_alert0: trip-point0 {
                    temperature = <90000>;
                    hysteresis = <2000>;
                    type = "hot";
                };
                cluster0_crit: cluster0_crit {
                    temperature = <110000>;
                    hysteresis = <2000>;
                    type = "critical";
                };
            };
        };

        /* ... */

        gpu-top-thermal {
            polling-delay-passive = <250>;
            polling-delay = <1000>;

            thermal-sensors = <&tsens0 11>;

            trips {
                gpu1_alert0: trip-point0 {
                    temperature = <90000>;
                    hysteresis = <2000>;
                    type = "hot";
                };
            };
        };
    };
```

### Explanation:
- **$ref**: 引用其他文件中的定义。
- **description**: 描述信息，用于说明字段的意义。
- **required**: 必须存在的字段列表。
- **additionalProperties**: 是否允许额外属性的存在。
- **examples**: 示例代码。

这个配置描述了一个系统的热管理设置，包括温度传感器、温度阈值（trips）、热区（thermal zones）以及冷却映射（cooling maps）。每个热区可以包含一个或多个温度传感器，并定义了不同温度阈值下的动作。冷却映射则指定了在达到特定温度阈值时如何调整冷却设备（如CPU频率）以降低系统温度。
~~~~
