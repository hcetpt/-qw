## Documentation/devicetree/bindings/thermal/samsung,exynos-thermal_cn.yaml
~~~~yaml
```yaml
# SPDX-License-Identifier: (GPL-2.0-only OR BSD-2-Clause)
%YAML 1.2
---
$id: http://devicetree.org/schemas/thermal/samsung,exynos-thermal.yaml#
$schema: http://devicetree.org/meta-schemas/core.yaml#

title: Samsung Exynos SoC 热管理单元 (TMU)

maintainers:
  - Krzysztof Kozlowski <krzk@kernel.org>

description: |
  对于多实例 TMU，每个实例都应在 "aliases" 节点中正确编号的别名
properties:
  compatible:
    enum:
      - samsung,exynos3250-tmu
      - samsung,exynos4412-tmu
      - samsung,exynos4210-tmu
      - samsung,exynos5250-tmu
      - samsung,exynos5260-tmu
        # 对于 Exynos5420 上的 TMU 通道 0 和 1：
      - samsung,exynos5420-tmu
        # 对于 Exynos5420 上的 TMU 通道 2、3 和 4：
      - samsung,exynos5420-tmu-ext-triminfo
      - samsung,exynos5433-tmu
      - samsung,exynos7-tmu

  clocks:
    minItems: 1
    maxItems: 3

  clock-names:
    minItems: 1
    maxItems: 3

  interrupts:
    description: |
      当达到给定温度阈值时，Exynos TMU 支持生成中断。支持的热过载点数量取决于 SoC（DT 中定义的第一个过载点将被配置）：
       - 大多数 SoC：4
       - samsung,exynos5433-tmu：8
       - samsung,exynos7-tmu：8
    maxItems: 1

  reg:
    items:
      - description: TMU 实例寄存器
- description: |
          共享 TMU 寄存器
Note:: 在 Exynos5420 上，对于 TMU 通道 2、3 和 4 的 TRIMINFO 寄存器位置不正确。在存在位置不正确的寄存器的情况下使用 "samsung,exynos5420-tmu-ext-triminfo"，同时提供访问该基地址所需的时钟。
位于 0x1006c000 的 TRIMINFO 包含 TMU 通道 3 的数据
          位于 0x100a0000 的 TRIMINFO 包含 TMU 通道 4 的数据
          位于 0x10068000 的 TRIMINFO 包含 TMU 通道 2 的数据
    minItems: 1

  '#thermal-sensor-cells':
    const: 0

  vtmu-supply:
    description: 为 TMU 提供电压的调节器节点
required:
  - compatible
  - clocks
  - clock-names
  - interrupts
  - reg

allOf:
  - $ref: /schemas/thermal/thermal-sensor.yaml
  - if:
      properties:
        compatible:
          contains:
            const: samsung,exynos5420-tmu-ext-triminfo
    then:
      properties:
        clocks:
          items:
            - description:
                TMU 通道的操作时钟
- description:
                可选时钟，用于访问 TMU 通道的共享寄存器（例如 TRIMINFO）
clock-names:
          items:
            - const: tmu_apbif
            - const: tmu_triminfo_apbif
        reg:
          minItems: 2
          maxItems: 2
  - if:
      properties:
        compatible:
          contains:
            enum:
              - samsung,exynos5433-tmu
              - samsung,exynos7-tmu
    then:
      properties:
        clocks:
          items:
            - description:
                TMU 通道的操作时钟
- description:
                TMU 通道功能操作的可选特殊时钟
clock-names:
          items:
            - const: tmu_apbif
            - const: tmu_sclk
        reg:
          minItems: 1
          maxItems: 1

  - if:
      properties:
        compatible:
          contains:
            enum:
              - samsung,exynos3250-tmu
              - samsung,exynos4412-tmu
              - samsung,exynos4210-tmu
              - samsung,exynos5250-tmu
              - samsung,exynos5260-tmu
              - samsung,exynos5420-tmu
    then:
      properties:
        clocks:
          minItems: 1
          maxItems: 1
        reg:
          minItems: 1
          maxItems: 1

additionalProperties: false

examples:
  - |
    #include <dt-bindings/clock/exynos4.h>

    tmu@100c0000 {
        compatible = "samsung,exynos4412-tmu";
        reg = <0x100C0000 0x100>;
        interrupt-parent = <&combiner>;
        interrupts = <2 4>;
        #thermal-sensor-cells = <0>;
        clocks = <&clock CLK_TMU_APBIF>;
        clock-names = "tmu_apbif";
        vtmu-supply = <&ldo10_reg>;
    };

  - |
    #include <dt-bindings/interrupt-controller/arm-gic.h>

    tmu@10068000 {
        compatible = "samsung,exynos5420-tmu-ext-triminfo";
        reg = <0x10068000 0x100>, <0x1006c000 0x4>;
        interrupts = <GIC_SPI 184 IRQ_TYPE_LEVEL_HIGH>;
        #thermal-sensor-cells = <0>;
        clocks = <&clock 318>, <&clock 318>; /* CLK_TMU */
        clock-names = "tmu_apbif", "tmu_triminfo_apbif";
        vtmu-supply = <&ldo7_reg>;
    };

  - |
    #include <dt-bindings/interrupt-controller/arm-gic.h>

    tmu@10060000 {
        compatible = "samsung,exynos5433-tmu";
        reg = <0x10060000 0x200>;
        interrupts = <GIC_SPI 95 IRQ_TYPE_LEVEL_HIGH>;
        #thermal-sensor-cells = <0>;
        clocks = <&cmu_peris 3>, /* CLK_PCLK_TMU0_APBIF */
                 <&cmu_peris 35>; /* CLK_SCLK_TMU0 */
        clock-names = "tmu_apbif", "tmu_sclk";
        vtmu-supply = <&ldo3_reg>;
    };
```
This translation provides a direct conversion into Chinese, while keeping the structure and formatting consistent with the original YAML document.
~~~~

## Documentation/devicetree/bindings/thermal/socionext,uniphier-thermal_cn.yaml
~~~~yaml
```yaml
# SPDX-许可证标识符: (GPL-2.0-only 或 BSD-2-Clause)
%YAML 1.2
---
$id: http://devicetree.org/schemas/thermal/socionext,uniphier-thermal.yaml#
$schema: http://devicetree.org/meta-schemas/core.yaml#

title: Socionext UniPhier 温度监控器

description: |
  这描述了用于温度监控器的设备树绑定，该温度监控器由在 Socionext UniPhier 系统级芯片上实现的过程、电压和温度(PVT)监控单元支持。
maintainers:
  - Kunihiko Hayashi <hayashi.kunihiko@socionext.com>

$ref: thermal-sensor.yaml#

properties:
  compatible:
    enum:
      - socionext,uniphier-pxs2-thermal
      - socionext,uniphier-ld20-thermal
      - socionext,uniphier-pxs3-thermal
      - socionext,uniphier-nx1-thermal

  interrupts:
    maxItems: 1

  "#thermal-sensor-cells":
    const: 0

  socionext,tmod-calibration:
    $ref: /schemas/types.yaml#/definitions/uint32-array
    maxItems: 2
    description:
      当 SoC 上未设置值时（例如参考板），从 PVT 引用的一对校准值
required:
  - compatible
  - interrupts

unevaluatedProperties: false

examples:
  - |
    // UniPhier 温度传感器应该是 "syscon" 兼容节点的子节点
#include <dt-bindings/interrupt-controller/arm-gic.h>
    pvtctl: thermal-sensor {
        compatible = "socionext,uniphier-ld20-thermal";
        interrupts = <GIC_SPI 3 IRQ_TYPE_LEVEL_HIGH>;
        #thermal-sensor-cells = <0>;
    };
```
~~~~

## Documentation/devicetree/bindings/thermal/spear-thermal_cn.txt
```
*SPEAr 热传感器*

所需属性:
- compatible（兼容性）: "st,thermal-spear1340"
- reg（寄存器范围）: 热传感器寄存器的地址范围
- st,thermal-flags（热标志）: 用于启用热传感器的标志

示例：

	thermal@fc000000 {    # 表明该设备的基地址为 0xfc000000
		compatible = "st,thermal-spear1340";    # 指定与 "st,thermal-spear1340" 兼容
		reg = <0xfc000000 0x1000>;             # 定义热传感器寄存器的地址范围从 0xfc000000 开始，长度为 0x1000
		st,thermal-flags = <0x7000>;           # 设置用于启用热传感器的标志为 0x7000
	};
```

## Documentation/devicetree/bindings/thermal/st,stih407-thermal_cn.yaml
```yaml
# SPDX-许可证标识符: (GPL-2.0-only 或 BSD-2-Clause)
%YAML 1.2
---
$id: http://devicetree.org/schemas/thermal/st,stih407-thermal.yaml#
$schema: http://devicetree.org/meta-schemas/core.yaml#

title: STMicroelectronics STi 数字温度传感器 (DTS)

maintainers:
  - Patrice Chotard <patrice.chotard@foss.st.com>
  - Lee Jones <lee@kernel.org>

allOf:
  - $ref: thermal-sensor.yaml

properties:
  compatible:
    const: st,stih407-thermal

  reg:
    maxItems: 1

  clocks:
    maxItems: 1

  clock-names:
    items:
      - const: thermal

  interrupts:
    description:
      对于未定义中断的温度传感器，将使用1000ms的轮询间隔从设备读取温度。
    maxItems: 1

  '#thermal-sensor-cells':
    const: 0

required:
  - compatible
  - reg
  - clocks
  - clock-names

unevaluatedProperties: false

examples:
  - |
    #include <dt-bindings/interrupt-controller/arm-gic.h>
    temperature-sensor@91a0000 {
        compatible = "st,stih407-thermal";
        reg = <0x91a0000 0x28>;
        clock-names = "thermal";
        clocks = <&CLK_SYSIN>;
        interrupts = <GIC_SPI 205 IRQ_TYPE_EDGE_RISING>;
        #thermal-sensor-cells = <0>;
    };
```

## Documentation/devicetree/bindings/thermal/st,stm32-thermal_cn.yaml
~~~~yaml
```yaml
# SPDX-文件许可标识: (GPL-2.0-only 或 BSD-2-Clause)
%YAML 1.2
---
$id: http://devicetree.org/schemas/thermal/st,stm32-thermal.yaml#
$schema: http://devicetree.org/meta-schemas/core.yaml#

title: STMicroelectronics STM32 数字温度传感器 (DTS)

maintainers:
  - Pascal Paillet <p.paillet@foss.st.com>

$ref: thermal-sensor.yaml#

properties:
  compatible:
    const: st,stm32-thermal

  reg:
    maxItems: 1

  interrupts:
    maxItems: 1

  clocks:
    maxItems: 1

  clock-names:
    items:
      - const: pclk

  "#thermal-sensor-cells":
    const: 0

required:
  - compatible
  - reg
  - interrupts
  - clocks
  - clock-names

unevaluatedProperties: false

examples:
  - |
    #include <dt-bindings/interrupt-controller/arm-gic.h>
    #include <dt-bindings/clock/stm32mp1-clks.h>
    dts: thermal@50028000 {
        compatible = "st,stm32-thermal";
        reg = <0x50028000 0x100>;
        clocks = <&rcc TMPSENS>;
        clock-names = "pclk";
        #thermal-sensor-cells = <0>;
        interrupts = <GIC_SPI 147 IRQ_TYPE_LEVEL_HIGH>;
    };

    thermal-zones {
        cpu_thermal: cpu-thermal {
            polling-delay-passive = <0>;
            polling-delay = <0>;

            thermal-sensors = <&dts>;
            trips {
                cpu_alert1: cpu-alert1 {
                    temperature = <85000>;
                    hysteresis = <0>;
                    type = "passive";
                };

                cpu_crit: cpu-crit {
                    temperature = <120000>;
                    hysteresis = <0>;
                    type = "critical";
                };
            };

            cooling-maps {
            };
        };
    };
..
```

这段内容描述了一个设备树（Device Tree）配置文件的模式定义，用于配置STMicroelectronics STM32系列微控制器中的数字温度传感器。该配置包括了与STM32 DTS相关的各种属性及其要求，并给出了一个具体的例子来说明如何在设备树中进行配置。
~~~~

## Documentation/devicetree/bindings/thermal/thermal-cooling-devices_cn.yaml
```yaml
# SPDX-许可证标识符: (GPL-2.0)
# 版权所有 2020 Linaro 有限公司
%YAML 1.2
---
$id: http://devicetree.org/schemas/thermal/thermal-cooling-devices.yaml#
$schema: http://devicetree.org/meta-schemas/core.yaml#

标题: 热冷却设备

维护者:
  - Amit Kucheria <amitk@kernel.org>

描述: |
  设备树中的热管理是通过描述传感器硬件、以及为采取适当行动以缓解热过载所需的冷却设备和热区域的软件抽象来实现的。
  以下节点类型用于在设备树中完全描述一个热管理系统：
   - 热传感器: 测量温度的设备，具有特定于SoC的绑定
   - 冷却设备: 用于被动或主动散热的设备
   - 热区域: 包含以下节点类型的容器，用于描述平台的所有热数据

  此绑定描述了冷却设备
存在两种基本方式来提供功率耗散的控制：
    - 被动冷却: 通过调节设备性能。一个典型的被动冷却机制是一个具有动态电压和频率缩放（DVFS）的CPU，并使用较低的频率作为冷却状态
    - 主动冷却: 通过激活设备来移除散发的热量，例如，调节风扇速度
任何冷却设备都有一系列冷却状态（即不同的热量散发级别）。它们还有一种确定设备当前冷却状态的方法。例如，风扇的冷却状态对应于可能的不同风扇速度。冷却状态用单个无符号整数表示，其中较大的数字意味着更大的热量散发。与设备相关联的确切冷却状态集应在特定设备的绑定中定义
选择: true

属性:
  "#cooling-cells":
    描述:
      必须为2，以便指定在冷却映射参考中使用的最小和最大冷却状态。第一个单元是最小冷却状态，第二个单元是请求的最大冷却状态
常量: 2

额外属性: true

示例:
  - |
    #include <dt-bindings/interrupt-controller/arm-gic.h>
    #include <dt-bindings/thermal/thermal.h>

    // 示例 1: CPU0 上的 Cpufreq 冷却设备
    cpus {
            #address-cells = <2>;
            #size-cells = <0>;

            CPU0: cpu@0 {
                    device_type = "cpu";
                    compatible = "qcom,kryo385";
                    reg = <0x0 0x0>;
                    enable-method = "psci";
                    cpu-idle-states = <&LITTLE_CPU_SLEEP_0>,
                                      <&LITTLE_CPU_SLEEP_1>,
                                      <&CLUSTER_SLEEP_0>;
                    capacity-dmips-mhz = <607>;
                    dynamic-power-coefficient = <100>;
                    qcom,freq-domain = <&cpufreq_hw 0>;
                    #cooling-cells = <2>;
                    next-level-cache = <&L2_0>;
                    L2_0: l2-cache {
                            compatible = "cache";
                            cache-unified;
                            cache-level = <2>;
                            next-level-cache = <&L3_0>;
                            L3_0: l3-cache {
                                    compatible = "cache";
                                    cache-unified;
                                    cache-level = <3>;
                            };
                    };
          };

          /* ... */

    };

    /* ... */

    thermal-zones {
            cpu0-thermal {
                    polling-delay-passive = <250>;
                    polling-delay = <1000>;

                    thermal-sensors = <&tsens0 1>;

                    trips {
                            cpu0_alert0: trip-point0 {
                                    temperature = <90000>;
                                    hysteresis = <2000>;
                                    type = "passive";
                            };
                    };

                    cooling-maps {
                            map0 {
                                    trip = <&cpu0_alert0>;
                                    /* 对应 OPP 表中的 1000MHz */
                                    cooling-device = <&CPU0 5 5>;
                            };
                    };
            };

            /* ... */
    };
..
```
