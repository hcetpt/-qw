## Documentation/devicetree/bindings/thermal/ti,am654-thermal_cn.yaml
~~~~yaml
```yaml
# SPDX-文件许可标识: (GPL-2.0-only 或 BSD-2-Clause)
%YAML 1.2
---
$id: http://devicetree.org/schemas/thermal/ti,am654-thermal.yaml#
$schema: http://devicetree.org/meta-schemas/core.yaml#

title: 德州仪器 AM654 VTM (设备树)

maintainers:
  - Keerthy <j-keerthy@ti.com>

$ref: thermal-sensor.yaml#

properties:
  compatible:
    const: ti,am654-vtm

  reg:
    maxItems: 1

  power-domains:
    maxItems: 1

  "#thermal-sensor-cells":
    const: 1

required:
  - compatible
  - reg
  - power-domains

unevaluatedProperties: false

examples:
  - |
    #include <dt-bindings/soc/ti,sci_pm_domain.h>
    vtm: thermal@42050000 {
        compatible = "ti,am654-vtm";
        reg = <0x42050000 0x25c>;
        power-domains = <&k3_pds 80 TI_SCI_PD_EXCLUSIVE>;
        #thermal-sensor-cells = <1>;
    };

    mpu0_thermal: mpu0_thermal {
        polling-delay-passive = <250>; /* 毫秒 */
        polling-delay = <500>; /* 毫秒 */
        thermal-sensors = <&vtm0 0>;

        trips {
            mpu0_crit: mpu0_crit {
                temperature = <125000>; /* 千分度 Celsius */
                hysteresis = <2000>; /* 千分度 Celsius */
                type = "critical";
            };
        };
    };
..
```

注意：上面的翻译保持了原有的 YAML 格式，并将注释和文本内容翻译成了中文。其中一些专业术语（如 `milliCelsius` 和 `TI_SCI_PD_EXCLUSIVE`）保持英文原样，因为这些术语在中文环境中通常也使用英文表示。
~~~~

## Documentation/devicetree/bindings/thermal/ti,j72xx-thermal_cn.yaml
```yaml
# SPDX-许可证标识符: (GPL-2.0-only 或 BSD-2-Clause)
%YAML 1.2
---
$id: http://devicetree.org/schemas/thermal/ti,j72xx-thermal.yaml#
$schema: http://devicetree.org/meta-schemas/core.yaml#

title: 德州仪器 J72XX VTM (DTS)

maintainers:
  - Keerthy <j-keerthy@ti.com>

description: |
  德州仪器的 K3 系列片上系统（SoC）通常配备一个电压和热管理（VTM）设备，用于控制多达8个温度二极管传感器，这些传感器可以测量芯片不同热点的硅结温，并提供温度、中断和报警信息。
对于该设备返回的值，可以使用以下多项式方程转换为摄氏温度：

  温度(℃) = (-9.2627e-12) * x^4 + (6.0373e-08) * x^3 + \
            (-1.7058e-04) * x^2 + (3.2512e-01) * x + (-4.9003e+01)

$ref: thermal-sensor.yaml#

properties:
  compatible:
    enum:
      - ti,j721e-vtm
      - ti,j7200-vtm

  reg:
    items:
      - description: VTM cfg1 寄存器空间
      - description: VTM cfg2 寄存器空间
      - description: |
          对于某些 Jacinto 设备，必须应用软件微调方法才能正常工作。此 eFuse 区域提供了这些 SoC 准确报告温度所需的信息
    minItems: 2

  power-domains:
    maxItems: 1

  "#thermal-sensor-cells":
    const: 1

allOf:
  - if:
      properties:
        compatible:
          contains:
            const: ti,j721e-vtm
    then:
      properties:
        reg:
          minItems: 3
    else:
      properties:
        reg:
          maxItems: 2

required:
  - compatible
  - reg
  - power-domains

unevaluatedProperties: false

examples:
  - |
    #include <dt-bindings/soc/ti,sci_pm_domain.h>
    wkup_vtm0: thermal-sensor@42040000 {
        compatible = "ti,j721e-vtm";
        reg = <0x42040000 0x350>,
              <0x42050000 0x350>,
              <0x43000300 0x10>;
        power-domains = <&k3_pds 154 TI_SCI_PD_EXCLUSIVE>;
        #thermal-sensor-cells = <1>;
    };

    mpu_thermal: mpu-thermal {
        polling-delay-passive = <250>; /* 毫秒 */
        polling-delay = <500>; /* 毫秒 */
        thermal-sensors = <&wkup_vtm0 0>;

        trips {
            mpu_crit: mpu-crit {
                temperature = <125000>; /* 毫摄氏度 */
                hysteresis = <2000>; /* 毫摄氏度 */
                type = "critical";
            };
        };
    };
```

## Documentation/devicetree/bindings/thermal/ti_soc_thermal_cn.txt
~~~~
在系统控制模块中，OMAP 提供了一个电压参考和温度传感器功能，这些功能被集成在带隙电压和温度传感器（VBGAPTS）模块中。带隙为内部电路和其他模拟 IP 块提供电流和电压参考。模数转换器（ADC）产生一个与硅温度成比例的输出值。

必需属性：
- `compatible`：应为：
  - `"ti,omap34xx-bandgap"`：对于 OMAP34xx 的带隙
  - `"ti,omap36xx-bandgap"`：对于 OMAP36xx 的带隙
  - `"ti,omap4430-bandgap"`：对于 OMAP4430 的带隙
  - `"ti,omap4460-bandgap"`：对于 OMAP4460 的带隙
  - `"ti,omap4470-bandgap"`：对于 OMAP4470 的带隙
  - `"ti,omap5430-bandgap"`：对于 OMAP5430 的带隙
- `interrupts`：此条目应指示 talert 信号路由到哪个中断线；
特定属性：
- `gpios`：此条目应用于告知 tshut 信号路由到了哪个 GPIO 线。所告知的 GPIO 将被视为 IRQ；
- `regs`：此条目也必须指定，并且它对每个带隙版本都是特定的，因为映射可能从一个 SoC 到另一个 SoC 发生变化，除了依赖于可用的功能之外。

示例：
OMAP34xx:
```
bandgap {
    reg = <0x48002524 0x4>;
    compatible = "ti,omap34xx-bandgap";
};
```

OMAP36xx:
```
bandgap {
    reg = <0x48002524 0x4>;
    compatible = "ti,omap36xx-bandgap";
};
```

OMAP4430:
```
bandgap {
    reg = <0x4a002260 0x4 0x4a00232C 0x4>;
    compatible = "ti,omap4430-bandgap";
};
```

OMAP4460:
```
bandgap {
    reg = <0x4a002260 0x4
           0x4a00232C 0x4
           0x4a002378 0x18>;
    compatible = "ti,omap4460-bandgap";
    interrupts = <0 126 4>; /* talert */
    gpios = <&gpio3 22 0>; /* tshut */
};
```

OMAP4470:
```
bandgap {
    reg = <0x4a002260 0x4
           0x4a00232C 0x4
           0x4a002378 0x18>;
    compatible = "ti,omap4470-bandgap";
    interrupts = <0 126 4>; /* talert */
    gpios = <&gpio3 22 0>; /* tshut */
};
```

OMAP5430:
```
bandgap {
    reg = <0x4a0021e0 0xc
           0x4a00232c 0xc
           0x4a002380 0x2c
           0x4a0023C0 0x3c>;
    compatible = "ti,omap5430-bandgap";
    interrupts = <0 126 4>; /* talert */
};
```

DRA752:
```
bandgap {
    reg = <0x4a0021e0 0xc
           0x4a00232c 0xc
           0x4a002380 0x2c
           0x4a0023C0 0x3c
           0x4a002564 0x8
           0x4a002574 0x50>;
    compatible = "ti,dra752-bandgap";
    interrupts = <0 126 4>; /* talert */
};
```
~~~~
