## Documentation/devicetree/bindings/thermal/mediatek,lvts-thermal_cn.yaml
```yaml
# SPDX-许可证标识符: (GPL-2.0-only 或 BSD-2-Clause)
%YAML 1.2
---
$id: http://devicetree.org/schemas/thermal/mediatek,lvts-thermal.yaml#
$schema: http://devicetree.org/meta-schemas/core.yaml#

标题: MediaTek SoC 低压温度传感器 (LVTS)

维护者:
  - Balsam CHIHI <bchihi@baylibre.com>

描述: |
  LVTS 是一种由三个子系统组成的热管理架构，包括：
  感知设备 - 热感知微电路单元 (TSMCU)，
  转换器 - 低压温度传感器转换器 (LVTS)，以及
  数字控制器 (LVTS_CTRL)。
属性:
  compatible:
    枚举:
      - mediatek,mt7988-lvts-ap
      - mediatek,mt8186-lvts
      - mediatek,mt8188-lvts-ap
      - mediatek,mt8188-lvts-mcu
      - mediatek,mt8192-lvts-ap
      - mediatek,mt8192-lvts-mcu
      - mediatek,mt8195-lvts-ap
      - mediatek,mt8195-lvts-mcu

  reg:
    最大项数: 1

  interrupts:
    最大项数: 1

  clocks:
    最大项数: 1

  resets:
    最大项数: 1
    描述: 用于清除 AP/MCU 上临时数据的 LVTS 复位
nvmem-cells:
    最小项数: 1
    项:
      - 描述: 用于 LVTS 的校准 eFuse 数据 1
      - 描述: 用于 LVTS 的校准 eFuse 数据 2

  nvmem-cell-names:
    最小项数: 1
    项:
      - 常量: lvts-calib-data-1
      - 常量: lvts-calib-data-2

  "#thermal-sensor-cells":
    常量: 1

allOf:
  - $ref: thermal-sensor.yaml#

  - 如果:
      属性:
        compatible:
          包含:
            枚举:
              - mediatek,mt8188-lvts-ap
              - mediatek,mt8188-lvts-mcu
              - mediatek,mt8192-lvts-ap
              - mediatek,mt8192-lvts-mcu
    那么:
      属性:
        nvmem-cells:
          最大项数: 1

        nvmem-cell-names:
          最大项数: 1

  - 如果:
      属性:
        compatible:
          包含:
            枚举:
              - mediatek,mt8186-lvts
              - mediatek,mt8195-lvts-ap
              - mediatek,mt8195-lvts-mcu
    那么:
      属性:
        nvmem-cells:
          最小项数: 2

        nvmem-cell-names:
          最小项数: 2

必需:
  - compatible
  - reg
  - interrupts
  - clocks
  - resets
  - nvmem-cells
  - nvmem-cell-names

附加属性: false

示例:
  - |
    #include <dt-bindings/interrupt-controller/arm-gic.h>
    #include <dt-bindings/clock/mt8195-clk.h>
    #include <dt-bindings/reset/mt8195-resets.h>
    #include <dt-bindings/thermal/mediatek,lvts-thermal.h>

    soc {
      #address-cells = <2>;
      #size-cells = <2>;

      lvts_mcu: thermal-sensor@11278000 {
        compatible = "mediatek,mt8195-lvts-mcu";
        reg = <0 0x11278000 0 0x1000>;
        interrupts = <GIC_SPI 170 IRQ_TYPE_LEVEL_HIGH 0>;
        clocks = <&infracfg_ao CLK_INFRA_AO_THERM>;
        resets = <&infracfg_ao MT8195_INFRA_RST4_THERM_CTRL_MCU_SWRST>;
        nvmem-cells = <&lvts_efuse_data1 &lvts_efuse_data2>;
        nvmem-cell-names = "lvts-calib-data-1", "lvts-calib-data-2";
        #thermal-sensor-cells = <1>;
      };
    };

    thermal_zones: thermal-zones {
      cpu0-thermal {
        polling-delay = <1000>;
        polling-delay-passive = <250>;
        thermal-sensors = <&lvts_mcu MT8195_MCU_LITTLE_CPU0>;

        trips {
          cpu0_alert: trip-alert {
            temperature = <85000>;
            hysteresis = <2000>;
            type = "passive";
          };

          cpu0_crit: trip-crit {
            temperature = <100000>;
            hysteresis = <2000>;
            type = "critical";
          };
        };
      };
    };
```

## Documentation/devicetree/bindings/thermal/mediatek,thermal_cn.yaml
```yaml
# SPDX-许可证标识符: GPL-2.0-only 或 BSD-2-Clause
%YAML 1.2
---
$id: http://devicetree.org/schemas/thermal/mediatek,thermal.yaml#
$schema: http://devicetree.org/meta-schemas/core.yaml#

标题: 用于片上温度的联发科热控制器

维护者:
  - Sascha Hauer <s.hauer@pengutronix.de>

描述:
  该设备没有自己的ADC，而是通过AHB总线访问直接控制AUXADC。因此它需要指向AUXADC的phandle。此外，它还通过AHB总线访问来控制apmixedsys寄存器空间中的复用器，因此也需要指向APMIXEDSYS的phandle。
allOf:
  - $ref: thermal-sensor.yaml#

属性:
  compatible:
    枚举:
      - mediatek,mt2701-thermal
      - mediatek,mt2712-thermal
      - mediatek,mt7622-thermal
      - mediatek,mt7981-thermal
      - mediatek,mt7986-thermal
      - mediatek,mt8173-thermal
      - mediatek,mt8183-thermal
      - mediatek,mt8365-thermal
      - mediatek,mt8516-thermal

  reg:
    最大项目数: 1

  interrupts:
    最大项目数: 1

  clocks:
    项目:
      - 描述: 用于寄存器访问的主要时钟
      - 描述: AUXADC时钟

  clock-names:
    项目:
      - 常量: therm
      - 常量: auxadc

  mediatek,auxadc:
    $ref: /schemas/types.yaml#/definitions/phandle
    描述: 指向热控制器使用的AUXADC的phandle

  mediatek,apmixedsys:
    $ref: /schemas/types.yaml#/definitions/phandle
    描述: 指向APMIXEDSYS控制器的phandle

  resets:
    描述: 控制热控制器的重置控制器

  nvmem-cells:
    项目:
      - 描述:
          NVMEM单元，其中包含指向由NVMEM设备提供的校准数据的EEPROMA phandle。如果未指定，则应使用默认值
nvmem-cell-names:
    项目:
      - 常量: calibration-data

必需:
  - reg
  - interrupts
  - clocks
  - clock-names
  - mediatek,auxadc
  - mediatek,apmixedsys

未评估属性: false

示例:
  - |
    #include <dt-bindings/interrupt-controller/irq.h>
    #include <dt-bindings/clock/mt8173-clk.h>
    #include <dt-bindings/reset/mt8173-resets.h>

    thermal@1100b000 {
        compatible = "mediatek,mt8173-thermal";
        reg = <0x1100b000 0x1000>;
        interrupts = <0 70 IRQ_TYPE_LEVEL_LOW>;
        clocks = <&pericfg CLK_PERI_THERM>, <&pericfg CLK_PERI_AUXADC>;
        clock-names = "therm", "auxadc";
        resets = <&pericfg MT8173_PERI_THERM_SW_RST>;
        mediatek,auxadc = <&auxadc>;
        mediatek,apmixedsys = <&apmixedsys>;
        nvmem-cells = <&thermal_calibration_data>;
        nvmem-cell-names = "calibration-data";
        #thermal-sensor-cells = <1>;
    };
```

## Documentation/devicetree/bindings/thermal/nvidia,tegra124-soctherm_cn.yaml
```yaml
# SPDX-许可证标识符: (GPL-2.0-only 或 BSD-2-Clause)
%YAML 1.2
---
$id: http://devicetree.org/schemas/thermal/nvidia,tegra124-soctherm.yaml#
$schema: http://devicetree.org/meta-schemas/core.yaml#

标题: NVIDIA Tegra124 SOCTHERM 温度管理系统

维护者:
  - Thierry Reding <thierry.reding@gmail.com>
  - Jon Hunter <jonathanh@nvidia.com>

描述: SOCTHERM IP 块包含温度传感器，支持轮询或中断型温度监控、基于温度阈值的 CPU 和 GPU 限速，以及处理外部过流通知。它还用于在过热情况下管理紧急关机。
属性:
  compatible:
    枚举:
      - nvidia,tegra124-soctherm
      - nvidia,tegra132-soctherm
      - nvidia,tegra210-soctherm

  reg:
    最大项数: 2

  reg-names:
    最大项数: 2

  interrupts:
    项:
      - 描述: 模块中断
      - 描述: EDP 中断

  interrupt-names:
    项:
      - 常量: thermal
      - 常量: edp

  clocks:
    项:
      - 描述: 温度传感器时钟
      - 描述: 模块时钟

  clock-names:
    项:
      - 常量: tsensor
      - 常量: soctherm

  resets:
    项:
      - 描述: 模块复位

  reset-names:
    项:
      - 常量: soctherm

  "#thermal-sensor-cells":
    常量: 1

  throttle-cfgs:
    $引用: thermal-cooling-devices.yaml
    描述: 一个子节点，用于包含每个硬件限速事件的配置。这些事件可以被设置为冷却设备。限速事件子节点必须命名为 "light" 或 "heavy"。
unevaluatedProperties: false
    正则表达式属性:
      "^(light|heavy|oc1)$":
        类型: 对象
        其他属性: false

        属性:
          "#cooling-cells":
            常量: 2

          nvidia,priority:
            $引用: /schemas/types.yaml#/definitions/uint32
            最小值: 1
            最大值: 100
            描述: 每个限速都有自己的限速设置，因此软件需要为不同的限速设置优先级，硬件仲裁器可以选择最终的限速设置。较大的值表示更高的优先级，通常，更高的优先级意味着更低的目标频率。软件需要确保关键的温度报警具有更高的优先级，并确保如果两个向量的优先级设置为相同的值时没有竞态条件。
nvidia,cpu-throt-percent:
            描述: 此属性适用于 Tegra124 和 Tegra210。它是脉冲跳过的限速深度，以百分比形式表示。
最小值: 0
            最大值: 100

          nvidia,cpu-throt-level:
            $引用: /schemas/types.yaml#/definitions/uint32
            描述: 此属性仅适用于 Tegra132，它是脉冲跳过的级别，用于限速时钟频率。它指示 CPU 时钟的限速深度，并且可以编程为以下值之一：
枚举:
              # 无 (TEGRA_SOCTHERM_THROT_LEVEL_NONE)
              - 0
              # 低 (TEGRA_SOCTHERM_THROT_LEVEL_LOW)
              - 1
              # 中 (TEGRA_SOCTHERM_THROT_LEVEL_MED)
              - 2
              # 高 (TEGRA_SOCTHERM_THROT_LEVEL_HIGH)
              - 3

          nvidia,gpu-throt-level:
            $引用: /schemas/types.yaml#/definitions/uint32
            描述: 此属性适用于 Tegra124 和 Tegra210。它是脉冲跳过的级别，用于限速时钟频率。它指示 GPU 时钟的限速深度，并且可以编程为以下值之一，这些值代表限速的百分比：
枚举:
              # 无 (0%, TEGRA_SOCTHERM_THROT_LEVEL_NONE)
              - 0
              # 低 (50%, TEGRA_SOCTHERM_THROT_LEVEL_LOW)
              - 1
              # 中 (75%, TEGRA_SOCTHERM_THROT_LEVEL_MED)
              - 2
              # 高 (85%, TEGRA_SOCTHERM_THROT_LEVEL_HIGH)
              - 3

          # 可选
          # 仅适用于 Tegra210 和 OCx 限速事件
          nvidia,count-threshold:
            $引用: /schemas/types.yaml#/definitions/uint32
            描述: 指定触发中断所需的过流事件的数量。如果缺少此属性，则不会触发中断。值为 0 表示在每次过流报警时都会产生中断。
nvidia,polarity-active-low:
            $引用: /schemas/types.yaml#/definitions/flag
            描述: 配置过流报警信号的极性。如果存在，这意味着低电平有效；否则高电平有效。
下面是给定内容的中文翻译：

nvidia,alarm-filter:
  $ref: /schemas/types.yaml#/definitions/uint32
  description: 用于过滤事件的时钟数。当过滤器过期（意味着过热事件已长时间未发生），计数器将被清零并重新设置过滤器。
default: 0

nvidia,throttle-period-us:
  description: 规定了在过热事件解除后进行限频的微秒数。
default: 0

# 可选
nvidia,thermtrips:
  $ref: /schemas/types.yaml#/definitions/uint32-matrix
  description: |
    当存在时，此属性指定了使SOCTHERM硬件断言热触发信号至电源管理IC的温度，该IC可以配置为重置或关闭设备。
    它是一个由对组成的数组，其中每一对代表一个温度传感器ID后跟以毫摄氏度表示的温度。若缺少此属性，则使用临界温度点作为热触发温度。
注意：
  - 若“nvidia,thermtrips”属性缺失，将使用“临界”类型的温度点来设定SOCTHERM硬件断言热触发的温度。当存在thermtrips属性时，违反临界温度点会报告给热框架以实现软件关机。
  - “热”类型的温度点将被设定为SOCTHERM硬件的限频温度。一旦该热区域的温度高于此值，将触发硬件限频事件。
items:
  items:
    - description: 传感器ID
      oneOf:
        - description: CPU传感器
          const: 0
        - description: 内存传感器
          const: 1
        - description: GPU传感器
          const: 2
        - description: PLLX传感器
          const: 3
    - description: 温度阈值（以毫摄氏度表示）

required:
  - compatible
  - reg
  - reg-names
  - interrupts
  - interrupt-names
  - clocks
  - clock-names
  - resets
  - reset-names

allOf:
  - $ref: thermal-sensor.yaml
  - if:
      properties:
        compatible:
          contains:
            enum:
              - nvidia,tegra124-soctherm
              - nvidia,tegra210-soctherm
    then:
      properties:
        reg:
          items:
            - description: SOCTHERM寄存器集
            - description: 时钟和复位控制器寄存器

        reg-names:
          items:
            - const: soctherm-reg
            - const: car-reg

    else:
      properties:
        reg:
          items:
            - description: SOCTHERM寄存器集
            - description: CCROC寄存器

        reg-names:
          items:
            - const: soctherm-reg
            - const: ccroc-reg

additionalProperties: false

examples:
  - |
    #include <dt-bindings/clock/tegra124-car.h>
    #include <dt-bindings/interrupt-controller/arm-gic.h>
    #include <dt-bindings/thermal/tegra124-soctherm.h>

    soctherm@700e2000 {
        compatible = "nvidia,tegra124-soctherm";
        reg = <0x700e2000 0x600>, /* SOC_THERM reg_base */
              <0x60006000 0x400>; /* CAR reg_base */
        reg-names = "soctherm-reg", "car-reg";
        interrupts = <GIC_SPI 48 IRQ_TYPE_LEVEL_HIGH>,
                     <GIC_SPI 51 IRQ_TYPE_LEVEL_HIGH>;
        interrupt-names = "thermal", "edp";
        clocks = <&tegra_car TEGRA124_CLK_TSENSOR>,
                 <&tegra_car TEGRA124_CLK_SOC_THERM>;
        clock-names = "tsensor", "soctherm";
        resets = <&tegra_car 78>;
        reset-names = "soctherm";

        #thermal-sensor-cells = <1>;

        nvidia,thermtrips = <TEGRA124_SOCTHERM_SENSOR_CPU 102500>,
                            <TEGRA124_SOCTHERM_SENSOR_GPU 103000>;

        throttle-cfgs {
            /*
             * 当“重度”冷却设备被触发时，
             * 硬件将在85%深度下跳过CPU时钟脉冲，
             * 在85%级别下跳过GPU时钟脉冲
             */
            heavy {
                nvidia,priority = <100>;
                nvidia,cpu-throt-percent = <85>;
                nvidia,gpu-throt-level = <TEGRA_SOCTHERM_THROT_LEVEL_HIGH>;

                #cooling-cells = <2>;
            };

            /*
             * 当“轻度”冷却设备被触发时，
             * 硬件将在50%深度下跳过CPU时钟脉冲，
             * 在50%级别下跳过GPU时钟脉冲
             */
            light {
                nvidia,priority = <80>;
                nvidia,cpu-throt-percent = <50>;
                nvidia,gpu-throt-level = <TEGRA_SOCTHERM_THROT_LEVEL_LOW>;

                #cooling-cells = <2>;
            };

            /*
             * 如果这两个设备同时被触发，硬件限频仲裁器会选择优先级最高的作为最终限频设置来跳过CPU脉冲
*/

            oc1 {
                nvidia,priority = <50>;
                nvidia,polarity-active-low;
                nvidia,count-threshold = <100>;
                nvidia,alarm-filter = <5100000>;
                nvidia,throttle-period-us = <0>;
                nvidia,cpu-throt-percent = <75>;
                nvidia,gpu-throt-level = <TEGRA_SOCTHERM_THROT_LEVEL_MED>;
            };
        };
    };

  # 引用Tegra132的“reg”，“reg-names”和“throttle-cfgs”
  - |
    thermal-sensor@700e2000 {
        compatible = "nvidia,tegra132-soctherm";
        reg = <0x700e2000 0x600>, /* SOC_THERM reg_base */
              <0x70040000 0x200>; /* CCROC reg_base */
        reg-names = "soctherm-reg", "ccroc-reg";
        interrupts = <GIC_SPI 48 IRQ_TYPE_LEVEL_HIGH>,
                     <GIC_SPI 51 IRQ_TYPE_LEVEL_HIGH>;
        interrupt-names = "thermal", "edp";
        clocks = <&tegra_car TEGRA124_CLK_TSENSOR>,
                 <&tegra_car TEGRA124_CLK_SOC_THERM>;
        clock-names = "tsensor", "soctherm";
        resets = <&tegra_car 78>;
        reset-names = "soctherm";
        #thermal-sensor-cells = <1>;

        throttle-cfgs {
            /*
             * 当“重度”冷却设备被触发时，
             * 硬件将在HIGH级别下跳过CPU时钟脉冲
             */
            heavy {
                nvidia,priority = <100>;
                nvidia,cpu-throt-level = <TEGRA_SOCTHERM_THROT_LEVEL_HIGH>;

                #cooling-cells = <2>;
            };

            /*
             * 当“轻度”冷却设备被触发时，
             * 硬件将在MED级别下跳过CPU时钟脉冲
             */
            light {
                nvidia,priority = <80>;
                nvidia,cpu-throt-level = <TEGRA_SOCTHERM_THROT_LEVEL_MED>;

                #cooling-cells = <2>;
            };

            /*
             * 如果这两个设备同时被触发，硬件限频仲裁器会选择优先级最高的作为最终限频设置来跳过CPU脉冲
*/
        };
    };

  # 引用热传感器
  - |
    thermal-zones {
        cpu-thermal {
            polling-delay-passive = <1000>;
            polling-delay = <1000>;

            thermal-sensors = <&soctherm TEGRA124_SOCTHERM_SENSOR_CPU>;

            trips {
                cpu_shutdown_trip: shutdown-trip {
                    temperature = <102500>;
                    hysteresis = <1000>;
                    type = "critical";
                };

                cpu_throttle_trip: throttle-trip {
                    temperature = <100000>;
                    hysteresis = <1000>;
                    type = "hot";
                };
            };

            cooling-maps {
                map0 {
                    trip = <&cpu_throttle_trip>;
                    cooling-device = <&throttle_heavy 1 1>;
                };
            };
        };
    };
```

## Documentation/devicetree/bindings/thermal/nvidia,tegra186-bpmp-thermal_cn.yaml
~~~~yaml
```yaml
# SPDX-文件许可人: (GPL-2.0-only 或 BSD-2-Clause)
%YAML 1.2
---
$id: http://devicetree.org/schemas/thermal/nvidia,tegra186-bpmp-thermal.yaml#
$schema: http://devicetree.org/meta-schemas/core.yaml#

title: NVIDIA Tegra186 (及后续版本) BPMP 温度传感器

maintainers:
  - Thierry Reding <thierry.reding@gmail.com>
  - Jon Hunter <jonathanh@nvidia.com>

description: |
  在 Tegra186 中，BPMP（启动和电源管理处理器）实现了
  一个接口，用于读取系统温度，包括 CPU 集群和 GPU 温度。此绑定描述了由 BPMP
  暴露的温度传感器。
BPMP 温度节点必须直接位于主 BPMP
  节点内。有关 BPMP 绑定的详细信息，请参阅 ../firmware/nvidia,tegra186-bpmp.yaml
$ref: thermal-sensor.yaml#

properties:
  compatible:
    enum:
      - nvidia,tegra186-bpmp-thermal
      - nvidia,tegra194-bpmp-thermal

  '#thermal-sensor-cells':
    const: 1

unevaluatedProperties: false
```
~~~~
