## Documentation/devicetree/bindings/thermal/nvidia,tegra30-tsensor_cn.yaml
```yaml
# SPDX-许可证标识符: (GPL-2.0-only 或 BSD-2-Clause)
%YAML 1.2
---
$id: http://devicetree.org/schemas/thermal/nvidia,tegra30-tsensor.yaml#
$schema: http://devicetree.org/meta-schemas/core.yaml#

title: NVIDIA Tegra30 温度传感器

maintainers:
  - Dmitry Osipenko <digetx@gmail.com>
  - Jon Hunter <jonathanh@nvidia.com>
  - Thierry Reding <thierry.reding@gmail.com>

description: |
  TSENSOR 提供温度和电压传感器以监控芯片的温度和电压。传感器分布在整个芯片上以测量整个芯片的温度。TSENSOR 模块:

    在达到特定的温度/电压阈值时，生成一个中断到软件以通过 DVFS 降低温度
在达到特定的温度/电压阈值时，生成一个信号给 CAR 以将 CPU 频率减半
当温度达到危险高的水平时，向 PMC 发送一个信号以复位芯片，并在 PMC 中设置一个标志
TSENSOR 有两个通道，用于监控 SoC 的两个不同位置
$ref: thermal-sensor.yaml#

properties:
  compatible:
    const: nvidia,tegra30-tsensor

  reg:
    maxItems: 1

  clocks:
    maxItems: 1

  resets:
    maxItems: 1

  interrupts:
    maxItems: 1

  "#thermal-sensor-cells":
    const: 1

required:
  - compatible
  - reg
  - clocks
  - resets
  - interrupts

unevaluatedProperties: false

examples:
  - |
    thermal-sensor@70014000 {
      compatible = "nvidia,tegra30-tsensor";
      reg = <0x70014000 0x500>;
      interrupts = <0 102 4>;
      clocks = <&clk 100>;
      resets = <&rst 100>;

      #thermal-sensor-cells = <1>;
    };
```

## Documentation/devicetree/bindings/thermal/qcom,spmi-temp-alarm_cn.yaml
```yaml
# SPDX-文件许可人: GPL-2.0-only 或 BSD-2-Clause
%YAML 1.2
---
$id: http://devicetree.org/schemas/thermal/qcom,spmi-temp-alarm.yaml#
$schema: http://devicetree.org/meta-schemas/core.yaml#

title: 高通 QPNP PMIC 温度报警

maintainers:
  - Bjorn Andersson <bjorn.andersson@linaro.org>

description:
  QPNP 温度报警外设位于使用高通 SPMI 实现的高通 PMIC 芯片内部。这些外设提供了一个中断信号和状态寄存器来识别高 PMIC 晶圆温度。
allOf:
  - $ref: thermal-sensor.yaml#

properties:
  compatible:
    const: qcom,spmi-temp-alarm

  reg:
    maxItems: 1

  interrupts:
    maxItems: 1

  io-channels:
    items:
      - description: ADC 通道，报告芯片晶圆温度

  io-channel-names:
    items:
      - const: thermal

  '#thermal-sensor-cells':
    const: 0

required:
  - compatible
  - reg
  - interrupts

additionalProperties: false

examples:
  - |
    #include <dt-bindings/interrupt-controller/arm-gic.h>

    pmic {
        #address-cells = <1>;
        #size-cells = <0>;

        pm8350_temp_alarm: temperature-sensor@a00 {
            compatible = "qcom,spmi-temp-alarm";
            reg = <0xa00>;
            interrupts = <0x1 0xa 0x0 IRQ_TYPE_EDGE_BOTH>;
            #thermal-sensor-cells = <0>;
        };
    };

    thermal-zones {
        pm8350_thermal: pm8350c-thermal {
            polling-delay-passive = <100>;
            polling-delay = <0>;
            thermal-sensors = <&pm8350_temp_alarm>;

            trips {
                pm8350_trip0: trip0 {
                    temperature = <95000>;
                    hysteresis = <0>;
                    type = "passive";
                };

                pm8350_crit: pm8350c-crit {
                    temperature = <115000>;
                    hysteresis = <0>;
                    type = "critical";
                };
            };
        };
    };
```

## Documentation/devicetree/bindings/thermal/qcom-lmh_cn.yaml
~~~~yaml
```yaml
# SPDX-许可证标识符: (GPL-2.0-only 或 BSD-2-Clause)
# 版权所有 2021 Linaro 有限公司
%YAML 1.2
---
$id: http://devicetree.org/schemas/thermal/qcom-lmh.yaml#
$schema: http://devicetree.org/meta-schemas/core.yaml#

标题: 高通 Limits 管理硬件 (LMh)

维护者:
  - Thara Gopinath <thara.gopinath@gmail.com>

描述:
  Limits 管理硬件 (LMh) 是某些高通 SoC 上的硬件基础设施，它可以根据软件编程为像 CPU 这样的特定 IP 强制执行温度和电流限制。

属性:
  compatible:
    oneOf:
      - 枚举:
          - qcom,sc8180x-lmh
          - qcom,sdm845-lmh
          - qcom,sm8150-lmh
      - 项:
          - 常量: qcom,qcm2290-lmh
          - 常量: qcom,sm8150-lmh

  reg:
    项:
      - 描述: 核心寄存器

  interrupts:
    maxItems: 1

  '#interrupt-cells':
    常量: 1

  interrupt-controller: true

  cpus:
    描述:
      LMh 集群中第一个 CPU 的 phandle
    maxItems: 1

  qcom,lmh-temp-arm-millicelsius:
    描述:
      表示 LMh 热状态机被启动时的温度阈值的一个整数

  qcom,lmh-temp-low-millicelsius:
    描述:
      表示状态机将尝试取消频率节流时的温度阈值的一个整数

  qcom,lmh-temp-high-millicelsius:
    描述:
      表示状态机将尝试节流频率时的温度阈值的一个整数

必需:
  - compatible
  - reg
  - interrupts
  - '#interrupt-cells'
  - interrupt-controller
  - cpus
  - qcom,lmh-temp-arm-millicelsius
  - qcom,lmh-temp-low-millicelsius
  - qcom,lmh-temp-high-millicelsius

额外属性: false

示例:
  - |
    #include <dt-bindings/interrupt-controller/arm-gic.h>

    lmh@17d70800 {
      compatible = "qcom,sdm845-lmh";
      reg = <0x17d70800 0x400>;
      interrupts = <GIC_SPI 33 IRQ_TYPE_LEVEL_HIGH>;
      cpus = <&CPU4>;
      qcom,lmh-temp-arm-millicelsius = <65000>;
      qcom,lmh-temp-low-millicelsius = <94500>;
      qcom,lmh-temp-high-millicelsius = <95000>;
      interrupt-controller;
      #interrupt-cells = <1>;
    };
```
请注意，`标题` 和 `描述` 等字段已经根据 YAML 规范进行了翻译。另外，注释和代码样例中的文本也已翻译成中文。
~~~~

## Documentation/devicetree/bindings/thermal/qcom-spmi-adc-tm-hc_cn.yaml
```yaml
下面是给定内容的中文翻译：

# SPDX-License-Identifier: (GPL-2.0 OR BSD-2-Clause)
%YAML 1.2
---
$id: http://devicetree.org/schemas/thermal/qcom-spmi-adc-tm-hc.yaml#
$schema: http://devicetree.org/meta-schemas/core.yaml#

title: 高通 SPMI PMIC ADC HC 热监控
maintainers:
  - Dmitry Baryshkov <dmitry.baryshkov@linaro.org>

$ref: thermal-sensor.yaml#

properties:
  compatible:
    const: qcom,spmi-adc-tm-hc

  reg:
    maxItems: 1

  interrupts:
    maxItems: 1

  "#thermal-sensor-cells":
    const: 1

  "#address-cells":
    const: 1

  "#size-cells":
    const: 0

  qcom,avg-samples:
    $ref: /schemas/types.yaml#/definitions/uint32
    description: 用于测量的样本数量
  enum:
      - 1
      - 2
      - 4
      - 8
      - 16
    default: 1

  qcom,decimation:
    $ref: /schemas/types.yaml#/definitions/uint32
    description: 此参数用于降低 ADC 采样率
    更快的测量可以通过减少抽取比率来实现
  enum:
      - 256
      - 512
      - 1024
    default: 1024

patternProperties:
  "^([-a-z0-9]*)@[0-7]$":
    type: object
    description:
      表示一个热传感器
    properties:
      reg:
        description: 指定传感器通道。PMIC5 的 ADC TM 有 8 个通道
        minimum: 0
        maximum: 7

      io-channels:
        description:
          来自通用 IIO 绑定。用于将 PMIC ADC 通道连接到热监控器

      qcom,ratiometric:
        $ref: /schemas/types.yaml#/definitions/flag
        description:
          通道校准类型
如果指定了此属性，VADC 将使用 VDD 参考（1.875V）和 GND 进行通道校准。如果没有找到该属性，
则将使用 0V 和 1.25V 参考通道进行校准，也称为绝对校准。
      qcom,hw-settle-time-us:
        description: AMUX 被配置与 ADC 开始转换之间的时间
  enum: [0, 100, 200, 300, 400, 500, 600, 700, 1000, 2000, 4000, 6000, 8000, 10000]

      qcom,pre-scaling:
        $ref: /schemas/types.yaml#/definitions/uint32-array
        description: 用于在信号馈送到 VADC 之前对通道输入信号进行缩放
          此节点的配置是为了了解预设的比例，并使用它来进行后缩放。这是一个整数对，表示输入信号被乘以的分数的分子和分母。例如，<1 3> 表示信号在 ADC 测量前被缩放到其值的 1/3。如果未找到此属性，则会使用依赖于芯片的默认值。
  items:
          - const: 1
          - enum: [ 1, 3, 4, 6, 20, 8, 10 ]

    required:
      - reg
      - io-channels

    additionalProperties:
      false

required:
  - compatible
  - reg
  - interrupts
  - "#address-cells"
  - "#size-cells"

unevaluatedProperties: false

examples:
  - |
    #include <dt-bindings/iio/qcom,spmi-vadc.h>
    #include <dt-bindings/interrupt-controller/irq.h>

    pmic {
        #address-cells = <1>;
        #size-cells = <0>;

        pm8998_adc: adc@3100 {
            compatible = "qcom,spmi-adc-rev2";
            reg = <0x3100>;
            #address-cells = <1>;
            #size-cells = <0>;
            #io-channel-cells = <1>;

            /* 其他属性省略 */
            channel@4c {
                reg = <ADC5_XO_THERM_100K_PU>;
            };
        };

        adc-tm@3400 {
            compatible = "qcom,spmi-adc-tm-hc";
            reg = <0x3400>;
            interrupts = <0x2 0x34 0x0 IRQ_TYPE_EDGE_RISING>;
            #thermal-sensor-cells = <1>;
            #address-cells = <1>;
            #size-cells = <0>;

            thermistor@1 {
                reg = <1>;
                io-channels = <&pm8998_adc ADC5_XO_THERM_100K_PU>;
                qcom,ratiometric;
                qcom,hw-settle-time-us = <200>;
            };
        };
    };
..
```

## Documentation/devicetree/bindings/thermal/qcom-spmi-adc-tm5_cn.yaml
~~~~yaml
下面是给定内容的中文翻译：

# SPDX-License-Identifier: (GPL-2.0 OR BSD-2-Clause)
%YAML 1.2
---
$id: http://devicetree.org/schemas/thermal/qcom-spmi-adc-tm5.yaml#
$schema: http://devicetree.org/meta-schemas/core.yaml#

title: 高通SPMI电源管理集成电路ADC温度监控
maintainers:
  - Dmitry Baryshkov <dmitry.baryshkov@linaro.org>

$ref: thermal-sensor.yaml#

properties:
  compatible:
    enum:
      - qcom,spmi-adc-tm5
      - qcom,spmi-adc-tm5-gen2
      - qcom,adc-tm7 # 不完整 / 可能会更改

  reg:
    maxItems: 1

  interrupts:
    maxItems: 1

  "#thermal-sensor-cells":
    const: 1

  "#address-cells":
    const: 1

  "#size-cells":
    const: 0

  qcom,avg-samples:
    $ref: /schemas/types.yaml#/definitions/uint32
    description: 用于测量的样本数量
不适用于Gen2 ADC_TM外设
enum:
      - 1
      - 2
      - 4
      - 8
      - 16
    default: 1

  qcom,decimation:
    $ref: /schemas/types.yaml#/definitions/uint32
    description: 此参数用于降低ADC采样率
通过减少分频比可以进行更快的测量
不适用于Gen2 ADC_TM外设
enum:
      - 250
      - 420
      - 840
    default: 840

patternProperties:
  "^([-a-z0-9]*)@[0-7]$":
    type: object
    description:
      表示一个温度传感器
properties:
      reg:
        description: 指定传感器通道。PMIC5的ADC TM有8个通道
        minimum: 0
        maximum: 7

      io-channels:
        description:
          来自通用IIO绑定。用于将PMIC ADC通道连接到温度监控器

      qcom,ratiometric:
        $ref: /schemas/types.yaml#/definitions/flag
        description:
          通道校准类型
如果指定了此属性，VADC将使用VDD参考（1.875V）和GND进行通道校准。如果没有找到该属性，
          通道将使用0V和1.25V参考通道进行校准，也称为绝对校准
qcom,hw-settle-time-us:
        description: AMUX配置与ADC开始转换之间的时间
enum: [15, 100, 200, 300, 400, 500, 600, 700, 1000, 2000, 4000, 8000, 16000, 32000, 64000, 128000]

      qcom,pre-scaling:
        $ref: /schemas/types.yaml#/definitions/uint32-array
        description: 用于在信号输入到VADC之前对通道输入信号进行缩放。
          此节点的配置是为了了解预设的比例并使用它来进行后缩放。它是一对整数，
          表示输入信号乘以的分数的分子和分母。例如，<1 3>表示信号在ADC测量前被缩放到其值的1/3。如果未找到此属性，则根据芯片使用默认值。
这段文档描述了两个示例，涉及Qualcomm SPMI (Smart Power Management Interface) ADC (Analog-to-Digital Converter) 设备的配置。下面是对这段内容的中文翻译。

### 属性：
- `const`: 1
- `enum`: [1, 3, 4, 6, 20, 8, 10]

`qcom,avg-samples`:
  - `$ref`: `/schemas/types.yaml#/definitions/uint32`
  - 描述：用于测量的样本数量
  - 此属性仅适用于Gen2 ADC_TM外设
  - `enum`: [1, 2, 4, 8, 16]
  - 默认值：1

`qcom,decimation`:
  - `$ref`: `/schemas/types.yaml#/definitions/uint32`
  - 描述：此参数用于降低ADC采样率
  - 减少抽取比可以实现更快的测量
  - 此属性仅适用于Gen2 ADC_TM外设
  - `enum`: [85, 340, 1360]
  - 默认值：1360

### 必需项：
- `reg`
- `io-channels`

### 额外属性：
- `false`

### allOf：
- 如果`compatible`包含`qcom,spmi-adc-tm5`：
  - `patternProperties`:
    - `"^([-a-z0-9]*)@[0-7]$"`:
      - `properties`:
        - `qcom,decimation`: `false`
        - `qcom,avg-samples`: `false`

- 如果`compatible`包含`qcom,spmi-adc-tm5-gen2`：
  - `properties`:
    - `qcom,avg-samples`: `false`
    - `qcom,decimation`: `false`

### 必需项：
- `compatible`
- `reg`
- `interrupts`
- `"#address-cells"`
- `"#size-cells"`

### 未评估的属性：
- `false`

### 示例：

#### 示例 1:
```yaml
#include <dt-bindings/iio/qcom,spmi-vadc.h>
#include <dt-bindings/interrupt-controller/irq.h>

pmic {
    #address-cells = <1>;
    #size-cells = <0>;

    pm8150b_adc: adc@3100 {
        compatible = "qcom,spmi-adc5";
        reg = <0x3100>;
        #address-cells = <1>;
        #size-cells = <0>;
        #io-channel-cells = <1>;

        /* 其他属性被省略 */
        channel@4f {
            reg = <ADC5_AMUX_THM3_100K_PU>;
            qcom,ratiometric;
            qcom,hw-settle-time = <200>;
            label = "conn_therm";
        };
    };

    adc-tm@3500 {
        compatible = "qcom,spmi-adc-tm5";
        reg = <0x3500>;
        interrupts = <0x2 0x35 0x0 IRQ_TYPE_EDGE_RISING>;
        #thermal-sensor-cells = <1>;
        #address-cells = <1>;
        #size-cells = <0>;

        conn-therm@0 {
            reg = <0>;
            io-channels = <&pm8150b_adc ADC5_AMUX_THM3_100K_PU>;
            qcom,ratiometric;
            qcom,hw-settle-time-us = <200>;
        };
    };
};
```

#### 示例 2:
```yaml
#include <dt-bindings/iio/qcom,spmi-adc7-pmk8350.h>
#include <dt-bindings/iio/qcom,spmi-adc7-pm8350.h>
#include <dt-bindings/interrupt-controller/irq.h>

pmic {
    #address-cells = <1>;
    #size-cells = <0>;

    pmk8350_vadc: adc@3100 {
        compatible = "qcom,spmi-adc7";
        reg = <0x3100>;
        #address-cells = <1>;
        #size-cells = <0>;
        #io-channel-cells = <1>;

        /* 其他属性被省略 */
        channel@44 {
            reg = <PMK8350_ADC7_AMUX_THM1_100K_PU>;
            qcom,ratiometric;
            qcom,hw-settle-time = <200>;
            label = "xo_therm";
        };

        channel@147 {
            reg = <PM8350_ADC7_AMUX_THM4_100K_PU(1)>;
            qcom,ratiometric;
            qcom,hw-settle-time = <200>;
            label = "conn_therm";
        };
    };

    adc-tm@3400 {
        compatible = "qcom,spmi-adc-tm5-gen2";
        reg = <0x3400>;
        interrupts = <0x0 0x34 0x0 IRQ_TYPE_EDGE_RISING>;
        #thermal-sensor-cells = <1>;
        #address-cells = <1>;
        #size-cells = <0>;

        pmk8350-xo-therm@0 {
            reg = <0>;
            io-channels = <&pmk8350_vadc PMK8350_ADC7_AMUX_THM1_100K_PU>;
            qcom,decimation = <340>;
            qcom,ratiometric;
            qcom,hw-settle-time-us = <200>;
        };

        conn-therm@1 {
            reg = <1>;
            io-channels = <&pmk8350_vadc PM8350_ADC7_AMUX_THM4_100K_PU(1)>;
            qcom,avg-samples = <2>;
            qcom,ratiometric;
            qcom,hw-settle-time-us = <200>;
        };
    };
};
```
这些示例展示了如何配置Qualcomm SPMI ADC设备及其相关的温度传感器。
~~~~
