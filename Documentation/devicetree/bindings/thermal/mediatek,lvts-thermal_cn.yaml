## Documentation/devicetree/bindings/thermal/qoriq-thermal_cn.yaml
```yaml
# SPDX-文件许可人: (GPL-2.0-only 或 BSD-2-Clause)
%YAML 1.2
---
$id: http://devicetree.org/schemas/thermal/qoriq-thermal.yaml#
$schema: http://devicetree.org/meta-schemas/core.yaml#

标题: Freescale QorIQ 系统芯片上的热监控单元 (TMU)

维护者:
  - Shawn Guo <shawnguo@kernel.org>
  - Sascha Hauer <s.hauer@pengutronix.de>
  - Fabio Estevam <festevam@gmail.com>

$ref: thermal-sensor.yaml#

属性:
  compatible:
    描述: |
      设备的版本由位于偏移量 0x0BF8 的 TMU IP 块修订寄存器 (IPBRR0) 确定。
      IPBRR0 值与示例芯片之间的对应表：
            值           芯片
            ----------  -----
            0x01900102   T1040
    枚举:
      - fsl,qoriq-tmu
      - fsl,imx8mq-tmu

  reg:
    maxItems: 1

  interrupts:
    maxItems: 1

  fsl,tmu-range:
    $ref: /schemas/types.yaml#/definitions/uint32-array
    描述: |
      根据系统芯片参考手册，要编程到 TTRnCR 中的值。第一个单元格是 TTR0CR，第二个是 TTR1CR，依此类推。
    minItems: 2
    maxItems: 7

  fsl,tmu-calibration:
    $ref: /schemas/types.yaml#/definitions/uint32-matrix
    描述: |
      包含温度校准数据的单元对列表，根据系统芯片参考手册指定。每对中的第一个单元是要写入 TTCFGR 的值，第二个是要写入 TSCFGR 的值。
    items:
      items:
        - 描述: TTCFGR 的值
        - 描述: TSCFGR 的值
    minItems: 1
    maxItems: 64

  little-endian:
    描述: |
      布尔值，如果存在，则 TMU 寄存器为小端模式。如果不存在，默认为大端模式。
    类型: 布尔值

  clocks:
    maxItems: 1

  "#thermal-sensor-cells":
    常量: 1

必需项:
  - compatible
  - reg
  - interrupts
  - fsl,tmu-range
  - fsl,tmu-calibration

未评估属性: false

示例:
  - |
    tmu@f0000 {
        compatible = "fsl,qoriq-tmu";
        reg = <0xf0000 0x1000>;
        interrupts = <18 2 0 0>;
        fsl,tmu-range = <0x000a0000 0x00090026 0x0008004a 0x0001006a>;
        fsl,tmu-calibration = <0x00000000 0x00000025>,
                              <0x00000001 0x00000028>,
                              <0x00000002 0x0000002d>,
                              <0x00000003 0x00000031>,
                              <0x00000004 0x00000036>,
                              <0x00000005 0x0000003a>,
                              <0x00000006 0x00000040>,
                              <0x00000007 0x00000044>,
                              <0x00000008 0x0000004a>,
                              <0x00000009 0x0000004f>,
                              <0x0000000a 0x00000054>,
                              <0x00010000 0x0000000d>,
                              <0x00010001 0x00000013>,
                              <0x00010002 0x00000019>,
                              <0x00010003 0x0000001f>,
                              <0x00010004 0x00000025>,
                              <0x00010005 0x0000002d>,
                              <0x00010006 0x00000033>,
                              <0x00010007 0x00000043>,
                              <0x00010008 0x0000004b>,
                              <0x00010009 0x00000053>,
                              <0x00020000 0x00000010>,
                              <0x00020001 0x00000017>,
                              <0x00020002 0x0000001f>,
                              <0x00020003 0x00000029>,
                              <0x00020004 0x00000031>,
                              <0x00020005 0x0000003c>,
                              <0x00020006 0x00000042>,
                              <0x00020007 0x0000004d>,
                              <0x00020008 0x00000056>,
                              <0x00030000 0x00000012>,
                              <0x00030001 0x0000001d>;
        #thermal-sensor-cells = <1>;
    };
```

## Documentation/devicetree/bindings/thermal/rcar-thermal_cn.yaml
```yaml
# SPDX-License-Identifier: GPL-2.0-only
# 版权所有 (C) 2020 瑞萨电子公司
%YAML 1.2
---
$id: http://devicetree.org/schemas/thermal/rcar-thermal.yaml#
$schema: http://devicetree.org/meta-schemas/core.yaml#

title: 瑞萨 R-Car 温度监控

maintainers:
  - Niklas Söderlund <niklas.soderlund@ragnatech.se>

properties:
  compatible:
    oneOf:
      - items:
          - enum:
              - renesas,thermal-r8a73a4 # R-Mobile APE6
              - renesas,thermal-r8a7779 # R-Car H1
          - const: renesas,rcar-thermal # 无温度区域的通用配置
      - items:
          - enum:
              - renesas,thermal-r8a7742 # RZ/G1H
              - renesas,thermal-r8a7743 # RZ/G1M
              - renesas,thermal-r8a7744 # RZ/G1N
          - const: renesas,rcar-gen2-thermal # 有温度区域的通用配置
      - items:
          - enum:
              - renesas,thermal-r8a7790 # R-Car H2
              - renesas,thermal-r8a7791 # R-Car M2-W
              - renesas,thermal-r8a7792 # R-Car V2H
              - renesas,thermal-r8a7793 # R-Car M2-N
          - const: renesas,rcar-gen2-thermal # 有温度区域的通用配置
          - const: renesas,rcar-thermal # 无温度区域的通用配置
      - items:
          - enum:
              - renesas,thermal-r8a774c0 # RZ/G2E
              - renesas,thermal-r8a77970 # R-Car V3M
              - renesas,thermal-r8a77990 # R-Car E3
              - renesas,thermal-r8a77995 # R-Car D3
  reg:
    description:
      温度寄存器的地址范围。如果给出多个范围，第一个必须是公共寄存器，后面跟着数据手册中指定的每个传感器
minItems: 1
    maxItems: 4

  interrupts:
    minItems: 1
    maxItems: 3

  clocks:
    maxItems: 1

  power-domains:
    maxItems: 1

  resets:
    maxItems: 1

  "#thermal-sensor-cells":
    const: 0

required:
  - compatible
  - reg

allOf:
  - if:
      not:
        properties:
          compatible:
            contains:
              enum:
                - renesas,thermal-r8a73a4 # R-Mobile APE6
                - renesas,thermal-r8a7779 # R-Car H1
    then:
      required:
        - resets
        - '#thermal-sensor-cells'

  - if:
      not:
        properties:
          compatible:
            contains:
              const: renesas,thermal-r8a7779 # R-Car H1
    then:
      required:
        - interrupts
        - clocks
        - power-domains

additionalProperties: false

examples:
  # 示例（不支持中断）
  - |
    thermal@ffc48000 {
        compatible = "renesas,thermal-r8a7779", "renesas,rcar-thermal";
        reg = <0xffc48000 0x38>;
    };

  # 示例（支持中断）
  - |
    #include <dt-bindings/clock/r8a73a4-clock.h>
    #include <dt-bindings/interrupt-controller/arm-gic.h>
    #include <dt-bindings/interrupt-controller/irq.h>

    thermal@e61f0000 {
        compatible = "renesas,thermal-r8a73a4", "renesas,rcar-thermal";
        reg = <0xe61f0000 0x14>, <0xe61f0100 0x38>,
              <0xe61f0200 0x38>, <0xe61f0300 0x38>;
        interrupts = <GIC_SPI 69 IRQ_TYPE_LEVEL_HIGH>;
        clocks = <&mstp5_clks R8A73A4_CLK_THERMAL>;
        power-domains = <&pd_c5>;
    };

  # 示例（带温度区域）
  - |
    #include <dt-bindings/clock/r8a7790-cpg-mssr.h>
    #include <dt-bindings/interrupt-controller/arm-gic.h>
    #include <dt-bindings/power/r8a7790-sysc.h>

    thermal: thermal@e61f0000 {
        compatible = "renesas,thermal-r8a7790",
                     "renesas,rcar-gen2-thermal",
                     "renesas,rcar-thermal";
        reg = <0xe61f0000 0x10>, <0xe61f0100 0x38>;
        interrupts = <GIC_SPI 69 IRQ_TYPE_LEVEL_HIGH>;
        clocks = <&cpg CPG_MOD 522>;
        power-domains = <&sysc R8A7790_PD_ALWAYS_ON>;
        resets = <&cpg 522>;
        #thermal-sensor-cells = <0>;
    };

    thermal-zones {
        cpu_thermal: cpu-thermal {
            polling-delay-passive = <1000>;
            polling-delay = <5000>;

            thermal-sensors = <&thermal>;

            trips {
                cpu-crit {
                    temperature = <115000>;
                    hysteresis = <0>;
                    type = "critical";
                };
            };
            cooling-maps {
            };
        };
    };
```

## Documentation/devicetree/bindings/thermal/rockchip-thermal_cn.yaml
```yaml
# SPDX-License-Identifier: GPL-2.0-only
%YAML 1.2
---
$id: http://devicetree.org/schemas/thermal/rockchip-thermal.yaml#
$schema: http://devicetree.org/meta-schemas/core.yaml#

title: Rockchip SoCs 上的温度传感器 ADC (TSADC)

maintainers:
  - Heiko Stuebner <heiko@sntech.de>

$ref: thermal-sensor.yaml#

properties:
  compatible:
    enum:
      - rockchip,px30-tsadc
      - rockchip,rk3228-tsadc
      - rockchip,rk3288-tsadc
      - rockchip,rk3328-tsadc
      - rockchip,rk3368-tsadc
      - rockchip,rk3399-tsadc
      - rockchip,rk3568-tsadc
      - rockchip,rk3588-tsadc
      - rockchip,rv1108-tsadc

  reg:
    maxItems: 1

  interrupts:
    maxItems: 1

  clocks:
    minItems: 2
    maxItems: 2

  clock-names:
    items:
      - const: tsadc
      - const: apb_pclk

  resets:
    minItems: 1
    maxItems: 3

  reset-names:
    minItems: 1
    items:
      - const: tsadc-apb
      - const: tsadc
      - const: tsadc-phy

  "#thermal-sensor-cells":
    const: 1

  rockchip,grf:
    description: 通用寄存文件的 syscon 节点的 phandle
$ref: /schemas/types.yaml#/definitions/phandle

  rockchip,hw-tshut-temp:
    description: 硬件控制的关机温度值
$ref: /schemas/types.yaml#/definitions/uint32

  rockchip,hw-tshut-mode:
    description: 硬件控制的关机模式 0:CRU 1:GPIO
$ref: /schemas/types.yaml#/definitions/uint32
    enum: [0, 1]

  rockchip,hw-tshut-polarity:
    description: 硬件控制的有效极性 0:低电平 1:高电平
$ref: /schemas/types.yaml#/definitions/uint32
    enum: [0, 1]

required:
  - compatible
  - reg
  - interrupts
  - clocks
  - clock-names
  - resets

unevaluatedProperties: false

examples:
  - |
    #include <dt-bindings/interrupt-controller/arm-gic.h>
    #include <dt-bindings/clock/rk3288-cru.h>

    tsadc: tsadc@ff280000 {
        compatible = "rockchip,rk3288-tsadc";
        reg = <0xff280000 0x100>;
        interrupts = <GIC_SPI 37 IRQ_TYPE_LEVEL_HIGH>;
        clocks = <&cru SCLK_TSADC>, <&cru PCLK_TSADC>;
        clock-names = "tsadc", "apb_pclk";
        resets = <&cru SRST_TSADC>;
        reset-names = "tsadc-apb";
        #thermal-sensor-cells = <1>;
        rockchip,hw-tshut-temp = <95000>;
        rockchip,hw-tshut-mode = <0>;
        rockchip,hw-tshut-polarity = <0>;
    };
```

## Documentation/devicetree/bindings/thermal/rzg2l-thermal_cn.yaml
```yaml
# SPDX-许可证标识符: (GPL-2.0-only 或 BSD-2-Clause)
%YAML 1.2
---
$id: http://devicetree.org/schemas/thermal/rzg2l-thermal.yaml#
$schema: http://devicetree.org/meta-schemas/core.yaml#

title: Renesas RZ/G2L 温度传感器单元

description:
  在 RZ/G2L 系统芯片中，温度传感器单元 (TSU) 测量 LSI 内部的温度 (Tj)
maintainers:
  - Biju Das <biju.das.jz@bp.renesas.com>

$ref: thermal-sensor.yaml#

properties:
  compatible:
    items:
      - enum:
          - renesas,r9a07g043-tsu # RZ/G2UL 和 RZ/Five
          - renesas,r9a07g044-tsu # RZ/G2{L,LC}
          - renesas,r9a07g054-tsu # RZ/V2L
      - const: renesas,rzg2l-tsu

  reg:
    maxItems: 1

  clocks:
    maxItems: 1

  power-domains:
    maxItems: 1

  resets:
    maxItems: 1

  "#thermal-sensor-cells":
    const: 1

required:
  - compatible
  - reg
  - clocks
  - power-domains
  - resets

unevaluatedProperties: false

examples:
  - |
    #include <dt-bindings/clock/r9a07g044-cpg.h>

    tsu: thermal@10059400 {
        compatible = "renesas,r9a07g044-tsu",
                     "renesas,rzg2l-tsu";
        reg = <0x10059400 0x400>;
        clocks = <&cpg CPG_MOD R9A07G044_TSU_PCLK>;
        resets = <&cpg R9A07G044_TSU_PRESETN>;
        power-domains = <&cpg>;
        #thermal-sensor-cells = <1>;
    };

    thermal-zones {
        cpu-thermal {
            polling-delay-passive = <250>;
            polling-delay = <1000>;
            thermal-sensors = <&tsu 0>;

            trips {
                sensor_crit: sensor-crit {
                    temperature = <125000>;
                    hysteresis = <1000>;
                    type = "critical";
                };
            };
        };
    };
```
