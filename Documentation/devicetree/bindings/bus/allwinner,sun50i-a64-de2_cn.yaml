## Documentation/devicetree/bindings/bus/qcom,ebi2_cn.txt
~~~~
### Qualcomm 外部总线接口 2 (EBI2)

EBI2 包含两个外设模块：XMEM 和 LCDC。XMEM 负责处理任何外部存储器（如 NAND 或其他内存映射的外设），而 LCDC 则处理 LCD 显示屏。
正如所述，它将设备连接到一个外部总线接口，这意味着地址线（最多 9 条地址线，因此只能寻址 1KiB 的外部存储空间）、数据线（16 位）、OE（输出使能）、ADV（地址有效，用于某些 NOR 闪存）、WE（写入使能）。此外还有 6 个不同的片选信号（CS0 至 CS5），理论上可以连接 6 个不同的设备。
显然，此总线时钟频率为 64MHz。在封装上有专用引脚，并且总线只能从这些引脚引出。但如果某些引脚未使用，则可以留空或重用为 GPIO 或在某些情况下用作其他正交功能。
此外，CS1 和 CS2 有 -A 和 -B 信号。为什么会有这样的设计尚不清楚。
片选信号具有以下内存范围分配。这部分内存被称为“外围芯片选择 SS FPB0”，其大小为 168MB。

| 片选信号 | 物理地址基址 |
| --- | --- |
| CS0 GPIO134 | 0x1a800000-0x1b000000 (8MB) |
| CS1 GPIO39 (A) / GPIO123 (B) | 0x1b000000-0x1b800000 (8MB) |
| CS2 GPIO40 (A) / GPIO124 (B) | 0x1b800000-0x1c000000 (8MB) |
| CS3 GPIO133 | 0x1d000000-0x25000000 (128 MB) |
| CS4 GPIO132 | 0x1c800000-0x1d000000 (8MB) |
| CS5 GPIO131 | 0x1c000000-0x1c800000 (8MB) |

APQ8060 Qualcomm 应用处理器用户指南 80-N7150-14 Rev. A，2012 年 8 月 6 日包含了一些关于 EBI2 的不完整文档。
FIXME: 手册中提到了“写预充电周期”和“预充电周期”。我们未能确定这些对应硬件中的哪些位字段，或者有效的值是什么。当前的假设是这可能仅用于快速片选信号，而慢速片选信号则被完全理解。还存在一个用于 8 位存储器的“字节设备使能”标志。
FIXME: 片选信号有 SLOW 和 FAST 配置寄存器。这有点不清楚，如果它们是互斥的，是否可以一起使用，或者一些片选信号被硬性设定为 FAST，而其他的则是 SLOW 设计。
XMEM 寄存器完全没有文档说明，但可以通过部分解码，因为 Cypress AN49576 Antioch Westbridge 显然具有类似的寄存器布局，参见：http://www.cypress.com/file/105771/download

### 必需属性：
- compatible：应为其中之一：
  - "qcom,msm8660-ebi2"
  - "qcom,apq8060-ebi2"
- #address-cells：应为 <2>：第一个单元是片选，第二个单元是内存范围内的偏移量
- #size-cells：应为 <1>
- ranges：应设置为：
  ranges = <0 0x0 0x1a800000 0x00800000>,
           <1 0x0 0x1b000000 0x00800000>,
           <2 0x0 0x1b800000 0x00800000>,
           <3 0x0 0x1d000000 0x08000000>,
           <4 0x0 0x1c800000 0x00800000>,
           <5 0x0 0x1c000000 0x00800000>;
- reg：两组寄存器范围：EBI2 配置和 XMEM 配置区域
- reg-names：应为 "ebi2", "xmem"
- clocks：两个时钟，EBI_2X 和 EBI
- clock-names：应为 "ebi2x", "ebi2"

### 可选子节点：
- 在 EBI2 内的节点将被视为设备节点。
以下是可选属性，这些属性可以附加到任何设备子节点上。我们假设每个芯片选择（chipselect）子节点只能有一个设备，否则这些属性将会变得含糊不清。

慢速芯片选择的可选属性数组：
- `qcom,xmem-recovery-cycles`：恢复周期是指在OE被取消后，内存继续驱动数据总线的时间，以避免数据总线上的竞争。当从一个CS读取并切换到另一个CS，或者在同一CS上进行读操作后写操作时会插入这些周期。有效值为0至15。最小值实际上是1，因此即使设置为0也会产生1个恢复周期。
- `qcom,xmem-write-hold-cycles`：写保持周期，即在每次写入后插入的额外周期，最小值为1。数据输出从WE被置位开始直到CS被置位为止。如果保持周期为1（值=0），则CS将保持多一个周期等。有效值为0至15。
- `qcom,xmem-write-delta-cycles`：对于首次向页面或突发内存写入时插入的初始延迟周期。有效值为0至255。
- `qcom,xmem-read-delta-cycles`：对于首次向页面或突发内存读取时插入的初始延迟周期。有效值为0至255。
- `qcom,xmem-write-wait-cycles`：每个写访问的等待周期数，其中0表示1个周期。有效值为0至15。
- `qcom,xmem-read-wait-cycles`：每个读访问的等待周期数，其中0表示1个周期。有效值为0至15。

快速芯片选择的可选属性数组：
- `qcom,xmem-address-hold-enable`：这是一个布尔属性，表明我们需要额外保持一个周期的地址，以满足ADV（地址有效）断言时的保持时间要求。
- `qcom,xmem-adv-to-oe-recovery-cycles`：ADV（地址有效）断言与OE断言之间经过的周期数。例如，2意味着ADV和OE之间有2个周期。有效值为0、1、2或3。
这段文本描述了一个设备树配置，用于定义特定硬件组件（如内存控制器）的属性。以下是翻译成中文的内容：

---

`qcom,xmem-read-hold-cycles`: 表示读取传输第一段的周期长度。对于单个读取传输，这将是芯片选择信号（CS）有效到输出使能信号（OE）有效的这段时间。有效值范围为0至15。
示例：

```plaintext
ebi2@1a100000 {
	compatible = "qcom,apq8060-ebi2";  // 兼容性声明，表示这个节点与“qcom,apq8060-ebi2”兼容
	#address-cells = <2>;  // 地址单元数量
	#size-cells = <1>;  // 大小单元数量
	ranges = <0 0x0 0x1a800000 0x00800000>,  // 定义地址空间映射
		 <1 0x0 0x1b000000 0x00800000>,
		 <2 0x0 0x1b800000 0x00800000>,
		 <3 0x0 0x1d000000 0x08000000>,
		 <4 0x0 0x1c800000 0x00800000>,
		 <5 0x0 0x1c000000 0x00800000>;
	reg = <0x1a100000 0x1000>, <0x1a110000 0x1000>;  // 定义寄存器基地址和大小
	reg-names = "ebi2", "xmem";  // 寄存器名称
	clocks = <&gcc EBI2_2X_CLK>, <&gcc EBI2_CLK>;  // 时钟源
	clock-names = "ebi2x", "ebi2";  // 时钟名称
	/* 确保设置EBI2的引脚控制 */
	pinctrl-names = "default";  // 引脚控制名称
	pinctrl-0 = <&foo_ebi2_pins>;  // 引脚控制配置

	foo-ebi2@2,0 {  // 子节点
		compatible = "foo";  // 兼容性声明
		reg = <2 0x0 0x100>;  // 定义寄存器基地址和大小
		(...)
		qcom,xmem-recovery-cycles = <0>;  // xmem恢复周期
		qcom,xmem-write-hold-cycles = <3>;  // xmem写保持周期
		qcom,xmem-write-delta-cycles = <31>;  // xmem写增量周期
		qcom,xmem-read-delta-cycles = <28>;  // xmem读取增量周期
		qcom,xmem-write-wait-cycles = <9>;  // xmem写等待周期
		qcom,xmem-read-wait-cycles = <9>;  // xmem读取等待周期
	};
};
```

--- 

请注意，这里的“foo”和“foo_ebi2_pins”等是占位符，实际使用中需要替换成具体的设备树节点或配置。
~~~~

## Documentation/devicetree/bindings/bus/qcom,ssbi_cn.yaml
~~~~yaml
```yaml
# SPDX-License-Identifier: (GPL-2.0 OR BSD-2-Clause)
%YAML 1.2
---
$id: 'http://devicetree.org/schemas/bus/qcom,ssbi.yaml'
$schema: 'http://devicetree.org/meta-schemas/core.yaml'

title: 高通单线串行总线接口 (SSBI)

description:
  某些高通MSM设备包含一个点对点的串行总线，用于与有限范围内的设备（主要是电源管理芯片）通信。
maintainers:
  - Andy Gross <agross@kernel.org>
  - Bjorn Andersson <andersson@kernel.org>

properties:
  compatible:
    const: qcom,ssbi

  reg:
    maxItems: 1

  qcom,controller-type:
    description:
      指示控制器应使用哪种SSBI总线变体来与从设备进行通信。所选类型由连接的从设备确定。
    enum:
      - ssbi
      - ssbi2
      - pmic-arbiter

  pmic:
    $ref: '/schemas/mfd/qcom-pm8xxx.yaml'

required:
  - compatible
  - reg
  - qcom,controller-type

additionalProperties: false

examples:
  - |
    #include <dt-bindings/interrupt-controller/irq.h>
    ssbi@c00000 {
        compatible = "qcom,ssbi";
        reg = <0x00c00000 0x1000>;
        qcom,controller-type = "pmic-arbiter";

        pmic {
            compatible = "qcom,pm8821";
            interrupt-parent = <&msmgpio>;
            interrupts = <76 IRQ_TYPE_LEVEL_LOW>;
            #interrupt-cells = <2>;
            interrupt-controller;
            #address-cells = <1>;
            #size-cells = <0>;
        };
    };
```
This is a translation of the provided YAML file into Chinese, maintaining the structure and meaning as closely as possible.
~~~~

## Documentation/devicetree/bindings/bus/qcom,ssc-block-bus_cn.yaml
```yaml
# SPDX-许可证标识符: (GPL-2.0-only 或 BSD-2-Clause)
%YAML 1.2
---
$id: http://devicetree.org/schemas/bus/qcom,ssc-block-bus.yaml#
$schema: http://devicetree.org/meta-schemas/core.yaml#

标题: 在某些 qcom 系统级芯片上提供 SSC 块全局视图的 AHB 总线

维护者:
  - Michael Srba <Michael.Srba@seznam.cz>

描述: |
  此绑定描述了需要按顺序开启的依赖项（时钟、复位、电源域），以使通过 AHB 总线进行通信成为可能。
  另外，reg 属性用于向驱动程序传递两个未记录寄存器的位置信息，这些寄存器作为序列的一部分需要被访问。
  SSC（Snapdragon Sensor Core）块包含一个 GPIO 控制器、I2C/SPI/UART 控制器、Hexagon 核心以及为上述组件提供时钟的时钟控制器。

属性:
  compatible:
    items:
      - const: qcom,msm8998-ssc-block-bus
      - const: qcom,ssc-block-bus

  reg:
    items:
      - description: SSCAON_CONFIG0 寄存器
      - description: SSCAON_CONFIG1 寄存器

  reg-names:
    items:
      - const: mpm_sscaon_config0
      - const: mpm_sscaon_config1

  '#address-cells':
    enum: [ 1, 2 ]

  '#size-cells':
    enum: [ 1, 2 ]

  ranges: true

  clocks:
    maxItems: 6

  clock-names:
    items:
      - const: xo
      - const: aggre2
      - const: gcc_im_sleep
      - const: aggre2_north
      - const: ssc_xo
      - const: ssc_ahbs

  power-domains:
    items:
      - description: CX 电源域
      - description: MX 电源域

  power-domain-names:
    items:
      - const: ssc_cx
      - const: ssc_mx

  resets:
    items:
      - description: 主复位
      - description:
          SSC 分支控制寄存器复位（与 ssc_xo 和 ssc_ahbs 时钟相关联）

  reset-names:
    items:
      - const: ssc_reset
      - const: ssc_bcr

  qcom,halt-regs:
    $ref: /schemas/types.yaml#/definitions/phandle-array
    description: 描述如何定位 ssc AXI 停止寄存器
    items:
      - items:
          - description: 指向代表 TCSR 的 syscon 的 phandle 引用
          - description: ssc AXI 停止寄存器的偏移量

必需:
  - compatible
  - reg
  - reg-names
  - '#address-cells'
  - '#size-cells'
  - ranges
  - clocks
  - clock-names
  - power-domains
  - power-domain-names
  - resets
  - reset-names
  - qcom,halt-regs

附加属性:
  type: object

示例:
  - |
    #include <dt-bindings/clock/qcom,gcc-msm8998.h>
    #include <dt-bindings/clock/qcom,rpmcc.h>
    #include <dt-bindings/power/qcom-rpmpd.h>

    soc {
        #address-cells = <1>;
        #size-cells = <1>;

        // 该节点下的设备物理上位于 SSC 块中，并连接到 ssc 内部总线上；
        ssc_ahb_slave: bus@10ac008 {
            #address-cells = <1>;
            #size-cells = <1>;
            ranges;

            compatible = "qcom,msm8998-ssc-block-bus", "qcom,ssc-block-bus";
            reg = <0x10ac008 0x4>, <0x10ac010 0x4>;
            reg-names = "mpm_sscaon_config0", "mpm_sscaon_config1";

            clocks = <&xo>,
                     <&rpmcc RPM_SMD_AGGR2_NOC_CLK>,
                     <&gcc GCC_IM_SLEEP>,
                     <&gcc AGGRE2_SNOC_NORTH_AXI>,
                     <&gcc SSC_XO>,
                     <&gcc SSC_CNOC_AHBS_CLK>;
            clock-names = "xo", "aggre2", "gcc_im_sleep", "aggre2_north", "ssc_xo", "ssc_ahbs";

            resets = <&gcc GCC_SSC_RESET>, <&gcc GCC_SSC_BCR>;
            reset-names = "ssc_reset", "ssc_bcr";

            power-domains = <&rpmpd MSM8998_SSCCX>, <&rpmpd MSM8998_SSCMX>;
            power-domain-names = "ssc_cx", "ssc_mx";

            qcom,halt-regs = <&tcsr_mutex_regs 0x26000>;
        };
    };
```

## Documentation/devicetree/bindings/bus/renesas,bsc_cn.yaml
~~~~yaml
此文档定义了Renesas Bus State Controller (BSC)在Device Tree中的表示方式。

```yaml
%YAML 1.2
---
$id: http://devicetree.org/schemas/bus/renesas,bsc.yaml#
$schema: http://devicetree.org/meta-schemas/core.yaml#

title: Renesas Bus State Controller (BSC)

maintainers:
  - Geert Uytterhoeven <geert+renesas@glider.be>

description: |
  Renesas Bus State Controller (BSC，有时被称为“Bus Bridge内的LBSC”或“外部总线接口”) 可以在多个Renesas ARM片上系统(SoC)中找到。它提供了一个外部总线，用于将多个外部设备连接到SoC，并驱动若干个芯片选择线，例如用于NOR FLASH、以太网和USB等。
尽管BSC是一个相对简单的内存映射总线，但它可能属于一个电源管理(PM)域，并且可能有一个可控制的功能时钟。在可以访问连接到BSC的设备之前，必须为包含BSC的PM域供电，并启用驱动BSC的功能时钟。
BSC的绑定扩展了"simple-pm-bus"的绑定。

allOf:
  - $ref: simple-pm-bus.yaml#

properties:
  compatible:
    items:
      - enum:
          - renesas,bsc-r8a73a4  # R-Mobile APE6 (r8a73a4)
          - renesas,bsc-sh73a0   # SH-Mobile AG5 (sh73a0)
      - const: renesas,bsc
      - {} # simple-pm-bus，但为了避免错误选择此处未列出

  reg:
    maxItems: 1

  interrupts:
    maxItems: 1

required:
  - reg

unevaluatedProperties: false

examples:
  - |
    #include <dt-bindings/interrupt-controller/irq.h>

    bsc: bus@fec10000 {
        compatible = "renesas,bsc-sh73a0", "renesas,bsc", "simple-pm-bus";
        #address-cells = <1>;
        #size-cells = <1>;
        ranges = <0 0 0x20000000>;
        reg = <0xfec10000 0x400>;
        interrupts = <0 39 IRQ_TYPE_LEVEL_HIGH>;
        clocks = <&zb_clk>;
        power-domains = <&pd_a4s>;
    };
```

这段配置描述了一个Renesas BSC设备的Device Tree节点示例。其中：
- `compatible` 属性指定了与该节点兼容的设备类型，包括特定的型号如 R-Mobile APE6 (r8a73a4) 和 SH-Mobile AG5 (sh73a0)，以及通用的 "renesas,bsc" 标识符。
- `reg` 属性指定了BSC的基地址和长度。
- `interrupts` 属性定义了中断控制器的中断配置。
- `clocks` 和 `power-domains` 属性分别指定了BSC所使用的时钟源和电源域。
~~~~

## Documentation/devicetree/bindings/bus/simple-pm-bus_cn.yaml
```yaml
# SPDX-许可证标识符: GPL-2.0
%YAML 1.2
---
$id: http://devicetree.org/schemas/bus/simple-pm-bus.yaml#
$schema: http://devicetree.org/meta-schemas/core.yaml#

标题: 简单电源管理总线

维护者:
  - Geert Uytterhoeven <geert+renesas@glider.be>

描述: |
  一个简单的电源管理总线是一个透明的总线，它不需要一个真正的驱动程序，因为它通常由引导加载程序初始化。
然而，其总线控制器是电源管理域(PM域)的一部分，或受功能时钟的控制。因此，为了使连接到该总线(无论是片上还是外部)的子设备正常工作，必须启用总线控制器的PM域和/或时钟。
虽然"simple-pm-bus"遵循设备树规范中指定的"simple-bus"属性集，但它并不是"simple-bus"的扩展。
属性:
  $nodename:
    模式: "^bus(@[0-9a-f]+)?$"

  compatible:
    包含:
      常量: simple-pm-bus
    描述:
      应包含"simple-pm-bus"，除了在各个pm-bus绑定中定义的可选总线特定兼容字符串外
'#address-cells':
    枚举: [ 1, 2 ]

  '#size-cells':
    枚举: [ 1, 2 ]

  ranges: true

  clocks: true
    # 功能时钟
    # 如果power-domains不存在，则必需；否则为可选

  power-domains:
    # 如果clocks不存在，则必需；否则为可选
    最小项: 1

必需:
  - compatible
  - '#address-cells'
  - '#size-cells'
  - ranges

anyOf:
  - 必需:
      - clocks
  - 必需:
      - power-domains

其他属性: true

示例:
  - |
    #include <dt-bindings/clock/qcom,gcc-msm8996.h>
    #include <dt-bindings/interrupt-controller/irq.h>

    bus {
        power-domains = <&gcc AGGRE0_NOC_GDSC>;
        compatible = "simple-pm-bus";
        #address-cells = <1>;
        #size-cells = <1>;
        ranges;
    };
```

## Documentation/devicetree/bindings/bus/socionext,uniphier-system-bus_cn.yaml
```yaml
# SPDX-许可证标识符: GPL-2.0-only 或 BSD-2-Clause
%YAML 1.2
---
$id: http://devicetree.org/schemas/bus/socionext,uniphier-system-bus.yaml#
$schema: http://devicetree.org/meta-schemas/core.yaml#

title: UniPhier 系统总线

description: |
  UniPhier 系统总线是一种外部总线，用于将板载设备连接到 UniPhier SoC。它是一个简单的（半）并行总线，具有地址、数据和一些控制信号。它支持最多 8 个存储器组（芯片选择）
在访问总线之前，必须配置总线控制器；总线控制器寄存器提供了从每个存储器组内的偏移量到 CPU 视图地址的转换控制。所需的设置包括基地址、每个存储器组的大小。可选地，可以针对更快的总线访问优化一些时序参数。
maintainers:
  - Masahiro Yamada <yamada.masahiro@socionext.com>

properties:
  compatible:
    const: socionext,uniphier-system-bus

  reg:
    maxItems: 1

  "#address-cells":
    description: |
      第一个单元是存储器组编号（芯片选择）
第二个单元是存储器组内的地址偏移量
const: 2

  "#size-cells":
    const: 1

  ranges:
    description: |
      提供从系统总线到父级总线的地址转换
注意：
      可以为系统总线分配的地址区域由具体实现定义。某些 SoC 可以使用 0x00000000-0x0fffffff 和 0x40000000-0x4fffffff，而其他 SoC 只能使用 0x40000000-0x4fffffff
根据 SoC 和引导模式可能存在额外限制
只要在支持的地址空间中按所需对齐方式分配存储器组，并且它们不相互重叠，地址转换是任意的
例如，可以映射如下：
        存储器组 0 到 0x42000000-0x43ffffff，存储器组 5 到 0x46000000-0x46ffffff
也可以映射如下：
        存储器组 0 到 0x48000000-0x49ffffff，存储器组 5 到 0x44000000-0x44ffffff
没有理由坚持特定的转换映射，但 "ranges" 属性应提供一个“合理”的默认值，已知该值有效。软件应据此初始化总线控制器
patternProperties:
  "^.*@[1-5],[1-9a-f][0-9a-f]+$":
    description: 连接到芯片选择的设备
    type: object

required:
  - compatible
  - reg
  - "#address-cells"
  - "#size-cells"
  - ranges

additionalProperties: false

examples:
  - |
    // 在这个示例中，
    // - 以太网设备连接到 CS1 的偏移量 0x01f00000 并映射到父级总线的 0x43f00000
该段文字描述了一个设备树（Device Tree）片段，主要用于定义SoC（System on Chip）中的总线和连接到此总线的设备。下面是翻译后的中文版本：

// UART 设备连接在 CS5 的偏移地址 0x00200000 处，
// 并映射到父级总线的 0x46200000 地址处。
system-bus@58c00000 {
        compatible = "socionext,uniphier-system-bus"; // 兼容性标识
        reg = <0x58c00000 0x400>; // 注册器地址范围
        #address-cells = <2>; // 地址单元数量
        #size-cells = <1>; // 大小单元数量
        ranges = <1 0x00000000 0x42000000 0x02000000>, // 地址映射
                 <5 0x00000000 0x46000000 0x01000000>;

        ethernet@1,1f00000 { // 以太网设备
            compatible = "smsc,lan9115"; // 兼容性标识
            reg = <1 0x01f00000 0x1000>; // 注册器地址范围
            interrupts = <0 48 4>; // 中断信息
            phy-mode = "mii"; // 物理层模式
        };

        serial@5,200000 { // UART 串口设备
            compatible = "ns16550a"; // 兼容性标识
            reg = <5 0x00200000 0x20>; // 注册器地址范围
            interrupts = <0 49 4>; // 中断信息
            clock-frequency = <12288000>; // 时钟频率
        };
    };

这里的关键点包括：
- `system-bus` 定义了系统总线的相关配置；
- `ethernet` 和 `serial` 分别指定了以太网和 UART 串口设备，并定义了它们的具体配置信息。
```
