## Documentation/devicetree/bindings/bus/st,stm32-etzpc_cn.yaml
~~~~yaml
下面是给定内容的中文翻译：

```yaml
# SPDX-文件许可标识符: (GPL-2.0-only 或 BSD-2-Clause)
%YAML 1.2
---
$id: http://devicetree.org/schemas/bus/st,stm32-etzpc.yaml#
$schema: http://devicetree.org/meta-schemas/core.yaml#

title: STM32 扩展 TrustZone 保护控制器

description: |
  ETZPC 在具有可编程安全属性（可保护资源）的总线主控器和设备的系统上配置 TrustZone 安全性。
maintainers:
  - Gatien Chevallier <gatien.chevallier@foss.st.com>

select:
  properties:
    compatible:
      contains:
        const: st,stm32-etzpc
  required:
    - compatible

properties:
  compatible:
    items:
      - const: st,stm32-etzpc
      - const: simple-bus

  reg:
    maxItems: 1

  "#address-cells":
    const: 1

  "#size-cells":
    const: 1

  ranges: true

  "#access-controller-cells":
    const: 1
    description:
      包含与外设关联的防火墙ID
patternProperties:
  "^.*@[0-9a-f]+$":
    description: 外设
    type: object

    additionalProperties: true

    required:
      - access-controllers

required:
  - compatible
  - reg
  - "#address-cells"
  - "#size-cells"
  - "#access-controller-cells"
  - ranges

additionalProperties: false

examples:
  - |
    // 在这个例子中，usart2 设备引用 rifsc 作为其访问控制器
// 在创建设备前会验证访问权限
#include <dt-bindings/interrupt-controller/arm-gic.h>
    #include <dt-bindings/clock/stm32mp13-clks.h>
    #include <dt-bindings/reset/stm32mp13-resets.h>

    etzpc: bus@5c007000 {
        compatible = "st,stm32-etzpc", "simple-bus";
        reg = <0x5c007000 0x400>;
        #address-cells = <1>;
        #size-cells = <1>;
        #access-controller-cells = <1>;
        ranges;

        usart2: serial@4c001000 {
            compatible = "st,stm32h7-uart";
            reg = <0x4c001000 0x400>;
            interrupts-extended = <&exti 27 IRQ_TYPE_LEVEL_HIGH>;
            clocks = <&rcc USART2_K>;
            resets = <&rcc USART2_R>;
            wakeup-source;
            dmas = <&dmamux1 43 0x400 0x5>,
                    <&dmamux1 44 0x400 0x1>;
            dma-names = "rx", "tx";
            access-controllers = <&etzpc 17>;
        };
    };
```

请注意，上述代码示例中的注释已尽可能进行了翻译。由于 YAML 文件格式限制了注释的使用方式，某些部分的翻译可能不是完全直接的翻译。
~~~~

## Documentation/devicetree/bindings/bus/st,stm32mp25-rifsc_cn.yaml
```yaml
# SPDX-许可证标识符: (GPL-2.0-only 或 BSD-2-Clause)
%YAML 1.2
---
$id: http://devicetree.org/schemas/bus/st,stm32mp25-rifsc.yaml#
$schema: http://devicetree.org/meta-schemas/core.yaml#

标题: STM32 资源隔离框架安全控制器

维护者:
  - 加蒂安·谢瓦利耶 <gatien.chevallier@foss.st.com>

描述: |
  资源隔离框架 (RIF) 是一组全面的硬件模块，旨在实施和管理 STM32 硬件资源（如内存和外设）的隔离。
  RIFSC（RIF 安全控制器）由三组寄存器组成，每组管理特定的一组硬件资源：
    - 与 RISUP 逻辑（用于外设的资源隔离设备单元）关联的 RISC 寄存器，将所有非 RIF 兼容的外设分配给零、一个或任何安全域（安全、特权、隔间）
- RIMC 寄存器：与 RIMU 逻辑（资源隔离主控单元）相关联，通过在系统总线上设置安全、特权和隔间信息，将所有非 RIF 兼容的总线主控器分配给一个安全域
  可选地，控制外设端口访问的 RISUP 逻辑可以为该外设主控器端口指定目标总线属性（支持的属性：CID）
- 与 RISAL 逻辑（地址空间的资源隔离设备单元——轻量级版本）关联的 RISC 寄存器，将地址空间子区域分配给一个安全域（安全、特权、隔间）
选择:
  属性:
    compatible:
      包含:
        常量: st,stm32mp25-rifsc
  必需:
    - compatible

属性:
  compatible:
    项目:
      - 常量: st,stm32mp25-rifsc
      - 常量: simple-bus

  reg:
    最大项数: 1

  "#address-cells":
    常量: 1

  "#size-cells":
    常量: 1

  ranges: true

  "#access-controller-cells":
    常量: 1
    描述:
      包含与外设相关的防火墙 ID
模式属性:
  "^.*@[0-9a-f]+$":
    描述: 外设
    类型: 对象

    其他属性: true

    必需:
      - access-controllers

必需:
  - compatible
  - reg
  - "#address-cells"
  - "#size-cells"
  - "#access-controller-cells"
  - ranges

其他属性: false

示例:
  - |
    // 在此示例中，usart2 设备将其域控制器引用为 rifsc
    // 创建设备前会验证访问权限
#include <dt-bindings/interrupt-controller/arm-gic.h>

    rifsc: bus@42080000 {
        compatible = "st,stm32mp25-rifsc", "simple-bus";
        reg = <0x42080000 0x1000>;
        #address-cells = <1>;
        #size-cells = <1>;
        #access-controller-cells = <1>;
        ranges;

        usart2: serial@400e0000 {
              compatible = "st,stm32h7-uart";
              reg = <0x400e0000 0x400>;
              interrupts = <GIC_SPI 115 IRQ_TYPE_LEVEL_HIGH>;
              clocks = <&ck_flexgen_08>;
              access-controllers = <&rifsc 32>;
        };
    };
```
