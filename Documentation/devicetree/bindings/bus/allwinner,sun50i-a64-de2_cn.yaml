## Documentation/devicetree/bindings/bus/mvebu-mbus_cn.txt
~~~~
* Marvell MBus

必需属性：

- compatible:   应设置为以下选项之一：
         marvell,armada370-mbus
         marvell,armadaxp-mbus
         marvell,armada375-mbus
         marvell,armada380-mbus
         marvell,kirkwood-mbus
         marvell,dove-mbus
         marvell,orion5x-88f5281-mbus
         marvell,orion5x-88f5182-mbus
         marvell,orion5x-88f5181-mbus
         marvell,orion5x-88f6183-mbus
         marvell,mv78xx0-mbus
- address-cells: 必须是 '2'。第一个单元用于 MBus ID 编码，
                第二个单元用于窗口内的地址偏移
- size-cells:    必须是 '1'
- ranges:        必须设置以提供对每个子节点的正确转换
请参阅下面的例子
- controller:    包含指向 MBus 控制器节点的单个 phandle。这允许指定包含控制 MBus 的寄存器的节点，
                 该节点通常位于内部寄存器窗口内（见下文）
可选属性：

- pcie-mem-aperture: 此可选属性包含 PCIe 驱动程序内存区域的孔径
如果定义了此属性，它必须编码分配给 PCIe 内存区域的地址解码窗口的基址和大小
- pcie-io-aperture: 与上述属性相同，此可选属性包含 PCIe 驱动程序 I/O 区域的孔径

* Marvell MBus 控制器

必需属性：

- compatible:   应设置为 "marvell,mbus-controller"
- reg:          设备的寄存器空间
预计会有两到三个条目（参见下面的例子）：
第一个控制设备的解码窗口，
第二个控制SDRAM的解码窗口，
第三个控制MBus桥接器（仅与
`marvell,armada370-mbus` 和 `marvell,armadaxp-mbus`
兼容字符串相关）

例子：

```text
soc {
	compatible = "marvell,armada370-mbus", "simple-bus";
	#address-cells = <2>;
	#size-cells = <1>;
	controller = <&mbusc>;
	pcie-mem-aperture = <0xe0000000 0x8000000>;
	pcie-io-aperture  = <0xe8000000 0x100000>;

	internal-regs {
		compatible = "simple-bus";

		mbusc: mbus-controller@20000 {
			compatible = "marvell,mbus-controller";
			reg = <0x20000 0x100>, <0x20180 0x20>, <0x20250 0x8>;
		};

		/* 更多子节点... */
	};
};
```

** MBus 地址解码窗口规范

MBus 子节点地址空间由两个单元组成：第一个用于窗口ID，第二个用于窗口内的偏移量。
为了允许描述有效和无效的窗口条目，使用了以下编码方式：

  0xSIAA0000 0x00oooooo

其中：

  S = 0x0 表示有效的MBus窗口
  S = 0xf 表示无效的窗口（参见下文）

如果 S = 0x0，则：

   I = 4位窗口目标ID
  AA = 窗口属性

如果 S = 0xf，则：

   I = 不关心
   AA = 对于内部寄存器为1

根据上述编码，对于每个有效的MBus窗口（S = 0x0）的范围条目，都会分配一个地址解码窗口。另一方面，不对应有效窗口（S = 0xf）的转换条目会被跳过。

```text
soc {
	compatible = "marvell,armada370-mbus", "simple-bus";
	#address-cells = <2>;
	#size-cells = <1>;
	controller = <&mbusc>;

	ranges = <0xf0010000 0 0 0xd0000000 0x100000
		  0x01e00000 0 0 0xfff00000 0x100000>;

	bootrom {
		compatible = "marvell,bootrom";
		reg = <0x01e00000 0 0x100000>;
	};

	/* 其他子节点 */
	..
internal-regs {
		compatible = "simple-bus";
		ranges = <0 0xf0010000 0 0x100000>;

		mbusc: mbus-controller@20000 {
			compatible = "marvell,mbus-controller";
			reg = <0x20000 0x100>, <0x20180 0x20>, <0x20250 0x8>;
		};

		/* 更多子节点... */
	};
};
```

在所示的例子中，'ranges' 属性中的转换条目使得MBus驱动程序为相应的子设备创建静态解码窗口。请注意，此绑定不需要存在子节点。当然，需要子节点来探测设备。
由于每个窗口通过其目标ID和属性ID来标识，因此有一个特殊的宏可以用来简化转换条目：

```text
#define MBUS_ID(target,attributes) (((target) << 24) | ((attributes) << 16))
```

使用这个宏，上面的例子可以表示为：

```text
soc {
	compatible = "marvell,armada370-mbus", "simple-bus";
	#address-cells = <2>;
	#size-cells = <1>;
	controller = <&mbusc>;

	ranges = < MBUS_ID(0xf0, 0x01) 0 0 0xd0000000 0x100000
		   MBUS_ID(0x01, 0xe0) 0 0 0xfff00000 0x100000>;

	bootrom {
		compatible = "marvell,bootrom";
		reg = <MBUS_ID(0x01, 0xe0) 0 0x100000>;
	};

	/* 其他子节点 */
	..
internal-regs {
		compatible = "simple-bus";
		#address-cells = <1>;
		#size-cells = <1>;
		ranges = <0 MBUS_ID(0xf0, 0x01) 0 0x100000>;

		mbusc: mbus-controller@20000 {
			compatible = "marvell,mbus-controller";
			reg = <0x20000 0x100>, <0x20180 0x20>, <0x20250 0x8>;
		};

		/* 其他子节点 */
		..
};
};
```

** 关于窗口基地址

请记住MBus控制器允许选择解码窗口基地址时有极大的灵活性。在规划设备树布局时，可以选择任何地址作为基地址，当然前提是必须有足够的区域可用，并且具有所需的对齐方式。
换句话说：如果我们希望的区域未被使用，没有什么阻止我们将基地址设置为0xf0000000或0xd0000000，如上所述的NOR设备。

** 窗口分配策略

mbus-node的ranges属性定义了一组由操作系统设置的MBus窗口，这些窗口保证彼此之间或与系统内存范围无重叠。
属性中的每个条目都指代一个确切的窗口。如果操作系统选择使用不同的MBus窗口集，则必须确保从下游设备执行的任何地址转换相应地进行调整。
操作系统可能会插入额外的内存总线 (mbus) 窗口，这些窗口不会与在范围内列出的窗口发生冲突，例如用于映射 PCIe 设备。作为一个特殊情况，内部寄存器窗口必须由启动加载器按照 `ranges` 属性中列出的地址进行设置，因为需要访问该区域以设置其他窗口。

** 示例 **

请参阅以下示例，其中展示了一个更为完整的设备树：

```plaintext
soc {
    compatible = "marvell,armadaxp-mbus", "simple-bus";
    controller = <&mbusc>;

    ranges = <MBUS_ID(0xf0, 0x01) 0 0 0xd0000000 0x100000   /* 内部寄存器 */
              MBUS_ID(0x01, 0x1d) 0 0 0xfff00000 0x100000
              MBUS_ID(0x01, 0x2f) 0 0 0xf0000000 0x8000000>;

    bootrom {
        compatible = "marvell,bootrom";
        reg = <MBUS_ID(0x01, 0x1d) 0 0x100000>;
    };

    devbus-bootcs {
        ranges = <0 MBUS_ID(0x01, 0x2f) 0 0x8000000>;

        /* NOR Flash */
        nor {
            compatible = "cfi-flash";
            reg = <0 0x8000000>;
            bank-width = <2>;
        };
    };

    pcie-controller {
        compatible = "marvell,armada-xp-pcie";
        device_type = "pci";

        #address-cells = <3>;
        #size-cells = <2>;

        ranges =
               <0x82000000 0 0x40000 MBUS_ID(0xf0, 0x01) 0x40000 0 0x00002000   /* 端口 0.0 寄存器 */
                0x82000000 0 0x42000 MBUS_ID(0xf0, 0x01) 0x42000 0 0x00002000   /* 端口 2.0 寄存器 */
                0x82000000 0 0x44000 MBUS_ID(0xf0, 0x01) 0x44000 0 0x00002000   /* 端口 0.1 寄存器 */
                0x82000000 0 0x48000 MBUS_ID(0xf0, 0x01) 0x48000 0 0x00002000   /* 端口 0.2 寄存器 */
                0x82000000 0 0x4c000 MBUS_ID(0xf0, 0x01) 0x4c000 0 0x00002000   /* 端口 0.3 寄存器 */
                0x82000800 0 0xe0000000 MBUS_ID(0x04, 0xe8) 0xe0000000 0 0x08000000 /* 端口 0.0 内存 */
                0x81000800 0 0          MBUS_ID(0x04, 0xe0) 0xe8000000 0 0x00100000 /* 端口 0.0 输入输出 */>;

        pcie@1,0 {
            /* 端口 0, 车道 0 */
        };
    };

    internal-regs {
        compatible = "simple-bus";
        #address-cells = <1>;
        #size-cells = <1>;
        ranges = <0 MBUS_ID(0xf0, 0x01) 0 0x100000>;

        mbusc: mbus-controller@20000 {
            reg = <0x20000 0x100>, <0x20180 0x20>, <0x20250 0x8>;
        };

        interrupt-controller@20000 {
            reg = <0x20a00 0x2d0>, <0x21070 0x58>;
        };
    };
};
```
在这个示例中，展示了如何配置一个 SoC 的设备树，包括了内部寄存器、PCIe 控制器和 NOR Flash 等组件。
~~~~

## Documentation/devicetree/bindings/bus/nvidia,tegra20-gmi_cn.txt
```
NVIDIA Tegra 通用内存接口总线的设备树绑定

通用内存接口（Generic Memory Interface，GMI）总线实现了内部和外部内存之间的数据传输。它可以用于连接各种高速设备，例如同步/异步NOR闪存、FPGA、UART等。
实际的设备是从GMI节点的子节点实例化的。
**必需属性：**
 - compatible ：应包含以下内容之一：
        对于Tegra20，必须包含"nvidia,tegra20-gmi"
对于Tegra30，必须包含"nvidia,tegra30-gmi"
- reg: 应包含GMI控制器寄存器的位置和长度
- clocks: 必须为clock-names中的每一项包含一个条目
- clock-names: 必须包括以下条目："gmi"
 - resets : 必须为reset-names中的每一项包含一个条目
- reset-names : 必须包括以下条目："gmi"
 - #address-cells: 用于表示GMI地址空间中物理基址的单元格数量。应为2
- #size-cells: 用于表示GMI地址空间中地址范围大小的单元格数量。应为1
- ranges: 必须设置以反映带有三个整数值的内存布局，针对每个使用的片选线（仅支持一个条目，参见下面的注释）：
   <cs-number> <offset> <映射的物理地址> <大小>

请注意，GMI控制器没有内部的片选地址解码功能，因此片选要么需要通过软件管理，要么使用外部片选解码逻辑来实现。
如果使用外部芯片选择逻辑来支持多个设备，则假设这些设备具有相同的定时特性，因此可能是同一类型的。这也假设它们可以适应在256MB的地址范围内。在这种情况下，仅支持一个子设备，该子设备代表活动的芯片选择线，更多细节请参见示例。

芯片选择编号是从`ranges`属性的子节点的第二个地址单元解码得出的，如果`ranges`属性不存在或为空，则从`reg`属性的第一个单元解码芯片选择信号。

可选的子节点`cs`属性如下：

- `nvidia,snor-data-width-32bit`: 使用32位数据总线，默认为16位。
- `nvidia,snor-mux-mode`: 启用地址/数据复用模式。
- `nvidia,snor-rdy-active-before-data`: 在数据之前一个周期断言RDY信号；如果省略，则与数据一起断言RDY信号。
- `nvidia,snor-rdy-active-high`: RDY信号为高电平有效。
- `nvidia,snor-adv-active-high`: ADV信号为高电平有效。
- `nvidia,snor-oe-active-high`: WE/OE信号为高电平有效。
- `nvidia,snor-cs-active-high`: CS信号为高电平有效。

需要注意的是，对于定时值有一些特殊的处理方式。根据Tegra TRM：
编程值为0意味着1个时钟周期：实际周期数=编程周期数+1。

- `nvidia,snor-muxed-width`: 地址/数据复用信号在总线上断言的周期数。有效值范围是0-15，默认值为1。
- `nvidia,snor-hold-width`: CE信号在WR_N（在SLAVE/MASTER请求的情况下）或OE_N（在MASTER请求的情况下）撤销后保持断言的周期数。有效值范围是0-15，默认值为1。
- `nvidia,snor-adv-width`: ADV信号保持断言状态的周期数。有效值范围是0-15，默认值为1。
- `nvidia,snor-ce-width`: CE信号断言前的周期数。
有效值为0-15，默认值为4
- nvidia,snor-we-width: WE保持有效的周期数
有效值为0-15，默认值为1
- nvidia,snor-oe-width: OE保持有效的周期数
有效值为0-255，默认值为1
- nvidia,snor-wait-width: 在READY被置位之前的周期数
有效值为0-255，默认值为3

两个SJA1000 CAN控制器连接到GMI总线的例子。我们将这些控制器用一个简单的总线节点包装起来，因为它们都连接到了同一个片选信号（CS4）上；在这个例子中，提供了外部地址解码：

gmi@70009000 {
	compatible = "nvidia,tegra20-gmi";
	reg = <0x70009000 0x1000>;
	#address-cells = <2>;
	#size-cells = <1>;
	clocks = <&tegra_car TEGRA20_CLK_NOR>;
	clock-names = "gmi";
	resets = <&tegra_car 42>;
	reset-names = "gmi";
	ranges = <4 0 0xd0000000 0xfffffff>;

	bus@4,0 {
		compatible = "simple-bus";
		#address-cells = <1>;
		#size-cells = <1>;
		ranges = <0 4 0 0x40100>;

		nvidia,snor-mux-mode;
		nvidia,snor-adv-active-high;

		can@0 {
			reg = <0 0x100>;
			..
};

		can@40000 {
			reg = <0x40000 0x100>;
			..
};
	};
};

一个SJA1000 CAN控制器连接到GMI总线上的CS4的例子：

gmi@70009000 {
	compatible = "nvidia,tegra20-gmi";
	reg = <0x70009000 0x1000>;
	#address-cells = <2>;
	#size-cells = <1>;
	clocks = <&tegra_car TEGRA20_CLK_NOR>;
	clock-names = "gmi";
	resets = <&tegra_car 42>;
	reset-names = "gmi";
	ranges = <4 0 0xd0000000 0xfffffff>;

	can@4,0 {
		reg = <4 0 0x100>;
		nvidia,snor-mux-mode;
		nvidia,snor-adv-active-high;
		..
};
};
```

## Documentation/devicetree/bindings/bus/nvidia,tegra210-aconnect_cn.yaml
```yaml
下面是给定内容的中文翻译：

# SPDX-文件许可标识符: (GPL-2.0-only 或 BSD-2-Clause)
%YAML 1.2
---
$id: http://devicetree.org/schemas/bus/nvidia,tegra210-aconnect.yaml#
$schema: http://devicetree.org/meta-schemas/core.yaml#

title: NVIDIA Tegra ACONNECT 总线

description: |
  Tegra ACONNECT 总线是一个 AXI 开关，用于连接音频处理引擎（APE）内的各个组件。
  所有 CPU 对 APE 子系统的访问都通过 ACONNECT 和 APB 到 AXI 的封装器进行。所有通过 ACONNECT 访问的设备都由子节点描述。
maintainers:
  - Jon Hunter <jonathanh@nvidia.com>

properties:
  compatible:
    oneOf:
      - const: nvidia,tegra210-aconnect
      - items:
          - enum:
              - nvidia,tegra234-aconnect
              - nvidia,tegra186-aconnect
              - nvidia,tegra194-aconnect
          - const: nvidia,tegra210-aconnect

  clocks:
    items:
      - description: 必须包含 APE 时钟的条目
      - description: 必须包含 APE 接口时钟的条目

  clock-names:
    items:
      - const: ape
      - const: apb2ape

  power-domains:
    maxItems: 1

  "#address-cells":
    enum: [ 1, 2 ]

  "#size-cells":
    enum: [ 1, 2 ]

  ranges: true

patternProperties:
  "@[0-9a-f]+$":
    type: object

required:
  - compatible
  - clocks
  - clock-names
  - power-domains
  - "#address-cells"
  - "#size-cells"
  - ranges

additionalProperties: false

examples:
  - |
    #include <dt-bindings/clock/tegra210-car.h>

    aconnect@702c0000 {
        compatible = "nvidia,tegra210-aconnect";
        clocks = <&tegra_car TEGRA210_CLK_APE>,
                 <&tegra_car TEGRA210_CLK_APB2APE>;
        clock-names = "ape", "apb2ape";
        power-domains = <&pd_audio>;

        #address-cells = <1>;
        #size-cells = <1>;
        ranges = <0x702c0000 0x702c0000 0x00040000>;

        // 子设备节点随后 ...
    };
```

## Documentation/devicetree/bindings/bus/omap-ocp2scp_cn.txt
```
* OMAP OCP2SCP - OCP接口到SCP接口

属性:
- compatible : 对于AM437x处理器，应为"ti,am437x-ocp2scp"
               对于其他处理器，应为"ti,omap-ocp2scp"
- reg : 设备寄存器集的地址和长度
- #address-cells, #size-cells : 如果设备有子节点，则必须存在
- ranges : 子地址空间以1:1映射到父地址空间
- ti,hwmods : 必须是"ocp2scp_usb_phy"

子节点:
所有连接到ocp2scp的设备都通过ocp2scp的子节点进行描述。

ocp2scp@4a0ad000 {
	compatible = "ti,omap-ocp2scp";
	reg = <0x4a0ad000 0x1f>;
	#address-cells = <1>;
	#size-cells = <1>;
	ranges;
	ti,hwmods = "ocp2scp_usb_phy";

	subnode1 {
	..
	};

	subnode2 {
	..
	};
};
```

## Documentation/devicetree/bindings/bus/palmbus_cn.yaml
```yaml
下面是给定内容的中文翻译：

---

SPDX 许可证标识符: (GPL-2.0-only 或 BSD-2-Clause)

YAML 1.2
---
$id: http://devicetree.org/schemas/bus/palmbus.yaml#
$schema: http://devicetree.org/meta-schemas/core.yaml#

标题: Ralink PalmBus

维护者:
  - Sergio Paracuellos <sergio.paracuellos@gmail.com>

描述: |
  Ralink 的 PalmBus 控制器可以在所有 Ralink MIPS
  系统级芯片中找到。它提供了一个外部总线，用于将多个
  外部设备连接到系统级芯片上。

属性:
  $nodename:
    模式: "^palmbus(@[0-9a-f]+)?$"

  "#address-cells":
    常量: 1

  "#size-cells":
    常量: 1

  compatible:
    常量: palmbus

  reg:
    最大项数: 1

  ranges: 真

模式属性:
  # 所有其他属性应为带有 unit-address 和 'reg' 的子节点
  "@[0-9a-f]+$":
    类型: 对象
    额外属性: 真
    属性:
      reg:
        最大项数: 1

    必需:
      - reg

必需:
  - compatible
  - reg
  - "#address-cells"
  - "#size-cells"
  - ranges

额外属性: 假

示例:
  - |
    #include <dt-bindings/interrupt-controller/mips-gic.h>
    #include <dt-bindings/interrupt-controller/irq.h>
    palmbus@1e000000 {
        compatible = "palmbus";
        reg = <0x1e000000 0x100000>;
        #address-cells = <1>;
        #size-cells = <1>;
        ranges = <0x0 0x1e000000 0x0fffff>;

        gpio@600 {
            #gpio-cells = <2>;
            #interrupt-cells = <2>;
            compatible = "mediatek,mt7621-gpio";
            gpio-controller;
            gpio-ranges = <&pinctrl 0 0 95>;
            interrupt-controller;
            reg = <0x600 0x100>;
            interrupt-parent = <&gic>;
            interrupts = <GIC_SHARED 12 IRQ_TYPE_LEVEL_HIGH>;
        };
    };

..
```
