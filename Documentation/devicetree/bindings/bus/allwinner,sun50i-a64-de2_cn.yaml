## Documentation/devicetree/bindings/bus/allwinner,sun50i-a64-de2_cn.yaml
```yaml
# SPDX-许可证标识符: GPL-2.0
%YAML 1.2
---
$id: http://devicetree.org/schemas/bus/allwinner,sun50i-a64-de2.yaml#
$schema: http://devicetree.org/meta-schemas/core.yaml#

标题: Allwinner A64 显示引擎总线

维护者:
  - 陈宇 蔡 <wens@csie.org>
  - 马克西姆·里帕德 <mripard@kernel.org>

属性:
  $nodename:
    模式: "^bus(@[0-9a-f]+)?$"

  "#address-cells":
    常量: 1

  "#size-cells":
    常量: 1

  compatible:
    oneOf:
      - 常量: allwinner,sun50i-a64-de2
      - items:
          - 常量: allwinner,sun50i-h6-de3
          - 常量: allwinner,sun50i-a64-de2

  reg:
    maxItems: 1

  allwinner,sram:
    描述:
      需要声明的SRAM以访问显示引擎总线
$ref: /schemas/types.yaml#/definitions/phandle-array
    items:
      - items:
          - 描述: SRAM 的 phandle
          - 描述: 设备的寄存器值

  ranges: 真

模式属性:
  # 所有其他属性应该是具有 unit-address 和 'reg' 的子节点
  "^[a-zA-Z][a-zA-Z0-9,+\\-._]{0,63}@[0-9a-fA-F]+$":
    类型: 对象
    additionalProperties: 真
    属性:
      reg:
        maxItems: 1

    必需:
      - reg

必需:
  - compatible
  - reg
  - "#address-cells"
  - "#size-cells"
  - ranges
  - allwinner,sram

additionalProperties: 假

示例:
  - |
    bus@1000000 {
        compatible = "allwinner,sun50i-a64-de2";
        reg = <0x1000000 0x400000>;
        allwinner,sram = <&de2_sram 1>;
        #address-cells = <1>;
        #size-cells = <1>;
        ranges = <0 0x1000000 0x400000>;

        display_clocks: clock@0 {
            compatible = "allwinner,sun50i-a64-de2-clk";
            reg = <0x0 0x100000>;
            clocks = <&ccu 52>, <&ccu 99>;
            clock-names = "bus", "mod";
            resets = <&ccu 30>;
            #clock-cells = <1>;
            #reset-cells = <1>;
        };
    };

..
```

## Documentation/devicetree/bindings/bus/arm,integrator-ap-lm_cn.yaml
~~~~yaml
# SPDX-许可证标识符: (GPL-2.0-only 或 BSD-2-Clause)
%YAML 1.2
---
$id: http://devicetree.org/schemas/bus/arm,integrator-ap-lm.yaml#
$schema: http://devicetree.org/meta-schemas/core.yaml#

标题: Integrator/AP 逻辑模块扩展总线

维护者:
  - Linus Walleij <linusw@kernel.org>

描述: Integrator/AP 是一个原型平台，因此它可以堆叠多达四个专门为此平台设计的逻辑模块（LM）。可以通过读取一个特殊的系统控制器寄存器来判断在索引 0、1、2 或 3 处是否连接了逻辑模块。此绑定描述了逻辑模块连接器。而逻辑模块本身则有各自特定的模块绑定，并作为此逻辑模块扩展总线下的子节点进行描述。
属性:
  "#address-cells":
    常量: 1

  "#size-cells":
    常量: 1

  compatible:
    项:
      - 常量: arm,integrator-ap-lm

  ranges: 真
  dma-ranges: 真

模式属性:
  "^bus(@[0-9a-f]*)?$":
    描述: 逻辑模块总线上的节点代表逻辑模块，并命名为 bus。第一个模块位于 0xc0000000，第二个位于 0xd0000000，以此类推，直到系统的内存顶部 0xffffffff。有关模块使用的所有内存信息都在 ranges 和 dma-ranges 中给出。
类型: 对象

    必需:
      - compatible

必需:
  - compatible

示例:
  - |
    bus@c0000000 {
      compatible = "arm,integrator-ap-lm";
      #address-cells = <1>;
      #size-cells = <1>;
      ranges = <0xc0000000 0xc0000000 0x40000000>;
      dma-ranges;

      bus@c0000000 {
        compatible = "simple-bus";
        ranges = <0x00000000 0xc0000000 0x10000000>;
        /* 逻辑模块看到的核心模块 0 的 RAM 位于 0x80000000 */
        dma-ranges = <0x00000000 0x80000000 0x10000000>;
        #address-cells = <1>;
        #size-cells = <1>;

        serial@100000 {
          compatible = "arm,pl011", "arm,primecell";
          reg = <0x00100000 0x1000>;
          interrupts-extended = <&impd1_vic 1>;
        };

        impd1_vic: interrupt-controller@3000000 {
          compatible = "arm,pl192-vic";
          interrupt-controller;
          #interrupt-cells = <1>;
          reg = <0x03000000 0x1000>;
          valid-mask = <0x00000bff>;
          interrupts-extended = <&pic 9>;
        };
      };
    };

额外属性: 假
```
~~~~

## Documentation/devicetree/bindings/bus/aspeed,ast2600-ahbc_cn.yaml
~~~~yaml
```yaml
# SPDX-许可证标识符: (GPL-2.0-only 或 BSD-2-Clause)
%YAML 1.2
---
$id: http://devicetree.org/schemas/bus/aspeed,ast2600-ahbc.yaml#
$schema: http://devicetree.org/meta-schemas/core.yaml#

title: ASPEED 高级高性能总线控制器 (AHBC)

maintainers:
  - Neal Liu <neal_liu@aspeedtech.com>
  - Chia-Wei Wang <chiawei_wang@aspeedtech.com>

description: |
  高级高性能总线控制器 (AHBC) 支持多种机制，包括优先级仲裁器、地址解码器和数据多路复用器，
  用于控制高级高性能总线 (AHB) 的整体操作。

properties:
  compatible:
    enum:
      - aspeed,ast2600-ahbc

  reg:
    maxItems: 1

required:
  - compatible
  - reg

additionalProperties: false

examples:
  - |
    ahbc@1e600000 {
        compatible = "aspeed,ast2600-ahbc";
        reg = <0x1e600000 0x100>;
    };
```

这段 YAML 文件描述了 ASPEED 公司的高级高性能总线控制器 (AHBC) 在 Device Tree 中的定义。该文件包含了必要的属性和示例，以帮助设备树作者正确地配置和使用 AHBC 控制器。
~~~~

## Documentation/devicetree/bindings/bus/baikal,bt1-apb_cn.yaml
```yaml
下面是给定内容的中文翻译：

# SPDX-文件许可标识符: (GPL-2.0-only 或 BSD-2-Clause)
# 版权所有 (C) 2020 白海电子股份公司
%YAML 1.2
---
$id: http://devicetree.org/schemas/bus/baikal,bt1-apb.yaml#
$schema: http://devicetree.org/meta-schemas/core.yaml#

标题: 白海-T1 APB 总线

维护者:
  - Serge Semin <fancer.lancer@gmail.com>

描述: |
  白海-T1 CPU 或 DMA 控制器的 MMIO 请求由 AMBA 3 AXI 互联处理，
  它将请求路由到 AXI-APB 桥接器。此接口是一个单主控多个从设备总线，依次序列化 I/O 访问并将它们路由到对应的 APB 从设备。
  在出现任何 APB 协议冲突、从设备在超时后未响应的情况下，会触发一个中断，并向 APB 终结器（APB 错误处理模块）报告错误地址。
allOf:
  - $ref: /schemas/simple-bus.yaml#

属性:
  compatible:
    包含:
      常量: baikal,bt1-apb

  reg:
    项:
      - 描述: APB EHB MMIO 寄存器
      - 描述: 无任何设备映射的 APB MMIO 区域

  reg-names:
    项:
      - 常量: ehb
      - 常量: nodev

  interrupts:
    最大项数: 1

  clocks:
    项:
      - 描述: APB 参考时钟

  clock-names:
    项:
      - 常量: pclk

  resets:
    项:
      - 描述: APB 域复位信号线

  reset-names:
    项:
      - 常量: prst

未评估属性: false

必需:
  - compatible
  - reg
  - reg-names
  - interrupts
  - clocks
  - clock-names

示例:
  - |
    #include <dt-bindings/interrupt-controller/mips-gic.h>

    bus@1f059000 {
      compatible = "baikal,bt1-apb", "simple-bus";
      reg = <0x1f059000 0x1000>,
            <0x1d000000 0x2040000>;
      reg-names = "ehb", "nodev";
      #address-cells = <1>;
      #size-cells = <1>;

      ranges;

      interrupts = <GIC_SHARED 16 IRQ_TYPE_LEVEL_HIGH>;

      clocks = <&ccu_sys 1>;
      clock-names = "pclk";

      resets = <&ccu_sys 1>;
      reset-names = "prst";
    };
```

## Documentation/devicetree/bindings/bus/baikal,bt1-axi_cn.yaml
~~~~yaml
以下是给定内容的中文翻译：

```yaml
# SPDX-文件许可标识符: (GPL-2.0-only 或 BSD-2-Clause)
# 版权 (C) 2020 百科电子, 股份有限公司
%YAML 1.2
---
$id: http://devicetree.org/schemas/bus/baikal,bt1-axi.yaml#
$schema: http://devicetree.org/meta-schemas/core.yaml#

标题: 百科-T1 AXI 总线

维护者:
  - Serge Semin <fancer.lancer@gmail.com>

描述: |
  AXI3 总线是百科-T1 系统芯片的主要通信总线，用于连接所有高速外围 IP 核心与 RAM 控制器以及 MIPS P5600 核心。流量仲裁通过 DesignWare AXI 互连（即所谓的 AXI 主互连）实现，该互连将 I/O 请求从一个块路由到另一个：从 CPU 到系统芯片外围设备，以及在某些系统芯片外围设备之间（主要是在外围设备和 RAM 之间，但也在 DMA 和一些外围设备之间）。在出现任何协议错误或设备未响应的情况下，会触发一个中断，并向位于 DesignWare AXI 互连之上的 AXI 错误处理模块 (EHB) 报告故障情况，该模块可通过百科-T1 系统控制器访问。
allOf:
  - $ref: /schemas/simple-bus.yaml#

属性:
  compatible:
    包含:
      常量: baikal,bt1-axi

  reg:
    最少项目数: 1
    项目:
      - 描述: Synopsys DesignWare AXI 互连 QoS 寄存器
      - 描述: AXI EHB MMIO 系统控制器寄存器

  reg-names:
    最少项目数: 1
    项目:
      - 常量: qos
      - 常量: ehb

  '#interconnect-cells':
    常量: 1

  syscon:
    $ref: /schemas/types.yaml#/definitions/phandle
    描述: 百科-T1 系统控制器 DT 节点的 phandle

  interrupts:
    最大项目数: 1

  clocks:
    项目:
      - 描述: 主互连上行参考时钟

  clock-names:
    项目:
      - 常量: aclk

  resets:
    项目:
      - 描述: 主互连复位线

  reset-names:
    项目:
      - 常量: arst

unevaluatedProperties: false

必需:
  - compatible
  - reg
  - reg-names
  - syscon
  - interrupts
  - clocks
  - clock-names

示例:
  - |
    #include <dt-bindings/interrupt-controller/mips-gic.h>

    bus@1f05a000 {
      compatible = "baikal,bt1-axi", "simple-bus";
      reg = <0x1f05a000 0x1000>,
            <0x1f04d110 0x8>;
      reg-names = "qos", "ehb";
      #address-cells = <1>;
      #size-cells = <1>;
      #interconnect-cells = <1>;

      syscon = <&syscon>;

      ranges;

      interrupts = <GIC_SHARED 127 IRQ_TYPE_LEVEL_HIGH>;

      clocks = <&ccu_axi 0>;
      clock-names = "aclk";

      resets = <&ccu_axi 0>;
      reset-names = "arst";
    };
..
```
```
~~~~

## Documentation/devicetree/bindings/bus/brcm,bus-axi_cn.txt
~~~~
ARM AXI总线的驱动程序，包含 Broadcom 插件 (bcma)

必需属性：

- `compatible`：应为 `brcm,bus-axi`

- `reg`：芯片通用核心的内存地址范围

AXI 总线上的核心由 bcma 根据它们使用的内存范围自动检测，并随后注册。对于 BCM47xx/BCM53xx ARM 系统级芯片 (SoC)，IRQ 编号的自动检测无法正常工作。为了给核心分配 IRQ 编号，需要通过设备树手动提供这些编号。使用中断映射 (`interrupt-map`) 来指定总线上设备所用的 IRQ。第一个地址仅仅是一个索引，因为我们没有特殊的寄存器。顶级的 AXI 总线可能包含表示连接的核心（设备）的子节点。这是必要的，因为一些硬件细节无法自动检测（例如 IRQ 编号）。此外，某些核心可能负责额外的任务，例如 ChipCommon 提供对 GPIO 芯片的访问。
示例：

```plaintext
axi@18000000 {
	compatible = "brcm,bus-axi";
	reg = <0x18000000 0x1000>;
	ranges = <0x00000000 0x18000000 0x00100000>;
	#address-cells = <1>;
	#size-cells = <1>;
	#interrupt-cells = <1>;
	interrupt-map-mask = <0x000fffff 0xffff>;
	interrupt-map =
		/* 以太网控制器 0 */
		<0x00024000 0 &gic GIC_SPI 147 IRQ_TYPE_LEVEL_HIGH>,

		/* 以太网控制器 1 */
		<0x00025000 0 &gic GIC_SPI 148 IRQ_TYPE_LEVEL_HIGH>;

		/* PCIe 控制器 0 */
		<0x00012000 0 &gic GIC_SPI 126 IRQ_TYPE_LEVEL_HIGH>,
		<0x00012000 1 &gic GIC_SPI 127 IRQ_TYPE_LEVEL_HIGH>,
		<0x00012000 2 &gic GIC_SPI 128 IRQ_TYPE_LEVEL_HIGH>,
		<0x00012000 3 &gic GIC_SPI 129 IRQ_TYPE_LEVEL_HIGH>,
		<0x00012000 4 &gic GIC_SPI 130 IRQ_TYPE_LEVEL_HIGH>,
		<0x00012000 5 &gic GIC_SPI 131 IRQ_TYPE_LEVEL_HIGH>;

	chipcommon {
		reg = <0x00000000 0x1000>;

		gpio-controller;
		#gpio-cells = <2>;
	};
};
```
这段代码描述了如何在设备树中定义一个 AXI 总线及其子节点，包括了以太网控制器和 PCIe 控制器的 IRQ 映射配置以及 ChipCommon 的 GPIO 配置。
~~~~

## Documentation/devicetree/bindings/bus/brcm,gisb-arb_cn.yaml
```yaml
# SPDX-许可证标识符: (GPL-2.0-only 或 BSD-2-Clause)
%YAML 1.2
---
$id: http://devicetree.org/schemas/bus/brcm,gisb-arb.yaml#
$schema: http://devicetree.org/meta-schemas/core.yaml#

title: Broadcom GISB 总线仲裁控制器

maintainers:
  - Florian Fainelli <f.fainelli@gmail.com>

properties:
  compatible:
    oneOf:
      - items:
          - enum:
              - brcm,bcm7445-gisb-arb  # 对于其他 28nm 芯片
          - const: brcm,gisb-arb
      - items:
          - enum:
              - brcm,bcm74165-gisb-arb  # 对于 V7 新型 16nm 芯片
              - brcm,bcm7278-gisb-arb  # 对于 V7 28nm 芯片
              - brcm,bcm7435-gisb-arb  # 对于较新的 40nm 芯片
              - brcm,bcm7400-gisb-arb  # 对于旧的 40nm 芯片和所有 65nm 芯片
              - brcm,bcm7038-gisb-arb  # 对于 130nm 芯片
              - brcm,gisb-arb          # 兼容性回退

  reg:
    maxItems: 1

  interrupts:
    minItems: 2
    items:
      - description: 超时中断线路
      - description: 目标中止中断线路
      - description: 断点中断线路

  brcm,gisb-arb-master-mask:
    $ref: /schemas/types.yaml#/definitions/uint32
    description: >
      32 位宽的位掩码，用于指定在系统级别哪些 GISB 主设备是有效的

  brcm,gisb-arb-master-names:
    $ref: /schemas/types.yaml#/definitions/string-array
    description: >
      GISB 主设备的字面名称的字符串列表。应与 brcm,gisb-arb-master-mask 中设置的位数匹配，并且从最高有效位到最低有效位的顺序出现
required:
  - compatible
  - reg
  - interrupts

additionalProperties: false

examples:
  - |
    gisb-arb@f0400000 {
      compatible = "brcm,gisb-arb";
      reg = <0xf0400000 0x800>;
      interrupts = <0>, <2>;
      interrupt-parent = <&sun_l2_intc>;
      brcm,gisb-arb-master-mask = <0x7>;
      brcm,gisb-arb-master-names = "bsp_0", "scpu_0", "cpu_0";
    };
```

## Documentation/devicetree/bindings/bus/fsl,spba-bus_cn.yaml
```yaml
# SPDX-许可证标识符: (GPL-2.0-only 或 BSD-2-Clause)
%YAML 1.2
---
$id: http://devicetree.org/schemas/bus/fsl,spba-bus.yaml#
$schema: http://devicetree.org/meta-schemas/core.yaml#

标题: 共享外设总线接口

维护者:
  - Shawn Guo <shawnguo@kernel.org>

描述: |
  一个简单的总线，用于访问共享外设。
"spba-bus" 遵循 Devicetree 规范中指定的 "simple-bus" 属性集。它是 "simple-bus" 的扩展，因为 SDMA 控制器使用此兼容性标志来确定哪些外设对它可用以及 SDMA 可以访问的范围。总线上没有特殊的时钟，因为 SDMA 控制器本身有自己的中断和时钟分配。
选择:
  属性:
    compatible:
      包含:
        常量: fsl,spba-bus
  必需:
    - compatible

属性:
  $nodename:
    模式: "^spba-bus(@[0-9a-f]+)?$"

  compatible:
    项目:
      - 常量: fsl,spba-bus
      - 常量: simple-bus

  '#address-cells':
    枚举: [ 1, 2 ]

  '#size-cells':
    枚举: [ 1, 2 ]

  reg:
    最大项数: 1

  ranges: 真

必需:
  - compatible
  - '#address-cells'
  - '#size-cells'
  - reg
  - ranges

附加属性:
  类型: 对象

示例:
  - |
    spba-bus@30000000 {
        compatible = "fsl,spba-bus", "simple-bus";
        #address-cells = <1>;
        #size-cells = <1>;
        reg = <0x30000000 0x100000>;
        ranges;
    };
```

## Documentation/devicetree/bindings/bus/microsoft,vmbus_cn.yaml
```yaml
# SPDX-许可证标识符: (GPL-2.0-only 或 BSD-2-Clause)
%YAML 1.2
---
$id: http://devicetree.org/schemas/bus/microsoft,vmbus.yaml#
$schema: http://devicetree.org/meta-schemas/core.yaml#

标题: Microsoft Hyper-V VMBus

维护者:
  - Saurabh Sengar <ssengar@linux.microsoft.com>

描述:
  VMBus 是一个软件总线，实现了根操作系统或宿主操作系统与客户机操作系统（虚拟机）之间通信的协议。
属性:
  compatible:
    常量: microsoft,vmbus

  ranges: 真

  '#address-cells':
    常量: 2

  '#size-cells':
    常量: 1

必需:
  - compatible
  - ranges
  - '#address-cells'
  - '#size-cells'

额外属性: 错误

示例:
  - |
    soc {
        #address-cells = <2>;
        #size-cells = <1>;
        bus {
            compatible = "simple-bus";
            #address-cells = <2>;
            #size-cells = <1>;
            ranges;

            vmbus@ff0000000 {
                compatible = "microsoft,vmbus";
                #address-cells = <2>;
                #size-cells = <1>;
                ranges = <0x0f 0xf0000000 0x0f 0xf0000000 0x10000000>;
            };
        };
    };
```

## Documentation/devicetree/bindings/bus/moxtet_cn.txt
~~~~
Turris Mox 模块状态和配置总线（通过 SPI）

必需属性：
- compatible：应为 "cznic,moxtet"
- #address-cells：必须是 1
- #size-cells：必须是 0
- spi-cpol：所需反相时钟极性
- spi-cpha：所需移位时钟相位
- interrupts：必须包含对共享中断线的引用
- interrupt-controller：必需
- #interrupt-cells：必须是 1

对于 SPI 从节点的其他必需和可选属性，请参阅
../spi/spi-bus.txt
子节点的必需属性：
- reg：应为在 Moxtet 总线上所处的位置（从该模块到 CPU 模块之间有多少个 Moxtet 模块，因此
              可以是 0 或一个正整数）

驱动程序会自行查找连接到总线的设备，但在某些情况下可能需要从设备树的其他部分引用其中一些设备。在这种情况下，可以将这些设备定义为 moxtet 节点的子节点。
示例：

``` 
    moxtet@1 {
        compatible = "cznic,moxtet";
        #address-cells = <1>;
        #size-cells = <0>;
        reg = <1>;
        spi-max-frequency = <10000000>;
        spi-cpol;
        spi-cpha;
        interrupt-controller;
        #interrupt-cells = <1>;
        interrupt-parent = <&gpiosb>;
        interrupts = <5 IRQ_TYPE_EDGE_FALLING>;

        moxtet_sfp: gpio@0 {
            compatible = "cznic,moxtet-gpio";
            gpio-controller;
            #gpio-cells = <2>;
            reg = <0>;
        }
    };
```

这段文本描述了如何在设备树中定义一个使用 SPI 的 Turris Mox 模块，并给出了必要的属性以及一个具体的示例。
~~~~

## Documentation/devicetree/bindings/bus/mti,mips-cdmm_cn.yaml
~~~~yaml
```yaml
# SPDX-许可证标识符: (GPL-2.0-only 或 BSD-2-Clause)
%YAML 1.2
---
$id: http://devicetree.org/schemas/bus/mti,mips-cdmm.yaml#
$schema: http://devicetree.org/meta-schemas/core.yaml#

title: MIPS 公共设备内存映射

description: |
  定义了 MIPS 公共设备内存映射寄存器的位置
maintainers:
  - James Hogan <jhogan@kernel.org>

properties:
  compatible:
    const: mti,mips-cdmm

  reg:
    description: |
      未占用内存区域的基地址和大小，将用于映射 MIPS CDMM 寄存器块
maxItems: 1

required:
  - compatible
  - reg

additionalProperties: false

examples:
  - |
    cdmm@1bde8000 {
      compatible = "mti,mips-cdmm";
      reg = <0x1bde8000 0x8000>;
    };
```

这段 YAML 文件描述了一个设备树配置，定义了 MIPS 架构中的公共设备内存映射（MIPS Common Device Memory Map）的相关属性。具体包括了必需的兼容字符串和内存区域的注册信息。
~~~~
