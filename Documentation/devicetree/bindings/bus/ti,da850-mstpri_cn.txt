## Documentation/devicetree/bindings/display/allwinner,sun8i-r40-tcon-top_cn.yaml
```yaml
下面是给定 YAML 文档的中文翻译：

# SPDX 许可标识符: GPL-2.0
%YAML 1.2
---
$id: http://devicetree.org/schemas/display/allwinner,sun8i-r40-tcon-top.yaml#
$schema: http://devicetree.org/meta-schemas/core.yaml#

标题: Allwinner R40 TCON TOP

维护者:
  - 陈宇蔡 <wens@csie.org>
  - 马克西姆·里帕德 <mripard@kernel.org>

描述: |
  TCON TOP 的主要目的是配置整个显示管道。它
  确定了混合器与 TCON 之间的关系，选择 HDMI 的源
  TCON，复用 LCD 和 TV 编码器 GPIO 输出，选择 TV
  编码器时钟源，并包含额外的 TV TCON 和 DSI 门控。
  它允许以非常不同的方式配置显示管道：

                                  / LCD0/LVDS0
                   / [0] TCON-LCD0
                   |              \ MIPI DSI
   mixer0          |
          \        / [1] TCON-LCD1 - LCD1/LVDS1
           TCON-TOP
          /        \ [2] TCON-TV0 [0] - TVE0/RGB
   mixer1          |                  \
                   |                   TCON-TOP - HDMI
                   |                  /
                   \ [3] TCON-TV1 [1] - TVE1/RGB

  注意两个 TCON TOP 引用相同的物理单元。两个混合器
  可以连接到任意一个 TCON。并非所有 TCON TOP 变体都支持所有
  功能。
属性:
  "#clock-cells":
    常量: 1

  兼容性:
    枚举:
      - allwinner,sun8i-r40-tcon-top
      - allwinner,sun20i-d1-tcon-top
      - allwinner,sun50i-h6-tcon-top

  地址:
    最大项数: 1

  时钟:
    最小项数: 2
    最大项数: 6

  时钟名称:
    最小项数: 2
    最大项数: 6

  时钟输出名称:
    最小项数: 1
    最大项数: 3

  重置:
    最大项数: 1

  端口:
    $ref: /schemas/graph.yaml#/properties/ports

    属性:
      port@0:
        $ref: /schemas/graph.yaml#/properties/port
        描述: |
          混合器 0 复用器的输入端点
port@1:
        $ref: /schemas/graph.yaml#/properties/port
        描述: |
          混合器 0 复用器的输出端点

      port@2:
        $ref: /schemas/graph.yaml#/properties/port
        描述: |
          混合器 1 复用器的输入端点
port@3:
        $ref: /schemas/graph.yaml#/properties/port
        描述: |
          混合器 1 复用器的输出端点

      port@4:
        $ref: /schemas/graph.yaml#/properties/port
        描述: |
          HDMI 复用器的输入端点
port@5:
        $ref: /schemas/graph.yaml#/properties/port
        描述: |
          HDMI 复用器的输出端点

    必需:
      - port@0
      - port@1
      - port@4
      - port@5

必需:
  - "#clock-cells"
  - 兼容性
  - 地址
  - 时钟
  - 时钟名称
  - 时钟输出名称
  - 重置
  - 端口

其他属性: false

allOf:
  - 如果:
      属性:
        兼容性:
          包含:
            常量: allwinner,sun8i-r40-tcon-top

    则:
      属性:
        时钟:
          项:
            - 描述: TCON TOP 接口时钟
            - 描述: TCON TOP TV0 时钟
            - 描述: TCON TOP TVE0 时钟
            - 描述: TCON TOP TV1 时钟
            - 描述: TCON TOP TVE1 时钟
            - 描述: TCON TOP MIPI DSI 时钟

        时钟名称:
          项:
            - 常量: bus
            - 常量: tcon-tv0
            - 常量: tve0
            - 常量: tcon-tv1
            - 常量: tve1
            - 常量: dsi

        时钟输出名称:
          项:
            - 描述: TCON TV0 输出时钟名称
            - 描述: TCON TV1 输出时钟名称
            - 描述: DSI 输出时钟名称

        端口:
          必需:
            - port@2
            - port@3

  - 如果:
      属性:
        兼容性:
          包含:
            常量: allwinner,sun20i-d1-tcon-top

    则:
      属性:
        时钟:
          项:
            - 描述: TCON TOP 接口时钟
            - 描述: TCON TOP TV0 时钟
            - 描述: TCON TOP TVE0 时钟
            - 描述: TCON TOP MIPI DSI 时钟

        时钟名称:
          项:
            - 常量: bus
            - 常量: tcon-tv0
            - 常量: tve0
            - 常量: dsi

        时钟输出名称:
          项:
            - 描述: TCON TV0 输出时钟名称
            - 描述: DSI 输出时钟名称

  - 如果:
      属性:
        兼容性:
          包含:
            常量: allwinner,sun50i-h6-tcon-top

    则:
      属性:
        时钟:
          项:
            - 描述: TCON TOP 接口时钟
            - 描述: TCON TOP TV0 时钟

        时钟名称:
          项:
            - 常量: bus
            - 常量: tcon-tv0

        时钟输出名称:
          项:
            - 描述: TCON TV0 输出时钟名称

示例:
  - |
    #include <dt-bindings/interrupt-controller/arm-gic.h>

    #include <dt-bindings/clock/sun8i-r40-ccu.h>
    #include <dt-bindings/reset/sun8i-r40-ccu.h>

      tcon_top: tcon-top@1c70000 {
          兼容性 = "allwinner,sun8i-r40-tcon-top";
          地址 = <0x01c70000 0x1000>;
          时钟 = <&ccu CLK_BUS_TCON_TOP>,
                   <&ccu CLK_TCON_TV0>,
                   <&ccu CLK_TVE0>,
                   <&ccu CLK_TCON_TV1>,
                   <&ccu CLK_TVE1>,
                   <&ccu CLK_DSI_DPHY>;
          时钟名称 = "bus",
                        "tcon-tv0",
                        "tve0",
                        "tcon-tv1",
                        "tve1",
                        "dsi";
          时钟输出名称 = "tcon-top-tv0",
                               "tcon-top-tv1",
                               "tcon-top-dsi";
          重置 = <&ccu RST_BUS_TCON_TOP>;
          #clock-cells = <1>;

          端口 {
              #address-cells = <1>;
              #size-cells = <0>;

              tcon_top_mixer0_in: port@0 {
                  reg = <0>;

                  tcon_top_mixer0_in_mixer0: endpoint {
                      remote-endpoint = <&mixer0_out_tcon_top>;
                  };
              };

              tcon_top_mixer0_out: port@1 {
                  #address-cells = <1>;
                  #size-cells = <0>;
                  reg = <1>;

                  tcon_top_mixer0_out_tcon_lcd0: endpoint@0 {
                      reg = <0>;
                  };

                  tcon_top_mixer0_out_tcon_lcd1: endpoint@1 {
                      reg = <1>;
                  };

                  tcon_top_mixer0_out_tcon_tv0: endpoint@2 {
                      reg = <2>;
                      remote-endpoint = <&tcon_tv0_in_tcon_top_mixer0>;
                  };

                  tcon_top_mixer0_out_tcon_tv1: endpoint@3 {
                      reg = <3>;
                      remote-endpoint = <&tcon_tv1_in_tcon_top_mixer0>;
                  };
              };

              tcon_top_mixer1_in: port@2 {
                  #address-cells = <1>;
                  #size-cells = <0>;
                  reg = <2>;

                  tcon_top_mixer1_in_mixer1: endpoint@1 {
                      reg = <1>;
                      remote-endpoint = <&mixer1_out_tcon_top>;
                  };
              };

              tcon_top_mixer1_out: port@3 {
                  #address-cells = <1>;
                  #size-cells = <0>;
                  reg = <3>;

                  tcon_top_mixer1_out_tcon_lcd0: endpoint@0 {
                      reg = <0>;
                  };

                  tcon_top_mixer1_out_tcon_lcd1: endpoint@1 {
                      reg = <1>;
                  };

                  tcon_top_mixer1_out_tcon_tv0: endpoint@2 {
                      reg = <2>;
                      remote-endpoint = <&tcon_tv0_in_tcon_top_mixer1>;
                  };

                  tcon_top_mixer1_out_tcon_tv1: endpoint@3 {
                      reg = <3>;
                      remote-endpoint = <&tcon_tv1_in_tcon_top_mixer1>;
                  };
              };

              tcon_top_hdmi_in: port@4 {
                  #address-cells = <1>;
                  #size-cells = <0>;
                  reg = <4>;

                  tcon_top_hdmi_in_tcon_tv0: endpoint@0 {
                      reg = <0>;
                      remote-endpoint = <&tcon_tv0_out_tcon_top>;
                  };

                  tcon_top_hdmi_in_tcon_tv1: endpoint@1 {
                      reg = <1>;
                      remote-endpoint = <&tcon_tv1_out_tcon_top>;
                  };
              };

              tcon_top_hdmi_out: port@5 {
                  reg = <5>;

                  tcon_top_hdmi_out_hdmi: endpoint {
                      remote-endpoint = <&hdmi_in_tcon_top>;
                  };
              };
          };
      };
```

## Documentation/devicetree/bindings/display/allwinner,sun9i-a80-deu_cn.yaml
```yaml
# SPDX-许可证标识符: GPL-2.0
%YAML 1.2
---
$id: http://devicetree.org/schemas/display/allwinner,sun9i-a80-deu.yaml#
$schema: http://devicetree.org/meta-schemas/core.yaml#

标题: Allwinner A80 细节增强单元

维护者:
  - 陈宇蔡 <wens@csie.org>
  - 马西姆·里帕德 <mripard@kernel.org>

描述: |
  存在于 Allwinner A80 系统级芯片中的细节增强单元 (DEU) 可以同时在亮度和色度通道中提高显示内容的清晰度。

属性:
  compatible:
    常量: allwinner,sun9i-a80-deu

  reg:
    最大项目数: 1

  interrupts:
    最大项目数: 1

  clocks:
    项目:
      - 描述: DEU 接口时钟
      - 描述: DEU 模块时钟
      - 描述: DEU DRAM 时钟

  clock-names:
    项目:
      - 常量: ahb
      - 常量: mod
      - 常量: ram

  resets:
    最大项目数: 1

  ports:
    $ref: /schemas/graph.yaml#/properties/ports

    属性:
      port@0:
        $ref: /schemas/graph.yaml#/properties/port
        描述: |
          控制器的输入端点
      port@1:
        $ref: /schemas/graph.yaml#/properties/port
        描述: |
          控制器的输出端点

必需项:
  - port@0
  - port@1

必需项:
  - compatible
  - reg
  - interrupts
  - clocks
  - clock-names
  - resets
  - ports

额外属性: false

示例:
  - |
    #include <dt-bindings/interrupt-controller/arm-gic.h>

    #include <dt-bindings/clock/sun9i-a80-de.h>
    #include <dt-bindings/reset/sun9i-a80-de.h>

    deu0: deu@3300000 {
        compatible = "allwinner,sun9i-a80-deu";
        reg = <0x03300000 0x40000>;
        interrupts = <GIC_SPI 92 IRQ_TYPE_LEVEL_HIGH>;
        clocks = <&de_clocks CLK_BUS_DEU0>,
                 <&de_clocks CLK_IEP_DEU0>,
                 <&de_clocks CLK_DRAM_DEU0>;
        clock-names = "ahb",
                      "mod",
                      "ram";
        resets = <&de_clocks RST_DEU0>;

        ports {
            #address-cells = <1>;
            #size-cells = <0>;

            deu0_in: port@0 {
                reg = <0>;

                deu0_in_fe0: endpoint {
                    remote-endpoint = <&fe0_out_deu0>;
                };
            };

            deu0_out: port@1 {
                #address-cells = <1>;
                #size-cells = <0>;
                reg = <1>;

                deu0_out_be0: endpoint@0 {
                    reg = <0>;
                    remote-endpoint = <&be0_in_deu0>;
                };

                deu0_out_be1: endpoint@1 {
                    reg = <1>;
                    remote-endpoint = <&be1_in_deu0>;
                };
            };
        };
    };
```

## Documentation/devicetree/bindings/display/amlogic,meson-dw-hdmi_cn.yaml
~~~~yaml
此文档定义了Amlogic针对Synopsys Designware HDMI控制器的特定扩展。

- **许可证**: (GPL-2.0 或 BSD-2-Clause)
- **版权所有**: 2019 BayLibre, SAS
- **YAML版本**: 1.2
- **标识符**: `http://devicetree.org/schemas/display/amlogic,meson-dw-hdmi.yaml`
- **模式**: `http://devicetree.org/meta-schemas/core.yaml`

**标题**: Amlogic针对Synopsys Designware HDMI控制器的特定扩展

**维护者**:
  - Neil Armstrong <neil.armstrong@linaro.org>

**基于**:
  - `/schemas/sound/dai-common.yaml`

**描述**: 
  Amlogic Meson Synopsys Designware HDMI集成包括以下部分:
  - Synopsys DesignWare HDMI 控制器IP
  - 用于控制时钟和PHY的TOP控制块
  - 用于将视频信号转换为TMDS信号的自定义HDMI PHY
  ![架构图]
  - HDMI TOP仅支持HPD感测
  - Synopsys HDMI控制器中断通过TOP块中断进行路由
  - 与TOP块及Synopsys HDMI控制器之间的通信通过一对专用地址+读写寄存器实现
  - HDMI PHY由HHI寄存器块中的寄存器配置
  - 像素数据以“4:4:4”格式从VENC块到达，VPU HDMI复用器选择ENCI编码器用于576i或480i格式，或ENCP编码器用于其他所有格式，包括交错HD格式
  - VENC在ENCI或ENCP编码器之上使用DVI编码器生成HDMI控制器所需的DVI定时
  - Amlogic Meson GXBB, GXL 和 GXM 系列SoC嵌入了Synopsys DesignWare HDMI TX IP版本2.01a，包含HDCP和I2C&S/PDIF音频源接口

**兼容性属性**:
  - `compatible`: 必须指定如下之一:
    - `amlogic,meson-gxbb-dw-hdmi` (GXBB/S905)
    - `amlogic,meson-gxl-dw-hdmi` (GXL/S905X, S905D)
    - `amlogic,meson-gxm-dw-hdmi` (GXM/S912)
    - `amlogic,meson-gx-dw-hdmi` (通用)
    - `amlogic,meson-g12a-dw-hdmi` (G12A/S905X2, S905Y2, S905D2)

**硬件资源属性**:
  - `reg`: 单项
  - `interrupts`: 单项
  - `clocks`: 至少三项
  - `clock-names`: 包含`isfr`, `iahb`, `venci`
  - `power-domains`: 单项, 指向相关电源域
  - `resets`: 至少三项
  - `reset-names`: 包含`hdmitx_apb`, `hdmitx`, `hdmitx_phy`
  - `hdmi-supply`: 指向外部5V稳压器以供电HDMI逻辑

**端口节点**:
  - `port@0`: 指向VENC输入端口节点
  - `port@1`: 指向TMDS输出端口节点

**其他属性**:
  - `#address-cells`: 常数1
  - `#size-cells`: 常数0
  - `#sound-dai-cells`: 常数0
  - `sound-name-prefix`: 真

**必需属性**:
  - `compatible`
  - `reg`
  - `interrupts`
  - `clocks`
  - `clock-names`
  - `resets`
  - `reset-names`
  - `port@0`
  - `port@1`
  - `#address-cells`
  - `#size-cells`

**额外属性**: 不允许

**示例**:
```yaml
hdmi_tx: hdmi-tx@c883a000 {
    compatible = "amlogic,meson-gxbb-dw-hdmi", "amlogic,meson-gx-dw-hdmi";
    reg = <0xc883a000 0x1c>;
    interrupts = <57>;
    resets = <&reset_apb>, <&reset_hdmitx>, <&reset_hdmitx_phy>;
    reset-names = "hdmitx_apb", "hdmitx", "hdmitx_phy";
    clocks = <&clk_isfr>, <&clk_iahb>, <&clk_venci>;
    clock-names = "isfr", "iahb", "venci";
    power-domains = <&pd_vpu>;
    #address-cells = <1>;
    #size-cells = <0>;

    /* VPU VENC Input */
    hdmi_tx_venc_port: port@0 {
        reg = <0>;

        hdmi_tx_in: endpoint {
            remote-endpoint = <&hdmi_tx_out>;
        };
    };

    /* TMDS Output */
    hdmi_tx_tmds_port: port@1 {
         reg = <1>;

         hdmi_tx_tmds_out: endpoint {
             remote-endpoint = <&hdmi_connector_in>;
         };
    };
};
```

请注意，上述文本中提到的架构图并未实际提供，但根据文本描述可以理解其内容。
~~~~

## Documentation/devicetree/bindings/display/amlogic,meson-g12a-dw-mipi-dsi_cn.yaml
```yaml
此文档定义了Amlogic特定的扩展，用于Synopsys Designware MIPI DSI（移动行业处理器接口）主机控制器。以下是文档的关键部分翻译：

# SPDX 许可证标识符: (GPL-2.0 或 BSD-2-Clause)
# 版权所有 2020 BayLibre, SAS
%YAML 1.2
---
$id: http://devicetree.org/schemas/display/amlogic,meson-g12a-dw-mipi-dsi.yaml#
$schema: http://devicetree.org/meta-schemas/core.yaml#

标题: Amlogic针对Synopsys Designware MIPI DSI主机控制器的特定扩展

维护者:
  - Neil Armstrong <neil.armstrong@linaro.org>

描述: |
  Amlogic Meson Synopsys Designware集成包括：
  - 一个Synopsys DesignWare MIPI DSI主机控制器IP
  - 一个控制该IP时钟与复位的TOP控制块

allOf:
  - $ref: dsi-controller.yaml#

属性:
  compatible:
    枚举:
      - amlogic,meson-g12a-dw-mipi-dsi

  reg:
    最大项数: 1

  clocks:
    最小项数: 3
    最大项数: 4

  clock-names:
    最小项数: 3
    项:
      - 常量: pclk
      - 常量: bit
      - 常量: px
      - 常量: meas

  resets:
    最大项数: 1

  reset-names:
    项:
      - 常量: top

  phys:
    最大项数: 1

  phy-names:
    项:
      - 常量: dphy

  ports:
    $ref: /schemas/graph.yaml#/properties/ports

    属性:
      port@0:
        $ref: /schemas/graph.yaml#/properties/port
        描述: 接收像素数据的输入节点
      port@1:
        $ref: /schemas/graph.yaml#/properties/port
        描述: 输出到面板的DSI节点

必需:
  - port@0
  - port@1

必需:
  - compatible
  - reg
  - clocks
  - clock-names
  - resets
  - reset-names
  - phys
  - phy-names
  - ports

未评估属性: false

示例:
  - |
    dsi@6000 {
          compatible = "amlogic,meson-g12a-dw-mipi-dsi";
          reg = <0x6000 0x400>;
          resets = <&reset_top>;
          reset-names = "top";
          clocks = <&clk_pclk>, <&bit_clk>, <&clk_px>;
          clock-names = "pclk", "bit", "px";
          phys = <&mipi_dphy>;
          phy-names = "dphy";

          ports {
              #address-cells = <1>;
              #size-cells = <0>;

              /* VPU VENC 输入 */
              mipi_dsi_venc_port: port@0 {
                  reg = <0>;

                  mipi_dsi_in: endpoint {
                       remote-endpoint = <&dpi_out>;
                  };
              };

              /* DSI 输出 */
              mipi_dsi_panel_port: port@1 {
                  reg = <1>;

                  mipi_out_panel: endpoint {
                      remote-endpoint = <&mipi_in_panel>;
                  };
              };
          };
    };
```
