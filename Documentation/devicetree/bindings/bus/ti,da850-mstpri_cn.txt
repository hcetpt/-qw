## Documentation/devicetree/bindings/display/allwinner,sun4i-a10-display-backend_cn.yaml
```yaml
# SPDX-许可证标识符: GPL-2.0
%YAML 1.2
---
$id: http://devicetree.org/schemas/display/allwinner,sun4i-a10-display-backend.yaml#
$schema: http://devicetree.org/meta-schemas/core.yaml#

标题: Allwinner A10 显示引擎后端

维护者:
  - 陈宇蔡 <wens@csie.org>
  - 马克西姆·里帕德 <mripard@kernel.org>

描述: |
  显示引擎后端向系统暴露图层和精灵

属性:
  compatible:
    枚举:
      - allwinner,sun4i-a10-display-backend
      - allwinner,sun5i-a13-display-backend
      - allwinner,sun6i-a31-display-backend
      - allwinner,sun7i-a20-display-backend
      - allwinner,sun8i-a23-display-backend
      - allwinner,sun8i-a33-display-backend
      - allwinner,sun9i-a80-display-backend

  reg:
    最小项数: 1
    项:
      - 描述: 显示后端寄存器
      - 描述: SAT 寄存器

  reg-names:
    最小项数: 1
    项:
      - 常量: be
      - 常量: sat

  interrupts:
    最大项数: 1

  clocks:
    最小项数: 3
    项:
      - 描述: 后端接口时钟
      - 描述: 后端模块时钟
      - 描述: 后端 DRAM 时钟
      - 描述: SAT 时钟

  clock-names:
    最小项数: 3
    项:
      - 常量: ahb
      - 常量: mod
      - 常量: ram
      - 常量: sat

  resets:
    最小项数: 1
    项:
      - 描述: 后端复位线
      - 描述: SAT 复位线

  reset-names:
    最小项数: 1
    项:
      - 常量: be
      - 常量: sat

  # FIXME: 这最终应该被设置为必需的，一旦所有 SoC 都声明了 MBUS
互联:
    最大项数: 1

  # FIXME: 这最终应该被设置为必需的，一旦所有 SoC 都声明了 MBUS
interconnect-names:
    常量: dma-mem

  ports:
    $ref: /schemas/graph.yaml#/properties/ports

    属性:
      port@0:
        $ref: /schemas/graph.yaml#/properties/port
        描述:
          控制器的输入端点
      port@1:
        $ref: /schemas/graph.yaml#/properties/port
        描述:
          控制器的输出端点

所需:
      - port@0
      - port@1

所需:
  - compatible
  - reg
  - interrupts
  - clocks
  - clock-names
  - resets
  - ports

额外属性: false

如果:
  属性:
    compatible:
      包含:
        常量: allwinner,sun8i-a33-display-backend

然后:
  属性:
    reg:
      最小项数: 2

    reg-names:
      最小项数: 2

    clocks:
      最小项数: 4

    clock-names:
      最小项数: 4

    resets:
      最小项数: 2

    reset-names:
      最小项数: 2

  所需:
    - reg-names
    - reset-names

否则:
  属性:
    reg:
      最大项数: 1

    reg-names:
      最大项数: 1

    clocks:
      最大项数: 3

    clock-names:
      最大项数: 3

    resets:
      最大项数: 1

    reset-names:
      最大项数: 1

示例:
  - |
    /*
     * 这来自 clock/sun4i-a10-ccu.h 和
     * reset/sun4i-a10-ccu.h 标头文件，但我们不能包含它们，因为
     * 它会触发与另一个示例中符号重新定义的一系列警告
*/

    #define CLK_AHB_DE_BE0	42
    #define CLK_DRAM_DE_BE0	140
    #define CLK_DE_BE0		144
    #define RST_DE_BE0		5

    display-backend@1e60000 {
        compatible = "allwinner,sun4i-a10-display-backend";
        reg = <0x01e60000 0x10000>;
        interrupts = <47>;
        clocks = <&ccu CLK_AHB_DE_BE0>, <&ccu CLK_DE_BE0>,
                 <&ccu CLK_DRAM_DE_BE0>;
        clock-names = "ahb", "mod",
                      "ram";
        resets = <&ccu RST_DE_BE0>;

        ports {
            #address-cells = <1>;
            #size-cells = <0>;

            port@0 {
                #address-cells = <1>;
                #size-cells = <0>;
                reg = <0>;

                endpoint@0 {
                    reg = <0>;
                    remote-endpoint = <&fe0_out_be0>;
                };

                endpoint@1 {
                    reg = <1>;
                    remote-endpoint = <&fe1_out_be0>;
                };
            };

            port@1 {
                #address-cells = <1>;
                #size-cells = <0>;
                reg = <1>;

                endpoint@0 {
                    reg = <0>;
                    remote-endpoint = <&tcon0_in_be0>;
                };

                endpoint@1 {
                    reg = <1>;
                    remote-endpoint = <&tcon1_in_be0>;
                };
            };
        };
    };

  - |
    #include <dt-bindings/interrupt-controller/arm-gic.h>

    /*
     * 这来自 clock/sun8i-a23-a33-ccu.h 和
     * reset/sun8i-a23-a33-ccu.h 标头文件，但我们不能包含它们
     * 因为它会触发与另一个示例中符号重新定义的一系列警告
*/

    #define CLK_BUS_DE_BE	40
    #define CLK_BUS_SAT		46
    #define CLK_DRAM_DE_BE	84
    #define CLK_DE_BE		85
    #define RST_BUS_DE_BE	21
    #define RST_BUS_SAT		27

    display-backend@1e60000 {
        compatible = "allwinner,sun8i-a33-display-backend";
        reg = <0x01e60000 0x10000>, <0x01e80000 0x1000>;
        reg-names = "be", "sat";
        interrupts = <GIC_SPI 95 IRQ_TYPE_LEVEL_HIGH>;
        clocks = <&ccu CLK_BUS_DE_BE>, <&ccu CLK_DE_BE>,
                 <&ccu CLK_DRAM_DE_BE>, <&ccu CLK_BUS_SAT>;
        clock-names = "ahb", "mod",
                      "ram", "sat";
        resets = <&ccu RST_BUS_DE_BE>, <&ccu RST_BUS_SAT>;
        reset-names = "be", "sat";

        ports {
            #address-cells = <1>;
            #size-cells = <0>;

            port@0 {
                reg = <0>;

                endpoint {
                    remote-endpoint = <&fe0_out_be0>;
                };
            };

            port@1 {
                reg = <1>;

                endpoint {
                    remote-endpoint = <&drc0_in_be0>;
                };
            };
        };
    };
```

## Documentation/devicetree/bindings/display/allwinner,sun4i-a10-display-engine_cn.yaml
```yaml
# SPDX-许可证标识符: GPL-2.0
%YAML 1.2
---
$id: http://devicetree.org/schemas/display/allwinner,sun4i-a10-display-engine.yaml#
$schema: http://devicetree.org/meta-schemas/core.yaml#

标题: Allwinner A10 显示引擎管道

维护者:
  - 陈宇蔡 <wens@csie.org>
  - 马克西姆·里帕德 <mripard@kernel.org>

描述: |
  显示引擎管道（及其入口点，因为它可以是后端或前端）表示为一个额外的节点。
  Allwinner A10 显示管道由以下几个组件组成，这些将在下面进行说明：

  对于显示管道中直至TCON的所有组件之间的连接，在同一层级有多个相同类型的组件时，
  本地终点ID必须与远程组件的索引相同。例如，如果远程终点是前端1，则本地终点ID必须是1。
  前端 0  [0] ------- [0]  后端 0  [0] ------- [0]  TCON 0
              [1] --   -- [1]             [1] --   -- [1]
                    \ /                         \ /
                     X                           X
                    / \                         / \
              [0] --   -- [0]             [0] --   -- [0]
  前端 1  [1] ------- [1]  后端 1  [1] ------- [1]  TCON 1

  对于上述所示的双管道系统，线条代表组件间的连接，而方括号内的数字对应于本地终点的ID。
  DE 2.0 混合器-TCON 连接也遵循同样的规则：

  混合器 0  [0] ----------- [0]  TCON 0
           [1] ----   ---- [1]
                   \ /
                    X
                   / \
           [0] ----   ---- [0]
  混合器 1  [1] ----------- [1]  TCON 1

属性:
  compatible:
    枚举:
      - allwinner,sun4i-a10-display-engine
      - allwinner,sun5i-a10s-display-engine
      - allwinner,sun5i-a13-display-engine
      - allwinner,sun6i-a31-display-engine
      - allwinner,sun6i-a31s-display-engine
      - allwinner,sun7i-a20-display-engine
      - allwinner,sun8i-a23-display-engine
      - allwinner,sun8i-a33-display-engine
      - allwinner,sun8i-a83t-display-engine
      - allwinner,sun8i-h3-display-engine
      - allwinner,sun8i-r40-display-engine
      - allwinner,sun8i-v3s-display-engine
      - allwinner,sun9i-a80-display-engine
      - allwinner,sun20i-d1-display-engine
      - allwinner,sun50i-a64-display-engine
      - allwinner,sun50i-h6-display-engine

  allwinner,pipelines:
    $ref: /schemas/types.yaml#/definitions/phandle-array
    minItems: 1
    maxItems: 2
    items:
      maxItems: 1
    描述: |
      可用的显示引擎前端（DE 1.0）或混合器（DE 2.0/3.0）

必需:
  - compatible
  - allwinner,pipelines

其他属性: false

如果:
  属性:
    compatible:
      包含:
        枚举:
          - allwinner,sun4i-a10-display-engine
          - allwinner,sun6i-a31-display-engine
          - allwinner,sun6i-a31s-display-engine
          - allwinner,sun7i-a20-display-engine
          - allwinner,sun8i-a83t-display-engine
          - allwinner,sun8i-r40-display-engine
          - allwinner,sun9i-a80-display-engine
          - allwinner,sun20i-d1-display-engine
          - allwinner,sun50i-a64-display-engine

那么:
  属性:
    allwinner,pipelines:
      minItems: 2

否则:
  属性:
    allwinner,pipelines:
      maxItems: 1

示例:
  - |
      de: display-engine {
          compatible = "allwinner,sun4i-a10-display-engine";
          allwinner,pipelines = <&fe0>, <&fe1>;
      };
```

## Documentation/devicetree/bindings/display/allwinner,sun4i-a10-display-frontend_cn.yaml
```yaml
# SPDX-许可证标识符: GPL-2.0
%YAML 1.2
---
$id: http://devicetree.org/schemas/display/allwinner,sun4i-a10-display-frontend.yaml#
$schema: http://devicetree.org/meta-schemas/core.yaml#

标题: Allwinner A10 显示引擎前端

维护者:
  - 陈宇蔡 <wens@csie.org>
  - 马克西姆·里帕德 <mripard@kernel.org>

描述: |
  显示引擎前端执行格式转换、缩放、去交织和色彩空间转换。
属性:
  compatible:
    枚举:
      - allwinner,sun4i-a10-display-frontend
      - allwinner,sun5i-a13-display-frontend
      - allwinner,sun6i-a31-display-frontend
      - allwinner,sun7i-a20-display-frontend
      - allwinner,sun8i-a23-display-frontend
      - allwinner,sun8i-a33-display-frontend
      - allwinner,sun9i-a80-display-frontend

  reg:
    最大项数: 1

  interrupts:
    最大项数: 1

  clocks:
    项:
      - 描述: 前端接口时钟
      - 描述: 前端模块时钟
      - 描述: 前端DRAM时钟

  clock-names:
    项:
      - 常量: ahb
      - 常量: mod
      - 常量: ram

  # FIXME: 应该最终要求这一点，一旦所有SoC都有MBUS声明
互连:
    最大项数: 1

  # FIXME: 应该最终要求这一点，一旦所有SoC都有MBUS声明
互连名称:
    常量: dma-mem

  resets:
    最大项数: 1

  ports:
    $ref: /schemas/graph.yaml#/properties/ports

    属性:
      port@0:
        $ref: /schemas/graph.yaml#/properties/port
        描述: |
          控制器的输入端点
      port@1:
        $ref: /schemas/graph.yaml#/properties/port
        描述: |
          控制器的输出端点
必需:
      - port@1

必需:
  - compatible
  - reg
  - interrupts
  - clocks
  - clock-names
  - resets
  - ports

其他属性: false

示例:
  - |
    #include <dt-bindings/clock/sun4i-a10-ccu.h>
    #include <dt-bindings/reset/sun4i-a10-ccu.h>

    fe0: display-frontend@1e00000 {
        compatible = "allwinner,sun4i-a10-display-frontend";
        reg = <0x01e00000 0x20000>;
        interrupts = <47>;
        clocks = <&ccu CLK_AHB_DE_FE0>, <&ccu CLK_DE_FE0>,
                 <&ccu CLK_DRAM_DE_FE0>;
        clock-names = "ahb", "mod",
                      "ram";
        resets = <&ccu RST_DE_FE0>;

        ports {
            #address-cells = <1>;
            #size-cells = <0>;

            fe0_out: port@1 {
                #address-cells = <1>;
                #size-cells = <0>;
                reg = <1>;

                fe0_out_be0: endpoint@0 {
                    reg = <0>;
                    remote-endpoint = <&be0_in_fe0>;
                };

                fe0_out_be1: endpoint@1 {
                    reg = <1>;
                    remote-endpoint = <&be1_in_fe0>;
                };
            };
        };
    };
```

## Documentation/devicetree/bindings/display/allwinner,sun4i-a10-hdmi_cn.yaml
```yaml
# SPDX-许可证标识符: GPL-2.0
%YAML 1.2
---
$id: http://devicetree.org/schemas/display/allwinner,sun4i-a10-hdmi.yaml#
$schema: http://devicetree.org/meta-schemas/core.yaml#

标题: Allwinner A10 HDMI 控制器

描述: |
  HDMI 编码器支持 HDMI 视频和音频输出，并且实现了 CEC。它是管道的一端。
维护者:
  - 陈宇蔡 <wens@csie.org>
  - 马克西姆·里帕德 <mripard@kernel.org>

属性:
  compatible:
    oneOf:
      - const: allwinner,sun4i-a10-hdmi
      - const: allwinner,sun5i-a10s-hdmi
      - const: allwinner,sun6i-a31-hdmi
      - items:
          - const: allwinner,sun7i-a20-hdmi
          - const: allwinner,sun5i-a10s-hdmi

  reg:
    maxItems: 1

  interrupts:
    maxItems: 1

  clocks:
    oneOf:
      - items:
          - description: HDMI 接口时钟
          - description: HDMI 模块时钟
          - description: 第一个视频 PLL
          - description: 第二个视频 PLL

      - items:
          - description: HDMI 接口时钟
          - description: HDMI 模块时钟
          - description: HDMI DDC 时钟
          - description: 第一个视频 PLL
          - description: 第二个视频 PLL

  clock-names:
    oneOf:
      - items:
          - const: ahb
          - const: mod
          - const: pll-0
          - const: pll-1

      - items:
          - const: ahb
          - const: mod
          - const: ddc
          - const: pll-0
          - const: pll-1

  resets:
    maxItems: 1

  dmas:
    items:
      - description: DDC 发送 DMA 通道
      - description: DDC 接收 DMA 通道
      - description: 音频发送 DMA 通道

  dma-names:
    items:
      - const: ddc-tx
      - const: ddc-rx
      - const: audio-tx

  ports:
    $ref: /schemas/graph.yaml#/properties/ports

    属性:
      port@0:
        $ref: /schemas/graph.yaml#/properties/port
        description: |
          控制器的输入端点
      port@1:
        $ref: /schemas/graph.yaml#/properties/port
        description: |
          控制器的输出端点。通常是一个 HDMI 连接器
必需:
      - port@0
      - port@1

必需:
  - compatible
  - reg
  - interrupts
  - clocks
  - clock-names
  - dmas
  - dma-names

如果:
  属性:
    compatible:
      contains:
        const: allwinner,sun6i-a31-hdmi

然后:
  属性:
    clocks:
      minItems: 5

    clock-names:
      minItems: 5

  必需:
    - resets

additionalProperties: false

示例:
  - |
    #include <dt-bindings/clock/sun4i-a10-ccu.h>
    #include <dt-bindings/dma/sun4i-a10.h>
    #include <dt-bindings/reset/sun4i-a10-ccu.h>

    hdmi: hdmi@1c16000 {
        compatible = "allwinner,sun4i-a10-hdmi";
        reg = <0x01c16000 0x1000>;
        interrupts = <58>;
        clocks = <&ccu CLK_AHB_HDMI0>, <&ccu CLK_HDMI>,
                 <&ccu CLK_PLL_VIDEO0_2X>,
                 <&ccu CLK_PLL_VIDEO1_2X>;
        clock-names = "ahb", "mod", "pll-0", "pll-1";
        dmas = <&dma SUN4I_DMA_NORMAL 16>,
               <&dma SUN4I_DMA_NORMAL 16>,
               <&dma SUN4I_DMA_DEDICATED 24>;
        dma-names = "ddc-tx", "ddc-rx", "audio-tx";

        ports {
            #address-cells = <1>;
            #size-cells = <0>;

            hdmi_in: port@0 {
                #address-cells = <1>;
                #size-cells = <0>;
                reg = <0>;

                hdmi_in_tcon0: endpoint@0 {
                    reg = <0>;
                    remote-endpoint = <&tcon0_out_hdmi>;
                };

                hdmi_in_tcon1: endpoint@1 {
                    reg = <1>;
                    remote-endpoint = <&tcon1_out_hdmi>;
                };
            };

            hdmi_out: port@1 {
                reg = <1>;
            };
        };
    };

..
```
