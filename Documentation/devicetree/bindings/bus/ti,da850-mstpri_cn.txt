## Documentation/devicetree/bindings/bus/ti,da850-mstpri_cn.txt
~~~~
针对德州仪器 (Texas Instruments) DA8xx 主外设优先级驱动的设备树绑定

DA8XX 系统芯片（SoC）具有一组寄存器，可以用来改变被分类为主设备的所有外设的优先级。

文档：
OMAP-L138 (DA850) - http://www.ti.com/lit/ug/spruh82c/spruh82c.pdf

必需的属性：

- compatible:         "ti,da850-mstpri" —— 对于基于 da850 的板子
- reg:                DA850 主外设优先级寄存器的偏移和长度

下面展示了 da850-lcdk 的示例：
``` 
mstpri {
    compatible = "ti,da850-mstpri";
    reg = <0x14110 0x0c>;
};
```
~~~~

## Documentation/devicetree/bindings/bus/ti-sysc_cn.yaml
```yaml
# SPDX-许可证标识符: (GPL-2.0-only 或 BSD-2-Clause)
%YAML 1.2
---
$id: http://devicetree.org/schemas/bus/ti-sysc.yaml#
$schema: http://devicetree.org/meta-schemas/core.yaml#

标题: 德州仪器互联目标模块

维护者:
  - Tony Lindgren <tony@atomide.com>

描述:
  德州仪器的SoC可以有一个通用的互联目标模块，用于连接到各种互联上（例如使用Arteris NoC的L3互联和使用Sonics s3220的L4互联）。此模块主要用于与电源、复位和时钟管理器PRCM进行交互。它参与了OCP断开协议，除此之外，它在很大程度上独立于具体的互联。每个互联目标模块可以有一个或多个设备连接到它。有一组控制寄存器用于管理互联目标模块的时钟、空闲模式和互联级别的复位。
  互联目标模块的控制寄存器散布在由该互联目标模块管理的第一个子设备IP块未使用的寄存器地址空间中。通常这些寄存器的名字是REVISION、SYSCONFIG 和 SYSSTATUS。

属性:
  $nodename:
    模式: "^target-module(@[0-9a-f]+)?$"

  compatible:
    oneOf:
      - items:
          - 枚举:
              - ti,sysc-omap2
              - ti,sysc-omap4
              - ti,sysc-omap4-simple
              - ti,sysc-omap2-timer
              - ti,sysc-omap4-timer
              - ti,sysc-omap3430-sr
              - ti,sysc-omap3630-sr
              - ti,sysc-omap4-sr
              - ti,sysc-omap3-sham
              - ti,sysc-omap-aes
              - ti,sysc-mcasp
              - ti,sysc-dra7-mcasp
              - ti,sysc-usb-host-fs
              - ti,sysc-dra7-mcan
              - ti,sysc-pruss
          - 常量: ti,sysc
      - items:
          - 常量: ti,sysc

  reg:
    描述:
      互联目标模块的控制寄存器，包括 REVISION、SYSCONFIG 和 SYSSTATUS 寄存器，如 SoC 的技术参考手册中所定义。
minItems: 1
    maxItems: 3

  reg-names:
    描述:
      互联目标模块的控制寄存器名称，包括 "rev"、"sysc" 和 "syss"
oneOf:
      - minItems: 1
        items:
          - 常量: rev
          - 常量: sysc
          - 常量: syss
      - items:
          - 常量: rev
          - 常量: syss
      - 枚举: [ sysc, syss ]

  power-domains:
    描述: 如果可用，则为目标模块提供电源域
maxItems: 1

  clocks:
    描述:
      目标模块的时钟，包括一个功能时钟、一个接口时钟以及最多8个模块特定的可选时钟。某些模块可能只有功能时钟，而有些则没有可配置的时钟。
minItems: 1
    maxItems: 4

  clock-names:
    描述:
      如果时钟是可配置的，则为目标模块提供时钟名称，例如 "fck"、"ick"、"optck1"、"optck2"。
oneOf:
      - 枚举: [ ick, fck, sys_clk ]
      - items:
          - 常量: fck
          - 枚举: [ ick, dbclk, osc, sys_clk, dss_clk, ahclkx ]
      - items:
          - 常量: fck
          - 常量: phy-clk
          - 常量: phy-clk-div
      - items:
          - 常量: fck
          - 常量: hdmi_clk
          - 常量: sys_clk
          - 常量: tv_clk
      - items:
          - 常量: fck
          - 常量: ahclkx
          - 常量: ahclkr

  resets:
    描述:
      如果为模块连线的话，则为RSTCTRL寄存器中的目标模块复位位。
请注意，其他的复位位应该被映射以供子设备驱动程序使用。
- maxItems: 1

  reset-names:
    描述:
      目标模块在RSTCTRL寄存器中的复位名称，通常命名为"rstctrl"如果只有一个复位位与该模块相连。
    items:
      - 常量: rstctrl

  '#address-cells':
    枚举: [1, 2]

  '#size-cells':
    枚举: [1, 2]

  ranges: 真

  dma-ranges: 真

  ti,sysc-mask:
    描述: SYSCONFIG寄存器中支持的寄存器位的掩码
    $ref: /schemas/types.yaml#/definitions/uint32

  ti,sysc-midle:
    描述: 列表包含硬件支持的空闲模式
    $ref: /schemas/types.yaml#/definitions/uint32-array

  ti,sysc-sidle:
    描述: 列表包含硬件支持的空闲模式
    $ref: /schemas/types.yaml#/definitions/uint32-array

  ti,syss-mask:
    描述: SYSSTATUS寄存器中支持的寄存器位的掩码
    $ref: /schemas/types.yaml#/definitions/uint32

  ti,sysc-delay-us:
    描述: 在访问SYSCONFIG之前，在OCP软复位后所需的延迟
    默认: 0
    最小值: 0
    最大值: 2

  ti,no-reset-on-init:
    描述: 初始化时不应复位互连目标模块
    类型: 布尔值

  ti,no-idle-on-init:
    描述: 初始化时不应使互连目标模块进入空闲状态
    类型: 布尔值

  ti,no-idle:
    描述: 不应使互连目标模块进入空闲状态
    类型: 布尔值

  ti,hwmods:
    描述: 使用遗留hwmod数据时的互连模块名称
    $ref: /schemas/types.yaml#/definitions/string
    过时: 真

必需字段:
  - 兼容性
  - '#address-cells'
  - '#size-cells'
  - ranges

附加属性:
  类型: 对象

示例:
  - |
    #include <dt-bindings/bus/ti-sysc.h>
    #include <dt-bindings/clock/omap4.h>

    target-module@2b000 {
        compatible = "ti,sysc-omap2", "ti,sysc";
        ti,hwmods = "usb_otg_hs";
        reg = <0x2b400 0x4>,
              <0x2b404 0x4>,
              <0x2b408 0x4>;
        reg-names = "rev", "sysc", "syss";
        clocks = <&l3_init_clkctrl OMAP4_USB_OTG_HS_CLKCTRL 0>;
        clock-names = "fck";
        ti,sysc-mask = <(SYSC_OMAP2_ENAWAKEUP |
                         SYSC_OMAP2_SOFTRESET |
                         SYSC_OMAP2_AUTOIDLE)>;
        ti,sysc-midle = <SYSC_IDLE_FORCE>,
                        <SYSC_IDLE_NO>,
                        <SYSC_IDLE_SMART>;
        ti,sysc-sidle = <SYSC_IDLE_FORCE>,
                        <SYSC_IDLE_NO>,
                        <SYSC_IDLE_SMART>,
                        <SYSC_IDLE_SMART_WKUP>;
        ti,syss-mask = <1>;
        #address-cells = <1>;
        #size-cells = <1>;
        ranges = <0 0x2b000 0x1000>;
    };
```

## Documentation/devicetree/bindings/bus/ts-nbus_cn.txt
~~~~
### 技术系统公司 NBUS

NBUS 是一种总线，用于与技术系统公司 FPGA 上的外围设备进行接口，在 TS-4600 系统级模块 (SoM) 中使用。
必需属性：
- `compatible`：必须为 `"technologic,ts-nbus"`
- `#address-cells`：必须为 1
- `#size-cells`：必须为 0
- `pwms`：绑定到 FPGA 的 PWM
- `ts,data-gpios`：连接到 FPGA 数据线上的 8 个 GPIO 引脚
- `ts,csn-gpios`：连接到 FPGA CSN 线路上的 GPIO 引脚
- `ts,txrx-gpios`：连接到 FPGA TXRX 线路上的 GPIO 引脚
- `ts,strobe-gpios`：连接到 FPGA STROBE 线路上的 GPIO 引脚
- `ts,ale-gpios`：连接到 FPGA ALE 线路上的 GPIO 引脚
- `ts,rdy-gpios`：连接到 FPGA RDY 线路上的 GPIO 引脚

#### 子节点

NBUS 节点可以包含零个或多个表示总线上外围设备的子节点。
示例：

```yaml
nbus {
    compatible = "technologic,ts-nbus";
    pinctrl-0 = <&nbus_pins>;
    #address-cells = <1>;
    #size-cells = <0>;
    pwms = <&pwm 2 83>;
    ts,data-gpios = <&gpio0 0 GPIO_ACTIVE_HIGH
                     &gpio0 1 GPIO_ACTIVE_HIGH
                     &gpio0 2 GPIO_ACTIVE_HIGH
                     &gpio0 3 GPIO_ACTIVE_HIGH
                     &gpio0 4 GPIO_ACTIVE_HIGH
                     &gpio0 5 GPIO_ACTIVE_HIGH
                     &gpio0 6 GPIO_ACTIVE_HIGH
                     &gpio0 7 GPIO_ACTIVE_HIGH>;
    ts,csn-gpios = <&gpio0 16 GPIO_ACTIVE_HIGH>;
    ts,txrx-gpios = <&gpio0 24 GPIO_ACTIVE_HIGH>;
    ts,strobe-gpios = <&gpio0 25 GPIO_ACTIVE_HIGH>;
    ts,ale-gpios = <&gpio0 26 GPIO_ACTIVE_HIGH>;
    ts,rdy-gpios = <&gpio0 21 GPIO_ACTIVE_HIGH>;

    watchdog@2a {
        compatible = "...";

        /* ... */
    };
};
```
以上示例展示了如何配置一个 NBUS 总线及其相关的 GPIO 和 PWM 控制器，并且包含了一个名为 `watchdog@2a` 的示例子节点。
~~~~

## Documentation/devicetree/bindings/bus/xlnx,versal-net-cdx_cn.yaml
~~~~yaml
```yaml
# SPDX-许可证标识符: (GPL-2.0 或 BSD-2-Clause)
%YAML 1.2
---
$id: http://devicetree.org/schemas/bus/xlnx,versal-net-cdx.yaml#
$schema: http://devicetree.org/meta-schemas/core.yaml#

title: AMD CDX 总线控制器

description: |
  对于 AMD 设备的 CDX 总线控制器实现了动态检测 CDX 总线和使用固件的设备。
  CDX 总线管理多个基于 FPGA 的硬件设备，这些设备可以支持网络、加密或其他任何专业类型的设备。
  这些基于 FPGA 的设备可以在运行时动态添加/修改。
  在 CDX 总线上的所有设备都将有一个唯一的流 ID（用于 IOMMU）和一个唯一设备 ID（用于 MSI），对应于请求者 ID（与设备一对一关联）。
  流 ID 和设备 ID 分别用于配置 SMMU 和 GIC-ITS。
  属性 iommu-map 用于定义每个设备对应的流 ID 集及其关联的 IOMMU。
  MSI 写操作伴随着侧带数据（设备 ID）。
  属性 msi-map 用于将设备与设备 ID 及其关联的 ITS 控制器相关联。
  属性 rproc (xlnx,rproc) 用于标识 APU（应用处理器单元）交互以找出总线和设备配置的远程处理器。
maintainers:
  - Nipun Gupta <nipun.gupta@amd.com>
  - Nikhil Agarwal <nikhil.agarwal@amd.com>

properties:
  compatible:
    const: xlnx,versal-net-cdx

  iommu-map: true

  msi-map: true

  xlnx,rproc:
    $ref: /schemas/types.yaml#/definitions/phandle
    description:
      通过该属性指明 APU 与远程处理器交互的 remoteproc_r5 rproc 节点的 phandle
ranges: true

  "#address-cells":
    enum: [1, 2]

  "#size-cells":
    enum: [1, 2]

required:
  - compatible
  - iommu-map
  - msi-map
  - xlnx,rproc
  - ranges
  - "#address-cells"
  - "#size-cells"

additionalProperties: false

examples:
  - |
    cdx {
        compatible = "xlnx,versal-net-cdx";
        #address-cells = <1>;
        #size-cells = <1>;
        /* 定义 RIDs 250-259 的映射 */
        iommu-map = <250 &smmu 250 10>;
        /* 定义 RIDs 250-259 的 msi 映射 */
        msi-map = <250 &its 250 10>;
        xlnx,rproc = <&remoteproc_r5>;
        ranges;
    };
```
```
~~~~

## Documentation/devicetree/bindings/devfreq/event/samsung,exynos-nocp_cn.yaml
```yaml
# SPDX-许可证标识符: GPL-2.0
%YAML 1.2
---
$id: http://devicetree.org/schemas/devfreq/event/samsung,exynos-nocp.yaml#
$schema: http://devicetree.org/meta-schemas/core.yaml#

标题: Samsung Exynos NoC (片上网络) 探测器

维护者:
  - Chanwoo Choi <cw00.choi@samsung.com>
  - Krzysztof Kozlowski <krzk@kernel.org>

描述: |
  Samsung Exynos542x 系统芯片具有一个 NoC (片上网络) 探测器用于 NoC 总线。
NoC 提供了获取性能数据的基本值。片上网络 (NoC) 探测器检测到的数据包通过网络基础设施传输到观察单元。您可以配置探测器来捕获带有头部或数据的请求响应网络上的数据包，或者作为流量调试或统计收集器。Exynos542x 总线有多个 NoC 探测器提供关于系统行为的带宽信息，这些信息可以在分析系统性能时使用。

属性:
  compatible:
    常量: samsung,exynos5420-nocp

  clock-names:
    项目:
      - 常量: nocp

  clocks:
    最大项数: 1

  reg:
    最大项数: 1

必需:
  - compatible
  - reg

附加属性: false

示例:
  - |
    nocp_mem0_0: nocp@10ca1000 {
        compatible = "samsung,exynos5420-nocp";
        reg = <0x10ca1000 0x200>;
    };
```

## Documentation/devicetree/bindings/devfreq/event/samsung,exynos-ppmu_cn.yaml
```yaml
# SPDX-许可证标识符: GPL-2.0
%YAML 1.2
---
$id: http://devicetree.org/schemas/devfreq/event/samsung,exynos-ppmu.yaml#
$schema: http://devicetree.org/meta-schemas/core.yaml#

标题: Samsung Exynos SoC PPMU (平台性能监控单元)

维护者:
  - Chanwoo Choi <cw00.choi@samsung.com>
  - Krzysztof Kozlowski <krzk@kernel.org>

描述: |
  Samsung Exynos SoC 包含针对每个 IP 的 PPMU（平台性能监控单元）。PPMU 提供了获取性能数据的基础值。这些 PPMU 事件提供了有关 SoC 行为的信息，可以用来分析系统性能、使行为可视化以及统计各 IP（DMC、CPU、RIGHTBUS、LEFTBUS、CAM 接口、LCD、G3D、MFC）的使用情况。Exynos PPMU 驱动程序使用 devfreq-event 类来向各种 devfreq 设备提供事件数据。devfreq 设备在确定每个 IP 的当前状态时会使用这些事件数据。
属性:
  compatible:
    枚举:
      - samsung,exynos-ppmu
      - samsung,exynos-ppmu-v2

  clock-names:
    项:
      - 常量: ppmu

  clocks:
    最大项数: 1

  reg:
    最大项数: 1

  events:
    类型: 对象

    模式属性:
      '^ppmu-event[0-9]+(-[a-z0-9]+){,2}$':
        类型: 对象
        属性:
          event-name:
            描述: |
              在 PPMU 设备中的唯一事件名称
            $ref: /schemas/types.yaml#/definitions/string

          event-data-type:
            描述: |
              定义计数器将计数的数据类型
              可以检查 include/dt-bindings/pmu/exynos_ppmu.h 中的所有
              可能类型，例如计数读请求、按字节计数写入数据等。此字段是可选的，并且当它缺失时，驱动程序代码将使用默认数据类型
            $ref: /schemas/types.yaml#/definitions/uint32

        必需:
          - event-name

        不允许额外属性: false

    不允许额外属性: false

必需:
  - compatible
  - reg

不允许额外属性: false

示例:
  - |
    // Exynos3250 的 PPMUv1 节点（尽管板级 DTS 定义了事件）
    #include <dt-bindings/clock/exynos3250.h>

    ppmu_dmc0: ppmu@106a0000 {
        compatible = "samsung,exynos-ppmu";
        reg = <0x106a0000 0x2000>;

        events {
            ppmu_dmc0_3: ppmu-event3-dmc0 {
                event-name = "ppmu-event3-dmc0";
            };

            ppmu_dmc0_2: ppmu-event2-dmc0 {
                event-name = "ppmu-event2-dmc0";
            };

            ppmu_dmc0_1: ppmu-event1-dmc0 {
                event-name = "ppmu-event1-dmc0";
            };

            ppmu_dmc0_0: ppmu-event0-dmc0 {
                event-name = "ppmu-event0-dmc0";
            };
        };
    };

    ppmu_rightbus: ppmu@112a0000 {
        compatible = "samsung,exynos-ppmu";
        reg = <0x112a0000 0x2000>;
        clocks = <&cmu CLK_PPMURIGHT>;
        clock-names = "ppmu";

        events {
            ppmu_rightbus_3: ppmu-event3-rightbus {
                event-name = "ppmu-event3-rightbus";
            };
        };
    };

  - |
    // Exynos5433 中的 PPMUv2 节点
    ppmu_d0_cpu: ppmu@10480000 {
        compatible = "samsung,exynos-ppmu-v2";
        reg = <0x10480000 0x2000>;
    };

    ppmu_d0_general: ppmu@10490000 {
        compatible = "samsung,exynos-ppmu-v2";
        reg = <0x10490000 0x2000>;

        events {
            ppmu_event0_d0_general: ppmu-event0-d0-general {
                event-name = "ppmu-event0-d0-general";
            };
        };
    };

    ppmu_d0_rt: ppmu@104a0000 {
        compatible = "samsung,exynos-ppmu-v2";
        reg = <0x104a0000 0x2000>;
    };

    ppmu_d1_cpu: ppmu@104b0000 {
        compatible = "samsung,exynos-ppmu-v2";
        reg = <0x104b0000 0x2000>;
    };

    ppmu_d1_general: ppmu@104c0000 {
        compatible = "samsung,exynos-ppmu-v2";
        reg = <0x104c0000 0x2000>;
    };

    ppmu_d1_rt: ppmu@104d0000 {
        compatible = "samsung,exynos-ppmu-v2";
        reg = <0x104d0000 0x2000>;
    };

  - |
    // Exynos4412 的带 event-data-type 的 PPMUv1 节点
    #include <dt-bindings/pmu/exynos_ppmu.h>

    ppmu@106a0000 {
        compatible = "samsung,exynos-ppmu";
        reg = <0x106a0000 0x2000>;
        clocks = <&clock 400>;
        clock-names = "ppmu";

        events {
            ppmu-event3-dmc0 {
                event-name = "ppmu-event3-dmc0";
                event-data-type = <(PPMU_RO_DATA_CNT |
                                    PPMU_WO_DATA_CNT)>;
            };
        };
    };
```

## Documentation/devicetree/bindings/devfreq/nvidia,tegra30-actmon_cn.yaml
~~~~yaml
下面是给定内容的中文翻译：

```yaml
# SPDX-文件许可标识符: (GPL-2.0-only 或 BSD-2-Clause)
%YAML 1.2
---
$id: http://devicetree.org/schemas/devfreq/nvidia,tegra30-actmon.yaml#
$schema: http://devicetree.org/meta-schemas/core.yaml#

标题: NVIDIA Tegra30 活动监控器

维护者:
  - Dmitry Osipenko <digetx@gmail.com>
  - Jon Hunter <jonathanh@nvidia.com>
  - Thierry Reding <thierry.reding@gmail.com>

描述: |
  活动监控器模块收集系统中其他组件的行为统计信息。这些信息可用于确定外部内存需要以何种频率时钟运行，以便满足所有受监控客户端的请求。

属性:
  compatible:
    枚举:
      - nvidia,tegra30-actmon
      - nvidia,tegra114-actmon
      - nvidia,tegra124-actmon
      - nvidia,tegra210-actmon

  reg:
    最大项目数: 1

  clocks:
    最大项目数: 2

  clock-names:
    项目:
      - 常量: actmon
      - 常量: emc

  resets:
    最大项目数: 1

  reset-names:
    项目:
      - 常量: actmon

  interrupts:
    最大项目数: 1

  interconnects:
    最小项目数: 1
    最大项目数: 12

  interconnect-names:
    最小项目数: 1
    最大项目数: 12
    描述:
      应包含每个互联条目的互联路径名称。有关可用内存客户端的信息，请参阅TRM文档中的“MEMORY CONTROLLER”和“ACTIVITY MONITOR”部分。
operating-points-v2:
    描述:
      应包含频率和电压以及 opp-supported-hw 属性，该属性是一个位字段，指示SoC速度计ID掩码。
"#cooling-cells":
    常量: 2

必需:
  - compatible
  - reg
  - clocks
  - clock-names
  - resets
  - reset-names
  - interrupts
  - interconnects
  - interconnect-names
  - operating-points-v2
  - "#cooling-cells"

附加属性: false

示例:
  - |
    #include <dt-bindings/memory/tegra30-mc.h>

    mc: memory-controller@7000f000 {
        compatible = "nvidia,tegra30-mc";
        reg = <0x7000f000 0x400>;
        clocks = <&clk 32>;
        clock-names = "mc";

        interrupts = <0 77 4>;

        #iommu-cells = <1>;
        #reset-cells = <1>;
        #interconnect-cells = <1>;
    };

    emc: external-memory-controller@7000f400 {
        compatible = "nvidia,tegra30-emc";
        reg = <0x7000f400 0x400>;
        interrupts = <0 78 4>;
        clocks = <&clk 57>;

        nvidia,memory-controller = <&mc>;
        operating-points-v2 = <&dvfs_opp_table>;
        power-domains = <&domain>;

        #interconnect-cells = <0>;
    };

    actmon@6000c800 {
        compatible = "nvidia,tegra30-actmon";
        reg = <0x6000c800 0x400>;
        interrupts = <0 45 4>;
        clocks = <&clk 119>, <&clk 57>;
        clock-names = "actmon", "emc";
        resets = <&rst 119>;
        reset-names = "actmon";
        operating-points-v2 = <&dvfs_opp_table>;
        interconnects = <&mc TEGRA30_MC_MPCORER &emc>;
        interconnect-names = "cpu-read";
        #cooling-cells = <2>;
    };
```
```
~~~~
