## Documentation/devicetree/bindings/display/allwinner,sun4i-a10-tv-encoder_cn.yaml
```yaml
# SPDX-许可证标识符: GPL-2.0
%YAML 1.2
---
$id: http://devicetree.org/schemas/display/allwinner,sun4i-a10-tv-encoder.yaml#
$schema: http://devicetree.org/meta-schemas/core.yaml#

标题: Allwinner A10 电视编码器

维护者:
  - 陈宇蔡 <wens@csie.org>
  - 马克西姆·里帕德 <mripard@kernel.org>

属性:
  compatible:
    常量: allwinner,sun4i-a10-tv-encoder

  reg:
    最大项目数: 1

  clocks:
    最大项目数: 1

  resets:
    最大项目数: 1

  port:
    $ref: /schemas/graph.yaml#/properties/port
    描述:
      第一个端口应为输入端点，通常来自关联的TCON

必需:
  - compatible
  - reg
  - clocks
  - resets
  - port

额外属性: false

示例:
  - |
    tve0: tv-encoder@1c0a000 {
        compatible = "allwinner,sun4i-a10-tv-encoder";
        reg = <0x01c0a000 0x1000>;
        clocks = <&ahb_gates 34>;
        resets = <&tcon_ch0_clk 0>;

        port {
            tve0_in_tcon0: 端点 {
                remote-endpoint = <&tcon0_out_tve0>;
            };
        };
    };

..
```

## Documentation/devicetree/bindings/display/allwinner,sun6i-a31-drc_cn.yaml
```yaml
# SPDX-许可证标识符: GPL-2.0
%YAML 1.2
---
$id: http://devicetree.org/schemas/display/allwinner,sun6i-a31-drc.yaml#
$schema: http://devicetree.org/meta-schemas/core.yaml#

标题: Allwinner A31 动态范围控制器

维护者:
  - 陈宇蔡 <wens@csie.org>
  - 马克西姆·里帕德 <mripard@kernel.org>

描述: |
  动态范围控制器(DRC)允许根据LCD内容自适应背光控制的直方图测量动态调整
  像素的亮度/对比度。

属性:
  compatible:
    枚举:
      - allwinner,sun6i-a31-drc
      - allwinner,sun6i-a31s-drc
      - allwinner,sun8i-a23-drc
      - allwinner,sun8i-a33-drc
      - allwinner,sun9i-a80-drc

  reg:
    最大项数: 1

  interrupts:
    最大项数: 1

  clocks:
    项:
      - 描述: DRC接口时钟
      - 描述: DRC模块时钟
      - 描述: DRC DRAM时钟

  clock-names:
    项:
      - 常量: ahb
      - 常量: mod
      - 常量: ram

  resets:
    最大项数: 1

  ports:
    $ref: /schemas/graph.yaml#/properties/ports

    属性:
      port@0:
        $ref: /schemas/graph.yaml#/properties/port
        描述: |
          控制器的输入端点。
      port@1:
        $ref: /schemas/graph.yaml#/properties/port
        描述: |
          控制器的输出端点。
必需:
  - port@0
  - port@1

必需:
  - compatible
  - reg
  - interrupts
  - clocks
  - clock-names
  - resets
  - ports

额外属性: false

示例:
  - |
    #include <dt-bindings/interrupt-controller/arm-gic.h>

    #include <dt-bindings/clock/sun6i-a31-ccu.h>
    #include <dt-bindings/reset/sun6i-a31-ccu.h>

    drc0: drc@1e70000 {
        compatible = "allwinner,sun6i-a31-drc";
        reg = <0x01e70000 0x10000>;
        interrupts = <GIC_SPI 91 IRQ_TYPE_LEVEL_HIGH>;
        clocks = <&ccu CLK_AHB1_DRC0>, <&ccu CLK_IEP_DRC0>,
                 <&ccu CLK_DRAM_DRC0>;
        clock-names = "ahb", "mod",
                      "ram";
        resets = <&ccu RST_AHB1_DRC0>;

        ports {
            #address-cells = <1>;
            #size-cells = <0>;

            drc0_in: port@0 {
                reg = <0>;

                drc0_in_be0: endpoint {
                    remote-endpoint = <&be0_out_drc0>;
                };
            };

            drc0_out: port@1 {
                #address-cells = <1>;
                #size-cells = <0>;
                reg = <1>;

                drc0_out_tcon0: endpoint@0 {
                    reg = <0>;
                    remote-endpoint = <&tcon0_in_drc0>;
                };

                drc0_out_tcon1: endpoint@1 {
                    reg = <1>;
                    remote-endpoint = <&tcon1_in_drc0>;
                };
            };
        };
    };
```

## Documentation/devicetree/bindings/display/allwinner,sun6i-a31-mipi-dsi_cn.yaml
```yaml
# SPDX-许可证标识符: GPL-2.0
%YAML 1.2
---
$id: http://devicetree.org/schemas/display/allwinner,sun6i-a31-mipi-dsi.yaml#
$schema: http://devicetree.org/meta-schemas/core.yaml#

标题: Allwinner A31 MIPI-DSI 控制器

维护者:
  - 陈宇蔡 <wens@csie.org>
  - 马克西姆·里帕德 <mripard@kernel.org>

属性:
  compatible:
    oneOf:
      - 枚举:
          - allwinner,sun6i-a31-mipi-dsi
          - allwinner,sun50i-a64-mipi-dsi
          - allwinner,sun50i-a100-mipi-dsi
      - items:
          - 常量: allwinner,sun20i-d1-mipi-dsi
          - 常量: allwinner,sun50i-a100-mipi-dsi

  reg:
    最大项数: 1

  interrupts:
    最大项数: 1

  clocks:
    最小项数: 1
    items:
      - 描述: 总线时钟
      - 描述: 模块时钟

  clock-names:
    items:
      - 常量: bus
      - 常量: mod

  resets:
    最大项数: 1

  vcc-dsi-supply:
    描述: DSI 编码器的 VCC-DSI 电源供应

  phys:
    最大项数: 1

  phy-names:
    常量: dphy

  port:
    $ref: /schemas/graph.yaml#/properties/port
    描述:
      端口应该是输入端点，通常来自关联的 TCON。

必需:
  - compatible
  - reg
  - interrupts
  - clocks
  - phys
  - phy-names
  - resets
  - port

全部:
  - $ref: dsi-controller.yaml#
  - 如果:
      属性:
        compatible:
          包含:
            枚举:
              - allwinner,sun6i-a31-mipi-dsi
              - allwinner,sun50i-a100-mipi-dsi

    那么:
      属性:
        clocks:
          最小项数: 2

      必需:
        - clock-names

    否则:
      属性:
        clocks:
          最大项数: 1

  - 如果:
      属性:
        compatible:
          包含:
            枚举:
              - allwinner,sun6i-a31-mipi-dsi
              - allwinner,sun50i-a64-mipi-dsi

    那么:
      必需:
        - vcc-dsi-supply

未评估属性: false

示例:
  - |
    dsi0: dsi@1ca0000 {
        compatible = "allwinner,sun6i-a31-mipi-dsi";
        reg = <0x01ca0000 0x1000>;
        interrupts = <0 89 4>;
        clocks = <&ccu 23>, <&ccu 96>;
        clock-names = "bus", "mod";
        resets = <&ccu 4>;
        phys = <&dphy0>;
        phy-names = "dphy";
        vcc-dsi-supply = <&reg_dcdc1>;
        #address-cells = <1>;
        #size-cells = <0>;

        panel@0 {
                compatible = "bananapi,lhr050h41", "ilitek,ili9881c";
                reg = <0>;
                power-supply = <&reg_display>;
                reset-gpios = <&r_pio 0 5 1>; /* PL05 */
                backlight = <&pwm_bl>;
        };

        port {
            dsi0_in_tcon0: endpoint {
                remote-endpoint = <&tcon0_out_dsi0>;
            };
        };
    };
```

## Documentation/devicetree/bindings/display/allwinner,sun8i-a83t-de2-mixer_cn.yaml
```yaml
# SPDX-许可证标识符: GPL-2.0
%YAML 1.2
---
$id: http://devicetree.org/schemas/display/allwinner,sun8i-a83t-de2-mixer.yaml#
$schema: http://devicetree.org/meta-schemas/core.yaml#

标题: Allwinner 显示引擎 2.0 混合器

维护者:
  - 陈宇 蔡 <wens@csie.org>
  - 马克西姆·里帕德 <mripard@kernel.org>

属性:
  compatible:
    枚举:
      - allwinner,sun8i-a83t-de2-mixer-0
      - allwinner,sun8i-a83t-de2-mixer-1
      - allwinner,sun8i-h3-de2-mixer-0
      - allwinner,sun8i-r40-de2-mixer-0
      - allwinner,sun8i-r40-de2-mixer-1
      - allwinner,sun8i-v3s-de2-mixer
      - allwinner,sun20i-d1-de2-mixer-0
      - allwinner,sun20i-d1-de2-mixer-1
      - allwinner,sun50i-a64-de2-mixer-0
      - allwinner,sun50i-a64-de2-mixer-1
      - allwinner,sun50i-h6-de3-mixer-0

  reg:
    最大项数: 1

  clocks:
    项:
      - 描述: 混合器接口时钟
      - 描述: 混合器模块时钟

  clock-names:
    项:
      - 常量: bus
      - 常量: mod

  iommus:
    最大项数: 1

  resets:
    最大项数: 1

  ports:
    $ref: /schemas/graph.yaml#/properties/ports

    属性:
      port@0:
        $ref: /schemas/graph.yaml#/properties/port
        描述: |
          控制器的输入端点
      port@1:
        $ref: /schemas/graph.yaml#/properties/port
        描述: |
          控制器的输出端点
必需:
      - port@1

必需:
  - compatible
  - reg
  - clocks
  - clock-names
  - resets
  - ports

额外属性: false

示例:
  - |
    #include <dt-bindings/clock/sun8i-de2.h>
    #include <dt-bindings/reset/sun8i-de2.h>

    mixer0: mixer@1100000 {
        compatible = "allwinner,sun8i-a83t-de2-mixer-0";
        reg = <0x01100000 0x100000>;
        clocks = <&display_clocks CLK_BUS_MIXER0>,
                 <&display_clocks CLK_MIXER0>;
        clock-names = "bus",
                      "mod";
        resets = <&display_clocks RST_MIXER0>;

        ports {
            #address-cells = <1>;
            #size-cells = <0>;

            mixer0_out: port@1 {
                #address-cells = <1>;
                #size-cells = <0>;
                reg = <1>;

                mixer0_out_tcon0: endpoint@0 {
                    reg = <0>;
                    remote-endpoint = <&tcon0_in_mixer0>;
                };

                mixer0_out_tcon1: endpoint@1 {
                    reg = <1>;
                    remote-endpoint = <&tcon1_in_mixer0>;
                };
            };
        };
    };
```

## Documentation/devicetree/bindings/display/allwinner,sun8i-a83t-dw-hdmi_cn.yaml
~~~~yaml
以下是提供的 YAML 文件的中文翻译：

```yaml
# SPDX 许可证标识符: GPL-2.0
%YAML 1.2
---
$id: http://devicetree.org/schemas/display/allwinner,sun8i-a83t-dw-hdmi.yaml#
$schema: http://devicetree.org/meta-schemas/core.yaml#

title: Allwinner A83t DWC HDMI 发送器编码器

description: |
  HDMI 发送器是一个 Synopsys DesignWare HDMI 1.4 TX 控制器
  IP，结合了 Allwinner 自有的 PHY IP。它支持音频和视频输出
  以及 CEC 功能。
这些设备树绑定遵循在 bridge/synopsys,dw-hdmi.yaml 中定义的
  Synopsys DWC HDMI TX 绑定，并包含以下特定于设备的属性。
maintainers:
  - 陈宇 蔡 <wens@csie.org>
  - 马克西姆·里帕德 <mripard@kernel.org>

properties:
  "#phy-cells":
    const: 0

  compatible:
    oneOf:
      - const: allwinner,sun8i-a83t-dw-hdmi
      - const: allwinner,sun50i-h6-dw-hdmi

      - items:
          - enum:
              - allwinner,sun8i-h3-dw-hdmi
              - allwinner,sun8i-r40-dw-hdmi
              - allwinner,sun50i-a64-dw-hdmi
          - const: allwinner,sun8i-a83t-dw-hdmi

  reg:
    maxItems: 1

  reg-io-width:
    const: 1

  interrupts:
    maxItems: 1

  clocks:
    minItems: 3
    items:
      - description: 总线时钟
      - description: 寄存器时钟
      - description: TMDS 时钟
      - description: HDMI CEC 时钟
      - description: HDCP 时钟
      - description: HDCP 总线时钟

  clock-names:
    minItems: 3
    items:
      - const: iahb
      - const: isfr
      - const: tmds
      - const: cec
      - const: hdcp
      - const: hdcp-bus

  resets:
    minItems: 1
    items:
      - description: HDMI 控制器复位
      - description: HDCP 复位

  reset-names:
    minItems: 1
    items:
      - const: ctrl
      - const: hdcp

  phys:
    maxItems: 1
    description:
      DWC HDMI PHY 的物理句柄
phy-names:
    const: phy

  hvcc-supply:
    description:
      控制器的 VCC 电源供应

  ports:
    $ref: /schemas/graph.yaml#/properties/ports

    properties:
      port@0:
        $ref: /schemas/graph.yaml#/properties/port
        description: |
          控制器的输入端点。通常与
          相关联的 TCON
port@1:
        $ref: /schemas/graph.yaml#/properties/port
        description: |
          控制器的输出端点。通常是一个 HDMI
          连接器
required:
      - port@0
      - port@1

required:
  - compatible
  - reg
  - reg-io-width
  - interrupts
  - clocks
  - clock-names
  - resets
  - reset-names
  - phys
  - phy-names
  - ports

if:
  properties:
    compatible:
      contains:
        enum:
          - allwinner,sun50i-h6-dw-hdmi

then:
  properties:
    clocks:
      minItems: 6

    clock-names:
      minItems: 6

    resets:
      minItems: 2

    reset-names:
      minItems: 2


additionalProperties: false

examples:
  - |
    #include <dt-bindings/interrupt-controller/arm-gic.h>

    /*
     * 这些来自 clock/sun8i-a83t-ccu.h 和
     * reset/sun8i-a83t-ccu.h 头文件，但是我们不能直接包含它们，因为
     * 它们会触发大量警告，因为与其它示例中的符号重复定义问题
*/
    #define CLK_BUS_HDMI	39
    #define CLK_HDMI		93
    #define CLK_HDMI_SLOW	94
    #define RST_BUS_HDMI1	26

    hdmi@1ee0000 {
        compatible = "allwinner,sun8i-a83t-dw-hdmi";
        reg = <0x01ee0000 0x10000>;
        reg-io-width = <1>;
        interrupts = <GIC_SPI 88 IRQ_TYPE_LEVEL_HIGH>;
        clocks = <&ccu CLK_BUS_HDMI>, <&ccu CLK_HDMI_SLOW>,
                 <&ccu CLK_HDMI>;
        clock-names = "iahb", "isfr", "tmds";
        resets = <&ccu RST_BUS_HDMI1>;
        reset-names = "ctrl";
        phys = <&hdmi_phy>;
        phy-names = "phy";
        pinctrl-names = "default";
        pinctrl-0 = <&hdmi_pins>;

        ports {
            #address-cells = <1>;
            #size-cells = <0>;

            port@0 {
                reg = <0>;

                endpoint {
                    remote-endpoint = <&tcon1_out_hdmi>;
                };
            };

            port@1 {
                reg = <1>;
            };
        };
    };

    /* 清理 */
    #undef CLK_BUS_HDMI
    #undef CLK_HDMI
    #undef CLK_HDMI_SLOW

  - |
    #include <dt-bindings/interrupt-controller/arm-gic.h>

    /*
     * 这些来自 clock/sun50i-h6-ccu.h 和
     * reset/sun50i-h6-ccu.h 头文件，但是我们不能直接包含它们，因为
     * 它们会触发大量警告，因为与其它示例中的符号重复定义问题
*/
    #define CLK_BUS_HDMI	126
    #define CLK_BUS_HDCP	137
    #define CLK_HDMI		123
    #define CLK_HDMI_SLOW	124
    #define CLK_HDMI_CEC	125
    #define CLK_HDCP		136
    #define RST_BUS_HDMI_SUB	57
    #define RST_BUS_HDCP	62

    hdmi@6000000 {
        compatible = "allwinner,sun50i-h6-dw-hdmi";
        reg = <0x06000000 0x10000>;
        reg-io-width = <1>;
        interrupts = <GIC_SPI 64 IRQ_TYPE_LEVEL_HIGH>;
        clocks = <&ccu CLK_BUS_HDMI>, <&ccu CLK_HDMI_SLOW>,
                 <&ccu CLK_HDMI>, <&ccu CLK_HDMI_CEC>,
                 <&ccu CLK_HDCP>, <&ccu CLK_BUS_HDCP>;
        clock-names = "iahb", "isfr", "tmds", "cec", "hdcp",
                      "hdcp-bus";
        resets = <&ccu RST_BUS_HDMI_SUB>, <&ccu RST_BUS_HDCP>;
        reset-names = "ctrl", "hdcp";
        phys = <&hdmi_phy>;
        phy-names = "phy";
        pinctrl-names = "default";
        pinctrl-0 = <&hdmi_pins>;

        ports {
            #address-cells = <1>;
            #size-cells = <0>;

            port@0 {
                reg = <0>;

                endpoint {
                    remote-endpoint = <&tcon_top_hdmi_out_hdmi>;
                };
            };

            port@1 {
                reg = <1>;
            };
        };
    };
```
请注意，某些注释和代码块的细节可能需要根据实际上下文进行调整以确保准确性。
~~~~
