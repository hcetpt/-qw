## Documentation/devicetree/bindings/display/allwinner,sun4i-a10-tcon_cn.yaml
~~~~yaml
以下是给定内容的中文翻译：

# SPDX-许可证标识符: GPL-2.0
%YAML 1.2
---
$id: http://devicetree.org/schemas/display/allwinner,sun4i-a10-tcon.yaml#
$schema: http://devicetree.org/meta-schemas/core.yaml#

标题: Allwinner A10 时序控制器（TCON）

维护者:
  - 陈宇蔡 <wens@csie.org>
  - 马克斯·里帕德 <mripard@kernel.org>

描述: |
  TCON 作为 RGB、LVDS 和电视接口的时序控制器发挥作用。

属性:
  "#clock-cells":
    常量: 0

  compatible:
    oneOf:
      - 常量: allwinner,sun4i-a10-tcon
      - 常量: allwinner,sun5i-a13-tcon
      - 常量: allwinner,sun6i-a31-tcon
      - 常量: allwinner,sun6i-a31s-tcon
      - 常量: allwinner,sun7i-a20-tcon
      - 常量: allwinner,sun8i-a23-tcon
      - 常量: allwinner,sun8i-a33-tcon
      - 常量: allwinner,sun8i-a83t-tcon-lcd
      - 常量: allwinner,sun8i-a83t-tcon-tv
      - 常量: allwinner,sun8i-r40-tcon-tv
      - 常量: allwinner,sun8i-v3s-tcon
      - 常量: allwinner,sun9i-a80-tcon-lcd
      - 常量: allwinner,sun9i-a80-tcon-tv
      - 常量: allwinner,sun20i-d1-tcon-lcd
      - 常量: allwinner,sun20i-d1-tcon-tv

      - items:
          - 枚举:
              - allwinner,sun7i-a20-tcon0
              - allwinner,sun7i-a20-tcon1
          - 常量: allwinner,sun7i-a20-tcon

      - items:
          - 枚举:
              - allwinner,sun50i-a64-tcon-lcd
          - 常量: allwinner,sun8i-a83t-tcon-lcd

      - items:
          - 枚举:
              - allwinner,sun8i-h3-tcon-tv
              - allwinner,sun50i-a64-tcon-tv
          - 常量: allwinner,sun8i-a83t-tcon-tv

      - items:
          - 枚举:
              - allwinner,sun50i-h6-tcon-tv
          - 常量: allwinner,sun8i-r40-tcon-tv

  reg:
    最大项数: 1

  interrupts:
    最大项数: 1

  clocks:
    最小项数: 1
    最大项数: 4

  clock-names:
    最小项数: 1
    最大项数: 4

  clock-output-names:
    描述:
      创建的LCD像素时钟名称
最大项数: 1

  dmas:
    最大项数: 1

  resets:
    anyOf:
      - items:
          - 描述: TCON 重置线

      - items:
          - 描述: TCON 重置线
          - 描述: TCON LVDS 重置线

      - items:
          - 描述: TCON 重置线
          - 描述: TCON eDP 重置线

      - items:
          - 描述: TCON 重置线
          - 描述: TCON eDP 重置线
          - 描述: TCON LVDS 重置线

  reset-names:
    oneOf:
      - 常量: lcd

      - items:
          - 常量: lcd
          - 常量: lvds

      - items:
          - 常量: lcd
          - 常量: edp

      - items:
          - 常量: lcd
          - 常量: edp
          - 常量: lvds

  ports:
    $ref: /schemas/graph.yaml#/properties/ports

    属性:
      port@0:
        $ref: /schemas/graph.yaml#/properties/port
        描述: |
          控制器的输入端点
port@1:
        $ref: /schemas/graph.yaml#/$defs/port-base
        未评估属性: false
        描述: |
          控制器的输出端点
模式属性:
          "^endpoint(@[0-9])$":
            $ref: /schemas/graph.yaml#/$defs/endpoint-base
            未评估属性: false

            属性:
              allwinner,tcon-channel:
                $ref: /schemas/types.yaml#/definitions/uint32
                描述: |
                  TCON 可以有 1 或 2 个通道，通常第一个通道用于面板接口
                  （RGB、LVDS 等），第二个通道用于需要另一个控制器的输出
                  （电视编码器、HDMI 等）。
如果该属性存在，则指定了与端点相关联的 TCON
                  通道。如果该属性不存在，则使用端点编号作为通道编号
要求:
      - port@0
      - port@1

要求:
  - compatible
  - reg
  - interrupts
  - clocks
  - clock-names
  - resets
  - ports

额外属性: false

allOf:
  - 如果:
      属性:
        compatible:
          包含:
            枚举:
              - allwinner,sun4i-a10-tcon
              - allwinner,sun5i-a13-tcon
              - allwinner,sun7i-a20-tcon

    则:
      属性:
        clocks:
          最小项数: 3

        clock-names:
          items:
            - 常量: ahb
            - 常量: tcon-ch0
            - 常量: tcon-ch1

  - 如果:
      属性:
        compatible:
          包含:
            枚举:
              - allwinner,sun6i-a31-tcon
              - allwinner,sun6i-a31s-tcon

    则:
      属性:
        clocks:
          最小项数: 4

        clock-names:
          items:
            - 常量: ahb
            - 常量: tcon-ch0
            - 常量: tcon-ch1
            - 常量: lvds-alt

  - 如果:
      属性:
        compatible:
          包含:
            枚举:
              - allwinner,sun8i-a23-tcon
              - allwinner,sun8i-a33-tcon

    则:
      属性:
        clocks:
          最小项数: 3

        clock-names:
          items:
            - 常量: ahb
            - 常量: tcon-ch0
            - 常量: lvds-alt

  - 如果:
      属性:
        compatible:
          包含:
            枚举:
              - allwinner,sun8i-a83t-tcon-lcd
              - allwinner,sun8i-v3s-tcon
              - allwinner,sun9i-a80-tcon-lcd
              - allwinner,sun20i-d1-tcon-lcd

    则:
      属性:
        clocks:
          最小项数: 2

        clock-names:
          items:
            - 常量: ahb
            - 常量: tcon-ch0

  - 如果:
      属性:
        compatible:
          包含:
            枚举:
              - allwinner,sun8i-a83t-tcon-tv
              - allwinner,sun8i-r40-tcon-tv
              - allwinner,sun9i-a80-tcon-tv
              - allwinner,sun20i-d1-tcon-tv

    则:
      属性:
        clocks:
          最小项数: 2

        clock-names:
          items:
            - 常量: ahb
            - 常量: tcon-ch1

  - 如果:
      属性:
        compatible:
          包含:
            枚举:
              - allwinner,sun5i-a13-tcon
              - allwinner,sun6i-a31-tcon
              - allwinner,sun6i-a31s-tcon
              - allwinner,sun7i-a20-tcon
              - allwinner,sun8i-a23-tcon
              - allwinner,sun8i-a33-tcon
              - allwinner,sun8i-v3s-tcon
              - allwinner,sun9i-a80-tcon-lcd
              - allwinner,sun4i-a10-tcon
              - allwinner,sun8i-a83t-tcon-lcd
              - allwinner,sun20i-d1-tcon-lcd

    则:
      要求:
        - "#clock-cells"
        - clock-output-names

  - 如果:
      属性:
        compatible:
          包含:
            枚举:
              - allwinner,sun6i-a31-tcon
              - allwinner,sun6i-a31s-tcon
              - allwinner,sun8i-a23-tcon
              - allwinner,sun8i-a33-tcon
              - allwinner,sun8i-a83t-tcon-lcd
              - allwinner,sun20i-d1-tcon-lcd

    则:
      属性:
        resets:
          最小项数: 2

        reset-names:
          items:
            - 常量: lcd
            - 常量: lvds

  - 如果:
      属性:
        compatible:
          包含:
            枚举:
              - allwinner,sun9i-a80-tcon-lcd

    则:
      属性:
        resets:
          最小项数: 3

        reset-names:
          items:
            - 常量: lcd
            - 常量: edp
            - 常量: lvds

  - 如果:
      属性:
        compatible:
          包含:
            枚举:
              - allwinner,sun9i-a80-tcon-tv

    则:
      属性:
        resets:
          最小项数: 2

        reset-names:
          items:
            - 常量: lcd
            - 常量: edp

  - 如果:
      属性:
        compatible:
          包含:
            枚举:
              - allwinner,sun4i-a10-tcon
              - allwinner,sun5i-a13-tcon
              - allwinner,sun6i-a31-tcon
              - allwinner,sun6i-a31s-tcon
              - allwinner,sun7i-a20-tcon
              - allwinner,sun8i-a23-tcon
              - allwinner,sun8i-a33-tcon

    则:
      要求:
        - dmas

示例:
  - |
    #include <dt-bindings/dma/sun4i-a10.h>

    /*
     * 这些来自 clock/sun4i-a10-ccu.h 和
     * reset/sun4i-a10-ccu.h 头文件，但我们不能包含它们，因为
     * 这将触发与其他示例中符号重新定义的一系列警告
*/

    #define CLK_AHB_LCD0	56
    #define CLK_TCON0_CH0	149
    #define CLK_TCON0_CH1	155
    #define RST_TCON0		11

    lcd-controller@1c0c000 {
        compatible = "allwinner,sun4i-a10-tcon";
        reg = <0x01c0c000 0x1000>;
        interrupts = <44>;
        resets = <&ccu RST_TCON0>;
        reset-names = "lcd";
        clocks = <&ccu CLK_AHB_LCD0>,
                 <&ccu CLK_TCON0_CH0>,
                 <&ccu CLK_TCON0_CH1>;
        clock-names = "ahb",
                      "tcon-ch0",
                      "tcon-ch1";
        clock-output-names = "tcon0-pixel-clock";
        #clock-cells = <0>;
        dmas = <&dma SUN4I_DMA_DEDICATED 14>;

        ports {
            #address-cells = <1>;
            #size-cells = <0>;

            port@0 {
                #address-cells = <1>;
                #size-cells = <0>;
                reg = <0>;

                endpoint@0 {
                    reg = <0>;
                    remote-endpoint = <&be0_out_tcon0>;
                };

                endpoint@1 {
                    reg = <1>;
                    remote-endpoint = <&be1_out_tcon0>;
                };
            };

            port@1 {
                #address-cells = <1>;
                #size-cells = <0>;
                reg = <1>;

                endpoint@1 {
                    reg = <1>;
                    remote-endpoint = <&hdmi_in_tcon0>;
                    allwinner,tcon-channel = <1>;
                };
            };
        };
    };

    #undef CLK_AHB_LCD0
    #undef CLK_TCON0_CH0
    #undef CLK_TCON0_CH1
    #undef RST_TCON0

  - |
    #include <dt-bindings/interrupt-controller/arm-gic.h>

    /*
     * 这些来自 clock/sun6i-a31-ccu.h 和
     * reset/sun6i-a31-ccu.h 头文件，但我们不能包含它们，因为
     * 这将触发与其他示例中符号重新定义的一系列警告
*/

    #define CLK_PLL_MIPI	15
    #define CLK_AHB1_LCD0	47
    #define CLK_LCD0_CH0	127
    #define CLK_LCD0_CH1	129
    #define RST_AHB1_LCD0	27
    #define RST_AHB1_LVDS	41

    lcd-controller@1c0c000 {
        compatible = "allwinner,sun6i-a31-tcon";
        reg = <0x01c0c000 0x1000>;
        interrupts = <GIC_SPI 86 IRQ_TYPE_LEVEL_HIGH>;
        dmas = <&dma 11>;
        resets = <&ccu RST_AHB1_LCD0>, <&ccu RST_AHB1_LVDS>;
        reset-names = "lcd", "lvds";
        clocks = <&ccu CLK_AHB1_LCD0>,
                 <&ccu CLK_LCD0_CH0>,
                 <&ccu CLK_LCD0_CH1>,
                 <&ccu CLK_PLL_MIPI>;
        clock-names = "ahb",
                      "tcon-ch0",
                      "tcon-ch1",
                      "lvds-alt";
        clock-output-names = "tcon0-pixel-clock";
        #clock-cells = <0>;

        ports {
            #address-cells = <1>;
            #size-cells = <0>;

            port@0 {
                #address-cells = <1>;
                #size-cells = <0>;
                reg = <0>;

                endpoint@0 {
                    reg = <0>;
                    remote-endpoint = <&drc0_out_tcon0>;
                };

                endpoint@1 {
                    reg = <1>;
                    remote-endpoint = <&drc1_out_tcon0>;
                };
            };

            port@1 {
                #address-cells = <1>;
                #size-cells = <0>;
                reg = <1>;

                endpoint@1 {
                    reg = <1>;
                    remote-endpoint = <&hdmi_in_tcon0>;
                    allwinner,tcon-channel = <1>;
                };
            };
        };
    };

    #undef CLK_PLL_MIPI
    #undef CLK_AHB1_LCD0
    #undef CLK_LCD0_CH0
    #undef CLK_LCD0_CH1
    #undef RST_AHB1_LCD0
    #undef RST_AHB1_LVDS

  - |
    #include <dt-bindings/interrupt-controller/arm-gic.h>

    /*
     * 这些来自 clock/sun9i-a80-ccu.h 和
     * reset/sun9i-a80-ccu.h 头文件，但我们不能包含它们，因为
     * 这将触发与其他示例中符号重新定义的一系列警告
*/

    #define CLK_BUS_LCD0	102
    #define CLK_LCD0		58
    #define RST_BUS_LCD0	22
    #define RST_BUS_EDP		24
    #define RST_BUS_LVDS	25

    lcd-controller@3c00000 {
        compatible = "allwinner,sun9i-a80-tcon-lcd";
        reg = <0x03c00000 0x10000>;
        interrupts = <GIC_SPI 86 IRQ_TYPE_LEVEL_HIGH>;
        clocks = <&ccu CLK_BUS_LCD0>, <&ccu CLK_LCD0>;
        clock-names = "ahb", "tcon-ch0";
        resets = <&ccu RST_BUS_LCD0>, <&ccu RST_BUS_EDP>, <&ccu RST_BUS_LVDS>;
        reset-names = "lcd", "edp", "lvds";
        clock-output-names = "tcon0-pixel-clock";
        #clock-cells = <0>;

        ports {
            #address-cells = <1>;
            #size-cells = <0>;

            port@0 {
                reg = <0>;

                endpoint {
                    remote-endpoint = <&drc0_out_tcon0>;
                };
            };

            port@1 {
                reg = <1>;
            };
        };
    };

    #undef CLK_BUS_TCON0
    #undef CLK_TCON0
    #undef RST_BUS_TCON0
    #undef RST_BUS_EDP
    #undef RST_BUS_LVDS

  - |
    #include <dt-bindings/interrupt-controller/arm-gic.h>

    /*
     * 这些来自 clock/sun8i-a83t-ccu.h 和
     * reset/sun8i-a83t-ccu.h 头文件，但我们不能包含它们，因为
     * 这将触发与其他示例中符号重新定义的一系列警告
这段代码是 Device Tree (设备树) 的描述，用于配置 Allwinner SoC 上的 LCD 控制器。下面是中文翻译和解释：

```plaintext
// 定义时钟和复位信号的常量
#define CLK_BUS_TCON0 36
#define CLK_TCON0 85
#define RST_BUS_TCON0 22
#define RST_BUS_LVDS 31

// LCD控制器节点
lcd-controller@1c0c000 {
    // 兼容性字符串
    compatible = "allwinner,sun8i-a83t-tcon-lcd";
    // 寄存器地址范围
    reg = <0x01c0c000 0x1000>;
    // 中断配置
    interrupts = <GIC_SPI 86 IRQ_TYPE_LEVEL_HIGH>;
    // 时钟源
    clocks = <&ccu CLK_BUS_TCON0>, <&ccu CLK_TCON0>;
    // 时钟名称
    clock-names = "ahb", "tcon-ch0";
    // 输出时钟名称
    clock-output-names = "tcon-pixel-clock";
    // 时钟单元数量
    #clock-cells = <0>;
    // 复位信号
    resets = <&ccu RST_BUS_TCON0>, <&ccu RST_BUS_LVDS>;
    // 复位信号名称
    reset-names = "lcd", "lvds";

    // 端口配置
    ports {
        // 地址单元数量
        #address-cells = <1>;
        // 大小单元数量
        #size-cells = <0>;

        // 第一个端口
        port@0 {
            // 地址单元数量
            #address-cells = <1>;
            // 大小单元数量
            #size-cells = <0>;
            reg = <0>;

            // 第一个端点
            endpoint@0 {
                reg = <0>;
                // 远程端点
                remote-endpoint = <&mixer0_out_tcon0>;
            };

            // 第二个端点
            endpoint@1 {
                reg = <1>;
                // 远程端点
                remote-endpoint = <&mixer1_out_tcon0>;
            };
        };

        // 第二个端口
        port@1 {
            reg = <1>;
        };
    };
};

// 解释宏定义
#undef CLK_BUS_TCON0
#undef CLK_TCON0
#undef RST_BUS_TCON0
#undef RST_BUS_LVDS

// 包含中断控制器绑定
#include <dt-bindings/interrupt-controller/arm-gic.h>

/*
 * 下面这些值来自时钟/sun8i-r40-ccu.h 和复位/sun8i-r40-ccu.h头文件，
 * 但由于会触发其他示例中的符号重复定义警告，因此不能直接包含。
*/

// 定义TV控制器时钟和复位信号的常量
#define CLK_BUS_TCON_TV0 73
#define RST_BUS_TCON_TV0 49

// TV控制器节点
tcon_tv0: lcd-controller@1c73000 {
    // 兼容性字符串
    compatible = "allwinner,sun8i-r40-tcon-tv";
    // 寄存器地址范围
    reg = <0x01c73000 0x1000>;
    // 中断配置
    interrupts = <GIC_SPI 51 IRQ_TYPE_LEVEL_HIGH>;
    // 时钟源
    clocks = <&ccu CLK_BUS_TCON_TV0>, <&tcon_top 0>;
    // 时钟名称
    clock-names = "ahb", "tcon-ch1";
    // 复位信号
    resets = <&ccu RST_BUS_TCON_TV0>;
    // 复位信号名称
    reset-names = "lcd";

    // 端口配置
    ports {
        // 地址单元数量
        #address-cells = <1>;
        // 大小单元数量
        #size-cells = <0>;

        // 第一个端口
        port@0 {
            // 地址单元数量
            #address-cells = <1>;
            // 大小单元数量
            #size-cells = <0>;
            reg = <0>;

            // 第一个端点
            endpoint@0 {
                reg = <0>;
                // 远程端点
                remote-endpoint = <&tcon_top_mixer0_out_tcon_tv0>;
            };

            // 第二个端点
            endpoint@1 {
                reg = <1>;
                // 远程端点
                remote-endpoint = <&tcon_top_mixer1_out_tcon_tv0>;
            };
        };

        // 第二个端口
        tcon_tv0_out: port@1 {
            // 地址单元数量
            #address-cells = <1>;
            // 大小单元数量
            #size-cells = <0>;
            reg = <1>;

            // 第二个端点
            endpoint@1 {
                reg = <1>;
                // 远程端点
                remote-endpoint = <&tcon_top_hdmi_in_tcon_tv0>;
            };
        };
    };
};

// 解释宏定义
#undef CLK_BUS_TCON_TV0
#undef RST_BUS_TCON_TV0
```

这里描述了两个LCD/TV控制器的配置：一个用于TCON0（LCD），另一个用于TV0（TV输出）。每个控制器都包含了寄存器基址、中断信息、时钟源、复位信号以及端口连接等信息。
~~~~
