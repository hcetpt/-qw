## Documentation/devicetree/bindings/display/amlogic,meson-vpu_cn.yaml
```yaml
# SPDX-许可证标识符: (GPL-2.0 或 BSD-2-Clause)
# 版权所有 2019 BayLibre, SAS
%YAML 1.2
---
$id: http://devicetree.org/schemas/display/amlogic,meson-vpu.yaml#
$schema: http://devicetree.org/meta-schemas/core.yaml#

标题: Amlogic Meson 显示控制器

维护者:
  - Neil Armstrong <neil.armstrong@linaro.org>

描述: |
  Amlogic Meson 显示控制器由多个组件组成，这些组件将在下面进行说明。

  DMC|---------------VPU (视频处理单元)----------------|------HHI------|
     | vd1   _______     _____________    _________________     |               |
  D  |-------|      |----|            |   |                |    |   HDMI PLL    |
  D  | vd2   | VIU  |    | 视频后置处 |   | 视频编码器 |<---|-----VCLK      |
  R  |-------|      |----| 理         |   |                |    |               |
     | osd2  |      |    |            |---| Enci ----------|----|-----VDAC------|
  R  |-------| CSC  |----| 缩放器    |   | Encp ----------|----|----HDMI-TX----|
  A  | osd1  |      |    | 混合器   |   | Encl ----------|----|---------------|
  M  |-------|______|----|____________|   |________________|    |               |
  ___|__________________________________________________________|_______________|


  VIU: 视频输入单元
  ---------------------
  
  视频输入单元负责从DDR内存中扫描像素。它从“画布”内存中获取帧地址、步幅和参数。
  这一部分还负责CSC（色彩空间转换）。
  它可以处理2个OSD平面和2个视频平面。
  VPP: 视频后置处理
  --------------------------

  视频后置处理单元负责将各种平面缩放和混合成单一的像素流。
  有一个特殊的“预混合”，用于视频平面，具有专用的缩放器和一个“后混合”，用于与OSD平面合并。
  OSD平面也具有一个专用的缩放器用于其中一个OSD。
  VENC: 视频编码器
  --------------------

  VENC由多个像素编码器组成
   - ENCI：用于CVBS和交错HDMI的交错视频编码器
   - ENCP：用于HDMI的逐行视频编码器
   - ENCL：LCD LVDS 编码器
  VENC单元从专用的HDMI PLL和时钟树获取像素时钟(VCLK)，并为VPP和VIU提供扫描时钟。
  ENCI连接到一个单独的VDAC以用于复合输出。
  ENCI和ENCP连接到一个片上HDMI收发器。
The provided YAML snippet describes a schema for defining a hardware component (specifically a Video Processing Unit, VPU) in Device Tree format, which is commonly used in Linux and other embedded systems to describe the hardware configuration of a system. Below is the translation into Chinese:

属性:
  compatible:
    oneOf:
      - items:
          - enum:
              - amlogic,meson-gxbb-vpu # GXBB (S905)
              - amlogic,meson-gxl-vpu # GXL (S905X, S905D)
              - amlogic,meson-gxm-vpu # GXM (S912)
          - const: amlogic,meson-gx-vpu
      - enum:
          - amlogic,meson-g12a-vpu # G12A (S905X2, S905Y2, S905D2)

  reg:
    maxItems: 2

  reg-names:
    items:
      - const: vpu
      - const: hhi

  interrupts:
    maxItems: 1

  amlogic,canvas:
    description: 应指向一个画布提供节点
    $ref: /schemas/types.yaml#/definitions/phandle

  power-domains:
    maxItems: 1
    description: 指向相关电源域的phandle

  port@0:
    $ref: /schemas/graph.yaml#/properties/port
    description:
      指向CVBS VDAC端口节点的一个端口节点
  port@1:
    $ref: /schemas/graph.yaml#/properties/port
    description:
      指向HDMI-TX端口节点的一个端口节点
  port@2:
    $ref: /schemas/graph.yaml#/properties/port
    description:
      指向DPI端口节点（例如DSI或LVDS发射器）的一个端口节点

  "#address-cells":
    const: 1

  "#size-cells":
    const: 0

required:
  - compatible
  - reg
  - interrupts
  - port@0
  - port@1
  - "#address-cells"
  - "#size-cells"
  - amlogic,canvas

additionalProperties: false

示例:
  - |
    vpu: vpu@d0100000 {
        compatible = "amlogic,meson-gxbb-vpu", "amlogic,meson-gx-vpu";
        reg = <0xd0100000 0x100000>, <0xc883c000 0x1000>;
        reg-names = "vpu", "hhi";
        interrupts = <3>;
        #address-cells = <1>;
        #size-cells = <0>;
        amlogic,canvas = <&canvas>;

        /* CVBS VDAC输出端口 */
        port@0 {
            reg = <0>;

            cvbs_vdac_out: endpoint {
                remote-endpoint = <&tv_connector_in>;
            };
        };

        /* HDMI TX输出端口 */
        port@1 {
            reg = <1>;

            hdmi_tx_out: endpoint {
                remote-endpoint = <&hdmi_tx_in>;
            };
        };
    };
```

## Documentation/devicetree/bindings/display/arm,hdlcd_cn.yaml
```yaml
# SPDX-文件许可人: (GPL-2.0-only 或 BSD-2-Clause)
%YAML 1.2
---
$id: http://devicetree.org/schemas/display/arm,hdlcd.yaml#
$schema: http://devicetree.org/meta-schemas/core.yaml#

标题: Arm HDLCD 显示控制器

维护者:
  - Liviu Dudau <Liviu.Dudau@arm.com>
  - Andre Przywara <andre.przywara@arm.com>

描述:
  Arm HDLCD 是一种显示控制器，出现在 ARM Ltd 制造的多个开发平台以及其更现代的快速模型中。HDLCD 是一个 RGB 流控制器，它从帧缓冲区读取数据并将其发送到单个数字编码器（DVI 或 HDMI）。
属性:
  compatible:
    常量: arm,hdlcd

  reg:
    最大项数: 1

  interrupts:
    最大项数: 1

  clock-names:
    常量: pxlclk

  clocks:
    最大项数: 1
    描述: 像素时钟的输入参考
内存区域:
    最大项数: 1
    描述:
      指向描述用于帧缓冲区的内存节点的句柄
      如果不存在，则帧缓冲区可以位于内存中的任何位置
iommus:
    最大项数: 1

  port:
    $ref: /schemas/graph.yaml#/properties/port
    不评估的属性: false
    描述:
      控制器的输出端点，连接 LCD 面板信号
其他属性: false

必需:
  - compatible
  - reg
  - interrupts
  - clocks
  - port

示例:
  - |
    hdlcd@2b000000 {
        compatible = "arm,hdlcd";
        reg = <0x2b000000 0x1000>;
        interrupts = <0 85 4>;
        clocks = <&oscclk5>;
        clock-names = "pxlclk";
        port {
            hdlcd_output: endpoint {
                remote-endpoint = <&hdmi_enc_input>;
            };
        };
    };

    /* 通过 I2C 总线的 HDMI 编码器 */
    i2c {
        #address-cells = <1>;
        #size-cells = <0>;
        hdmi-transmitter@70 {
            compatible = "nxp,tda998x";
            reg = <0x70>;
            port {
                hdmi_enc_input: endpoint {
                    remote-endpoint = <&hdlcd_output>;
                };
            };
        };
    };
..
```

## Documentation/devicetree/bindings/display/arm,komeda_cn.yaml
```yaml
下面是给定 YAML 文档的中文翻译：

---

SPDX 许可证标识符: (GPL-2.0-only 或 BSD-2-Clause)

%YAML 1.2
---
$id: http://devicetree.org/schemas/display/arm,komeda.yaml#
$schema: http://devicetree.org/meta-schemas/core.yaml#

标题: Arm Komeda 显示处理器

维护者:
  - Liviu Dudau <Liviu.Dudau@arm.com>
  - Andre Przywara <andre.przywara@arm.com>

描述:
  Arm Mali D71 显示处理器支持多达两个显示设备，每个设备分辨率可达 4K。每条流水线可以由多达四个图层组成。它通常连接到像 HDMI 这样的数字显示接口。

属性:
  compatible:
    oneOf:
      - items:
          - const: arm,mali-d32
          - const: arm,mali-d71
      - const: arm,mali-d71

  reg:
    maxItems: 1

  interrupts:
    maxItems: 1

  clock-names:
    const: aclk

  clocks:
    maxItems: 1
    描述: 主 DPU 处理器时钟

  "#address-cells":
    const: 1

  "#size-cells":
    const: 0

  memory-region:
    maxItems: 1
    描述:
      指向用于帧缓冲区的内存节点的句柄。如果没有此属性，则帧缓冲区可以在内存中的任何位置。
iommus:
    描述:
      为使用的每条流水线提供的流 ID，每个流水线四个 ID 对应四个图层，再加上一个回写流的 ID。
minItems: 5
    maxItems: 10

patternProperties:
  '^pipeline@[01]$':
    类型: object
    additionalProperties: false
    描述:
      时钟

    属性:
      reg:
        enum: [ 0, 1 ]

      clock-names:
        const: pxclk

      clocks:
        maxItems: 1
        描述: 输入像素时钟的参考
port:
        $ref: /schemas/graph.yaml#/$defs/port-base
        unevaluatedProperties: false

additionalProperties: false

必需:
  - "#address-cells"
  - "#size-cells"
  - compatible
  - reg
  - interrupts
  - clock-names
  - clocks
  - pipeline@0

示例:
  - |
    display@c00000 {
        #address-cells = <1>;
        #size-cells = <0>;
        compatible = "arm,mali-d71";
        reg = <0xc00000 0x20000>;
        interrupts = <168>;
        clocks = <&dpu_aclk>;
        clock-names = "aclk";
        iommus = <&smmu 0>, <&smmu 1>, <&smmu 2>, <&smmu 3>,
                 <&smmu 8>,
                 <&smmu 4>, <&smmu 5>, <&smmu 6>, <&smmu 7>,
                 <&smmu 9>;

        dp0_pipe0: pipeline@0 {
            clocks = <&fpgaosc2>;
            clock-names = "pxclk";
            reg = <0>;

            port {
                dp0_pipe0_out: endpoint {
                    remote-endpoint = <&db_dvi0_in>;
                };
            };
        };

        dp0_pipe1: pipeline@1 {
            clocks = <&fpgaosc2>;
            clock-names = "pxclk";
            reg = <1>;

            port {
                dp0_pipe1_out: endpoint {
                    remote-endpoint = <&db_dvi1_in>;
                };
            };
        };
    };
..
```

## Documentation/devicetree/bindings/display/arm,malidp_cn.yaml
```yaml
# SPDX-许可证标识符: (GPL-2.0-only 或 BSD-2-Clause)
%YAML 1.2
---
$id: http://devicetree.org/schemas/display/arm,malidp.yaml#
$schema: http://devicetree.org/meta-schemas/core.yaml#

标题: Arm Mali 显示处理器 (Mali-DP)

维护者:
  - Liviu Dudau <Liviu.Dudau@arm.com>
  - Andre Przywara <andre.przywara@arm.com>

描述:
  下列绑定适用于由 ARM Ltd. 作为可授权 IP 销售的一系列显示处理器。这些绑定描述了 Mali DP500、DP550 和 DP650 处理器，它们支持多层合成、旋转和输出缩放。
属性:
  compatible:
    枚举:
      - arm,mali-dp500
      - arm,mali-dp550
      - arm,mali-dp650

  reg:
    最大项数: 1

  interrupts:
    项:
      - 描述:
          显示引擎 (DE) 使用的中断。可以与缩放引擎 (SE) 的中断共享，但必须单独列出。
      - 描述:
          缩放引擎 (SE) 使用的中断。可以与显示引擎 (DE) 的中断共享，但必须单独列出。
interrupt-names:
    项:
      - 常量: DE
      - 常量: SE

  clock-names:
    项:
      - 常量: pxlclk
      - 常量: mclk
      - 常量: aclk
      - 常量: pclk

  clocks:
    项:
      - 描述: 供给处理器输出 PLL 的像素时钟
      - 描述: 主处理器时钟
      - 描述: AXI 接口时钟
      - 描述: APB 接口时钟

  memory-region:
    最大项数: 1
    描述:
      指向描述用于帧缓冲区内存的节点的句柄。如果未提供，则帧缓冲区可以在内存中的任何位置。
arm,malidp-output-port-lines:
    $ref: /schemas/types.yaml#/definitions/uint8-array
    描述:
      每个颜色通道的输出线/位数
项:
      - 描述: 红色通道 (R) 的输出线数
      - 描述: 绿色通道 (G) 的输出线数
      - 描述: 蓝色通道 (B) 的输出线数

  arm,malidp-arqos-value:
    $ref: /schemas/types.yaml#/definitions/uint32
    描述:
      显示引擎 FIFO 的服务质量值，用于写入 DP500 的 RQOS 寄存器
有关编码详情，请参阅 ARM Mali-DP500 TRM。如果省略，RQOS 寄存器将不会被更改。
port:
    $ref: /schemas/graph.yaml#/properties/port
    未评估属性: false
    描述:
      控制器的输出端点，连接到 LCD 面板信号
这段文本描述了一个设备树节点配置，用于硬件组件的定义。下面是中文翻译：

`additionalProperties: false`

`required:`  
 `- compatible`  
 `- reg`  
 `- interrupts`  
 `- interrupt-names`  
 `- clocks`  
 `- clock-names`  
 `- port`  
 `- arm,malidp-output-port-lines`

`examples:`  
 `- |`  
   `dp0: malidp@6f200000 {`  
     `compatible = "arm,mali-dp650";`  
     `reg = <0x6f200000 0x20000>;`  
     `memory-region = <&display_reserved>;`  
     `interrupts = <168>, <168>;`  
     `interrupt-names = "DE", "SE";`  
     `clocks = <&oscclk2>, <&fpgaosc0>, <&fpgaosc1>, <&fpgaosc1>;`  
     `clock-names = "pxlclk", "mclk", "aclk", "pclk";`  
     `arm,malidp-output-port-lines = /bits/ 8 <8 8 8>;`  
     `arm,malidp-arqos-value = <0xd000d000>;`  

     `port {`  
       `dp0_output: endpoint {`  
         `remote-endpoint = <&tda998x_2_input>;`  
       `};`  
     `};`  
   `};`

---

**说明：**

- `additionalProperties: false`: 表示不允许有额外未定义的属性。
- `required:` 列出了必需的字段。
- 在示例中定义了一个名为 `dp0` 的设备树节点，其地址为 `0x6f200000`。
- `compatible = "arm,mali-dp650";` 指定了与该设备兼容的字符串。
- `reg = <0x6f200000 0x20000>;` 定义了设备的寄存器空间大小和基地址。
- `memory-region = <&display_reserved>;` 引用了一个预定义的内存区域。
- `interrupts` 和 `interrupt-names` 分别指定了中断号及其名称。
- `clocks` 和 `clock-names` 定义了时钟源及其对应的名称。
- `arm,malidp-output-port-lines = /bits/ 8 <8 8 8>;` 指定输出端口线的数量。
- `arm,malidp-arqos-value = <0xd000d000>;` 定义了一个特定值。
- 最后定义了一个端口，并在其中指定了远程端点。
```
