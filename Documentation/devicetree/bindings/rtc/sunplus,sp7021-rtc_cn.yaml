## Documentation/devicetree/bindings/soc/fsl/cpm_qe/fsl,cpm1-scc-qmc_cn.yaml
```yaml
# SPDX-License-Identifier: (GPL-2.0-only OR BSD-2-Clause)
%YAML 1.2
---
$id: http://devicetree.org/schemas/soc/fsl/cpm_qe/fsl,cpm1-scc-qmc.yaml#
$schema: http://devicetree.org/meta-schemas/core.yaml#

title: PowerQUICC CPM QUICC 多通道控制器 (QMC)

maintainers:
  - Herve Codina <herve.codina@bootlin.com>

description:
  QMC (QUICC 多通道控制器) 在一个串行控制器中模拟最多 64 个通道，使用从 TSA 路由的相同的时分复用物理接口。
properties:
  compatible:
    items:
      - enum:
          - fsl,mpc885-scc-qmc
          - fsl,mpc866-scc-qmc
      - const: fsl,cpm1-scc-qmc

  reg:
    items:
      - description: SCC (串行通信控制器) 寄存器基址
      - description: SCC 参数 RAM 基址
      - description: 双端口 RAM 基址

  reg-names:
    items:
      - const: scc_regs
      - const: scc_pram
      - const: dpram

  interrupts:
    maxItems: 1
    description: SCC 中断线在 CPM 中断控制器中的位置

  fsl,tsa-serial:
    $ref: /schemas/types.yaml#/definitions/phandle-array
    items:
      - items:
          - description: 指向 TSA 节点的 phandle
          - enum: [1, 2, 3]
            description: |
              TSA 串行接口 (dt-bindings/soc/cpm1-fsl,tsa.h 定义了这些值)
               - 1: SCC2
               - 2: SCC3
               - 3: SCC4
    description:
      应该是一个 phandle/数字对。指向 TSA 节点的 phandle 和要使用的 TSA 串行接口
'#address-cells':
    const: 1

  '#size-cells':
    const: 0

patternProperties:
  '^channel@([0-9]|[1-5][0-9]|6[0-3])$':
    description:
      由这个控制器管理的一个通道
    type: object
    additionalProperties: false

    properties:
      reg:
        minimum: 0
        maximum: 63
        description:
          通道编号

      fsl,operational-mode:
        $ref: /schemas/types.yaml#/definitions/string
        enum: [transparent, hdlc]
        default: transparent
        description: |
          通道的操作模式
            - hdlc: 通道处理 HDLC 帧
            - transparent: 通道处理原始数据，不进行任何处理

      fsl,reverse-data:
        $ref: /schemas/types.yaml#/definitions/flag
        description:
          通道上的位顺序相反，
          首先发送/接收每个字节的最高有效位
此标志仅在 'transparent' 模式下使用
fsl,tx-ts-mask:
        $ref: /schemas/types.yaml#/definitions/uint64
        description:
          通道分配的 Tx 时隙，在通过 TSA 路由到该单元格的 Tx 时隙内
fsl,rx-ts-mask:
        $ref: /schemas/types.yaml#/definitions/uint64
        description:
          通道分配的 Rx 时隙，在通过 TSA 路由到该单元格的 Rx 时隙内
compatible:
        items:
          - enum:
              - fsl,mpc885-scc-qmc-hdlc
              - fsl,mpc866-scc-qmc-hdlc
          - const: fsl,cpm1-scc-qmc-hdlc
          - const: fsl,qmc-hdlc

      fsl,framer:
        $ref: /schemas/types.yaml#/definitions/phandle
        description:
          指向 framer 节点的 phandle。framer 负责连接到 TDM 总线的 E1/T1 线接口。
          可以用来获取 E1/T1 线的状态，例如链路上/下
allOf:
      - if:
          properties:
            compatible:
              not:
                contains:
                  const: fsl,qmc-hdlc
        then:
          properties:
            fsl,framer: false

    required:
      - reg
      - fsl,tx-ts-mask
      - fsl,rx-ts-mask

required:
  - compatible
  - reg
  - reg-names
  - interrupts
  - fsl,tsa-serial
  - '#address-cells'
  - '#size-cells'

additionalProperties: false

examples:
  - |
    #include <dt-bindings/soc/cpm1-fsl,tsa.h>

    qmc@a60 {
        compatible = "fsl,mpc885-scc-qmc", "fsl,cpm1-scc-qmc";
        reg = <0xa60 0x20>,
              <0x3f00 0xc0>,
              <0x2000 0x1000>;
        reg-names = "scc_regs", "scc_pram", "dpram";
        interrupts = <27>;
        interrupt-parent = <&CPM_PIC>;

        #address-cells = <1>;
        #size-cells = <0>;

        fsl,tsa-serial = <&tsa FSL_CPM_TSA_SCC4>;

        channel@16 {
            /* Ch16 : 从 TSA 路由的所有前 4 个偶数 TS */
            reg = <16>;
            fsl,operational-mode = "transparent";
            fsl,reverse-data;
            fsl,tx-ts-mask = <0x00000000 0x000000aa>;
            fsl,rx-ts-mask = <0x00000000 0x000000aa>;
        };

        channel@17 {
            /* Ch17 : 从 TSA 路由的所有前 4 个奇数 TS */
            reg = <17>;
            fsl,operational-mode = "transparent";
            fsl,reverse-data;
            fsl,tx-ts-mask = <0x00000000 0x00000055>;
            fsl,rx-ts-mask = <0x00000000 0x00000055>;
        };

        channel@19 {
            /* Ch19 : 8 个 TS (TS 8..15) 从 TSA 路由 */
            compatible = "fsl,mpc885-scc-qmc-hdlc",
                         "fsl,cpm1-scc-qmc-hdlc",
                         "fsl,qmc-hdlc";
            reg = <19>;
            fsl,operational-mode = "hdlc";
            fsl,tx-ts-mask = <0x00000000 0x0000ff00>;
            fsl,rx-ts-mask = <0x00000000 0x0000ff00>;
            fsl,framer = <&framer>;
        };
    };
```
