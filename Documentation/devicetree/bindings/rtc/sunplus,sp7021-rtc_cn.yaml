## Documentation/devicetree/bindings/rtc/sunplus,sp7021-rtc_cn.yaml
~~~~yaml
```yaml
# SPDX-文件许可标识: (GPL-2.0-only 或 BSD-2-Clause)
# 版权所有 (C) Sunplus Co., Ltd. 2021
%YAML 1.2
---
$id: 'http://devicetree.org/schemas/rtc/sunplus,sp7021-rtc.yaml#'
$schema: 'http://devicetree.org/meta-schemas/core.yaml#'

title: Sunplus SP7021 实时时钟控制器

maintainers:
  - Vincent Shih <vincent.sunplus@gmail.com>

properties:
  compatible:
    const: sunplus,sp7021-rtc

  reg:
    maxItems: 1

  reg-names:
    items:
      - const: rtc

  clocks:
    maxItems: 1

  resets:
    maxItems: 1

  interrupts:
    maxItems: 1

required:
  - compatible
  - reg
  - reg-names
  - clocks
  - resets
  - interrupts

additionalProperties: false

examples:
  - |
    #include <dt-bindings/interrupt-controller/irq.h>

    rtc: serial@9c003a00 {
        compatible = "sunplus,sp7021-rtc";
        reg = <0x9c003a00 0x80>;
        reg-names = "rtc";
        clocks = <&clkc 0x12>;
        resets = <&rstc 0x02>;
        interrupt-parent = <&intc>;
        interrupts = <163 IRQ_TYPE_EDGE_RISING>;
    };
```
请注意，由于 YAML 的特性，注释和示例中的代码片段可能需要根据实际使用场景进行适当的调整。
~~~~

## Documentation/devicetree/bindings/rtc/ti,k3-rtc_cn.yaml
~~~~yaml
```yaml
# SPDX-许可证标识符: (GPL-2.0-only 或 BSD-2-Clause)
%YAML 1.2
---
$id: http://devicetree.org/schemas/rtc/ti,k3-rtc.yaml#
$schema: http://devicetree.org/meta-schemas/core.yaml#

title: 德州仪器 K3 实时时钟

maintainers:
  - Nishanth Menon <nm@ti.com>

description: |
  此实时时钟出现在 AM62x 系列的片上系统(SoC)中
allOf:
  - $ref: rtc.yaml#

properties:
  compatible:
    enum:
      - ti,am62-rtc

  reg:
    maxItems: 1

  interrupts:
    maxItems: 1

  clocks:
    items:
      - description: VBUS 接口时钟
      - description: 32k 时钟源（外部或内部）
clock-names:
    items:
      - const: vbus
      - const: osc32k

  power-domains:
    maxItems: 1

required:
  - compatible
  - reg
  - interrupts
  - clocks
  - clock-names

unevaluatedProperties: false

examples:
  - |
    #include <dt-bindings/interrupt-controller/arm-gic.h>
    rtc@2b1f0000 {
        compatible = "ti,am62-rtc";
        reg = <0x2b1f0000 0x100>;
        interrupts = <GIC_SPI 100 IRQ_TYPE_LEVEL_HIGH>;
        power-domains = <&bar 0>;
        clocks = <&foo 0>, <&foo 1>;
        clock-names = "vbus", "osc32k";
        wakeup-source;
    };
```

此段代码定义了一个设备树片段，用于描述德州仪器 AM62x 系列片上系统中的实时时钟（RTC）组件。它详细说明了该 RTC 的兼容性、寄存器地址、中断配置、时钟源以及电源域等信息，并提供了一个具体的实例。
~~~~

## Documentation/devicetree/bindings/rtc/trivial-rtc_cn.yaml
```yaml
# SPDX-许可证标识符: GPL-2.0
%YAML 1.2
---
$id: http://devicetree.org/schemas/rtc/trivial-rtc.yaml#
$schema: http://devicetree.org/meta-schemas/core.yaml#

title: 简单RTC设备

maintainers:
  - Alexandre Belloni <alexandre.belloni@bootlin.com>

description: |
  这是一个简单RTC设备的列表，这些设备具有简单的设备树绑定，
  包括兼容性字段、地址以及可能的中断线。

allOf:
  - $ref: rtc.yaml#

properties:
  compatible:
    enum:
      # AB-RTCMC-32.768kHz-B5ZE-S3: 具有I2C接口的实时时钟/日历模块
      - abracon,abb5zes3
      # AB-RTCMC-32.768kHz-EOZ9: 具有I2C接口的实时时钟/日历模块
      - abracon,abeoz9
      # ASPEED BMC ast2400 实时时钟
      - aspeed,ast2400-rtc
      # ASPEED BMC ast2500 实时时钟
      - aspeed,ast2500-rtc
      # ASPEED BMC ast2600 实时时钟
      - aspeed,ast2600-rtc
      # Conexant Digicolor 实时时钟控制器
      - cnxt,cx92755-rtc
      # I2C, 32位二进制计数器看门狗实时时钟带微电流充电和复位输入/输出
      - dallas,ds1374
      # Dallas DS1672 实时时钟
      - dallas,ds1672
      # 极其准确的I²C实时时钟，集成了晶体和SRAM
      - dallas,ds3232
      # EM Microelectronic EM3027 RTC
      - emmicro,em3027
      # I2C-BUS 接口实时时钟模块
      - epson,rx8010
      # I2C-BUS 接口实时时钟模块
      - epson,rx8025
      - epson,rx8035
      # 带电池支持RAM的I2C-BUS 接口实时时钟模块
      - epson,rx8111
      - epson,rx8571
      # I2C-BUS 接口实时时钟模块
      - epson,rx8581
      # Android Goldfish 实时时钟
      - google,goldfish-rtc
      # Intersil ISL1208 低功耗RTC带电池支持SRAM
      - isil,isl1208
      # Intersil ISL1218 低功耗RTC带电池支持SRAM
      - isil,isl1218
      # Mvebu 实时时钟
      - marvell,orion-rtc
      # Maxim DS1742/DS1743 实时时钟
      - maxim,ds1742
      # SPI-BUS 接口实时时钟模块
      - maxim,mcp795
      # 具有I2C-Bus的实时时钟模块
      - microcrystal,rv3029
      # 实时时钟
      - microcrystal,rv8523
      # NXP LPC32xx SoC 实时时钟
      - nxp,lpc3220-rtc
      # 实时时钟模块
      - pericom,pt7c4338
      # I2C总线串行接口实时时钟IC
      - ricoh,r2025sd
      # I2C总线串行接口实时时钟IC
      - ricoh,r2221tl
      # I2C总线串行接口实时时钟IC
      - ricoh,rs5c372a
      # I2C总线串行接口实时时钟IC
      - ricoh,rs5c372b
      # I2C总线串行接口实时时钟IC
      - ricoh,rv5c386
      # I2C总线串行接口实时时钟IC
      - ricoh,rv5c387a
      # 2线CMOS实时时钟
      - sii,s35390a
      # ST SPEAr 实时时钟
      - st,spear600-rtc
      # VIA/Wondermedia VT8500 实时时钟
      - via,vt8500-rtc
      # I2C总线串行接口实时时钟IC
      - whwave,sd3078
      # Xircom X1205 I2C RTC
      - xircom,x1205

  reg:
    maxItems: 1

  interrupts:
    maxItems: 1

  start-year: true

required:
  - compatible
  - reg

additionalProperties: false
```

## Documentation/devicetree/bindings/rtc/xgene-rtc_cn.txt
```
* APM X-Gene 实时钟 (RTC)

这是 APM X-Gene 实时钟的 RTC 控制器。

必需属性：
- compatible（兼容性）: 应该是 "apm,xgene-rtc"
- reg（寄存器）: 控制器的物理基地址和内存映射区域的长度
- interrupts（中断）: RTC 的 IRQ 线
- #clock-cells（时钟单元数量）: 应该是 1
- clocks（时钟）: 指向时钟条目的引用
示例：

rtcclk: rtcclk {
	compatible = "fixed-clock"; // 兼容性设置为固定时钟
	#clock-cells = <1>; // 时钟单元数量为 1
	clock-frequency = <100000000>; // 时钟频率为 100MHz
	clock-output-names = "rtcclk"; // 输出时钟名称
};

rtc: rtc@10510000 { // RTC 控制器实例
	compatible = "apm,xgene-rtc"; // 兼容性设置为 APM X-Gene RTC
	reg = <0x0 0x10510000 0x0 0x400>; // 寄存器基地址为 0x10510000，内存映射区域长度为 0x400
	interrupts = <0x0 0x46 0x4>; // 中断线设置为 IRQ 46
	#clock-cells = <1>; // 时钟单元数量为 1
	clocks = <&rtcclk 0>; // 引用 rtcclk 时钟
};
```

## Documentation/devicetree/bindings/rtc/xlnx,zynqmp-rtc_cn.yaml
~~~~yaml
```yaml
# SPDX-许可证标识符: (GPL-2.0-only 或 BSD-2-Clause)
%YAML 1.2
---
$id: http://devicetree.org/schemas/rtc/xlnx,zynqmp-rtc.yaml#
$schema: http://devicetree.org/meta-schemas/core.yaml#

title: Xilinx Zynq Ultrascale+ MPSoC 实时时钟

description:
  Xilinx Zynq MPSoC 实时时钟的 RTC 控制器
RTC 控制器为秒和报警分别提供了独立的 IRQ 线
maintainers:
  - Michal Simek <michal.simek@amd.com>

allOf:
  - $ref: rtc.yaml#

properties:
  compatible:
    oneOf:
      - const: xlnx,zynqmp-rtc
      - items:
          - enum:
              - xlnx,versal-rtc
              - xlnx,versal-net-rtc
          - const: xlnx,zynqmp-rtc

  reg:
    maxItems: 1

  clocks:
    maxItems: 1

  clock-names:
    items:
      - const: rtc

  interrupts:
    maxItems: 2

  interrupt-names:
    items:
      - const: alarm
      - const: sec

  calibration:
    description: |
      用于 1 秒周期的校准值，该值将直接编程到校准寄存器中
$ref: /schemas/types.yaml#/definitions/uint32
    minimum: 0x1
    maximum: 0x1FFFFF
    default: 0x198233
    deprecated: true

  power-domains:
    maxItems: 1

required:
  - compatible
  - reg
  - interrupts
  - interrupt-names

additionalProperties: false

examples:
  - |
    soc {
      #address-cells = <2>;
      #size-cells = <2>;

      rtc: rtc@ffa60000 {
        compatible = "xlnx,zynqmp-rtc";
        reg = <0x0 0xffa60000 0x0 0x100>;
        interrupt-parent = <&gic>;
        interrupts = <0 26 4>, <0 27 4>;
        interrupt-names = "alarm", "sec";
        calibration = <0x198233>;
        clock-names = "rtc";
        clocks = <&rtc_clk>;
      };
    };
```

以上是将给定的 YAML 文档翻译成了中文版本。注意，某些专有名词（如设备树条目、变量名等）保持了原英文名称以避免混淆。
~~~~

## Documentation/devicetree/bindings/serio/allwinner,sun4i-a10-ps2_cn.yaml
```yaml
# SPDX-许可证标识符: GPL-2.0
%YAML 1.2
---
$id: http://devicetree.org/schemas/serio/allwinner,sun4i-a10-ps2.yaml#
$schema: http://devicetree.org/meta-schemas/core.yaml#

标题: Allwinner A10 PS2 主控制器

维护者:
  - 陈宇蔡 <wens@csie.org>
  - Maxime Ripard <mripard@kernel.org>

描述:
  A20 PS2 是一个双角色控制器（PS2 主机和 PS2 设备）。这些绑定适用于 PS2 A10/A20 主控制器。符合 IBM 规范的 IBM PS2 和 AT 兼容键盘与鼠标可以连接。
属性:
  compatible:
    常量: allwinner,sun4i-a10-ps2

  reg:
    最大项目数: 1

  interrupts:
    最大项目数: 1

  clocks:
    最大项目数: 1

必需:
  - compatible
  - reg
  - interrupts
  - clocks

附加属性: false

示例:
  - |
    #include <dt-bindings/interrupt-controller/arm-gic.h>
    #include <dt-bindings/clock/sun7i-a20-ccu.h>

    ps20: ps2@1c2a000 {
        compatible = "allwinner,sun4i-a10-ps2";
        reg = <0x01c2a000 0x400>;
        interrupts = <GIC_SPI 62 IRQ_TYPE_LEVEL_HIGH>;
        clocks = <&ccu CLK_APB1_PS20>;
    };
```

## Documentation/devicetree/bindings/serio/ps2-gpio_cn.yaml
```yaml
# SPDX-文件许可人: (GPL-2.0-only 或 BSD-2-Clause)
%YAML 1.2
---
$id: http://devicetree.org/schemas/serio/ps2-gpio.yaml#
$schema: http://devicetree.org/meta-schemas/core.yaml#

title: 基于GPIO的PS/2接口

maintainers:
  - Danilo Krummrich <danilokrummrich@dk-develop.de>

properties:
  compatible:
    const: ps2-gpio

  data-gpios:
    description:
      用于数据信号的GPIO - 这应该标记为使用开漏输出高电平有效 (GPIO_ACTIVE_HIGH | GPIO_OPEN_DRAIN)
      来自 <dt-bindings/gpio/gpio.h>，因为该信号本质上是开漏的。
    maxItems: 1

  clk-gpios:
    description:
      用于时钟信号的GPIO - 这应该标记为使用开漏输出高电平有效 (GPIO_ACTIVE_HIGH | GPIO_OPEN_DRAIN)
      来自 <dt-bindings/gpio/gpio.h>，因为该信号本质上是开漏的。
    maxItems: 1

  interrupts:
    description:
      给定的中断应在时钟线下降沿触发。
    maxItems: 1

  write-enable:
    type: boolean
    description:
      表示是否向串行设备提供写入功能。可能提供的写入功能无法正常工作，
      因为严格的定时要求。
required:
  - compatible
  - data-gpios
  - clk-gpios
  - interrupts

additionalProperties: false

examples:
  - |
    #include <dt-bindings/gpio/gpio.h>
    #include <dt-bindings/interrupt-controller/irq.h>

    ps2 {
        compatible = "ps2-gpio";
        interrupt-parent = <&gpio>;
        interrupts = <23 IRQ_TYPE_EDGE_FALLING>;
        data-gpios = <&gpio 24 (GPIO_ACTIVE_HIGH | GPIO_OPEN_DRAIN)>;
        clk-gpios = <&gpio 23 (GPIO_ACTIVE_HIGH | GPIO_OPEN_DRAIN)>;
        write-enable;
    };
```

## Documentation/devicetree/bindings/serio/snps-arc_ps2_cn.txt
```
* ARC PS/2 驱动程序：在某些 ARC FPGA 和 nSIM OSCI 模型中使用的 PS/2 模块。

所需属性：
- compatible（兼容性）		: "snps,arc_ps2"
- reg（寄存器）			: 寄存器的偏移量和长度（始终为 0x14）
- interrupts（中断）		: 中断
- interrupt-names（中断名称）	: 中断名称，必须为 "arc_ps2_irq"

示例：

serio@c9000400 {
	compatible = "snps,arc_ps2";
	reg = <0xc9000400 0x14>;
	interrupts = <13>;
	interrupt-names = "arc_ps2_irq";
}
```

## Documentation/devicetree/bindings/soc/amlogic/amlogic,canvas_cn.yaml
~~~~yaml
```yaml
# SPDX-许可证标识符: (GPL-2.0 或 BSD-2-Clause)
# 版权所有 2019 BayLibre, SAS
%YAML 1.2
---
$id: http://devicetree.org/schemas/soc/amlogic/amlogic,canvas.yaml#
$schema: http://devicetree.org/meta-schemas/core.yaml#

标题: Amlogic Canvas 视频查找表

维护者:
  - Neil Armstrong <neil.armstrong@linaro.org>
  - Maxime Jourdan <mjourdan@baylibre.com>

描述: |
  Canvas 是一组描述像素缓冲区的元数据。
  这些元数据包括：宽度、高度、物理地址、环绕和块模式。
  从 GXBB 开始，还可以描述字节顺序。
  Amlogic 系统级芯片中的许多 IP 都依赖于 Canvas 索引来读取/写入像素数据，
  而不是直接使用物理地址。例如，视频解码器和显示控制器就是这种情况。
  Amlogic 系统级芯片有 256 个 Canvas。

属性:
  compatible:
    oneOf:
      - items:
          - enum:
              - amlogic,meson8-canvas
              - amlogic,meson8b-canvas
              - amlogic,meson8m2-canvas
          - const: amlogic,canvas
      - const: amlogic,canvas # GXBB 和更新的系统级芯片

  reg:
    maxItems: 1

必需:
  - compatible
  - reg

额外属性: false

示例:
  - |
    canvas: video-lut@48 {
        compatible = "amlogic,canvas";
        reg = <0x48 0x14>;
    };
```

请注意，此翻译保持了 YAML 格式不变，并尽量遵循原文的结构和风格。
~~~~

## Documentation/devicetree/bindings/soc/amlogic/amlogic,meson-gx-clk-measure_cn.yaml
```yaml
# SPDX-许可证标识符: (GPL-2.0-only 或 BSD-2-Clause)
%YAML 1.2
---
$id: http://devicetree.org/schemas/soc/amlogic/amlogic,meson-gx-clk-measure.yaml#
$schema: http://devicetree.org/meta-schemas/core.yaml#

title: Amlogic 内部时钟测量器

description:
  Amlogic SoC 包含一个用于测量内部时钟的 IP。
  精度为兆赫兹的倍数，对于调试时钟状态非常有用。

maintainers:
  - Neil Armstrong <neil.armstrong@linaro.org>

properties:
  compatible:
    enum:
      - amlogic,meson-gx-clk-measure
      - amlogic,meson8-clk-measure
      - amlogic,meson8b-clk-measure
      - amlogic,meson-axg-clk-measure
      - amlogic,meson-g12a-clk-measure
      - amlogic,meson-sm1-clk-measure

  reg:
    maxItems: 1

required:
  - compatible
  - reg

unevaluatedProperties: false

examples:
  - |
    clock-measure@8758 {
        compatible = "amlogic,meson-gx-clk-measure";
        reg = <0x8758 0x10>;
    };
```
