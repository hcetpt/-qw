## Documentation/devicetree/bindings/soc/amlogic/amlogic,meson-gx-hhi-sysctrl_cn.yaml
```yaml
以下是提供的 YAML 文档的中文翻译：

# SPDX-许可证标识符: (GPL-2.0-only 或 BSD-2-Clause)
%YAML 1.2
---
$id: http://devicetree.org/schemas/soc/amlogic/amlogic,meson-gx-hhi-sysctrl.yaml#
$schema: http://devicetree.org/meta-schemas/core.yaml#

标题: Amlogic Meson 系统控制寄存器

维护者:
  - Neil Armstrong <neil.armstrong@linaro.org>

属性:
  compatible:
    items:
      - 枚举:
          - amlogic,meson-gx-hhi-sysctrl
          - amlogic,meson-gx-ao-sysctrl
          - amlogic,meson-axg-hhi-sysctrl
          - amlogic,meson-axg-ao-sysctrl
      - 常量: simple-mfd
      - 常量: syscon

  reg:
    最大项数: 1

  clock-controller:
    类型: 对象

  power-controller:
    $引用: /schemas/power/amlogic,meson-ee-pwrc.yaml

  pinctrl:
    类型: 对象

  phy:
    类型: 对象

allOf:
  - 如果:
      属性:
        compatible:
          枚举:
            - amlogic,meson-gx-hhi-sysctrl
            - amlogic,meson-axg-hhi-sysctrl
    那么:
      属性:
        clock-controller:
          $引用: /schemas/clock/amlogic,gxbb-clkc.yaml#

      必须包含:
        - power-controller

  - 如果:
      属性:
        compatible:
          枚举:
            - amlogic,meson-gx-ao-sysctrl
            - amlogic,meson-axg-ao-sysctrl
    那么:
      属性:
        clock-controller:
          $引用: /schemas/clock/amlogic,gxbb-aoclkc.yaml#

        power-controller: false
        phy: false

  - 如果:
      属性:
        compatible:
          枚举:
            - amlogic,meson-gx-hhi-sysctrl
    那么:
      属性:
        phy: false

  - 如果:
      属性:
        compatible:
          枚举:
            - amlogic,meson-axg-hhi-sysctrl
    那么:
      属性:
        phy:
          oneOf:
            - $引用: /schemas/phy/amlogic,g12a-mipi-dphy-analog.yaml
            - $引用: /schemas/phy/amlogic,meson-axg-mipi-pcie-analog.yaml

必须包含:
  - compatible
  - reg
  - clock-controller

额外属性: false

示例:
  - |
    bus@c883c000 {
        compatible = "simple-bus";
        reg = <0xc883c000 0x2000>;
        #address-cells = <1>;
        #size-cells = <1>;
        ranges = <0x0 0xc883c000 0x2000>;

        sysctrl: system-controller@0 {
            compatible = "amlogic,meson-gx-hhi-sysctrl", "simple-mfd", "syscon";
            reg = <0 0x400>;

            clock-controller {
                compatible = "amlogic,gxbb-clkc";
                #clock-cells = <1>;
                clocks = <&xtal>;
                clock-names = "xtal";
            };

            power-controller {
                compatible = "amlogic,meson-gxbb-pwrc";
                #power-domain-cells = <1>;
                amlogic,ao-sysctrl = <&sysctrl_AO>;

                resets = <&reset_viu>,
                         <&reset_venc>,
                         <&reset_vcbus>,
                         <&reset_bt656>,
                         <&reset_dvin>,
                         <&reset_rdma>,
                         <&reset_venci>,
                         <&reset_vencp>,
                         <&reset_vdac>,
                         <&reset_vdi6>,
                         <&reset_vencl>,
                         <&reset_vid_lock>;
                reset-names = "viu", "venc", "vcbus", "bt656", "dvin",
                              "rdma", "venci", "vencp", "vdac", "vdi6",
                              "vencl", "vid_lock";
                clocks = <&clk_vpu>, <&clk_vapb>;
                clock-names = "vpu", "vapb";
            };
        };
    };

    bus@c8100000 {
        compatible = "simple-bus";
        reg = <0xc8100000 0x100000>;
        #address-cells = <1>;
        #size-cells = <1>;
        ranges = <0x0 0xc8100000 0x100000>;

        sysctrl_AO: system-controller@0 {
            compatible = "amlogic,meson-gx-ao-sysctrl", "simple-mfd", "syscon";
            reg = <0 0x100>;

            clock-controller {
                compatible = "amlogic,meson-gxbb-aoclkc", "amlogic,meson-gx-aoclkc";
                #clock-cells = <1>;
                #reset-cells = <1>;
                clocks = <&xtal>, <&clk81>;
                clock-names = "xtal", "mpeg-clk";
            };
        };
    };

  - |
    system-controller@ff63c000 {
        compatible = "amlogic,meson-axg-hhi-sysctrl", "simple-mfd", "syscon";
        reg = <0xff63c000 0x400>;

        clock-controller {
            compatible = "amlogic,axg-clkc";
            #clock-cells = <1>;
            clocks = <&xtal>;
            clock-names = "xtal";
        };

        power-controller {
           compatible = "amlogic,meson-axg-pwrc";
           #power-domain-cells = <1>;
           amlogic,ao-sysctrl = <&sysctrl_AO>;

           resets = <&reset_viu>,
                    <&reset_venc>,
                    <&reset_vcbus>,
                    <&reset_vencl>,
                    <&reset_vid_lock>;
           reset-names = "viu", "venc", "vcbus", "vencl", "vid_lock";
           clocks = <&clk_vpu>, <&clk_vapb>;
           clock-names = "vpu", "vapb";
        };

        phy {
           compatible = "amlogic,axg-mipi-pcie-analog-phy";
           #phy-cells = <0>;
        };
    };
```

## Documentation/devicetree/bindings/soc/aspeed/uart-routing_cn.yaml
~~~~yaml
```yaml
# SPDX-许可证标识符: (GPL-2.0-only 或 BSD-2-Clause)
# 版权所有 (c) 2018 Google LLC
# 版权所有 (c) 2021 Aspeed Technology Inc
%YAML 1.2
---
$id: http://devicetree.org/schemas/soc/aspeed/uart-routing.yaml#
$schema: http://devicetree.org/meta-schemas/core.yaml#

title: Aspeed UART 路由控制器

maintainers:
  - Oskar Senft <osk@google.com>
  - Chia-Wei Wang <chiawei_wang@aspeedtech.com>

description:
  Aspeed UART 路由控制允许动态路由内置 UART 和物理串行 I/O 端口的输入。
  这使得，例如，可以将一个 UART 的输出连接到另一个 UART。
  这可用于启用通过 UART 实现的 Host <-> BMC 通信，例如允许访问 Host 的串行控制台。
  此驱动程序用于 BMC 一侧。sysfs 文件允许拥有系统配置策略的 BMC 用户空间配置 UART 和物理串行 I/O 端口如何路由。

properties:
  compatible:
    items:
      - enum:
          - aspeed,ast2400-uart-routing
          - aspeed,ast2500-uart-routing
          - aspeed,ast2600-uart-routing
  reg:
    maxItems: 1

required:
  - compatible

additionalProperties: false

examples:
  - |
    lpc: lpc@1e789000 {
        compatible = "aspeed,ast2600-lpc-v2", "simple-mfd", "syscon";
        reg = <0x1e789000 0x1000>;

        #address-cells = <1>;
        #size-cells = <1>;
        ranges = <0x0 0x1e789000 0x1000>;

        uart_routing: uart-routing@98 {
            compatible = "aspeed,ast2600-uart-routing";
            reg = <0x98 0x8>;
        };
    };
```

以上是将原文翻译成中文的结果。注意，由于 YAML 是一种数据格式，并且它有一些固定的语法结构，因此在翻译时保留了这些结构。同时，注释和描述部分进行了翻译以适应中文环境。
~~~~

## Documentation/devicetree/bindings/soc/bcm/brcm,bcm23550-cdc_cn.yaml
```yaml
# SPDX-许可证标识符: GPL-2.0-only 或 BSD-2-Clause
%YAML 1.2
---
$id: http://devicetree.org/schemas/soc/bcm/brcm,bcm23550-cdc.yaml#
$schema: http://devicetree.org/meta-schemas/core.yaml#

title: Broadcom BCM23550 集群休眠控制

description:
  集群休眠控制模块使CPU保持在空闲状态。需要向此模块发送命令以将CPU带入运行状态。
maintainers:
  - Florian Fainelli <f.fainelli@gmail.com>

properties:
  compatible:
    const: brcm,bcm23550-cdc

  reg:
    maxItems: 1

required:
  - compatible
  - reg

additionalProperties: false

examples:
  - |
    cdc@3fe0e000 {
        compatible = "brcm,bcm23550-cdc";
        reg = <0x3fe0e000 0x78>;
    };
```

## Documentation/devicetree/bindings/soc/bcm/brcm,bcm2835-vchiq_cn.yaml
```yaml
# SPDX-许可证标识符: (GPL-2.0-only 或 BSD-2-Clause)
%YAML 1.2
---
$id: http://devicetree.org/schemas/soc/bcm/brcm,bcm2835-vchiq.yaml#
$schema: http://devicetree.org/meta-schemas/core.yaml#

title: Broadcom VCHIQ 固件服务

maintainers:
  - Nicolas Saenz Julienne <nsaenz@kernel.org>

description:
  VCHIQ 通信通道可以由 BCM283x 和 Capri 系统芯片提供，用于与 VPU 一侧的操作系统服务进行通信。
properties:
  compatible:
    oneOf:
      - description: 基于 BCM2835 的板卡
        items:
          - enum:
              - brcm,bcm2835-vchiq

      - description: 基于 BCM2836/BCM2837 的板卡
        items:
          - enum:
              - brcm,bcm2836-vchiq
          - const: brcm,bcm2835-vchiq

  reg:
    description: 门铃寄存器对的物理基地址和长度
    minItems: 1

  interrupts:
    description: 门铃中断的中断编号
    minItems: 1

required:
  - compatible
  - reg
  - interrupts

additionalProperties: false

examples:
  - |
    mailbox@7e00b840 {
      compatible = "brcm,bcm2835-vchiq";
      reg = <0x7e00b840 0xf>;
      interrupts = <0 2>;
    };
```

## Documentation/devicetree/bindings/soc/bcm/raspberrypi,bcm2835-power_cn.txt
~~~~
### Raspberry Pi 电源域驱动

**所需属性：**

- `compatible`：应当为 "raspberrypi,bcm2835-power"。
- `firmware`：指向 Raspberry Pi 固件设备节点的引用。
- `#power-domain-cells`：应当为 `<1>`，因为我们提供了多个电源域。

对于电源域的有效定义包括：

- `RPI_POWER_DOMAIN_I2C0`
- `RPI_POWER_DOMAIN_I2C1`
- `RPI_POWER_DOMAIN_I2C2`
- `RPI_POWER_DOMAIN_VIDEO_SCALER`
- `RPI_POWER_DOMAIN_VPU1`
- `RPI_POWER_DOMAIN_HDMI`
- `RPI_POWER_DOMAIN_USB`
- `RPI_POWER_DOMAIN_VEC`
- `RPI_POWER_DOMAIN_JPEG`
- `RPI_POWER_DOMAIN_H264`
- `RPI_POWER_DOMAIN_V3D`
- `RPI_POWER_DOMAIN_ISP`
- `RPI_POWER_DOMAIN_UNICAM0`
- `RPI_POWER_DOMAIN_UNICAM1`
- `RPI_POWER_DOMAIN_CCP2RX`
- `RPI_POWER_DOMAIN_CSI2`
- `RPI_POWER_DOMAIN_CPI`
- `RPI_POWER_DOMAIN_DSI0`
- `RPI_POWER_DOMAIN_DSI1`
- `RPI_POWER_DOMAIN_TRANSPOSER`
- `RPI_POWER_DOMAIN_CCP2TX`
- `RPI_POWER_DOMAIN_CDP`
- `RPI_POWER_DOMAIN_ARM`

**示例：**

```yaml
power: power {
    compatible = "raspberrypi,bcm2835-power";
    firmware = <&firmware>;
    #power-domain-cells = <1>;
};
```

**使用电源域的示例：**

```yaml
&usb {
       power-domains = <&power RPI_POWER_DOMAIN_USB>;
};
```
~~~~

## Documentation/devicetree/bindings/soc/dove/pmu_cn.txt
~~~~
Marvell PMU 的 Device Tree 绑定

**必需属性：**
- `compatible`：值应为 `"marvell,dove-pmu"`。如果存在子设备，还可以包含 `"simple-bus"`，这种情况下需要指定 `ranges` 节点。
- `reg`：PM 控制器和 PMU 的两个基地址及其大小。
- `interrupts`：PMU 中断的单个中断编号。
- `interrupt-controller`：必须指定，因为 PMU 本身就是中断控制器。
- `#interrupt-cells`：必须是 1。
- `#reset-cells`：必须是 1。
- `domains`：包含域描述的子节点。

**可选属性：**
- `ranges`：根据此名称的标准属性定义子设备的地址映射。当 `compatible` 包含 `"simple-bus"` 时必须指定。

**电源域描述作为 `domains` 子节点的子节点列出。每个域具有以下属性：**

**必需属性：**
- `#power-domain-cells`：必须是 0。

**可选属性：**
- `marvell,pmu_pwr_mask`：指定 PMU 功率寄存器的掩码值。
- `marvell,pmu_iso_mask`：指定 PMU 隔离寄存器的掩码值。
- `resets`：指向重置管理器（PMU 节点）和重置索引。

**示例：**

```device-tree
pmu: power-management@d0000 {
	compatible = "marvell,dove-pmu";
	reg = <0xd0000 0x8000>, <0xd8000 0x8000>;
	interrupts = <33>;
	interrupt-controller;
	#interrupt-cells = <1>;
	#reset-cells = <1>;

	domains {
		vpu_domain: vpu-domain {
			#power-domain-cells = <0>;
			marvell,pmu_pwr_mask = <0x00000008>;
			marvell,pmu_iso_mask = <0x00000001>;
			resets = <&pmu 16>;
		};

		gpu_domain: gpu-domain {
			#power-domain-cells = <0>;
			marvell,pmu_pwr_mask = <0x00000004>;
			marvell,pmu_iso_mask = <0x00000002>;
			resets = <&pmu 18>;
		};
	};
};
```

以上 Device Tree 示例展示了 Marvell PMU 的配置信息，包括必要的地址范围、中断配置以及特定于电源域的配置。
~~~~

## Documentation/devicetree/bindings/soc/fsl/cpm_qe/cpm/brg_cn.txt
```
* 波特率发生器

当前已定义的兼容设备：
fsl,cpm-brg
fsl,cpm1-brg
fsl,cpm2-brg

属性：
- reg : 可以有任意数量的 reg 资源；BRG 的编号按照顺序分配给这些资源
- clock-frequency : 指定驱动 BRG 的基础频率
示例：
	brg@119f0 {
		compatible = "fsl,mpc8272-brg",
			     "fsl,cpm2-brg",
			     "fsl,cpm-brg";
		reg = <119f0 10 115f0 10>;
		clock-frequency = <25000000>;  // 注意：数字前的 'd#' 在原文中表示数字是十进制的，在这里直接使用数字即可
	};
```

## Documentation/devicetree/bindings/soc/fsl/cpm_qe/cpm/i2c_cn.txt
~~~~
I2C控制器在CPM节点下表示为一个总线。
属性：
- `compatible`：应为"fsl,cpm1-i2c"，"fsl,cpm2-i2c"
- `reg`：在CPM2设备上，第二个资源不是指定I2C参数RAM本身，而是CPM2参数RAM中的I2C_BASE字段（通常为0x8afc 0x2）
- `#address-cells`：应当为1。该单元是I2C设备地址，其中r/w位被设置为0
- `#size-cells`：应当为0
- `clock-frequency`：可用于设置I2C时钟频率。如果未指定，则使用默认频率60kHz
以下两个属性已被废弃。它们仅由遗留的I2C驱动程序用来查找要探测的总线：
- `linux,i2c-index`：可用于硬编码一个I2C总线编号。默认情况下，总线编号由I2C核心动态分配
- `linux,i2c-class`：可用于覆盖I2C类。该类被遗留的I2C设备驱动程序用于在特定上下文中（如系统管理、视频或音频）找到一个总线。默认情况下，使用I2C_CLASS_HWMON (1)。类的定义可以在include/i2c/i2c.h中找到

示例，基于mpc823：

```yaml
i2c@860 {
	compatible = "fsl,mpc823-i2c", "fsl,cpm1-i2c";
	reg = <0x860 0x20 0x3c80 0x30>;
	interrupts = <16>;
	interrupt-parent = <&CPM_PIC>;
	fsl,cpm-command = <0x10>;
	#address-cells = <1>;
	#size-cells = <0>;

	rtc@68 {
		compatible = "dallas,ds1307";
		reg = <0x68>;
	};
};
```
此示例展示了如何在一个设备树文件中定义一个I2C总线控制器以及连接到该总线的一个实时时钟（RTC）设备。
~~~~

## Documentation/devicetree/bindings/soc/fsl/cpm_qe/cpm/pic_cn.txt
~~~~
* 中断控制器

当前定义的兼容类型：
- fsl,cpm1-pic
  - 只有一个中断单元
- fsl,pq1-pic
- fsl,cpm2-pic
  - 第二个中断单元是边沿/感应类型：
    - 2 表示下降沿
    - 8 表示低电平有效

示例：
```
interrupt-controller@10c00 {
	#interrupt-cells = <2>;
	interrupt-controller;
	reg = <10c00 80>;
	compatible = "mpc8272-pic", "fsl,cpm2-pic";
};
```
~~~~

## Documentation/devicetree/bindings/soc/fsl/cpm_qe/cpm_cn.txt
~~~~
* 摩托罗拉通信处理器模块 (Freescale Communications Processor Module)

注释：这是一个临时绑定，随着支持的设备增加可能会有轻微的变化。特别是QE绑定还不完整。
* 根CPM节点

属性：
- compatible: "fsl,cpm1"、"fsl,cpm2" 或 "fsl,qe"
- reg: 一个从CPCR开始的48字节区域
示例：
     cpm@119c0 {
	#address-cells = <1>;
	#size-cells = <1>;
	#interrupt-cells = <2>;
	compatible = "fsl,mpc8272-cpm", "fsl,cpm2";
	reg = <119c0 30>;
     }

* 对多个CPM/QE设备通用的属性

- fsl,cpm-command: 这个值与操作码和命令标志进行或运算，以指定CPM命令所作用的设备
- fsl,cpm-brg: 表明该设备关联的是哪个波特率发生器（BRG）。如果未设置，则应动态分配一个未使用的BRG；如果为零，则表示该设备使用外部时钟而不是BRG
- reg: 除非另有说明，第一个资源代表scc/fcc/ucc寄存器，第二个资源代表设备的参数RAM区域（如果有）
* 多用户RAM (MURAM)

多用户/双端口RAM作为CPM节点下的总线表示。
必须根据以下限制来设置范围：

- 子节点的reg节点必须是从所有MURAM起始地址的偏移量，即使用户数据区不是从零开始
- 如果使用了多个范围条目，则父节点地址与子节点地址之间的差值在所有条目中都必须相同，以便可以通过单一映射覆盖它们，同时保持通过指针减法确定CPM侧偏移的能力。建议不要使用多个范围条目
- 即使没有包含它的reg资源，子节点地址为零也必须可被转换
必须存在一个子节点 "数据" 节点，与 "fsl,cpm-muram-data" 兼容，用于指示操作系统可用于任意目的的那部分 MURAM（内存）。该数据节点可以有任意数量的 `reg` 资源，所有这些资源都为可分配的 MURAM 池做出了贡献。

以下是一个基于 mpc8272 的示例：
``` 
muram@0 {
	#address-cells = <1>;
	#size-cells = <1>;
	ranges = <0 0 10000>;

	data@0 {
		compatible = "fsl,cpm-muram-data";
		reg = <0 2000 9800 800>;
	};
};
```
在此示例中：

- `muram@0` 表示 MURAM 的根节点。
- `#address-cells` 和 `#size-cells` 定义了地址和大小单元的数量。
- `ranges` 定义了地址空间的映射。
- `data@0` 是与 "fsl,cpm-muram-data" 兼容的数据节点，它定义了操作系统可以用于任意用途的 MURAM 部分。
- `reg = <0 2000 9800 800>` 表示从地址 0x2000 开始，长度为 0x800 的 MURAM 区域，这部分 MURAM 可供操作系统使用。
~~~~
