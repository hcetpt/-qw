## Documentation/devicetree/bindings/rtc/fsl,scu-rtc_cn.yaml
```yaml
# SPDX-许可证标识符: (GPL-2.0-only 或 BSD-2-Clause)
%YAML 1.2
---
$id: http://devicetree.org/schemas/rtc/fsl,scu-rtc.yaml#
$schema: http://devicetree.org/meta-schemas/core.yaml#

title: i.MX SCU 客户端设备节点 - 基于 SCU 消息协议的 RTC

maintainers:
  - Dong Aisheng <aisheng.dong@nxp.com>

description: i.MX SCU 客户端设备节点
  客户端节点作为相关 IMX-SCU 设备节点的子节点进行维护
allOf:
  - $ref: rtc.yaml#

properties:
  compatible:
    const: fsl,imx8qxp-sc-rtc

required:
  - compatible

additionalProperties: false

examples:
  - |
    rtc {
        compatible = "fsl,imx8qxp-sc-rtc";
    };
```

## Documentation/devicetree/bindings/rtc/fsl,stmp3xxx-rtc_cn.yaml
~~~~yaml
```yaml
# SPDX-许可证标识符: (GPL-2.0-only 或 BSD-2-Clause)
%YAML 1.2
---
$id: http://devicetree.org/schemas/rtc/fsl,stmp3xxx-rtc.yaml#
$schema: http://devicetree.org/meta-schemas/core.yaml#

title: STMP3xxx/i.MX28 实时时钟控制器

maintainers:
  - Javier Carrasco <javier.carrasco.cruz@gmail.com>

allOf:
  - $ref: rtc.yaml#

properties:
  compatible:
    oneOf:
      - items:
          - enum:
              - fsl,imx28-rtc
              - fsl,imx23-rtc
          - const: fsl,stmp3xxx-rtc
      - const: fsl,stmp3xxx-rtc

  reg:
    maxItems: 1

  interrupts:
    maxItems: 1

  stmp,crystal-freq:
    description:
      覆盖由熔丝位确定的晶体频率
使用 <0> 表示“无晶体”
$ref: /schemas/types.yaml#/definitions/uint32
    enum: [0, 32000, 32768]

required:
  - compatible
  - reg
  - interrupts

unevaluatedProperties: false

examples:
  - |
    rtc@80056000 {
        compatible = "fsl,imx28-rtc", "fsl,stmp3xxx-rtc";
        reg = <0x80056000 2000>;
        interrupts = <29>;
    };
```

这个 YAML 文件描述了一个设备树规范，用于定义 STMP3xxx 和 i.MX28 实时时钟控制器的配置。它指定了必需的属性（如兼容性、寄存器地址和中断），并提供了一个示例配置。
~~~~

## Documentation/devicetree/bindings/rtc/haoyu,hym8563_cn.yaml
```yaml
下面是给定内容的中文翻译：

# SPDX-许可证标识符: (GPL-2.0-only 或 BSD-2-Clause)
%YAML 1.2
---
$id: http://devicetree.org/schemas/rtc/haoyu,hym8563.yaml#
$schema: http://devicetree.org/meta-schemas/core.yaml#

title: 浩宇微电子 HYM8563 实时时钟 (RTC)

maintainers:
  - Alexandre Belloni <alexandre.belloni@bootlin.com>

properties:
  compatible:
    const: haoyu,hym8563

  reg:
    maxItems: 1

  interrupts:
    maxItems: 1

  "#clock-cells":
    const: 0

  clock-output-names:
    description: 根据通用时钟绑定来覆盖默认的输出时钟名称
    maxItems: 1

  wakeup-source:
    description: 启用在闹钟时唤醒主机系统
allOf:
  - $ref: rtc.yaml

unevaluatedProperties: false

required:
  - compatible
  - reg
  - "#clock-cells"

examples:
  - |
    #include <dt-bindings/interrupt-controller/irq.h>

    i2c {
        #address-cells = <1>;
        #size-cells = <0>;

        rtc@51 {
            compatible = "haoyu,hym8563";
            reg = <0x51>;
            interrupts = <13 IRQ_TYPE_EDGE_FALLING>;
            #clock-cells = <0>;
        };
    };
```

## Documentation/devicetree/bindings/rtc/imxdi-rtc_cn.yaml
```yaml
# SPDX-许可证标识符: (GPL-2.0-only 或 BSD-2-Clause)
%YAML 1.2
---
$id: http://devicetree.org/schemas/rtc/imxdi-rtc.yaml#
$schema: http://devicetree.org/meta-schemas/core.yaml#

标题: i.MX25 实时时钟控制器

维护者:
  - Roland Stigge <stigge@antcom.de>

属性:
  compatible:
    常量: fsl,imx25-rtc

  reg:
    最大项目数: 1

  interrupts:
    项目:
      - 描述: 实时时钟报警中断
      - 描述: 干冰安全违规中断
    最小项目数: 1

  clocks:
    最大项目数: 1

必需:
  - compatible
  - reg
  - interrupts
  - clocks

额外属性: false

示例:
  - |
    rtc@53ffc000 {
        compatible = "fsl,imx25-rtc";
        reg = <0x53ffc000 0x4000>;
        clocks = <&clks 81>;
        interrupts = <25>, <56>;
    };
```

## Documentation/devicetree/bindings/rtc/intersil,isl12022_cn.yaml
```yaml
下面是给定内容的中文翻译：

# SPDX-License-Identifier: GPL-2.0-only OR BSD-2-Clause
%YAML 1.2
---
$id: http://devicetree.org/schemas/rtc/intersil,isl12022.yaml#
$schema: http://devicetree.org/meta-schemas/core.yaml#

title: Intersil ISL12022 实时时钟

maintainers:
  - Alexandre Belloni <alexandre.belloni@bootlin.com>

properties:
  compatible:
    const: isil,isl12022

  reg:
    maxItems: 1

  interrupts:
    maxItems: 1

  '#clock-cells':
    const: 0

  isil,battery-trip-levels-microvolt:
    description:
      触发首次报警和二次报警时的电池电压（通常为标称V_BAT的~85%和~75%）
items:
      - 枚举: [2125000, 2295000, 2550000, 2805000, 3060000, 4250000, 4675000]
      - 枚举: [1875000, 2025000, 2250000, 2475000, 2700000, 3750000, 4125000]

required:
  - compatible
  - reg

allOf:
  - $ref: rtc.yaml#
  # 如果存在#clock-cells，则interrupts不应存在
  - if:
      required:
        - '#clock-cells'
    then:
      properties:
        interrupts: false

unevaluatedProperties: false

examples:
  - |
    #include <dt-bindings/interrupt-controller/irq.h>
    i2c {
        #address-cells = <1>;
        #size-cells = <0>;

        rtc@6f {
            compatible = "isil,isl12022";
            reg = <0x6f>;
            interrupts-extended = <&gpio1 5 IRQ_TYPE_LEVEL_LOW>;
            isil,battery-trip-levels-microvolt = <2550000>, <2250000>;
        };
    };

..
```

## Documentation/devicetree/bindings/rtc/isil,isl12026_cn.txt
~~~~
ISL12026 是一款 I²C RTC（实时时钟）/ EEPROM 组合设备。RTC 和控制寄存器响应的总线地址为 0x6f，而 EEPROM 数组响应的总线地址为 0x57。典型的 "reg" 值将用于 RTC 部分。
该设备支持的必需属性包括：

- "compatible"：必须为 "isil,isl12026"
- "reg"：设备的 I²C 总线地址（始终为 0x6f）

可选属性包括：

- "isil,pwr-bsw"：如果存在，则为了正常运行，PWR.BSW 位必须设置为指定的值
- "isil,pwr-sbib"：如果存在，则为了正常运行，PWR.SBIB 位必须设置为指定的值

示例：

``` 
rtc@6f {
    compatible = "isil,isl12026";
    reg = <0x6f>;
    isil,pwr-bsw = <0>;
    isil,pwr-sbib = <1>;
}
```
此示例表示一个 RTC 设备，其 I²C 地址为 0x6f，兼容性字符串为 "isil,isl12026"，并且具有额外的配置选项，其中 PWR.BSW 设置为 0 而 PWR.SBIB 设置为 1。
~~~~

## Documentation/devicetree/bindings/rtc/isil,isl12057_cn.txt
~~~~
Intersil ISL12057 I²C 实时时钟/闹钟芯片

ISL12057 是一个简单的 I²C 设备（它具有简单设备树绑定，包括兼容性字段、地址以及可能的中断线）。
尽管如此，它还支持一个可选的布尔属性（"wakeup-source"），用于处理至少三个使用该芯片的内部用户（NETGEAR ReadyNAS 102、104 和 2120 基于 ARM 的网络附加存储）所遇到的具体应用场景；在这些设备上，芯片的 IRQ#2 引脚（由驱动程序支持的闹钟功能相关联）并未连接到系统芯片(SoC)，而是连接到了电源管理集成电路(PMIC)。这使得当实时时钟(RTC)闹钟响起时，可以唤醒设备。为了标记设备为唤醒源并获取对 'wakealarm' sysfs 条目的访问权限，当芯片的 IRQ#2 引脚未连接到 SoC 但能够唤醒设备时，可以设置此特定属性。
设备支持的必需属性：

- "compatible"：必须是 "isil,isl12057"
- "reg"：设备的 I²C 总线地址

可选属性：

- "wakeup-source"：将芯片标记为唤醒源，无论是否具备连接至 SoC 的中断线

没有 IRQ#2 引脚连接的情况（不支持闹钟）的 isl12057 节点示例：

``` 
isl12057: isl12057@68 {
	compatible = "isil,isl12057";
	reg = <0x68>;
};
```

IRQ#2 引脚通过 MPP6 连接到主 SoC 的 isl12057 节点示例（请注意，下面给出的与引脚控制相关的属性是为了完整性而提供的，并且可能不需要或者根据您的系统或 SoC 不同而不同，以及用作中断线的 MPP 的主要功能，即 "interrupt-parent" 和 "interrupts" 通常就足够了）：

``` 
pinctrl {
	...
rtc_alarm_pin: rtc_alarm_pin {
	marvell,pins = "mpp6";
	marvell,function = "gpio";
};
...
};

...

isl12057: isl12057@68 {
	compatible = "isil,isl12057";
	reg = <0x68>;
	pinctrl-0 = <&rtc_alarm_pin>;
	pinctrl-names = "default";
	interrupt-parent = <&gpio0>;
	interrupts = <6 IRQ_TYPE_EDGE_FALLING>;
};
```

IRQ#2 引脚未连接到 SoC 而是连接到 PMIC 的 isl12057 节点示例，允许设备基于配置的闹钟启动：

``` 
isl12057: isl12057@68 {
	compatible = "isil,isl12057";
	reg = <0x68>;
	wakeup-source;
};
```
~~~~

## Documentation/devicetree/bindings/rtc/isil,isl1208_cn.yaml
```yaml
下面是给定内容的中文翻译：

# SPDX-文件许可人: (GPL-2.0-only 或 BSD-2-Clause)
%YAML 1.2
---
$id: http://devicetree.org/schemas/rtc/isil,isl1208.yaml#
$schema: http://devicetree.org/meta-schemas/core.yaml#

title: Intersil ISL1209/19 I2C 实时时钟/报警芯片带事件输入

maintainers:
  - Biju Das <biju.das.jz@bp.renesas.com>
  - Trent Piepho <tpiepho@gmail.com>

description:
  ISL12X9 拥有额外的引脚 EVIN 和 EVDET 用于篡改检测，而 ISL1208 和 ISL1218 则没有这些引脚。

properties:
  compatible:
    enum:
      - isil,isl1208
      - isil,isl1209
      - isil,isl1218
      - isil,isl1219

  reg:
    maxItems: 1

  clocks:
    maxItems: 1

  clock-names:
    description: |
      如果连接到外部晶体，请使用 xin；
      如果连接到外部时钟信号，请使用 clkin。
    enum:
      - xin
      - clkin

  interrupts:
    minItems: 1
    maxItems: 2

  interrupt-names:
    minItems: 1
    items:
      - const: irq
      - const: evdet

  isil,ev-evienb:
    $ref: /schemas/types.yaml#/definitions/uint32
    enum: [ 0, 1 ]
    description: |
      启用或禁用 EVIN 引脚上的内部上拉电阻
      默认情况下，保持上拉配置不变
      <0> : 启用 evin 引脚上的内部上拉
      <1> : 禁用 evin 引脚上的内部上拉

required:
  - compatible
  - reg

allOf:
  - $ref: rtc.yaml#
  - if:
      properties:
        compatible:
          contains:
            enum:
              - isil,isl1209
              - isil,isl1219
    then:
      properties:
        interrupts:
          maxItems: 2
        interrupt-names:
          items:
            - const: irq
            - const: evdet
    else:
      properties:
        interrupts:
          maxItems: 1
        interrupt-names:
          items:
            - const: irq

unevaluatedProperties: false

examples:
  - |
    i2c {
        #address-cells = <1>;
        #size-cells = <0>;

        rtc_twi: rtc@6f {
            compatible = "isil,isl1208";
            reg = <0x6f>;
        };
    };
```

## Documentation/devicetree/bindings/rtc/loongson,rtc_cn.yaml
```yaml
# SPDX-许可证标识符: (GPL-2.0-only 或 BSD-2-Clause)
%YAML 1.2
---
$id: http://devicetree.org/schemas/rtc/loongson,rtc.yaml#
$schema: http://devicetree.org/meta-schemas/core.yaml#

title: 龙芯实时时钟

description:
  龙芯系列芯片使用片上计数器0（年时间计数器）作为RTC。
maintainers:
  - 周彬彬 <zhoubinbin@loongson.cn>

allOf:
  - $ref: rtc.yaml#

properties:
  compatible:
    oneOf:
      - enum:
          - loongson,ls1b-rtc
          - loongson,ls1c-rtc
          - loongson,ls7a-rtc
          - loongson,ls2k1000-rtc
      - items:
          - enum:
              - loongson,ls2k2000-rtc
              - loongson,ls2k0500-rtc
          - const: loongson,ls7a-rtc

  reg:
    maxItems: 1

  interrupts:
    maxItems: 1

required:
  - compatible
  - reg

unevaluatedProperties: false

examples:
  - |
    #include <dt-bindings/interrupt-controller/irq.h>

    rtc@1fe27800 {
        compatible = "loongson,ls2k1000-rtc";
        reg = <0x1fe27800 0x100>;

        interrupt-parent = <&liointc1>;
        interrupts = <8 IRQ_TYPE_LEVEL_HIGH>;
    };
```

## Documentation/devicetree/bindings/rtc/marvell,armada-380-rtc_cn.yaml
~~~~yaml
```yaml
# SPDX-许可证标识符: (GPL-2.0 或 BSD-2-Clause)
%YAML 1.2
---
$id: http://devicetree.org/schemas/rtc/marvell,armada-380-rtc.yaml#
$schema: http://devicetree.org/meta-schemas/core.yaml#

title: 适用于 Armada 38x、7K 和 8K 系统级芯片的 RTC 控制器

maintainers:
  - Javier Carrasco <javier.carrasco.cruz@gmail.com>

allOf:
  - $ref: rtc.yaml#

properties:
  compatible:
    enum:
      - marvell,armada-380-rtc
      - marvell,armada-8k-rtc

  reg:
    items:
      - description: RTC 基地址大小
      - description: 系统级芯片相关寄存器的基地址和大小

  reg-names:
    items:
      - const: rtc
      - const: rtc-soc

  interrupts:
    maxItems: 1

required:
  - compatible
  - reg
  - reg-names
  - interrupts

unevaluatedProperties: false

examples:
  - |
    #include <dt-bindings/interrupt-controller/arm-gic.h>

    rtc@a3800 {
        compatible = "marvell,armada-380-rtc";
        reg = <0xa3800 0x20>, <0x184a0 0x0c>;
        reg-names = "rtc", "rtc-soc";
        interrupts = <GIC_SPI 21 IRQ_TYPE_LEVEL_HIGH>;
    };
```
此代码段定义了一个 Device Tree 元素，用于描述 Marvell Armada 38x、7K 和 8K SoC 中的实时时钟（RTC）控制器。它指定了 RTC 的兼容性、寄存器地址和中断信息，并给出了一个具体的示例配置。
~~~~

## Documentation/devicetree/bindings/rtc/marvell,pxa-rtc_cn.yaml
~~~~yaml
```yaml
# SPDX-许可证标识符: (GPL-2.0-only 或 BSD-2-Clause)
%YAML 1.2
---
$id: http://devicetree.org/schemas/rtc/marvell,pxa-rtc.yaml#
$schema: http://devicetree.org/meta-schemas/core.yaml#

title: PXA 实时时钟

maintainers:
  - Javier Carrasco <javier.carrasco.cruz@gmail.com>

allOf:
  - $ref: rtc.yaml#

properties:
  compatible:
    const: marvell,pxa-rtc

  reg:
    maxItems: 1

  interrupts:
    items:
      - description: 1 Hz
      - description: 报警

required:
  - compatible
  - reg
  - interrupts

unevaluatedProperties: false

examples:
  - |
    rtc@40900000 {
        compatible = "marvell,pxa-rtc";
        reg = <0x40900000 0x3c>;
        interrupts = <30>, <31>;
    };
```

请注意，某些关键词如 `const`, `maxItems`, `$ref` 等保留了英文形式，因为这些通常是 YAML 或 JSON Schema 的标准术语。同时，注释和描述性的文本已翻译为中文。
~~~~

## Documentation/devicetree/bindings/rtc/maxim-ds1302_cn.txt
~~~~
Maxim/Dallas Semiconductor DS-1302 实时时钟（RTC）

这是一个简单的设备，可用于在重启之间存储日期/时间。
该设备使用标准的 MicroWire 半双工传输时序，
主输出在低电平的时钟上设置，并由 RTC 在上升沿检测；
主输入由 RTC 在下降沿设置，并在低电平的时钟上被主设备检测。

**必需属性：**

- compatible : 应为 "maxim,ds1302"

**必需的 SPI 属性：**

- reg : 应为设备芯片选择地址在控制器内的地址
- spi-max-frequency : 如果 DS-1302 以 2.2V 供电，则为 500 kHz；如果以 5V 供电，则为 2 MHz
- spi-3wire : 设备有一个共享的输入/输出信号线
- spi-lsb-first : DS-1302 要求先传输最低有效位
- spi-cs-high: DS-1302 的芯片选择线为高电平有效。除非硬件中已经反相，否则这是必需的

**示例：**

```
spi@901c {
	#address-cells = <1>;
	#size-cells = <0>;
	compatible = "icpdas,lp8841-spi-rtc";
	reg = <0x901c 0x1>;

	rtc@0 {
		compatible = "maxim,ds1302";
		reg = <0>;
		spi-max-frequency = <500000>;
		spi-3wire;
		spi-lsb-first;
		spi-cs-high;
	};
};
```
~~~~

## Documentation/devicetree/bindings/rtc/mediatek,mt7622-rtc_cn.yaml
~~~~yaml
```yaml
# SPDX-许可证标识符: GPL-2.0-only 或 BSD-2-Clause
%YAML 1.2
---
$id: http://devicetree.org/schemas/rtc/mediatek,mt7622-rtc.yaml#
$schema: http://devicetree.org/meta-schemas/core.yaml#

title: MediaTek MT7622 片上 RTC

allOf:
  - $ref: rtc.yaml#

maintainers:
  - Sean Wang <sean.wang@mediatek.com>

properties:
  compatible:
    items:
      - const: mediatek,mt7622-rtc
      - const: mediatek,soc-rtc

  reg:
    maxItems: 1

  interrupts:
    maxItems: 1

  clocks:
    maxItems: 1

  clock-names:
    const: rtc

required:
  - reg
  - interrupts
  - clocks
  - clock-names

unevaluatedProperties: false

examples:
  - |
    #include <dt-bindings/clock/mt7622-clk.h>
    #include <dt-bindings/interrupt-controller/arm-gic.h>

    rtc@10212800 {
        compatible = "mediatek,mt7622-rtc", "mediatek,soc-rtc";
        reg = <0x10212800 0x200>;
        interrupts = <GIC_SPI 129 IRQ_TYPE_LEVEL_LOW>;
        clocks = <&topckgen CLK_TOP_RTC>;
        clock-names = "rtc";
    };
```

此文档定义了MediaTek MT7622 SoC中实时时钟(RTC)的设备树规范。其中包含了与RTC相关的配置属性，例如兼容性声明、寄存器地址范围、中断配置、时钟源等信息，并给出了一个具体的例子。
~~~~

## Documentation/devicetree/bindings/rtc/microchip,mfps-rtc_cn.yaml
```yaml
# SPDX-文件许可人: (GPL-2.0-only 或 BSD-2-Clause)
%YAML 1.2
---
$id: http://devicetree.org/schemas/rtc/microchip,mfps-rtc.yaml#

$schema: http://devicetree.org/meta-schemas/core.yaml#

title: Microchip PolarFire Soc (MPFS) 实时时钟

allOf:
  - $ref: rtc.yaml#

maintainers:
  - Daire McNamara <daire.mcnamara@microchip.com>
  - Lewis Hanly <lewis.hanly@microchip.com>

properties:
  compatible:
    enum:
      - microchip,mpfs-rtc

  reg:
    maxItems: 1

  interrupts:
    items:
      - description: |
          RTC_WAKEUP 中断
      - description: |
          RTC_MATCH，当报警寄存器的内容等于RTC计数寄存器的内容时被触发

clocks:
    items:
      - description: |
          AHB 时钟
      - description: |
          参考时钟：通过预分频器分频后生成一个基于时间的脉冲（通常为1 Hz），用于日历计数器。默认情况下，PolarFire SoC上的RTC与其MTIMER共享参考时钟，因此这将是一个1 MHz的时钟
clock-names:
    items:
      - const: rtc
      - const: rtcref

required:
  - compatible
  - reg
  - interrupts
  - clocks
  - clock-names

additionalProperties: false

examples:
  - |
    #include "dt-bindings/clock/microchip,mpfs-clock.h"
    rtc@20124000 {
        compatible = "microchip,mpfs-rtc";
        reg = <0x20124000 0x1000>;
        clocks = <&clkcfg CLK_RTC>, <&clkcfg CLK_RTCREF>;
        clock-names = "rtc", "rtcref";
        interrupts = <80>, <81>;
    };
```

## Documentation/devicetree/bindings/rtc/microchip,pic32-rtc_cn.txt
```
* Microchip PIC32 实时钟和日历

RTCC 以小时、分钟、秒以及半秒的形式记录时间。它提供了星期几、日期、月份和年份的日历功能。此外，它还提供了一个可配置的闹钟功能。
所需属性：
- compatible（兼容性）：应为 "microchip,pic32mzda-rtc"
- reg（寄存器）：控制器的物理基地址及内存映射区域的长度
- interrupts（中断）：RTC 报警/事件中断
- clocks（时钟）：时钟句柄

示例：

	rtc: rtc@1f8c0000 { // RTC 设备位于 0x1f8c0000
		compatible = "microchip,pic32mzda-rtc"; // 兼容性设置
		reg = <0x1f8c0000 0x60>; // 寄存器基地址为 0x1f8c0000，内存映射区域长度为 0x60
		interrupts = <166 IRQ_TYPE_EDGE_RISING>; // 中断号为 166，触发类型为上升沿
		clocks = <&PBCLK6>; // 使用 PBCLK6 作为时钟源
	};
```
