## Documentation/devicetree/bindings/rtc/microcrystal,rv3028_cn.yaml
~~~~yaml
```yaml
# SPDX-文件许可标识符: GPL-2.0-only 或 BSD-2-Clause
%YAML 1.2
---
$id: http://devicetree.org/schemas/rtc/microcrystal,rv3028.yaml#
$schema: http://devicetree.org/meta-schemas/core.yaml#

title: Microchip RV-3028 实时时钟 (RTC)

allOf:
  - $ref: rtc.yaml#

maintainers:
  - Alexandre Belloni <alexandre.belloni@bootlin.com>

properties:
  compatible:
    const: microcrystal,rv3028

  reg:
    maxItems: 1

  interrupts:
    maxItems: 1

  trickle-resistor-ohms:
    enum:
      - 3000
      - 5000
      - 9000
      - 15000

required:
  - compatible
  - reg

unevaluatedProperties: false

examples:
  - |
    #include <dt-bindings/interrupt-controller/irq.h>
    i2c {
        #address-cells = <1>;
        #size-cells = <0>;

        rtc@51 {
            compatible = "microcrystal,rv3028";
            reg = <0x51>;
            pinctrl-0 = <&rtc_nint_pins>;
            interrupts-extended = <&gpio1 16 IRQ_TYPE_LEVEL_HIGH>;
            trickle-resistor-ohms = <3000>;
        };
    };
```

这段 YAML 代码定义了一个设备树的模式，用于描述 Microchip RV-3028 实时时钟 (RTC) 的配置。它指定了该 RTC 的兼容性声明、所需的寄存器地址、中断信息以及可选的涓流充电电阻值。此外，还提供了一个示例来展示如何在设备树源文件中使用此模式。
~~~~

## Documentation/devicetree/bindings/rtc/microcrystal,rv3032_cn.yaml
~~~~yaml
```yaml
# SPDX-文件许可标识符: GPL-2.0-only 或 BSD-2-Clause
%YAML 1.2
---
$id: http://devicetree.org/schemas/rtc/microcrystal,rv3032.yaml#
$schema: http://devicetree.org/meta-schemas/core.yaml#

title: Microchip RV-3032 实时时钟 (RTC)

allOf:
  - $ref: rtc.yaml#

maintainers:
  - Alexandre Belloni <alexandre.belloni@bootlin.com>

properties:
  compatible:
    const: microcrystal,rv3032

  reg:
    maxItems: 1

  interrupts:
    maxItems: 1

  start-year: true

  trickle-resistor-ohms:
    enum:
      - 1000
      - 2000
      - 7000
      - 11000

  trickle-voltage-millivolt:
    $ref: /schemas/types.yaml#/definitions/uint32
    enum:
      - 1750
      - 3000
      - 4400

  wakeup-source: true

required:
  - compatible
  - reg

additionalProperties: false

examples:
  - |
    #include <dt-bindings/interrupt-controller/irq.h>
    i2c {
        #address-cells = <1>;
        #size-cells = <0>;

        rtc@51 {
            compatible = "microcrystal,rv3032";
            reg = <0x51>;
            pinctrl-0 = <&rtc_nint_pins>;
            interrupts-extended = <&gpio1 16 IRQ_TYPE_LEVEL_HIGH>;
            trickle-resistor-ohms = <7000>;
            trickle-voltage-millivolt = <1750>;
        };
    };
```

请注意，上述内容为 YAML 格式的文档的中文翻译。其中包含了一些特定于设备树标准的术语和格式，这些在中文环境中可能不是常见的表达方式。
~~~~

## Documentation/devicetree/bindings/rtc/moxa,moxart-rtc_cn.txt
```
MOXA ART 实时钟

所需属性:

- compatible（兼容性）: 应该是 "moxa,moxart-rtc"
- rtc-sclk-gpios（实时钟 SCLK GPIO）: 实时钟的 SCLK GPIO，带有零标志
- rtc-data-gpios（实时钟数据 GPIO）: 实时钟的数据 GPIO，带有零标志
- rtc-reset-gpios（实时钟复位 GPIO）: 实时钟的复位 GPIO，带有零标志

示例:

    rtc: rtc { 
        compatible = "moxa,moxart-rtc"; 
        rtc-sclk-gpios = <&gpio 5 0>; 
        rtc-data-gpios = <&gpio 6 0>; 
        rtc-reset-gpios = <&gpio 7 0>; 
    }; 

这段代码描述了一个与 MOXA ART 实时钟相关的设备树片段。它定义了与实时钟交互所需的 GPIO 引脚。每个 GPIO 引脚都与实时钟的一个功能相关联：SCLK（串行时钟）、DATA（数据）和 RESET（复位）。
```

## Documentation/devicetree/bindings/rtc/mstar,msc313-rtc_cn.yaml
```yaml
下面是给定内容的中文翻译：

# SPDX-文件许可：(GPL-2.0-only 或 BSD-2-Clause)
%YAML 1.2
---
$id: http://devicetree.org/schemas/rtc/mstar,msc313-rtc.yaml#
$schema: http://devicetree.org/meta-schemas/core.yaml#

title: Mstar MSC313e 实时时钟（RTC）

allOf:
  - $ref: rtc.yaml#

maintainers:
  - Daniel Palmer <daniel@0x0f.com>
  - Romain Perier <romain.perier@gmail.com>

properties:
  compatible:
    enum:
      - mstar,msc313-rtc

  reg:
    maxItems: 1

  interrupts:
    maxItems: 1

  start-year: true

  clocks:
    maxItems: 1

required:
  - compatible
  - reg
  - interrupts
  - clocks

additionalProperties: false

examples:
  - |
    #include <dt-bindings/interrupt-controller/arm-gic.h>
    rtc@2400 {
        compatible = "mstar,msc313-rtc";
        reg = <0x2400 0x40>;
        clocks = <&xtal_div2>;
        interrupts-extended = <&intc_irq GIC_SPI 44 IRQ_TYPE_LEVEL_HIGH>;
    };

请注意，上述内容为 YAML 格式的文档，用于描述 Mstar MSC313e 实时时钟（RTC）设备树节点的配置。这里的注释和示例代码也一并进行了翻译。
```

## Documentation/devicetree/bindings/rtc/mstar,ssd202d-rtc_cn.yaml
```yaml
# SPDX-文件许可人: (GPL-2.0-only 或 BSD-2-Clause)
%YAML 1.2
---
$id: http://devicetree.org/schemas/rtc/mstar,ssd202d-rtc.yaml#
$schema: http://devicetree.org/meta-schemas/core.yaml#

title: Mstar SSD202D 实时时钟

maintainers:
  - Daniel Palmer <daniel@0x0f.com>
  - Romain Perier <romain.perier@gmail.com>

allOf:
  - $ref: rtc.yaml#

properties:
  compatible:
    enum:
      - mstar,ssd202d-rtc
  reg:
    maxItems: 1

required:
  - compatible
  - reg

unevaluatedProperties: false

examples:
  - |
    rtc@6800 {
        compatible = "mstar,ssd202d-rtc";
        reg = <0x6800 0x200>;
    };
..
```

## Documentation/devicetree/bindings/rtc/nuvoton,ma35d1-rtc_cn.yaml
```yaml
下面是给定内容的中文翻译：

# SPDX-文件许可：(GPL-2.0-only 或 BSD-2-Clause)
%YAML 1.2
---
$id: http://devicetree.org/schemas/rtc/nuvoton,ma35d1-rtc.yaml#
$schema: http://devicetree.org/meta-schemas/core.yaml#

title: Nuvoton MA35D1 实时时钟

maintainers:
  - Min-Jen Chen <mjchen@nuvoton.com>

allOf:
  - $ref: rtc.yaml#

properties:
  compatible:
    enum:
      - nuvoton,ma35d1-rtc

  reg:
    maxItems: 1

  interrupts:
    maxItems: 1

  clocks:
    maxItems: 1

required:
  - compatible
  - reg
  - interrupts
  - clocks

unevaluatedProperties: false

examples:
  - |
    #include <dt-bindings/interrupt-controller/arm-gic.h>
    #include <dt-bindings/clock/nuvoton,ma35d1-clk.h>
    rtc@40410000 {
        compatible = "nuvoton,ma35d1-rtc";
        reg = <0x40410000 0x200>;
        interrupts = <GIC_SPI 5 IRQ_TYPE_EDGE_RISING>;
        clocks = <&clk RTC_GATE>;
    };
```

## Documentation/devicetree/bindings/rtc/nuvoton,nct3018y_cn.yaml
```yaml
下面是给定内容的中文翻译：

# SPDX-文件许可人: GPL-2.0-only 或 BSD-2-Clause
%YAML 1.2
---
$id: http://devicetree.org/schemas/rtc/nuvoton,nct3018y.yaml#
$schema: http://devicetree.org/meta-schemas/core.yaml#

title: 努沃顿 NCT3018Y 实时时钟

allOf:
  - $ref: rtc.yaml#

maintainers:
  - Medad CChien <ctcchien@nuvoton.com>
  - Mia Lin <mimi05633@gmail.com>

properties:
  compatible:
    const: nuvoton,nct3018y

  reg:
    maxItems: 1

  start-year: true

  reset-source: true

required:
  - compatible
  - reg

additionalProperties: false

examples:
  - |
    i2c {
        #address-cells = <1>;
        #size-cells = <0>;

        rtc@6f {
            compatible = "nuvoton,nct3018y";
            reg = <0x6f>;
        };
    };
```

## Documentation/devicetree/bindings/rtc/nvidia,tegra20-rtc_cn.yaml
```yaml
# SPDX-许可证标识符: (GPL-2.0-only 或 BSD-2-Clause)
%YAML 1.2
---
$id: http://devicetree.org/schemas/rtc/nvidia,tegra20-rtc.yaml#
$schema: http://devicetree.org/meta-schemas/core.yaml#

title: NVIDIA Tegra 实时时钟

maintainers:
  - Thierry Reding <thierry.reding@gmail.com>
  - Jon Hunter <jonathanh@nvidia.com>

description: |
  Tegra RTC 维护秒和毫秒计数器，以及五个报警寄存器。报警和其他中断可以将系统从低功耗状态唤醒。

properties:
  compatible:
    oneOf:
      - const: nvidia,tegra20-rtc
      - items:
          - enum:
              - nvidia,tegra30-rtc
              - nvidia,tegra114-rtc
              - nvidia,tegra124-rtc
              - nvidia,tegra210-rtc
              - nvidia,tegra186-rtc
              - nvidia,tegra194-rtc
              - nvidia,tegra234-rtc
          - const: nvidia,tegra20-rtc

  reg:
    maxItems: 1

  interrupts:
    maxItems: 1

  clocks:
    maxItems: 1

  clock-names:
    items:
      - const: rtc

additionalProperties: false

required:
  - compatible
  - reg
  - interrupts
  - clocks

examples:
  - |
    timer@7000e000 {
        compatible = "nvidia,tegra20-rtc";
        reg = <0x7000e000 0x100>;
        interrupts = <0 2 0x04>;
        clocks = <&tegra_car 4>;
    };
```

## Documentation/devicetree/bindings/rtc/nxp,lpc1788-rtc_cn.yaml
~~~~yaml
```yaml
# SPDX-许可证标识符: (GPL-2.0 或 BSD-2-Clause)
%YAML 1.2
---
$id: http://devicetree.org/schemas/rtc/nxp,lpc1788-rtc.yaml#
$schema: http://devicetree.org/meta-schemas/core.yaml#

title: NXP LPC1788 实时时钟

description:
  LPC1788 实时时钟提供了日历和时钟功能，
  同时支持周期性滴答和报警中断。
maintainers:
  - Javier Carrasco <javier.carrasco.cruz@gmail.com>

allOf:
  - $ref: rtc.yaml#

properties:
  compatible:
    const: nxp,lpc1788-rtc

  reg:
    maxItems: 1

  clocks:
    items:
      - description: 实时时钟
      - description: 寄存器时钟

  clock-names:
    items:
      - const: rtc
      - const: reg

  interrupts:
    maxItems: 1

required:
  - compatible
  - reg
  - clocks
  - clock-names
  - interrupts

unevaluatedProperties: false

examples:
  - |
    #include <dt-bindings/clock/lpc18xx-ccu.h>

    rtc@40046000 {
        compatible = "nxp,lpc1788-rtc";
        reg = <0x40046000 0x1000>;
        clocks = <&creg_clk 0>, <&ccu1 CLK_CPU_BUS>;
        clock-names = "rtc", "reg";
        interrupts = <47>;
    };
```

请注意，这里的 `clock-names` 和 `clocks` 属性中的描述已根据上下文进行了适当的翻译。此外，注释也根据需要进行了调整以保持其意义不变。
~~~~
