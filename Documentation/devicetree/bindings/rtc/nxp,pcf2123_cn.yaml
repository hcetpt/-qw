## Documentation/devicetree/bindings/rtc/nxp,pcf2123_cn.yaml
~~~~yaml
```yaml
# SPDX-文件许可标识: (GPL-2.0-only 或 BSD-2-Clause)
%YAML 1.2
---
$id: http://devicetree.org/schemas/rtc/nxp,pcf2123.yaml#
$schema: http://devicetree.org/meta-schemas/core.yaml#

title: NXP PCF2123 SPI 实时时钟

maintainers:
  - Javier Carrasco <javier.carrasco.cruz@gmail.com>

allOf:
  - $ref: /schemas/spi/spi-peripheral-props.yaml#
  - $ref: rtc.yaml#

properties:
  compatible:
    enum:
      - nxp,pcf2123

  reg:
    maxItems: 1

  interrupts:
    maxItems: 1

required:
  - compatible
  - reg

unevaluatedProperties: false

examples:
  - |
    #include <dt-bindings/interrupt-controller/arm-gic.h>
    spi {
        #address-cells = <1>;
        #size-cells = <0>;

        rtc@3 {
            compatible = "nxp,pcf2123";
            reg = <3>;
            interrupts = <GIC_SPI 130 IRQ_TYPE_LEVEL_LOW>;
            spi-cs-high;
        };
    };
```

请注意，上面的翻译保留了原有的 YAML 格式和结构，并将英文文本翻译成了中文。对于代码示例中的注释以及包含的文件路径等未做修改，因为这些通常不需要翻译。
~~~~

## Documentation/devicetree/bindings/rtc/nxp,pcf2127_cn.yaml
```yaml
下面是给定内容的中文翻译：

# SPDX-文件许可标识符: GPL-2.0-only 或 BSD-2-Clause
%YAML 1.2
---
$id: http://devicetree.org/schemas/rtc/nxp,pcf2127.yaml#
$schema: http://devicetree.org/meta-schemas/core.yaml#

title: NXP PCF2127 实时时钟

allOf:
  - $ref: rtc.yaml#

maintainers:
  - Alexandre Belloni <alexandre.belloni@bootlin.com>

properties:
  compatible:
    enum:
      - nxp,pca2129
      - nxp,pcf2127
      - nxp,pcf2129
      - nxp,pcf2131

  reg:
    maxItems: 1

  interrupts:
    maxItems: 1

  start-year: true

  reset-source: true

required:
  - compatible
  - reg

additionalProperties: false

examples:
  - |
    #include <dt-bindings/interrupt-controller/irq.h>
    i2c {
        #address-cells = <1>;
        #size-cells = <0>;

        rtc@51 {
            compatible = "nxp,pcf2127";
            reg = <0x51>;
            pinctrl-0 = <&rtc_nint_pins>;
            interrupts-extended = <&gpio1 16 IRQ_TYPE_LEVEL_HIGH>;
            reset-source;
        };
    };

..
```

## Documentation/devicetree/bindings/rtc/nxp,pcf85063_cn.yaml
```yaml
下面是给定内容的中文翻译：

# SPDX-文件许可标识符: (GPL-2.0-only 或 BSD-2-Clause)
%YAML 1.2
---
$id: http://devicetree.org/schemas/rtc/nxp,pcf85063.yaml#
$schema: http://devicetree.org/meta-schemas/core.yaml#

title: NXP PCF85063 实时时钟

maintainers:
  - Alexander Stein <alexander.stein@ew.tq-group.com>

properties:
  compatible:
    enum:
      - microcrystal,rv8263
      - nxp,pcf85063
      - nxp,pcf85063a
      - nxp,pcf85063tp
      - nxp,pca85073a

  reg:
    maxItems: 1

  "#clock-cells":
    const: 0

  clock-output-names:
    maxItems: 1

  interrupts:
    maxItems: 1

  quartz-load-femtofarads:
    description:
      晶体(x-tal)的电容负载
    enum: [7000, 12500]
    default: 7000

  clock:
    $ref: /schemas/clock/fixed-clock.yaml
    description:
      如果方形波引脚用作启动启用的固定时钟，则提供此配置
    wakeup-source: true

allOf:
  - $ref: rtc.yaml#
  - if:
      properties:
        compatible:
          contains:
            enum:
              - microcrystal,rv8263
    then:
      properties:
        quartz-load-femtofarads: false
  - if:
      properties:
        compatible:
          contains:
            enum:
              - nxp,pcf85063
    then:
      properties:
        quartz-load-femtofarads:
          const: 7000

required:
  - compatible
  - reg

additionalProperties: false

examples:
  - |
    i2c {
        #address-cells = <1>;
        #size-cells = <0>;

        rtc@51 {
          compatible = "nxp,pcf85063a";
          reg = <0x51>;
          quartz-load-femtofarads = <12500>;

          clock {
            compatible = "fixed-clock";
            #clock-cells = <0>;
            clock-frequency = <32768>;
          };
        };
      };
```

## Documentation/devicetree/bindings/rtc/nxp,pcf8523_cn.yaml
~~~~yaml
下面是给定内容的中文翻译：

```yaml
# SPDX-文件许可人: (GPL-2.0-only 或 BSD-2-Clause)
%YAML 1.2
---
$id: http://devicetree.org/schemas/rtc/nxp,pcf8523.yaml#
$schema: http://devicetree.org/meta-schemas/core.yaml#

title: NXP PCF8523 实时时钟

maintainers:
  - Sam Ravnborg <sam@ravnborg.org>

allOf:
  - $ref: rtc.yaml#

properties:
  compatible:
    const: nxp,pcf8523

  reg:
    maxItems: 1

  quartz-load-femtofarads:
    description:
      晶振的电容负载，以飞法拉（fF）为单位表示
    enum: [ 7000, 12500 ]
    default: 12500

required:
  - compatible
  - reg

unevaluatedProperties: false

examples:
  - |
    i2c {
        #address-cells = <1>;
        #size-cells = <0>;

        rtc@68 {
            compatible = "nxp,pcf8523";
            reg = <0x68>;
            quartz-load-femtofarads = <7000>;
        };
    };
```

请注意，这里的`$schema`, `$id`, `allOf` 和 `$ref` 是 YAML 文件中的特殊语法，并且在中文翻译中保持不变。
~~~~

## Documentation/devicetree/bindings/rtc/nxp,pcf85363_cn.yaml
```yaml
下面是给定内容的中文翻译：

# SPDX-许可证标识符: (GPL-2.0-only 或 BSD-2-Clause)
%YAML 1.2
---
$id: http://devicetree.org/schemas/rtc/nxp,pcf85363.yaml#
$schema: http://devicetree.org/meta-schemas/core.yaml#

title: Philips PCF85263/PCF85363 实时时钟

maintainers:
  - Alexandre Belloni <alexandre.belloni@bootlin.com>

allOf:
  - $ref: rtc.yaml#

properties:
  compatible:
    enum:
      - nxp,pcf85263
      - nxp,pcf85363

  reg:
    maxItems: 1

  "#clock-cells":
    const: 0

  clock-output-names:
    maxItems: 1

  interrupts:
    maxItems: 1

  quartz-load-femtofarads:
    description:
      石英晶体(x-tal)的电容负载
    enum: [6000, 7000, 12500]
    default: 7000

  start-year: true
  wakeup-source: true

required:
  - compatible
  - reg

additionalProperties: false

examples:
  - |
    i2c {
        #address-cells = <1>;
        #size-cells = <0>;

        rtc@51 {
            compatible = "nxp,pcf85363";
            reg = <0x51>;
            #clock-cells = <0>;
            quartz-load-femtofarads = <12500>;
        };
    };
```

## Documentation/devicetree/bindings/rtc/nxp,pcf8563_cn.yaml
```yaml
# SPDX-许可证标识符: GPL-2.0
%YAML 1.2
---
$id: http://devicetree.org/schemas/rtc/nxp,pcf8563.yaml#
$schema: http://devicetree.org/meta-schemas/core.yaml#

标题: Philips PCF8563/Epson RTC8564 实时时钟

维护者:
  - Alexandre Belloni <alexandre.belloni@bootlin.com>

allOf:
  - $ref: rtc.yaml#

属性:
  compatible:
    枚举:
      - epson,rtc8564
      - microcrystal,rv8564
      - nxp,pca8565
      - nxp,pcf8563

  reg:
    最大项数: 1

  "#clock-cells":
    常量: 0

  clock-output-names:
    最大项数: 1

  interrupts:
    最大项数: 1

  start-year: 真
  wakeup-source: 真

必需:
  - compatible
  - reg

额外属性: 错误

示例:
  - |
    i2c {
        #address-cells = <1>;
        #size-cells = <0>;

        rtc@51 {
            compatible = "nxp,pcf8563";
            reg = <0x51>;
            #clock-cells = <0>;
        };
    };
..
```

## Documentation/devicetree/bindings/rtc/qcom-pm8xxx-rtc_cn.yaml
```yaml
# SPDX-许可证标识符: (GPL-2.0 或 BSD-2-Clause)
%YAML 1.2
---
$id: http://devicetree.org/schemas/rtc/qcom-pm8xxx-rtc.yaml#
$schema: http://devicetree.org/meta-schemas/core.yaml#

title: 高通 PM8xxx PMIC 实时钟设备

maintainers:
  - Satya Priya <quic_c_skakit@quicinc.com>

properties:
  compatible:
    oneOf:
      - enum:
          - qcom,pm8058-rtc
          - qcom,pm8921-rtc
          - qcom,pm8941-rtc
          - qcom,pmk8350-rtc
      - items:
          - enum:
              - qcom,pm8018-rtc
          - const: qcom,pm8921-rtc

  reg:
    minItems: 1
    maxItems: 2

  reg-names:
    minItems: 1
    items:
      - const: rtc
      - const: alarm

  interrupts:
    maxItems: 1

  allow-set-time:
    $ref: /schemas/types.yaml#/definitions/flag
    description:
      表示主机 CPU 允许设置 RTC 时间

  nvmem-cells:
    items:
      - description:
          四字节的 nvmem 单元，以小端格式存储从 UNIX 纪元起的时间偏移量，表示 RTC 计时器最后一次重置的时间

  nvmem-cell-names:
    items:
      - const: offset

  wakeup-source: true

required:
  - compatible
  - reg
  - interrupts

additionalProperties: false

examples:
  - |
    #include <dt-bindings/interrupt-controller/irq.h>
    #include <dt-bindings/spmi/spmi.h>

    spmi {
        #address-cells = <2>;
        #size-cells = <0>;

        pmic@0 {
            compatible = "qcom,pm8941", "qcom,spmi-pmic";
            reg = <0x0 SPMI_USID>;
            #address-cells = <1>;
            #size-cells = <0>;

            rtc@6000 {
                compatible = "qcom,pm8941-rtc";
                reg = <0x6000>, <0x6100>;
                reg-names = "rtc", "alarm";
                interrupts = <0x0 0x61 0x1 IRQ_TYPE_EDGE_RISING>;
                nvmem-cells = <&rtc_offset>;
                nvmem-cell-names = "offset";
            };
        };
    };
..
```

## Documentation/devicetree/bindings/rtc/realtek,rtd119x_cn.txt
```
Realtek RTD129x 实时时钟
===============================

必需属性：
- compatible：应为 "realtek,rtd1295-rtc"
- reg        ：指定物理基地址和大小
- clocks     ：指定时钟门控

示例：

	rtc@9801b600 {
		compatible = "realtek,rtd1295-clk";
		reg = <0x9801b600 0x100>;
		clocks = <&clkc RTD1295_CLK_EN_MISC_RTC>;
	};

请注意，示例中的 `compatible` 的值应更正为 `"realtek,rtd1295-rtc"` 以符合文档的要求。以下是修正后的示例：

	rtc@9801b600 {
		compatible = "realtek,rtd1295-rtc";
		reg = <0x9801b600 0x100>;
		clocks = <&clkc RTD1295_CLK_EN_MISC_RTC>;
	};
```

## Documentation/devicetree/bindings/rtc/renesas,sh-rtc_cn.yaml
```yaml
# SPDX-许可证标识符: GPL-2.0
%YAML 1.2
---
$id: http://devicetree.org/schemas/rtc/renesas,sh-rtc.yaml#
$schema: http://devicetree.org/meta-schemas/core.yaml#

标题: 适用于Renesas SH和ARM系统级芯片的实时时钟

维护者:
  - Chris Brandt <chris.brandt@renesas.com>
  - Geert Uytterhoeven <geert+renesas@glider.be>

属性:
  compatible:
    items:
      - 常量: renesas,r7s72100-rtc  # RZ/A1H
      - 常量: renesas,sh-rtc

  reg:
    最大项数: 1

  interrupts:
    最大项数: 3

  interrupt-names:
    items:
      - 常量: alarm
      - 常量: period
      - 常量: carry

  clocks:
    # RTC 控制器的功能时钟源必须首先列出（如果存在）。此外，潜在的时钟计数源也应列出
    最小项数: 1
    最大项数: 4

  clock-names:
    # 功能时钟必须标记为"fck"。其他时钟可以按照系统级芯片硬件手册进行命名
    最小项数: 1
    最大项数: 4
    items:
      枚举: [ fck, rtc_x1, rtc_x3, extal ]

  power-domains:
    最大项数: 1

必需:
  - compatible
  - reg
  - interrupts
  - interrupt-names
  - clocks
  - clock-names
  - power-domains

额外属性: false

示例:
  - |
    #include <dt-bindings/clock/r7s72100-clock.h>
    #include <dt-bindings/interrupt-controller/arm-gic.h>
    #include <dt-bindings/interrupt-controller/irq.h>

    rtc: rtc@fcff1000 {
        compatible = "renesas,r7s72100-rtc", "renesas,sh-rtc";
        reg = <0xfcff1000 0x2e>;
        interrupts = <GIC_SPI 276 IRQ_TYPE_EDGE_RISING>,
                     <GIC_SPI 277 IRQ_TYPE_EDGE_RISING>,
                     <GIC_SPI 278 IRQ_TYPE_EDGE_RISING>;
        interrupt-names = "alarm", "period", "carry";
        clocks = <&mstp6_clks R7S72100_CLK_RTC>, <&rtc_x1_clk>,
                 <&rtc_x3_clk>, <&extal_clk>;
        power-domains = <&cpg_clocks>;
        clock-names = "fck", "rtc_x1", "rtc_x3", "extal";
    };
```

## Documentation/devicetree/bindings/rtc/rtc-cmos_cn.txt
~~~~
这段文本描述了一个与 Motorola MC146818 兼容的实时时钟（RTC）设备的配置。下面是中文翻译及解释：

---

**兼容性：** "motorola,mc146818"

**必需属性：**
  - **兼容性**："motorola,mc146818" 表示此 RTC 设备与 Motorola MC146818 兼容。
  - **reg**：应包含寄存器的位置和长度。

**可选属性：**
  - **interrupts**：应包含中断信息。
  - **ctrl-reg**：包含控制寄存器（也称为“寄存器 B”）的初始值。
  - **freq-reg**：包含频率寄存器（也称为“寄存器 A”）的初始值。

通常，“寄存器 A”和“寄存器 B”由固件（例如 BIOS）初始化。如果没有这样做，可以通过驱动程序来完成。

**ISA 示例：**

```plaintext
rtc@70 {
    compatible = "motorola,mc146818"; // 兼容性
    interrupts = <8 3>;              // 中断信息
    interrupt-parent = <&ioapic1>;   // 中断父设备
    ctrl-reg = <2>;                  // 控制寄存器（寄存器 B）的初始值
    freq-reg = <0x26>;               // 频率寄存器（寄存器 A）的初始值
    reg = <1 0x70 2>;                // 寄存器的位置和长度
};
```

---

**说明：**
- **compatible** 属性指定了设备的兼容类型，这里是与 Motorola MC146818 兼容。
- **interrupts** 属性指定了 RTC 设备使用的中断号以及中断触发方式。
- **interrupt-parent** 属性指定了 RTC 设备中断的父设备，通常是一个 I/O APIC。
- **ctrl-reg** 和 **freq-reg** 分别指定了控制寄存器（寄存器 B）和频率寄存器（寄存器 A）的初始值。
- **reg** 属性指定了 RTC 设备的寄存器位置及其长度。在这个例子中，寄存器位于地址 0x70，长度为 2 字节。
~~~~

## Documentation/devicetree/bindings/rtc/rtc-ds1307_cn.yaml
```yaml
# SPDX-许可证标识符: GPL-2.0
%YAML 1.2
---
$id: http://devicetree.org/schemas/rtc/rtc-ds1307.yaml#
$schema: http://devicetree.org/meta-schemas/core.yaml#

标题: Dallas DS1307 及兼容实时时钟 (RTC)

维护者:
  - Alexandre Belloni <alexandre.belloni@bootlin.com>

属性:
  compatible:
    oneOf:
      - 枚举:
          - dallas,ds1307
          - dallas,ds1308
          - dallas,ds1337
          - dallas,ds1338
          - dallas,ds1339
          - dallas,ds1388
          - dallas,ds1340
          - dallas,ds1341
          - maxim,ds3231
          - st,m41t0
          - st,m41t00
          - st,m41t11
          - microchip,mcp7940x
          - microchip,mcp7941x
          - pericom,pt7c4338
          - epson,rx8025
          - isil,isl12057
          - epson,rx8130

      - items:
          - 枚举:
              - st,m41t00
          - 常量: dallas,ds1338

  reg:
    maxItems: 1

  interrupts:
    minItems: 1
    maxItems: 2

  interrupt-names:
    maxItems: 2

  "#clock-cells":
    常量: 1

  clock-output-names:
    描述: 根据通用时钟绑定覆盖默认的输出时钟名称

  wakeup-source:
    描述: 启用在闹钟时唤醒主机系统

  vcc-supply: true

allOf:
  - $ref: rtc.yaml
  - 如果:
      属性:
        compatible:
          包含:
            枚举:
              - dallas,ds1339
              - dallas,ds1340
              - dallas,ds1388
    然后:
      属性:
        trickle-resistor-ohms:
          描述: 用于涓流充电器的选定电阻。如果要启用涓流充电器，则应指定该值。
          枚举: [ 250, 2000, 4000 ]

        trickle-diode-disable:
          描述: 不使用内部涓流充电器二极管。如果要禁用内部涓流充电器二极管（已被aux-voltage-chargeable取代），则应给出此值。
          过时: true

unevaluatedProperties: false

必需:
  - compatible
  - reg

示例:
  - |
    i2c {
      #address-cells = <1>;
      #size-cells = <0>;

      rtc@68 {
        compatible = "dallas,ds1337";
        reg = <0x68>;
        interrupt-parent = <&gpio4>;
        interrupts = <20 0>;
        trickle-resistor-ohms = <250>;
      };
    };
```

## Documentation/devicetree/bindings/rtc/rtc-fsl-ftm-alarm_cn.txt
~~~~
### Freescale FlexTimer 模块 (FTM) 报警

**必需属性:**
- `compatible`：应为 `"fsl,<chip>-ftm-alarm"`，支持的芯片包括：
  - `"fsl,ls1012a-ftm-alarm"`
  - `"fsl,ls1021a-ftm-alarm"`
  - `"fsl,ls1028a-ftm-alarm"`
  - `"fsl,ls1043a-ftm-alarm"`
  - `"fsl,ls1046a-ftm-alarm"`
  - `"fsl,ls1088a-ftm-alarm"`
  - `"fsl,ls208xa-ftm-alarm"`
  - `"fsl,lx2160a-ftm-alarm"`
- `reg`：指定 FlexTimer 模块寄存器集的基本物理地址和大小。
- `interrupts`：应为 FlexTimer 模块中断。
- `fsl,rcpm-wakeup` 属性和 `rcpm` 节点：请参考文档 `Documentation/devicetree/bindings/soc/fsl/rcpm.txt`

**可选属性:**
- `big-endian`：如果主机控制器处于大端模式，则指定此属性。默认字节序模式是小端。

**示例:**

```devicetree
rcpm: rcpm@1e34040 {
	compatible = "fsl,ls1088a-rcpm", "fsl,qoriq-rcpm-2.1+";
	reg = <0x0 0x1e34040 0x0 0x18>;
	#fsl,rcpm-wakeup-cells = <6>;
};

ftm_alarm0: timer@2800000 {
	compatible = "fsl,ls1088a-ftm-alarm";
	reg = <0x0 0x2800000 0x0 0x10000>;
	fsl,rcpm-wakeup = <&rcpm 0x0 0x0 0x0 0x0 0x4000 0x0>;
	interrupts = <0 44 4>;
};
```
以上示例展示了如何在 Device Tree 中配置 Freescale 的 FlexTimer 模块及其相关属性。
~~~~

## Documentation/devicetree/bindings/rtc/rtc-mt6397_cn.txt
```
针对MediaTek PMIC（电源管理集成电路）的RTC（实时时钟）的设备树绑定

MediaTek PMIC 基础的 RTC 是一个独立的功能，它作为 Multi-Function Device (MFD) 的一种类型。RTC 可以通过 PMIC 包装器总线进行配置和设置，PMIC 包装器总线是一种与同一 PMIC 上其他功能共享的公共资源。
对于 MediaTek PMIC MFD 绑定，请参阅：
../mfd/mt6397.txt

对于 MediaTek PMIC 包装器总线绑定，请参阅：
../soc/mediatek/pwrap.txt

必需属性：
- compatible: 应该是以下选项之一
       "mediatek,mt6323-rtc": 适用于 MT6323 PMIC
       "mediatek,mt6358-rtc": 适用于 MT6358 PMIC
       "mediatek,mt6366-rtc", "mediatek,mt6358-rtc": 适用于 MT6366 PMIC
       "mediatek,mt6397-rtc": 适用于 MT6397 PMIC

示例：

       pmic {
               compatible = "mediatek,mt6323";

               ..
rtc {
                       compatible = "mediatek,mt6323-rtc";
               };
       };

此示例展示了如何在设备树中声明一个基于MediaTek PMIC的RTC设备。在这个例子中，PMIC被标识为MT6323型号，并且其中包含了RTC组件。
```
