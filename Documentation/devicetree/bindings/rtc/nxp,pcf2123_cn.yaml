## Documentation/devicetree/bindings/rtc/rtc-mxc_cn.yaml
```yaml
# SPDX-许可证标识符: (GPL-2.0-only 或 BSD-2-Clause)
%YAML 1.2
---
$id: http://devicetree.org/schemas/rtc/rtc-mxc.yaml#
$schema: http://devicetree.org/meta-schemas/core.yaml#

标题: i.MX 系统级芯片中的实时时钟

全部需满足:
  - $ref: rtc.yaml#

维护者:
  - Philippe Reynes <tremyfr@gmail.com>

属性:
  compatible:
    枚举:
      - fsl,imx1-rtc
      - fsl,imx21-rtc

  reg:
    最大项目数: 1

  interrupts:
    最大项目数: 1

  clocks:
    项目:
      - 描述: 输入参考
      - 描述: 系统级芯片的 RTC 时钟

  clock-names:
    项目:
      - 常量: ref
      - 常量: ipg

必需:
  - compatible
  - reg
  - interrupts
  - clocks
  - clock-names

额外属性: false

示例:
  - |
    #include <dt-bindings/clock/imx27-clock.h>

    rtc@10007000 {
        compatible = "fsl,imx21-rtc";
        reg = <0x10007000 0x1000>;
        interrupts = <22>;
        clocks = <&clks IMX27_CLK_CKIL>,
                 <&clks IMX27_CLK_RTC_IPG_GATE>;
        clock-names = "ref", "ipg";
    };
```

## Documentation/devicetree/bindings/rtc/rtc-mxc_v2_cn.yaml
~~~~yaml
```yaml
# SPDX-许可证标识符: (GPL-2.0-only 或 BSD-2-Clause)
%YAML 1.2
---
$id: http://devicetree.org/schemas/rtc/rtc-mxc_v2.yaml#
$schema: http://devicetree.org/meta-schemas/core.yaml#

title: i.MX53 安全实时时钟 (SRTC)

allOf:
  - $ref: rtc.yaml#

maintainers:
  - Patrick Bruenn <p.bruenn@beckhoff.com>

properties:
  compatible:
    enum:
      - fsl,imx53-rtc

  reg:
    maxItems: 1

  clocks:
    maxItems: 1

  interrupts:
    maxItems: 1

required:
  - compatible
  - reg
  - clocks
  - interrupts

additionalProperties: false

examples:
  - |
    #include <dt-bindings/clock/imx5-clock.h>

    rtc@53fa4000 {
        compatible = "fsl,imx53-rtc";
        reg = <0x53fa4000 0x4000>;
        interrupts = <24>;
        clocks = <&clks IMX5_CLK_SRTC_GATE>;
    };
```

请注意，上述内容是对原始 YAML 文件的直接中文翻译。其中的技术术语和格式保持不变以保持其原意。
~~~~

## Documentation/devicetree/bindings/rtc/rtc-omap_cn.txt
~~~~
实时钟 (RTC) 配置：

必需属性：
- compatible（兼容性）:
  - "ti,da830-rtc" - 对于类似 DA8xx 系统芯片 (SoC) 家族中使用的 RTC IP
  - "ti,am3352-rtc" - 对于类似 AM335x 系统芯片 (SoC) 家族中使用的 RTC IP。此 RTC IP 具有特殊的 WAKE-EN 寄存器来启用事件警报的唤醒生成。它还可以通过 `pmic_power_en` 引脚来控制外部电源管理集成电路 (PMIC)。
  - "ti,am4372-rtc" - 对于类似 AM437X 系统芯片 (SoC) 家族中使用的 RTC IP
- reg（寄存器范围）: RTC 寄存器集的地址范围
- interrupts（中断）: RTC 定时器和警报中断，按顺序排列

可选属性：
- system-power-controller（系统电源控制器）: RTC 是否通过 `pmic_power_en` 控制系统电源
- clocks（时钟）: 输入到 RTC 的任何内部或外部时钟
- clock-names（时钟名称）: 对应时钟的名称
- pinctrl-0（引脚控制器0）: 指向设备的引脚设置的 phandle
- pinctrl-names（引脚控制器名称）: 应为 "default"

可选子节点：
- 通用引脚控制器节点

必需的引脚控制器子节点属性：
- pins（引脚）: 要配置的 ext_wakeup 引脚名称

可选的引脚控制器子节点属性：
- input-enable（输入使能）: 启用 ext_wakeup
- ti,active-high（高电平有效）: 设置输入为高电平有效（默认为低电平有效）

示例：

```text
rtc@1c23000 { // RTC 设备在地址 0x1c23000 处
    compatible = "ti,da830-rtc"; // 与 DA830 RTC 兼容
    reg = <0x23000 0x1000>; // RTC 寄存器集的地址范围
    interrupts = <19 // RTC 定时器中断
                  19>; // RTC 警报中断
    interrupt-parent = <&intc>; // 中断控制器的 phandle
    system-power-controller; // RTC 控制系统电源
    clocks = <&clk_32k_rtc>, <&clk_32768_ck>; // RTC 的两个时钟源
    clock-names = "ext-clk", "int-clk"; // 时钟名称

    pinctrl-0 = <&ext_wakeup>; // 引脚控制器的 phandle
    pinctrl-names = "default"; // 引脚控制器名称

    ext_wakeup: ext-wakeup { // ext_wakeup 子节点
        pins = "ext_wakeup0"; // 配置的 ext_wakeup 引脚名称
        input-enable; // 启用 ext_wakeup
        ti,active-high; // 设置输入为高电平有效
    };
};
```
以上是针对特定的 TI 实时钟 (RTC) 配置的描述，包括必需的属性、可选属性以及示例配置。
~~~~

## Documentation/devicetree/bindings/rtc/rtc-opal_cn.txt
```
IBM OPAL 实时钟

必需属性：
- compatible: 应为 "ibm,opal-rtc"

可选属性：
- wakeup-source: 决定是否支持唤醒功能
		 （支持的遗留属性："has-tpo"）

示例：
	rtc {
		compatible = "ibm,opal-rtc";
		wakeup-source;
		phandle = <0x10000029>;
		linux,phandle = <0x10000029>;
	};
```

## Documentation/devicetree/bindings/rtc/rtc-palmas_cn.txt
~~~~
帕尔马斯 (Palmas) RTC 控制器绑定

必需属性：
- compatible:
  - "ti,palmas-rtc" 对于 RTC 控制器的帕尔马斯系列
- interrupts: 设备上 RTC 子模块的中断编号
可选属性：

- ti,backup-battery-chargeable: 帕尔马斯系列设备如 TPS65913 或
	TPS80036 支持备用电池为 RTC 供电，当主电池被移除或处于极低功耗状态时。备用电池可以是可充电的或不可充电的。此标志用于指示电池是否可充电。如果电池可充电，则驱动程序可以启用充电功能
- ti,backup-battery-charge-high-current: 启用备用电池的大电流充电。设备支持 < 100uA 和 > 100uA 的充电电流
大电流充电将大于 100uA。如果缺少此属性，则将以较小的电流（即 < 100uA）给电池充电
示例：
```
palmas: tps65913@58 {
	..
palmas_rtc: rtc {
			compatible = "ti,palmas-rtc";
			interrupt-parent = <&palmas>;
			interrupts = <8 0>;
			ti,backup-battery-chargeable;
			ti,backup-battery-charge-high-current;
		};
		..
};
```
这段文本描述了如何在硬件配置文件中定义一个与帕尔马斯 (Palmas) 系列芯片中的实时时钟 (RTC) 控制器相关的设备节点，并指定了该节点所需的属性以及一些可选属性。
~~~~

## Documentation/devicetree/bindings/rtc/rtc-st-lpc_cn.txt
```
STMicroelectronics 低功耗控制器 (LPC) - 实时时钟 (RTC)
===================================================

LPC 目前支持看门狗 或 实时时钟 或 时钟源
功能
[参见：../watchdog/st_lpc_wdt.txt 获取看门狗选项]
[参见：../timer/st,stih407-lpc 获取时钟源选项]

必需的属性

- compatible 	: 必须为："st,stih407-lpc"
- reg		: LPC 寄存器基地址 + 大小
- interrupts    : LPC 中断线路编号及其相关标志
- clocks	: LPC 设备使用的时钟（参见：../clock/clock-bindings.txt）
- st,lpc-mode	: LPC 可以运行三种模式之一：
                  ST_LPC_MODE_RTC    [0] 
                  ST_LPC_MODE_WDT    [1] 
                  ST_LPC_MODE_CLKSRC [2] 
		  必须选择一种（且仅限一种）模式

示例：
	lpc@fde05000 {
		compatible	= "st,stih407-lpc";
		reg		= <0xfde05000 0x1000>;
		clocks 		= <&clk_s_d3_flexgen CLK_LPC_0>;
		st,lpc-mode	= <ST_LPC_MODE_RTC>;
	};
```

## Documentation/devicetree/bindings/rtc/s3c-rtc_cn.yaml
```yaml
# SPDX-许可证标识符: GPL-2.0
%YAML 1.2
---
$id: http://devicetree.org/schemas/rtc/s3c-rtc.yaml#
$schema: http://devicetree.org/meta-schemas/core.yaml#

标题: Samsung S3C, S5P 和 Exynos 实时时钟控制器

维护者:
  - Krzysztof Kozlowski <krzk@kernel.org>

属性:
  compatible:
    oneOf:
      - 枚举:
          - samsung,s3c2410-rtc
          - samsung,s3c2416-rtc
          - samsung,s3c2443-rtc
          - samsung,s3c6410-rtc
      - items:
          - 枚举:
              - samsung,exynos7-rtc
              - samsung,exynos850-rtc
          - 常量: samsung,s3c6410-rtc
      - 常量: samsung,exynos3250-rtc
        过时: true

  reg:
    最大项数: 1

  clocks:
    描述:
      必须包含 RTC 时钟及其 phandle 和时钟标识符的列表。对于兼容 s3c6410 控制器的情况，还应包含一个源时钟。
    最小项数: 1
    最大项数: 2

  clock-names:
    描述:
      必须包含 "rtc"，对于兼容 s3c6410 的控制器还应包含 "rtc_src"。
    最小项数: 1
    最大项数: 2

  interrupts:
    描述:
      应指定两个中断编号到 CPU。第一个中断编号是 RTC 报警中断，第二个中断编号是 RTC 计时中断。表示一个中断所需的单元格数量取决于父中断控制器。
    最小项数: 2
    最大项数: 2

allOf:
  - $ref: rtc.yaml#
  - if:
      属性:
        compatible:
          包含:
            枚举:
              - samsung,s3c6410-rtc
              - samsung,exynos3250-rtc
    then:
      属性:
        clocks:
          最小项数: 2
          最大项数: 2
        clock-names:
          items:
            - 常量: rtc
            - 常量: rtc_src
    else:
      属性:
        clocks:
          最小项数: 1
          最大项数: 1
        clock-names:
          items:
            - 常量: rtc

未评估属性: false

示例:
  - |
    #include <dt-bindings/clock/exynos5420.h>
    #include <dt-bindings/clock/samsung,s2mps11.h>

    rtc@10070000 {
        compatible = "samsung,s3c6410-rtc";
        reg = <0x10070000 0x100>;
        interrupts = <0 44 4>, <0 45 4>;
        clocks = <&clock CLK_RTC>,
                 <&s2mps11_osc S2MPS11_CLK_AP>;
        clock-names = "rtc", "rtc_src";
    };
```

## Documentation/devicetree/bindings/rtc/st,m41t80_cn.yaml
~~~~yaml
```yaml
# SPDX-许可证标识符: (GPL-2.0-only 或 BSD-2-Clause)
%YAML 1.2
---
$id: http://devicetree.org/schemas/rtc/st,m41t80.yaml#
$schema: http://devicetree.org/meta-schemas/core.yaml#

title: ST M41T80 系列实时时钟（RTC）及其兼容设备

maintainers:
  - Alexandre Belloni <alexandre.belloni@bootlin.com>

properties:
  compatible:
    enum:
      - st,m41t62
      - st,m41t65
      - st,m41t80
      - st,m41t81
      - st,m41t81s
      - st,m41t82
      - st,m41t83
      - st,m41t84
      - st,m41t85
      - st,m41t87
      - microcrystal,rv4162

  reg:
    maxItems: 1

  interrupts:
    maxItems: 1

  "#clock-cells":
    const: 1

  clock-output-names:
    maxItems: 1
    description: 根据通用时钟绑定来覆盖默认的输出时钟名称
clock:
    类型: object
    $ref: /schemas/clock/fixed-clock.yaml#
    properties:
      clock-frequency:
        const: 32768

allOf:
  - $ref: rtc.yaml

unevaluatedProperties: false

required:
  - compatible
  - reg

examples:
  - |
    i2c {
      #address-cells = <1>;
      #size-cells = <0>;
      rtc@68 {
        compatible = "st,m41t80";
        reg = <0x68>;
        interrupt-parent = <&UIC0>;
        interrupts = <0x9 0x8>;

        clock {
          compatible = "fixed-clock";
          #clock-cells = <0>;
          clock-frequency = <32768>;
        };
      };
    };
```

请注意，部分注释和描述可能没有直接翻译，因为它们涉及特定的技术背景和上下文。此外，`$schema`, `$id`, `allOf`, `unevaluatedProperties`, 和 `$ref` 等字段使用了英文表示法，这是因为这些是 YAML 文件结构的一部分，通常在各种语言中都保持不变。
~~~~

## Documentation/devicetree/bindings/rtc/st,stm32-rtc_cn.yaml
```yaml
下面是给定文档的中文翻译：

# SPDX-许可证标识符: (GPL-2.0-only 或 BSD-2-Clause)
%YAML 1.2
---
$id: http://devicetree.org/schemas/rtc/st,stm32-rtc.yaml#
$schema: http://devicetree.org/meta-schemas/core.yaml#

标题: STMicroelectronics STM32 实时时钟

维护者:
  - Gabriel Fernandez <gabriel.fernandez@foss.st.com>

属性:
  compatible:
    枚举:
      - st,stm32-rtc
      - st,stm32h7-rtc
      - st,stm32mp1-rtc

  reg:
    最大项目数: 1

  clocks:
    最小项目数: 1
    最大项目数: 2

  clock-names:
    项目:
      - 常量: pclk
      - 常量: rtc_ck

  interrupts:
    最大项目数: 1

  st,syscfg:
    $ref: /schemas/types.yaml#/definitions/phandle-array
    项目:
      最小项目数: 3
      最大项目数: 3
    描述: |
      Phandle/偏移/掩码三元组。指向用于访问位于指定偏移处控制寄存器的pwrcfg的phandle，以及由掩码表示的dbp（禁用备份保护）位，这是禁用/启用备份域（RTC寄存器）写保护所必需的。

  assigned-clocks:
    描述: |
      替换默认的rtc_ck父时钟参考为rtc_ck时钟条目
    最大项目数: 1

  assigned-clock-parents:
    描述: |
      替换默认的rtc_ck父时钟phandle为新的rtc_ck父时钟
    最大项目数: 1

allOf:
  - 如果:
      属性:
        compatible:
          包含:
            常量: st,stm32-rtc

    那么:
      属性:
        clocks:
          最小项目数: 1
          最大项目数: 1

        clock-names: false

      必需:
        - st,syscfg

  - 如果:
      属性:
        compatible:
          包含:
            常量: st,stm32h7-rtc

    那么:
      属性:
        clocks:
          最小项目数: 2
          最大项目数: 2

      必需:
        - clock-names
        - st,syscfg

  - 如果:
      属性:
        compatible:
          包含:
            常量: st,stm32mp1-rtc

    那么:
      属性:
        clocks:
          最小项目数: 2
          最大项目数: 2

        assigned-clocks: false
        assigned-clock-parents: false

      必需:
        - clock-names

必需:
  - compatible
  - reg
  - clocks
  - interrupts

额外属性: false

示例:
  - |
    #include <dt-bindings/mfd/stm32f4-rcc.h>
    #include <dt-bindings/clock/stm32fx-clock.h>
    rtc@40002800 {
      compatible = "st,stm32-rtc";
      reg = <0x40002800 0x400>;
      clocks = <&rcc 1 CLK_RTC>;
      assigned-clocks = <&rcc 1 CLK_RTC>;
      assigned-clock-parents = <&rcc 1 CLK_LSE>;
      interrupt-parent = <&exti>;
      interrupts = <17 1>;
      st,syscfg = <&pwrcfg 0x00 0x100>;
    };

  - |
    #include <dt-bindings/interrupt-controller/arm-gic.h>
    #include <dt-bindings/clock/stm32mp1-clks.h>
    rtc@5c004000 {
      compatible = "st,stm32mp1-rtc";
      reg = <0x5c004000 0x400>;
      clocks = <&rcc RTCAPB>, <&rcc RTC>;
      clock-names = "pclk", "rtc_ck";
      interrupts = <GIC_SPI 3 IRQ_TYPE_LEVEL_HIGH>;
    };
```
