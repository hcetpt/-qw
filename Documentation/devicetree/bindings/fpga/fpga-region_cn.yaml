## Documentation/devicetree/bindings/i2c/qcom,i2c-geni-qcom_cn.yaml
```yaml
# SPDX-许可证标识符: (GPL-2.0-only 或 BSD-2-Clause)
%YAML 1.2
---
$id: http://devicetree.org/schemas/i2c/qcom,i2c-geni-qcom.yaml#
$schema: http://devicetree.org/meta-schemas/core.yaml#

标题: Qualcomm 基于Geni的QUP I2C控制器

维护者:
  - Andy Gross <agross@kernel.org>
  - Bjorn Andersson <bjorn.andersson@linaro.org>

属性:
  compatible:
    枚举:
      - qcom,geni-i2c
      - qcom,geni-i2c-master-hub

  clocks:
    最少项目数: 1
    最大项目数: 2

  clock-names:
    最少项目数: 1
    最大项目数: 2

  clock-frequency:
    默认值: 100000

  dmas:
    最大项目数: 2

  dma-names:
    项目:
      - 常量: tx
      - 常量: rx

  interconnects:
    最少项目数: 2
    最大项目数: 3

  interconnect-names:
    最少项目数: 2
    最大项目数: 3

  interrupts:
    最大项目数: 1

  operating-points-v2: 真

  pinctrl-0: 真
  pinctrl-1: 真

  pinctrl-names:
    最少项目数: 1
    项目:
      - 常量: default
      - 常量: sleep

  power-domains:
    最大项目数: 1

  reg:
    最大项目数: 1

  required-opps:
    最大项目数: 1

必需:
  - compatible
  - interrupts
  - clocks
  - clock-names
  - reg

allOf:
  - $ref: /schemas/i2c/i2c-controller.yaml#
  - 如果:
      属性:
        compatible:
          包含:
            常量: qcom,geni-i2c-master-hub
    那么:
      属性:
        clocks:
          最少项目数: 2

        clock-names:
          项目:
            - 常量: se
            - 常量: core

        dmas: 假
        dma-names: 假

        interconnects:
          最大项目数: 2

        interconnect-names:
          项目:
            - 常量: qup-core
            - 常量: qup-config
    否则:
      属性:
        clocks:
          最大项目数: 1

        clock-names:
          常量: se

        interconnects:
          最少项目数: 3

        interconnect-names:
          项目:
            - 常量: qup-core
            - 常量: qup-config
            - 常量: qup-memory

未评估属性: 假

示例:
  - |
    #include <dt-bindings/interrupt-controller/arm-gic.h>
    #include <dt-bindings/clock/qcom,gcc-sc7180.h>
    #include <dt-bindings/interconnect/qcom,sc7180.h>
    #include <dt-bindings/power/qcom-rpmpd.h>

    i2c@88000 {
        compatible = "qcom,geni-i2c";
        reg = <0x00880000 0x4000>;
        clock-names = "se";
        clocks = <&gcc GCC_QUPV3_WRAP0_S0_CLK>;
        pinctrl-names = "default";
        pinctrl-0 = <&qup_i2c0_default>;
        interrupts = <GIC_SPI 601 IRQ_TYPE_LEVEL_HIGH>;
        #address-cells = <1>;
        #size-cells = <0>;
        interconnects = <&qup_virt MASTER_QUP_CORE_0 0 &qup_virt SLAVE_QUP_CORE_0 0>,
                        <&gem_noc MASTER_APPSS_PROC 0 &config_noc SLAVE_QUP_0 0>,
                        <&aggre1_noc MASTER_QUP_0 0 &mc_virt SLAVE_EBI1 0>;
        interconnect-names = "qup-core", "qup-config", "qup-memory";
        power-domains = <&rpmhpd SC7180_CX>;
        required-opps = <&rpmhpd_opp_low_svs>;
    };
```

## Documentation/devicetree/bindings/i2c/renesas,rzv2m_cn.yaml
~~~~yaml
```yaml
# SPDX-许可证标识符: (GPL-2.0-only 或 BSD-2-Clause)
%YAML 1.2
---
$id: http://devicetree.org/schemas/i2c/renesas,rzv2m.yaml#
$schema: http://devicetree.org/meta-schemas/core.yaml#

title: Renesas RZ/V2M I2C 总线接口

maintainers:
  - Fabrizio Castro <fabrizio.castro.jz@renesas.com>

allOf:
  - $ref: /schemas/i2c/i2c-controller.yaml#

properties:
  compatible:
    items:
      - enum:
          - renesas,r9a09g011-i2c  # RZ/V2M
      - const: renesas,rzv2m-i2c

  reg:
    maxItems: 1

  interrupts:
    items:
      - description: 数据传输/接收中断
      - description: 状态中断

  interrupt-names:
    items:
      - const: tia
      - const: tis

  clock-frequency:
    default: 100000
    enum: [ 100000, 400000 ]
    description:
      期望的 I2C 总线时钟频率 (Hz)

clocks:
    maxItems: 1

  power-domains:
    maxItems: 1

  resets:
    maxItems: 1

required:
  - compatible
  - reg
  - interrupts
  - interrupt-names
  - clocks
  - power-domains
  - resets
  - '#address-cells'
  - '#size-cells'

unevaluatedProperties: false

examples:
  - |
    #include <dt-bindings/clock/r9a09g011-cpg.h>
    #include <dt-bindings/interrupt-controller/arm-gic.h>

    i2c0: i2c@a4030000 {
        compatible = "renesas,r9a09g011-i2c", "renesas,rzv2m-i2c";
        reg = <0xa4030000 0x80>;
        interrupts = <GIC_SPI 232 IRQ_TYPE_EDGE_RISING>,
                     <GIC_SPI 236 IRQ_TYPE_EDGE_RISING>;
        interrupt-names = "tia", "tis";
        clocks = <&cpg CPG_MOD R9A09G011_IIC_PCLK0>;
        resets = <&cpg R9A09G011_IIC_GPA_PRESETN>;
        power-domains = <&cpg>;
        clock-frequency = <100000>;
        #address-cells = <1>;
        #size-cells = <0>;
    };
```
请注意，`clocks` 和 `interrupts` 的描述位置在翻译过程中进行了调整以符合中文阅读习惯。此外，“clocks”字段的中文翻译通常为“时钟”，但在这里为了保持与原文一致，依然使用了“clocks”。如果需要更准确的中文表达，可以将 “clocks” 替换为 “时钟”。
~~~~

## Documentation/devicetree/bindings/i2c/snps,designware-i2c_cn.yaml
```yaml
# SPDX-License-Identifier: GPL-2.0-only
%YAML 1.2
---
$id: http://devicetree.org/schemas/i2c/snps,designware-i2c.yaml#
$schema: http://devicetree.org/meta-schemas/core.yaml#

title: Synopsys DesignWare APB I2C 控制器

maintainers:
  - Jarkko Nikula <jarkko.nikula@linux.intel.com>

allOf:
  - $ref: /schemas/i2c/i2c-controller.yaml#
  - if:
      properties:
        compatible:
          not:
            contains:
              const: mscc,ocelot-i2c
    then:
      properties:
        reg:
          maxItems: 1

properties:
  compatible:
    oneOf:
      - description: 通用 Synopsys DesignWare I2C 控制器
        const: snps,designware-i2c
      - description: Microsemi Ocelot SoCs 的 I2C 控制器
        items:
          - const: mscc,ocelot-i2c
          - const: snps,designware-i2c
      - description: Baikal-T1 SoC 系统 I2C 控制器
        const: baikal,bt1-sys-i2c

  reg:
    minItems: 1
    items:
      - description: DW APB I2C 控制器的内存映射寄存器
      - description: |
          ICPU_CFG:TWI_DELAY 寄存器用于设置 SDA 保持时间。
          这些寄存器仅适用于 Ocelot I2C 控制器。

  interrupts:
    maxItems: 1

  clocks:
    minItems: 1
    items:
      - description: I2C 控制器参考时钟源
      - description: APB 接口时钟源

  clock-names:
    minItems: 1
    items:
      - const: ref
      - const: pclk

  resets:
    maxItems: 1

  clock-frequency:
    description: 预期的 I2C 总线时钟频率（赫兹）
    enum: [100000, 400000, 1000000, 3400000]
    default: 400000

  i2c-sda-hold-time-ns:
    description: |
      该属性应包含 SDA 保持时间（纳秒）。此选项仅在硬件块版本 1.11a 或更新版本或 Microsemi SoCs 中支持。
      
  i2c-scl-falling-time-ns:
    description: |
      该属性应包含 SCL 下降时间（纳秒）。
      此值用于计算 tLOW 周期。
    default: 300

  i2c-sda-falling-time-ns:
    description: |
      该属性应包含 SDA 下降时间（纳秒）。
      此值用于计算 tHIGH 周期。
    default: 300

  dmas:
    items:
      - description: TX DMA 通道
      - description: RX DMA 通道

  dma-names:
    items:
      - const: tx
      - const: rx

unevaluatedProperties: false

required:
  - compatible
  - reg
  - interrupts

examples:
  - |
    i2c@f0000 {
      compatible = "snps,designware-i2c";
      reg = <0xf0000 0x1000>;
      interrupts = <11>;
      clock-frequency = <400000>;
    };
  - |
    i2c@1120000 {
      compatible = "snps,designware-i2c";
      reg = <0x1120000 0x1000>;
      interrupts = <12 1>;
      clock-frequency = <400000>;
      i2c-sda-hold-time-ns = <300>;
      i2c-sda-falling-time-ns = <300>;
      i2c-scl-falling-time-ns = <300>;
    };
  - |
    i2c@2000 {
      compatible = "snps,designware-i2c";
      reg = <0x2000 0x100>;
      #address-cells = <1>;
      #size-cells = <0>;
      clock-frequency = <400000>;
      clocks = <&i2cclk>;
      interrupts = <0>;

      eeprom@64 {
        compatible = "atmel,24c02";
        reg = <0x64>;
      };
    };
  - |
    i2c@100400 {
      compatible = "mscc,ocelot-i2c", "snps,designware-i2c";
      reg = <0x100400 0x100>, <0x198 0x8>;
      pinctrl-0 = <&i2c_pins>;
      pinctrl-names = "default";
      interrupts = <8>;
      clocks = <&ahb_clk>;
    };
..
```
