## Documentation/devicetree/bindings/fpga/fpga-region_cn.yaml
```yaml
# SPDX-许可证标识符: GPL-2.0
%YAML 1.2
---
$id: http://devicetree.org/schemas/fpga/fpga-region.yaml#
$schema: http://devicetree.org/meta-schemas/core.yaml#

标题: FPGA 区域

维护者:
  - Michal Simek <michal.simek@amd.com>

描述: |
  内容
   - 引言
   - 术语
   - 序列
   - FPGA 区域
   - 支持的使用模型
   - 约束

  引言
  ============

  FPGA 区域在设备树中表示 FPGA 和 FPGA 的部分重构区域。FPGA 区域提供了一种方式来在设备树控制下编程 FPGA。
本文档涵盖了 FPGA 使用的一些关键点，并试图包括主要 FPGA 制造商使用的术语。本文档并不是任何制造商关于 FPGA 使用规格的替代品。

术语
  ===========

  完全重构
   * 整个 FPGA 被编程
部分重构 (PR)
   * FPGA 的一部分被重新编程，而 FPGA 的其余部分不受影响
* 并非所有 FPGA 都支持 PR
部分重构区域 (PRR)
   * 也称为“可重构分区”
   * PRR 是 FPGA 中用于重构的特定部分
* 基础（或静态）FPGA 图像可以创建一组 PRR，这些 PRR 后续可以独立地被多次重新编程
* 每个 PRR 的大小和具体位置是固定的
* 每个 PRR 边缘的连接是固定的。加载到 PRR 中的图像必须适合并且必须使用该区域连接的一个子集
* FPGA 内部的总线被分割，使得每个区域有自己的分支，可以独立地进行门控
Persona
   * 也称为“部分位流”
   * 是一个设计为加载到PRR（Partial Reconfiguration Region，部分重构区域）中的FPGA图像。可以设计任意数量的Persona以适应一个PRR，但每次只能加载一个。
   * Persona可能会创建更多的区域。
FPGA桥
   * FPGA桥用于在主机与FPGA之间对总线信号进行门控。
   * 在对FPGA编程时应禁用FPGA桥，以防止CPU总线上出现意外信号，并防止这些信号影响软逻辑。
   * FPGA桥可能是实际硬件或FPGA上的软逻辑。
   * 在全重构过程中，主机与FPGA之间的硬件桥会被禁用。
   * 在特定区域的部分重构过程中，将使用该区域的桥来门控总线。其他区域的通信不会受到影响。
   * 在某些实现中，FPGA管理器会透明地处理总线的门控，因此不需要在设备树中显示硬件FPGA桥。
   * 一个FPGA图像可以创建一组可重新编程的区域，每个区域都有自己的桥和自己分配的FPGA中的总线。
FPGA管理器
   * FPGA管理器是一个硬件模块，在主机处理器的控制下对FPGA进行编程。
### 基础图像

* 也称为“静态图像”
* 是一种专为对 FPGA 进行全重构而设计的 FPGA 图像
* 基础图像可能会设置一系列部分重构区域，这些区域可以在之后被重新编程

----------------       ----------------------------------
      |  主 CPU    |       |             FPGA               |
      |              |       |                                |
      |          ----|       |       -----------    --------  |
      |          | H |       |   |==>| 桥接器0 |<==>| PRR0 |  |
      |          | W |       |   -----------    --------  |
      |          |   |       |   |                            |
      |          | B |<=====>|<==|   -----------    --------  |
      |          | R |       |   |==>| 桥接器1 |<==>| PRR1 |  |
      |          | I |       |   -----------    --------  |
      |          | D |       |   |                            |
      |          | G |       |   |   -----------    --------  |
      |          | E |       |   |==>| 桥接器2 |<==>| PRR2 |  |
      |          ----|       |       -----------    --------  |
      |              |       |                                |
      ----------------       ----------------------------------

图 1：使用基础图像配置的 FPGA，该图像创建了三个区域。每个区域（PRR0-2）都拥有独立的总线分支，这些分支由 FPGA 中的软逻辑桥（桥接器0-2）独立控制。在系统其他部分继续运行的同时，每个 PRR 的内容可以独立地被重新编程。

### 序列
  ========

当应用针对 FPGA 区域的设备树覆盖时，FPGA 区域将执行以下操作：

1. 禁用相应的 FPGA 桥接器
2. 使用 FPGA 管理器编程 FPGA
3. 启用 FPGA 桥接器
4. 设备树覆盖被接受到活动树中
5. 子设备被填充

当移除覆盖时，子节点将被移除，并且 FPGA 区域会禁用桥接器。

### FPGA 区域
  ===========

FPGA 区域在设备树中表示 FPGA 和 FPGA 部分重构区域。FPGA 区域集成了在运行系统上进行编程和添加子设备所需的元素：

* FPGA 管理器
* FPGA 桥接器
* 编程所需特定于图像的信息
* 子节点

预期用途是设备树覆盖（DTO）可以在操作系统运行时用于重新编程 FPGA。
在活动设备树中存在的 FPGA 区域反映了当前状态。
如果活动树显示了 FPGA 区域下的 "firmware-name" 属性或子节点，则表明 FPGA 已经被编程。一个针对 FPGA 区域并添加 "firmware-name" 属性的 DTO 被视为重新编程 FPGA 的请求。重新编程成功后，该覆盖将被合并到活动树中。
设备树中的基础 FPGA 区域代表 FPGA 并支持完全重配置。它必须包含指向 FPGA 管理器的句柄。基础 FPGA 区域将是某个硬件桥的一个子节点（允许寄存器访问的桥）。如果在 FPGA 编程期间需要控制多个桥，则该区域也将包含指向其他硬件 FPGA 桥的句柄列表。
对于部分重配置 (PR)，每个 PR 区域都将拥有一个 FPGA 区域。
这些 FPGA 区域是 FPGA 桥的子节点，而这些桥又是基础 FPGA 区域的子节点。下面的“全重配置以添加 PR 区域”示例展示了这一点。
如果 FPGA 区域没有指定 FPGA 管理器，则会继承其祖先 FPGA 区域所指定的 FPGA 管理器。这既支持使用同一个 FPGA 管理器对整个 FPGA 进行管理的情况，也支持为每个区域使用不同 FPGA 管理器的情况。
FPGA 区域不会继承其祖先 FPGA 区域的桥。这可以防止在一个区域进行重配置时关闭其他活动区域上游的桥（参见上图）。在 PR 过程中，FPGA 的硬件桥保持启用状态。PR 区域的桥将是 FPGA 静态图像内的 FPGA 桥。
支持的使用模型
==================

在所有情况下，活动设备树必须包含 FPGA 管理器、FPGA 桥（如果有）以及一个 FPGA 区域。设备树覆盖的目标是 FPGA 区域。某些用法是特定于 FPGA 设备的。
* 没有 FPGA 桥
    在这种情况下，编程 FPGA 的 FPGA 管理器还负责处理背后的桥。对于完全重配置而言，不需要 FPGA 桥设备。
* 完全重构时带有硬件桥接
    在这种情况下，处理器与FPGA之间存在需要在完全重构过程中控制的硬件桥接。在应用覆盖层之前，实时设备树必须包含FPGA管理器、FPGA桥接和一个FPGA区域。FPGA区域是桥接的子节点，允许对FPGA进行寄存器访问。其他桥接可以在FPGA区域中的`fpga-bridges`属性或设备树覆盖层中列出。
* 带有FPGA内部桥接的部分重构
    在这种情况下，FPGA将有一个或多个可单独编程的部分重构区域（PRR），而FPGA的其余部分可以保持活动状态。为了管理这一点，FPGA内部需要存在桥接，以便在使能其他部分的总线时，能够对通往每个FPGA区域的总线进行门控。在执行任何部分重构之前，必须加载一个基础的FPGA图像，其中包含带有FPGA桥接的PRR。设备树应为每个PRR具有一个FPGA区域。
约束
  ===========
  
  完全描述实现部分重构所需的全部FPGA设计约束超出了本文档的范围[1] [2] [3]，但有几个要点值得快速提及：
- 一个人格（persona）必须拥有与其设计要进入的分区或区域边界连接相匹配的边界连接。
- 在编程期间，必须停止通过这些连接的事务，并且这些连接必须保持在一个固定的逻辑电平上。这可以通过存在于FPGA织物上的FPGA桥接来实现，在进行部分重构之前。

---
  [1] www.altera.com/content/dam/altera-www/global/en_US/pdfs/literature/ug/ug_partrecon.pdf
  [2] tspace.library.utoronto.ca/bitstream/1807/67932/1/Byma_Stuart_A_201411_MAS_thesis.pdf
  [3] https://www.xilinx.com/support/documentation/sw_manuals/xilinx14_1/ug702.pdf

属性：
  $nodename:
    模式: "^fpga-region(@.*|-([0-9]|[1-9][0-9]+))?$"

  兼容性:
    固定值: fpga-region

  地址空间:
    最大项目数: 1

  范围: 真
  "#address-cells": 真
  "#size-cells": 真

  config-complete-timeout-us:
    描述:
      FPGA从被编程后进入运行模式的最大时间（微秒）

encrypted-fpga-config:
    类型: 布尔值
    描述:
      如果位流已加密，则设置此属性

external-fpga-config:
    类型: 布尔值
    描述:
      如果FPGA已经在操作系统启动前配置好，则设置此属性

firmware-name:
    最大项目数: 1
    描述:
      应包含位于固件搜索路径上的FPGA图像文件名。如果此属性出现在实时设备树中，则表示FPGA已经使用该图像进行了编程
      如果此属性出现在针对FPGA区域的覆盖层中，则表示请求使用该图像对FPGA进行编程
Here's the translation into Chinese:

fpga-bridges:
    $ref: /schemas/types.yaml#/definitions/phandle-array
    description:
      应包含一系列指向在FPGA编程过程中需要控制的FPGA桥接器的phandle。如果包含父FPGA桥接器，此属性是可选的（当FPGA管理器处理桥接器时）。
      如果`fpga-region`是`fpga-bridge`的子节点，则列表中不应包含父桥接器。

fpga-mgr:
    $ref: /schemas/types.yaml#/definitions/phandle
    description:
      应包含指向FPGA管理器的phandle。子FPGA区域会从其祖先区域继承此属性。区域内的`fpga-mgr`属性将覆盖任何继承的FPGA管理器。

partial-fpga-config:
    类型: 布尔值
    description:
      如果要进行部分重构则设置该标志，否则进行全重构。

region-freeze-timeout-us:
    description:
      在区域被编程前等待桥接器成功禁用的最大时间（以微秒为单位）。

region-unfreeze-timeout-us:
    description:
      在区域被编程后等待桥接器成功启用的最大时间（以微秒为单位）。

必需字段:
  - compatible
  - fpga-mgr

附加属性:
  类型: 对象

示例:
  - |
    /*
     * 不带桥接器的全重构与设备树覆盖层
     */
    fpga_region0: fpga-region@0 {
      compatible = "fpga-region";
      reg = <0 0>;
      #address-cells = <1>;
      #size-cells = <1>;
      fpga-mgr = <&fpga_mgr0>;
      ranges = <0x10000000 0x20000000 0x10000000>;

      /* 设备树覆盖层包含: &fpga_region0 */
      firmware-name = "zynq-gpio.bin";
      gpio@40000000 {
        compatible = "xlnx,xps-gpio-1.00.a";
        reg = <0x40000000 0x10000>;
        gpio-controller;
        #gpio-cells = <2>;
      };
    };

  - |
    /*
     * 带有桥接器的部分重构
     */
    fpga_region1: fpga-region@0 {
      compatible = "fpga-region";
      reg = <0 0>;
      ranges;
      #address-cells = <1>;
      #size-cells = <1>;
      fpga-mgr = <&fpga_mgr1>;
      fpga-bridges = <&fpga_bridge1>;
      partial-fpga-config;

      /* 设备树覆盖层包含: &fpga_region1 */
      firmware-name = "zynq-gpio-partial.bin";
      clk: clock {
        compatible = "fixed-factor-clock";
        clocks = <&parentclk>;
        #clock-cells = <0>;
        clock-div = <2>;
        clock-mult = <1>;
      };
      axi {
        compatible = "simple-bus";
        #address-cells = <1>;
        #size-cells = <1>;
        ranges;
        gpio@40000000 {
          compatible = "xlnx,xps-gpio-1.00.a";
          reg = <0x40000000 0x10000>;
          #gpio-cells = <2>;
          gpio-controller;
          clocks = <&clk>;
        };
      };
    };
```

## Documentation/devicetree/bindings/fpga/intel-stratix10-soc-fpga-mgr_cn.txt
~~~~
Intel Stratix 10 SoC FPGA 管理器

所需属性：
fpga_mgr 节点具有以下必需属性，必须位于 firmware/svc 节点下
- compatible（兼容性）: 应包含 "intel,stratix10-soc-fpga-mgr" 或
	       "intel,agilex-soc-fpga-mgr"

示例：

```
firmware {  // 固件
	svc {  // 服务
		fpga_mgr: fpga-mgr {  // FPGA 管理器
			compatible = "intel,stratix10-soc-fpga-mgr";  // 兼容性
		};
	};
};
```
~~~~

## Documentation/devicetree/bindings/fpga/lattice,sysconfig_cn.yaml
```yaml
# SPDX-许可证标识符: (GPL-2.0-only 或 BSD-2-Clause)
%YAML 1.2
---
$id: http://devicetree.org/schemas/fpga/lattice,sysconfig.yaml#
$schema: http://devicetree.org/meta-schemas/core.yaml#

标题: Lattice Slave SPI sysCONFIG FPGA 管理器

维护者:
  - 弗拉基米尔·格奥尔吉耶夫 <v.georgiev@metrotek.ru>

描述: |
  Lattice 的 sysCONFIG 接口，主要用于 FPGA 配置等目的，具有 Slave 串行外设接口。仅支持全配置。
  对 ECP5 的编程是通过将未压缩的位流图像（.bit 格式）写入到 FPGA 的 SRAM 配置内存中完成的。
属性:
  compatible:
    枚举:
      - lattice,sysconfig-ecp5

  reg:
    最大项数: 1

  program-gpios:
    描述:
      连接到设备上 PROGRAMN（低电平有效）引脚的一个 GPIO 线
启动配置序列
最大项数: 1

  init-gpios:
    描述:
      连接到设备上 INITN（低电平有效）引脚的一个 GPIO 线
指示 FPGA 已准备好进行配置
最大项数: 1

  done-gpios:
    描述:
      连接到设备上 DONE（高电平有效）引脚的一个 GPIO 线
指示配置序列已完成
最大项数: 1

必需:
  - compatible
  - reg

allOf:
  - $ref: /schemas/spi/spi-peripheral-props.yaml

  - 如果:
      属性:
        compatible:
          包含:
            常量: lattice,sysconfig-ecp5
    则:
      属性:
        spi-max-frequency:
          最大值: 60000000

未评估属性: false

示例:
  - |
    #include <dt-bindings/gpio/gpio.h>

    spi {
        #address-cells = <1>;
        #size-cells = <0>;

        fpga-mgr@0 {
            compatible = "lattice,sysconfig-ecp5";
            reg = <0>;
            spi-max-frequency = <20000000>;
            program-gpios = <&gpio3 4 GPIO_ACTIVE_LOW>;
            init-gpios = <&gpio3 3 GPIO_ACTIVE_LOW>;
            done-gpios = <&gpio3 2 GPIO_ACTIVE_HIGH>;
        };
    };
```

## Documentation/devicetree/bindings/fpga/lattice-ice40-fpga-mgr_cn.txt
~~~~
### Lattice iCE40 FPGA 管理器

**必需属性：**
- `compatible`：应包含 `"lattice,ice40-fpga-mgr"`。
- `reg`：SPI 芯选信号。
- `spi-max-frequency`：最大 SPI 频率（>=1000000，<=25000000）。
- `cdone-gpios`：与 CDONE 引脚相连的 GPIO 输入。
- `reset-gpios`：与 CRESET_B 引脚相连的活动低电平 GPIO 输出。注意，在启动期间除非该 GPIO 保持为低电平状态，否则 FPGA 将进入 Master SPI 模式，并驱动 SCK 引脚产生时钟信号，这可能会阻塞总线上的其他设备直到固件加载完成。

**示例：**

```yaml
fpga: fpga@0 {
    compatible = "lattice,ice40-fpga-mgr";
    reg = <0>;
    spi-max-frequency = <1000000>;
    cdone-gpios = <&gpio 24 GPIO_ACTIVE_HIGH>;
    reset-gpios = <&gpio 22 GPIO_ACTIVE_LOW>;
};
```

此示例定义了一个 Lattice iCE40 FPGA 管理器节点，其中：
- 兼容性字段指定了 `"lattice,ice40-fpga-mgr"`。
- `reg` 字段设置 SPI 芯选信号为 0。
- `spi-max-frequency` 设置为 1000000 Hz。
- `cdone-gpios` 设置为 GPIO 24，且为高电平有效。
- `reset-gpios` 设置为 GPIO 22，且为低电平有效。
~~~~

## Documentation/devicetree/bindings/fpga/lattice-machxo2-spi_cn.txt
~~~~
Lattice MachXO2 从属 SPI FPGA 管理器

Lattice MachXO2 FPGA 支持通过“从属 SPI”接口加载位流的方法。
请参阅 www.latticesemi.com 上的《MachXO2编程与配置使用指南.pdf》。

必需属性：
- compatible：应包含 "lattice,machxo2-slave-spi"
- reg：FPGA 的 SPI 芯片选择

完整的 FPGA 配置示例：

```ini
fpga-region0 {
    compatible = "fpga-region";
    fpga-mgr = <&fpga_mgr_spi>;
    #address-cells = <0x1>;
    #size-cells = <0x1>;
};

spi1: spi@2000 {
    ..
fpga_mgr_spi: fpga-mgr@0 {
        compatible = "lattice,machxo2-slave-spi";
        spi-max-frequency = <8000000>;
        reg = <0>;
    };
};
```
请注意，上述代码示例中的某些部分（如 `spi@2000` 和其他具体实现细节）需要根据实际硬件配置进行调整。
~~~~

## Documentation/devicetree/bindings/fpga/microchip,mpf-spi-fpga-mgr_cn.yaml
~~~~yaml
```yaml
# SPDX-许可证标识符: (GPL-2.0-only 或 BSD-2-Clause)
%YAML 1.2
---
$id: http://devicetree.org/schemas/fpga/microchip,mpf-spi-fpga-mgr.yaml#
$schema: http://devicetree.org/meta-schemas/core.yaml#

title: Microchip Polarfire FPGA 管理器
maintainers:
  - Vladimir Georgiev <v.georgiev@metrotek.ru>

description:
  设备树绑定用于 Microchip Polarfire FPGA 管理器，使用从属 SPI 加载 .dat 格式的位流
properties:
  compatible:
    enum:
      - microchip,mpf-spi-fpga-mgr

  reg:
    description: SPI 芯片选择
    maxItems: 1

required:
  - compatible
  - reg

allOf:
  - $ref: /schemas/spi/spi-peripheral-props.yaml#

unevaluatedProperties: false

examples:
  - |
    spi {
            #address-cells = <1>;
            #size-cells = <0>;

            fpga_mgr@0 {
                    compatible = "microchip,mpf-spi-fpga-mgr";
                    spi-max-frequency = <20000000>;
                    reg = <0>;
            };
    };
```

这个 YAML 文件定义了一个设备树的绑定，用于描述如何在设备树中表示 Microchip Polarfire FPGA 的管理器，该管理器通过从属 SPI 接口加载 `.dat` 格式的位流文件。此外，文件还提供了一个示例配置，展示了如何在设备树中表示这个 FPGA 管理器。
~~~~

## Documentation/devicetree/bindings/fpga/xilinx-zynq-fpga-mgr_cn.yaml
~~~~yaml
```yaml
# SPDX-许可证标识符: (GPL-2.0 或 BSD-2-Clause)
%YAML 1.2
---
$id: http://devicetree.org/schemas/fpga/xilinx-zynq-fpga-mgr.yaml#
$schema: http://devicetree.org/meta-schemas/core.yaml#

title: Xilinx Zynq FPGA 管理器

maintainers:
  - Michal Simek <michal.simek@amd.com>

properties:
  compatible:
    const: xlnx,zynq-devcfg-1.0

  reg:
    maxItems: 1

  interrupts:
    maxItems: 1

  clocks:
    maxItems: 1

  clock-names:
    items:
      - const: ref_clk

  syscon:
    $ref: /schemas/types.yaml#/definitions/phandle
    description:
      Phandle 指向提供对 SLCR 寄存器访问权限的 syscon 块

required:
  - compatible
  - reg
  - clocks
  - clock-names
  - syscon

additionalProperties: false

examples:
  - |
    devcfg: devcfg@f8007000 {
      compatible = "xlnx,zynq-devcfg-1.0";
      reg = <0xf8007000 0x100>;
      interrupts = <0 8 4>;
      clocks = <&clkc 12>;
      clock-names = "ref_clk";
      syscon = <&slcr>;
    };
```

以上是将给定的 YAML 文件翻译为中文。需要注意的是，由于 YAML 是一种数据格式，并且其中包含特定的技术术语和语法，因此大部分内容保持了原有的英文形式以确保其正确性和可读性。只有必要的描述部分进行了翻译。
~~~~

## Documentation/devicetree/bindings/fpga/xlnx,fpga-selectmap_cn.yaml
```yaml
# SPDX-License-Identifier: (GPL-2.0-only OR BSD-2-Clause)
%YAML 1.2
---
$id: http://devicetree.org/schemas/fpga/xlnx,fpga-selectmap.yaml#
$schema: http://devicetree.org/meta-schemas/core.yaml#

title: Xilinx SelectMAP FPGA 接口

maintainers:
  - Charles Perry <charles.perry@savoirfairelinux.com>

description: |
  Xilinx 7 系列 FPGAs 支持一种通过名为 SelectMAP 接口的并行端口加载位流的方法。仅支持 x8 模式，其中数据在每个时钟上升沿以一个字节加载，每个字节的最高有效位（MSB）被呈现到 D0 引脚。
Datasheets:
    https://www.xilinx.com/support/documentation/user_guides/ug470_7Series_Config.pdf

allOf:
  - $ref: /schemas/memory-controllers/mc-peripheral-props.yaml#

properties:
  compatible:
    enum:
      - xlnx,fpga-xc7s-selectmap
      - xlnx,fpga-xc7a-selectmap
      - xlnx,fpga-xc7k-selectmap
      - xlnx,fpga-xc7v-selectmap

  reg:
    description:
      至少 1 字节的内存映射 IO
    maxItems: 1

  prog-gpios:
    description:
      配置引脚（在手册中称为 PROGRAM_B）
    maxItems: 1

  done-gpios:
    description:
      配置状态引脚（在手册中称为 DONE）
    maxItems: 1

  init-gpios:
    description:
      初始化状态和配置错误引脚（在手册中称为 INIT_B）
    maxItems: 1

  csi-gpios:
    description:
      芯片选择引脚（在手册中称为 CSI_B）
      如果总线控制器不提供芯片选择，则为可选 GPIO
    maxItems: 1

  rdwr-gpios:
    description:
      读/写选择引脚（在手册中称为 RDWR_B）
      如果总线控制器不提供此引脚，则为可选 GPIO
    maxItems: 1

required:
  - compatible
  - reg
  - prog-gpios
  - done-gpios
  - init-gpios

unevaluatedProperties: false

examples:
  - |
    #include <dt-bindings/gpio/gpio.h>
    fpga-mgr@8000000 {
      compatible = "xlnx,fpga-xc7s-selectmap";
      reg = <0x8000000 0x4>;
      prog-gpios = <&gpio5 5 GPIO_ACTIVE_LOW>;
      init-gpios = <&gpio5 8 GPIO_ACTIVE_LOW>;
      done-gpios = <&gpio2 30 GPIO_ACTIVE_HIGH>;
      csi-gpios = <&gpio3 19 GPIO_ACTIVE_LOW>;
      rdwr-gpios = <&gpio3 10 GPIO_ACTIVE_LOW>;
    };
```
