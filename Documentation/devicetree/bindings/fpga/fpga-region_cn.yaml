## Documentation/devicetree/bindings/fpga/xlnx,fpga-slave-serial_cn.yaml
```yaml
# SPDX-许可证标识符: (GPL-2.0-only 或 BSD-2-Clause)
%YAML 1.2
---
$id: http://devicetree.org/schemas/fpga/xlnx,fpga-slave-serial.yaml#
$schema: http://devicetree.org/meta-schemas/core.yaml#

title: Xilinx 从属串行 SPI FPGA

maintainers:
  - Nava Kishore Manne <nava.kishore.manne@amd.com>

description: |
  Xilinx Spartan-6 和 7 系列 FPGA 支持一种通过所谓的从属串行接口加载位流的方法。从属串行链路在技术上并不是 SPI，并且可能需要额外的电路才能与其他在同一总线上的 SPI 从属设备兼容。
数据手册:
    https://www.xilinx.com/support/documentation/user_guides/ug380.pdf
    https://www.xilinx.com/support/documentation/user_guides/ug470_7Series_Config.pdf
    https://www.xilinx.com/support/documentation/application_notes/xapp583-fpga-configuration.pdf

allOf:
  - $ref: /schemas/spi/spi-peripheral-props.yaml#

properties:
  compatible:
    enum:
      - xlnx,fpga-slave-serial

  spi-cpha: true

  spi-max-frequency:
    maximum: 60000000

  reg:
    maxItems: 1

  prog_b-gpios:
    description:
      配置引脚（在手册中称为 PROGRAM_B）
    maxItems: 1

  done-gpios:
    description:
      配置状态引脚（在手册中称为 DONE）
    maxItems: 1

  init-b-gpios:
    description:
      初始化状态和配置错误引脚（在手册中称为 INIT_B）
    maxItems: 1

required:
  - compatible
  - reg
  - prog_b-gpios
  - done-gpios
  - init-b-gpios

additionalProperties: false

examples:
  - |
    #include <dt-bindings/gpio/gpio.h>
    spi {
      #address-cells = <1>;
      #size-cells = <0>;
      fpga_mgr_spi: fpga-mgr@0 {
        compatible = "xlnx,fpga-slave-serial";
        spi-max-frequency = <60000000>;
        spi-cpha;
        reg = <0>;
        prog_b-gpios = <&gpio0 29 GPIO_ACTIVE_LOW>;
        init-b-gpios = <&gpio0 28 GPIO_ACTIVE_LOW>;
        done-gpios = <&gpio0 9 GPIO_ACTIVE_HIGH>;
      };
    };
..
```

## Documentation/devicetree/bindings/fpga/xlnx,pr-decoupler_cn.yaml
~~~~yaml
```yaml
# SPDX-License-Identifier: (GPL-2.0-only OR BSD-2-Clause)
%YAML 1.2
---
$id: http://devicetree.org/schemas/fpga/xlnx,pr-decoupler.yaml#
$schema: http://devicetree.org/meta-schemas/core.yaml#

title: Xilinx LogiCORE 部分重构解耦器/AXI关断管理软核

maintainers:
  - Nava Kishore Manne <nava.kishore.manne@amd.com>

allOf:
  - $ref: fpga-bridge.yaml#

description: |
  Xilinx LogiCORE 部分重构(PR)解耦器管理一个或多个解耦器/FPGA桥。控制器可以解耦/禁用这些桥，以阻止信号变化通过桥传输。控制器还可以耦合/启用这些桥，允许数据正常通过桥传输。
  Xilinx LogiCORE 动态功能交换(DFX) AXI关断管理软核与Xilinx LogiCORE pr-decoupler兼容。动态功能交换AXI关断管理器阻止AXI流量通过桥。当可重构分区正在进行动态重构时，控制器安全地处理AXI4MM和AXI4-Lite接口，防止由于DFX中断AXI事务而导致的系统死锁。
  请参阅本目录中的fpga-region.txt和fpga-bridge.txt文件，了解通用绑定部分和使用方法。

properties:
  compatible:
    oneOf:
      - items:
          - const: xlnx,pr-decoupler-1.00
          - const: xlnx,pr-decoupler
      - items:
          - const: xlnx,dfx-axi-shutdown-manager-1.00
          - const: xlnx,dfx-axi-shutdown-manager

  reg:
    maxItems: 1

  clocks:
    maxItems: 1

  clock-names:
    items:
      - const: aclk

required:
  - compatible
  - reg
  - clocks
  - clock-names

unevaluatedProperties: false

examples:
  - |
    fpga-bridge@100000450 {
      compatible = "xlnx,pr-decoupler-1.00", "xlnx,pr-decoupler";
      reg = <0x10000045 0x10>;
      clocks = <&clkc 15>;
      clock-names = "aclk";
    };
```

这段文本描述了一个Xilinx LogiCORE的部分重构解耦器（Partial Reconfig Decoupler）和AXI关断管理软核的设备树绑定定义。它用于管理FPGA中的部分重构流程，并确保在动态重构过程中系统的稳定性和安全性。
~~~~

## Documentation/devicetree/bindings/fpga/xlnx,versal-fpga_cn.yaml
```yaml
# SPDX-文件许可人: (GPL-2.0-only 或 BSD-2-Clause)
%YAML 1.2
---
$id: http://devicetree.org/schemas/fpga/xlnx,versal-fpga.yaml#
$schema: http://devicetree.org/meta-schemas/core.yaml#

title: Xilinx Versal FPGA 驱动程序
maintainers:
  - Nava Kishore Manne <nava.kishore.manne@amd.com>

description: |
  设备树中用于 Versal 系统级芯片的 Versal FPGA 绑定，通过固件接口进行控制。
properties:
  compatible:
    items:
      - enum:
          - xlnx,versal-fpga

required:
  - compatible

additionalProperties: false

examples:
  - |
    versal_fpga: versal-fpga {
         compatible = "xlnx,versal-fpga";
    };

..
```

## Documentation/devicetree/bindings/fpga/xlnx,zynqmp-pcap-fpga_cn.yaml
```yaml
下面是给定内容的中文翻译：

# SPDX-License-Identifier: (GPL-2.0 OR BSD-2-Clause)
%YAML 1.2
---
$id: http://devicetree.org/schemas/fpga/xlnx,zynqmp-pcap-fpga.yaml#
$schema: http://devicetree.org/meta-schemas/core.yaml#

title: Xilinx Zynq Ultrascale MPSoC FPGA 管理器

maintainers:
  - Nava Kishore Manne <nava.kishore.manne@amd.com>

description: |
  Zynq Ultrascale MPSoC FPGA 管理器的设备树绑定
  ZynqMP SoC 使用 PCAP（处理器配置端口）来配置可编程逻辑 (PL)。配置过程使用固件接口。

properties:
  compatible:
    const: xlnx,zynqmp-pcap-fpga

required:
  - compatible

additionalProperties: false

examples:
  - |
    firmware {
      zynqmp_firmware: zynqmp-firmware {
        zynqmp_pcap: pcap {
          compatible = "xlnx,zynqmp-pcap-fpga";
        };
      };
    };
..
```

## Documentation/devicetree/bindings/hwinfo/loongson,ls2k-chipid_cn.yaml
```yaml
# SPDX-许可证标识符: (GPL-2.0-only 或 BSD-2-Clause)
%YAML 1.2
---
$id: http://devicetree.org/schemas/hwinfo/loongson,ls2k-chipid.yaml#
$schema: http://devicetree.org/meta-schemas/core.yaml#

标题: Loongson-2 系统芯片 ChipID

维护者:
  - 朱银波 <zhuyinbo@loongson.cn>

描述: |
  Loongson-2 系统芯片包含许多组全局工具寄存器块，其中 ChipID 组寄存器记录了系统芯片的版本、特性、供应商和 ID 信息。
属性:
  compatible:
    常量: loongson,ls2k-chipid

  reg:
    最大项数: 1

  little-endian: true

必需:
  - compatible
  - reg

附加属性: false

示例:
  - |
    chipid: chipid@1fe00000 {
        compatible = "loongson,ls2k-chipid";
        reg = <0x1fe00000 0x3ffc>;
        little-endian;
    };
```

## Documentation/devicetree/bindings/hwinfo/renesas,prr_cn.yaml
```yaml
# SPDX-许可证标识符: (GPL-2.0-only 或 BSD-2-Clause)
%YAML 1.2
---
$id: http://devicetree.org/schemas/hwinfo/renesas,prr.yaml#
$schema: http://devicetree.org/meta-schemas/core.yaml#

title: Renesas 产品寄存器

maintainers:
  - Geert Uytterhoeven <geert+renesas@glider.be>
  - Magnus Damm <magnus.damm@gmail.com>

description: |
  大多数Renesas ARM系统级芯片(SoC)都具有一个产品寄存器或边界扫描ID寄存器，该寄存器允许检索SoC的产品和修订信息。
  如果存在，则应为此寄存器添加一个设备节点。
properties:
  compatible:
    enum:
      - renesas,prr
      - renesas,bsid
  reg:
    maxItems: 1

required:
  - compatible
  - reg

additionalProperties: false

examples:
  - |
    prr: chipid@ff000044 {
        compatible = "renesas,prr";
        reg = <0xff000044 4>;
    };
```

## Documentation/devicetree/bindings/hwinfo/samsung,exynos-chipid_cn.yaml
```yaml
# SPDX-许可证标识符: GPL-2.0
%YAML 1.2
---
$id: http://devicetree.org/schemas/hwinfo/samsung,exynos-chipid.yaml#
$schema: http://devicetree.org/meta-schemas/core.yaml#

标题: Samsung Exynos 系统级芯片系列的 Chipid 驱动程序

维护者:
  - Krzysztof Kozlowski <krzk@kernel.org>

属性:
  compatible:
    oneOf:
      - enum:
          - samsung,exynos4210-chipid
          - samsung,exynos850-chipid
      - items:
          - enum:
              - samsung,exynos5433-chipid
              - samsung,exynos7-chipid
          - const: samsung,exynos4210-chipid
      - items:
          - enum:
              - samsung,exynos7885-chipid
              - samsung,exynosautov9-chipid
              - samsung,exynosautov920-chipid
          - const: samsung,exynos850-chipid

  reg:
    maxItems: 1

  samsung,asv-bin:
    description:
      自适应供电电压档位选择。当 CHIPID 寄存器或 OTP 内存中缺少相关的信息时，可以使用它来确定 SoC 的 ASV 档位。
$ref: /schemas/types.yaml#/definitions/uint32
    enum: [0, 1, 2, 3]

必需:
  - compatible
  - reg

其他属性: false

示例:
  - |
    chipid@10000000 {
        compatible = "samsung,exynos4210-chipid";
        reg = <0x10000000 0x100>;
        samsung,asv-bin = <2>;
    };
```

## Documentation/devicetree/bindings/hwinfo/samsung,s5pv210-chipid_cn.yaml
~~~~yaml
```yaml
# SPDX-许可证标识符: GPL-2.0 或 BSD-2-Clause
%YAML 1.2
---
$id: http://devicetree.org/schemas/hwinfo/samsung,s5pv210-chipid.yaml#
$schema: http://devicetree.org/meta-schemas/core.yaml#

title: 三星 S5PV210 SoC 芯片ID

maintainers:
  - Krzysztof Kozlowski <krzk@kernel.org>

properties:
  compatible:
    const: samsung,s5pv210-chipid

  reg:
    maxItems: 1

required:
  - compatible
  - reg

additionalProperties: false

examples:
  - |
    chipid@e0000000 {
        compatible = "samsung,s5pv210-chipid";
        reg = <0xe0000000 0x1000>;
    };
```

以上是将提供的英文 YAML 文件翻译成了中文。请注意，由于 YAML 格式本身没有中文版本的规范，因此这里只是简单地将注释和字符串翻译为中文。其中的技术术语（如 `const`, `maxItems` 等）保持了原样，因为这些是 YAML 和 Device Tree 语法的一部分，并且通常不会被翻译。
~~~~

## Documentation/devicetree/bindings/hwinfo/ti,k3-socinfo_cn.yaml
```yaml
# SPDX-许可证标识符: (GPL-2.0-only 或 BSD-2-Clause)
%YAML 1.2
---
$id: http://devicetree.org/schemas/hwinfo/ti,k3-socinfo.yaml#
$schema: http://devicetree.org/meta-schemas/core.yaml#

title: 德州仪器 K3 多核系统级芯片平台的 chipid 模块

maintainers:
  - Tero Kristo <t-kristo@ti.com>
  - Nishanth Menon <nm@ti.com>

description: |
  德州仪器（ARM64）K3 多核系统级芯片平台的 chipid 模块由
  CTRLMMR_xxx_JTAGID 寄存器表示，该寄存器包含关于系统级芯片 ID 和修订版的信息。
properties:
  $nodename:
    pattern: "^chipid@[0-9a-f]+$"

  compatible:
    items:
      - const: ti,am654-chipid

  reg:
    maxItems: 1

required:
  - compatible
  - reg

additionalProperties: false

examples:
  - |
    chipid@43000014 {
        compatible = "ti,am654-chipid";
        reg = <0x43000014 0x4>;
    };
```

## Documentation/devicetree/bindings/i2c/i2c-img-scb_cn.txt
~~~~
### IMG Serial Control Bus (SCB) I²C 控制器

**所需属性：**
- `compatible`: "img,scb-i2c"
- `reg`: 控制器寄存器的物理基地址和长度
- `interrupts`: 控制器使用的中断编号
- `clocks`: 应包含 `clock-names` 中每一项对应的时钟指定符
- `clock-names`: 应包含以下条目：
    - "scb": 对于 SCB 核心时钟
    - "sys": 对于系统时钟
- `clock-frequency`: I²C 总线频率（单位：赫兹）
- `#address-cells`: 应为 `<1>`
- `#size-cells`: 应为 `<0>`

**示例：**

```dt
i2c@18100000 {
	compatible = "img,scb-i2c";
	reg = <0x18100000 0x200>; // 基地址为 0x18100000，长度为 0x200 字节
	interrupts = <GIC_SHARED 2 IRQ_TYPE_LEVEL_HIGH>; // 使用 GIC 共享中断，中断号为 2，类型为高电平触发
	clocks = <&i2c0_clk>, <&system_clk>; // 时钟引用 i2c0_clk 和 system_clk
	clock-names = "scb", "sys"; // 定义时钟名称 "scb" 和 "sys"
	clock-frequency = <400000>; // I²C 总线频率为 400 kHz
	#address-cells = <1>; // 地址单元数量为 1
	#size-cells = <0>; // 大小单元数量为 0
};
```
在这个示例中，`i2c@18100000` 表示一个位于物理地址 0x18100000 的 I²C 控制器。它使用了一个共享的 GIC 中断，中断号为 2，并且是高电平有效。此外，该控制器需要两个时钟：一个 SCB 核心时钟和一个系统时钟。I²C 总线的工作频率设置为 400 kHz。
~~~~

## Documentation/devicetree/bindings/i2c/i2c-mux-gpio_cn.yaml
```yaml
# SPDX-许可证标识符: GPL-2.0-only
%YAML 1.2
---
$id: http://devicetree.org/schemas/i2c/i2c-mux-gpio.yaml#
$schema: http://devicetree.org/meta-schemas/core.yaml#

标题: 基于GPIO的I2C总线多路复用器

维护者:
  - Wolfram Sang <wsa@kernel.org>

描述: |
  此绑定描述了一个使用GPIO来路由I2C信号的I2C总线多路复用器。
+-----+  +-----+
                                  | 设备 |  | 设备 |
    +------------+                +-----+  +-----+
    | SoC        |                   |        |
    |            |          /--------+--------+
    |   +------+ |  +------+    子总线A，当GPIO值设置为0时
    |   | I2C  |-|--| 多路复用器  |
    |   +------+ |  +--+---+    子总线B，当GPIO值设置为1时
    |            |     |    \----------+--------+--------+
    |   +------+ |     |               |        |        |
    |   | GPIO |-|-----+            +-----+  +-----+  +-----+
    |   +------+ |                  | 设备 |  | 设备 |  | 设备 |
    +------------+                  +-----+  +-----+  +-----+

  对于每个I2C子节点，将创建一个I2C子总线。它们将根据设备树中的顺序进行编号。
每当访问子总线上设备时，将使用GPIO列表输出相关节点reg属性中设置的值，其中列表中的第一个GPIO持有最低有效位的值。
如果定义了空闲状态，使用idle-state（可选）属性，则在不访问子总线上的设备时，GPIO将按照空闲值设置。
如果没有定义空闲状态，则在不访问子总线上的设备时，硬件中将保留最近使用的值。
属性:
  compatible:
    常量: i2c-mux-gpio

  i2c-parent:
    描述: 这个多路复用器主端口连接的I2C总线的phandle
    $ref: /schemas/types.yaml#/definitions/phandle

  mux-gpios:
    描述: 用于控制多路复用器的GPIO列表
    最小项数: 1
    最大项数: 4  # 应该足够

  idle-state:
    描述: 空闲时设置给多路复用器的值。如果没有给出值，默认为上次使用的值
$ref: /schemas/types.yaml#/definitions/uint32

allOf:
  - $ref: i2c-mux.yaml

未评估属性: false

必需:
  - compatible
  - i2c-parent
  - mux-gpios

示例:
  - |
    i2cmux {
      compatible = "i2c-mux-gpio";
      #address-cells = <1>;
      #size-cells = <0>;
      mux-gpios = <&gpio1 22 0>, <&gpio1 23 0>;
      i2c-parent = <&i2c1>;

      i2c@1 {
        reg = <1>;
        #address-cells = <1>;
        #size-cells = <0>;

        ssd1307: oled@3c {
          compatible = "solomon,ssd1307fb-i2c";
          reg = <0x3c>;
          pwms = <&pwm 4 3000>;
          reset-gpios = <&gpio2 7 1>;
        };
      };

      i2c@3 {
        reg = <3>;
        #address-cells = <1>;
        #size-cells = <0>;

        pca9555: pca9555@20 {
          compatible = "nxp,pca9555";
          gpio-controller;
          #gpio-cells = <2>;
          reg = <0x20>;
        };
      };
    };
```

## Documentation/devicetree/bindings/i2c/nxp,pnx-i2c_cn.yaml
~~~~yaml
```yaml
# SPDX-许可证标识符: (GPL-2.0-only 或 BSD-2-Clause)
%YAML 1.2
---
$id: http://devicetree.org/schemas/i2c/nxp,pnx-i2c.yaml#
$schema: http://devicetree.org/meta-schemas/core.yaml#

title: NXP PNX I2C 控制器

maintainers:
  - Animesh Agarwal <animeshagarwal28@gmail.com>

allOf:
  - $ref: /schemas/i2c/i2c-controller.yaml#

properties:
  compatible:
    const: nxp,pnx-i2c

  reg:
    maxItems: 1

  interrupts:
    maxItems: 1

  clock-frequency:
    default: 100000

required:
  - compatible
  - reg
  - interrupts
  - "#address-cells"
  - "#size-cells"

unevaluatedProperties: false

examples:
  - |
    i2c@400a0000 {
        compatible = "nxp,pnx-i2c";
        reg = <0x400a0000 0x100>;
        interrupt-parent = <&mic>;
        interrupts = <51 0>;
        #address-cells = <1>;
        #size-cells = <0>;
    };
```

此文档定义了NXP PNX I2C控制器在设备树中的描述规则，包括其兼容性字符串、寄存器地址、中断配置等属性。同时提供了示例说明如何在设备树源文件中定义一个PNX I2C控制器实例。
~~~~
