## Documentation/devicetree/bindings/mfd/mc13xxx_cn.txt
~~~~
飞思卡尔 MC13783/MC13892 电源管理集成电路 (PMIC)

必需属性：
- compatible：应为 "fsl,mc13783" 或 "fsl,mc13892"

可选属性：
- fsl,mc13xxx-uses-adc：指示是否使用了 ADC
- fsl,mc13xxx-uses-codec：指示是否使用了音频编解码器
- fsl,mc13xxx-uses-rtc：指示是否使用了 RTC
- fsl,mc13xxx-uses-touch：指示是否使用了触摸屏控制器

子节点：
- codec: 包含音频编解码器节点
- adc-port: 包含用于 ADC 的 PMIC SSI 端口号
- dac-port: 包含用于 DAC 的 PMIC SSI 端口号
- leds: 包含 LED 节点和初始寄存器值在 "led-control" 属性中。寄存器数量取决于所用 IC，对于 MC13783 是 6 个，对于 MC13892 是 4 个，对于 MC34708 是 1 个。参见数据手册了解这些寄存器位定义
- #address-cells: 必须是 1
- #size-cells: 必须是 0
每个 LED 节点都应包含 "reg"，其作为 LED 编号（如下所述）
可选属性 "label" 和 "linux,default-trigger" 在文档 `Documentation/devicetree/bindings/leds/common.txt` 中进行了描述
- regulators: 包含稳压器节点。稳压器通过其名称绑定，如下所示，并列出了启用它们的寄存器和位

MC13783 LED 编号：
    0  : 主显示屏
    1  : 辅显示屏
    2  : 键盘
    3  : 红色 1
    4  : 绿色 1
    5  : 蓝色 1
    6  : 红色 2
    7  : 绿色 2
    8  : 蓝色 2
    9  : 红色 3
    10 : 绿色 3
    11 : 蓝色 3

MC13892 LED 编号：
    0  : 主显示屏
    1  : 辅显示屏
    2  : 键盘
    3  : 红色
    4  : 绿色
    5  : 蓝色

MC34708 LED 编号：
    0  : 充电器红色
    1  : 充电器绿色

MC13783 稳压器：
    sw1a      : 稳压器 SW1A      （寄存器 24, 位 0）
    sw1b      : 稳压器 SW1B      （寄存器 25, 位 0）
    sw2a      : 稳压器 SW2A      （寄存器 26, 位 0）
    sw2b      : 稳压器 SW2B      （寄存器 27, 位 0）
    sw3       : 稳压器 SW3       （寄存器 29, 位 20）
    vaudio    : 稳压器 VAUDIO    （寄存器 32, 位 0）
    viohi     : 稳压器 VIOHI     （寄存器 32, 位 3）
    violo     : 稳压器 VIOLO     （寄存器 32, 位 6）
    vdig      : 稳压器 VDIG      （寄存器 32, 位 9）
    vgen      : 稳压器 VGEN      （寄存器 32, 位 12）
    vrfdig    : 稳压器 VRFDIG    （寄存器 32, 位 15）
    vrfref    : 稳压器 VRFREF    （寄存器 32, 位 18）
    vrfcp     : 稳压器 VRFCP     （寄存器 32, 位 21）
    vsim      : 稳压器 VSIM      （寄存器 33, 位 0）
    vesim     : 稳压器 VESIM     （寄存器 33, 位 3）
    vcam      : 稳压器 VCAM      （寄存器 33, 位 6）
    vrfbg     : 稳压器 VRFBG     （寄存器 33, 位 9）
    vvib      : 稳压器 VVIB      （寄存器 33, 位 11）
    vrf1      : 稳压器 VRF1      （寄存器 33, 位 12）
    vrf2      : 稳压器 VRF2      （寄存器 33, 位 15）
    vmmc1     : 稳压器 VMMC1     （寄存器 33, 位 18）
    vmmc2     : 稳压器 VMMC2     （寄存器 33, 位 21）
    gpo1      : 稳压器 GPO1      （寄存器 34, 位 6）
    gpo2      : 稳压器 GPO2      （寄存器 34, 位 8）
    gpo3      : 稳压器 GPO3      （寄存器 34, 位 10）
    gpo4      : 稳压器 GPO4      （寄存器 34, 位 12）
    pwgt1spi  : 稳压器 PWGT1SPI  （寄存器 34, 位 15）
    pwgt2spi  : 稳压器 PWGT2SPI  （寄存器 34, 位 16）

MC13892 稳压器：
    vcoincell : 稳压器 VCOINCELL （寄存器 13, 位 23）
    sw1       : 稳压器 SW1       （寄存器 24, 位 0）
    sw2       : 稳压器 SW2       （寄存器 25, 位 0）
    sw3       : 稳压器 SW3       （寄存器 26, 位 0）
    sw4       : 稳压器 SW4       （寄存器 27, 位 0）
    swbst     : 稳压器 SWBST     （寄存器 29, 位 20）
    vgen1     : 稳压器 VGEN1     （寄存器 32, 位 0）
    viohi     : 稳压器 VIOHI     （寄存器 32, 位 3）
    vdig      : 稳压器 VDIG      （寄存器 32, 位 9）
    vgen2     : 稳压器 VGEN2     （寄存器 32, 位 12）
    vpll      : 稳压器 VPLL      （寄存器 32, 位 15）
    vusb2     : 稳压器 VUSB2     （寄存器 32, 位 18）
    vgen3     : 稳压器 VGEN3     （寄存器 33, 位 0）
    vcam      : 稳压器 VCAM      （寄存器 33, 位 6）
    vvideo    : 稳压器 VVIDEO    （寄存器 33, 位 12）
    vaudio    : 稳压器 VAUDIO    （寄存器 33, 位 15）
    vsd       : 稳压器 VSD       （寄存器 33, 位 18）
    gpo1      : 稳压器 GPO1      （寄存器 34, 位 6）
    gpo2      : 稳压器 GPO2      （寄存器 34, 位 8）
    gpo3      : 稳压器 GPO3      （寄存器 34, 位 10）
    gpo4      : 稳压器 GPO4      （寄存器 34, 位 12）
    pwgt1spi  : 稳压器 PWGT1SPI  （寄存器 34, 位 15）
    pwgt2spi  : 稳压器 PWGT2SPI  （寄存器 34, 位 16）
    vusb      : 稳压器 VUSB      （寄存器 50, 位 3）

单个稳压器设备的绑定详情可以在以下文档中找到：
`Documentation/devicetree/bindings/regulator/regulator.txt`

示例：

```dt
ecspi@70010000 { /* ECSPI1 */
	cs-gpios = <&gpio4 24 0>, /* GPIO4_24 */
		   <&gpio4 25 0>; /* GPIO4_25 */

	pmic: mc13892@0 {
		#address-cells = <1>;
		#size-cells = <0>;
		compatible = "fsl,mc13892";
		spi-max-frequency = <6000000>;
		reg = <0>;
		interrupt-parent = <&gpio0>;
		interrupts = <8>;

		leds {
			#address-cells = <1>;
			#size-cells = <0>;
			led-control = <0x000 0x000 0x0e0 0x000>;

			sysled@3 {
				reg = <3>;
				label = "system:red:live";
				linux,default-trigger = "heartbeat";
			};
		};

		regulators {
			sw1_reg: mc13892__sw1 {
				regulator-min-microvolt = <600000>;
				regulator-max-microvolt = <1375000>;
				regulator-boot-on;
				regulator-always-on;
			};

			sw2_reg: mc13892__sw2 {
				regulator-min-microvolt = <900000>;
				regulator-max-microvolt = <1850000>;
				regulator-boot-on;
				regulator-always-on;
			};
		};
	};
};
```
~~~~

## Documentation/devicetree/bindings/mfd/mediatek,mt6357_cn.yaml
~~~~yaml
下面是给定内容的中文翻译：

```yaml
# SPDX 许可标识符: GPL-2.0-only 或 BSD-2-Clause
%YAML 1.2
---
$id: http://devicetree.org/schemas/mfd/mediatek,mt6357.yaml#
$schema: http://devicetree.org/meta-schemas/core.yaml#

标题: MediaTek MT6357 电源管理 IC

维护者:
  - Flora Fu <flora.fu@mediatek.com>
  - Alexandre Mergnat <amergnat@baylibre.com>

描述: |
  MT6357 是一款电源管理系统芯片，包含 5 个降压转换器和 29 个低压差稳压器 (LDO)。支持的功能包括音频编解码器、USB 充电、电量计、实时时钟等。

  这是一款多功能设备，具有以下子模块：
  - 稳压器
  - 实时时钟
  - 按键

  它通过专用硬件（称为 PMIC 包装器或 pwrap）使用 SPI 接口与主机控制器通信。此 MFD 是 pwrap 的子设备。
请参阅以下 pwrap 节点定义：
  文档/devicetree/bindings/soc/mediatek/mediatek,pwrap.yaml

属性:
  compatible:
    常量: mediatek,mt6357

  interrupts:
    最大项目数: 1

  interrupt-controller: true

  "#interrupt-cells":
    常量: 2

  regulators:
    类型: 对象
    $ref: /schemas/regulator/mediatek,mt6357-regulator.yaml
    不评估的属性: false
    描述:
      MT6357 降压转换器和 LDO 稳压器列表
rtc:
    类型: 对象
    $ref: /schemas/rtc/rtc.yaml#
    不评估的属性: false
    描述:
      MT6357 实时时钟
属性:
      compatible:
        常量: mediatek,mt6357-rtc
      start-year: true
    必需:
      - compatible

  keys:
    类型: 对象
    $ref: /schemas/input/mediatek,pmic-keys.yaml
    不评估的属性: false
    描述:
      MT6357 电源和主页按键
必需:
  - compatible
  - regulators

额外属性: false

示例:
  - |
    #include <dt-bindings/interrupt-controller/arm-gic.h>

    pwrap {
        pmic {
            compatible = "mediatek,mt6357";

            interrupt-parent = <&pio>;
            interrupts = <145 IRQ_TYPE_LEVEL_HIGH>;
            interrupt-controller;
            #interrupt-cells = <2>;

            regulators {
                mt6357_vproc_reg: buck-vproc {
                    regulator-name = "vproc";
                    regulator-min-microvolt = <518750>;
                    regulator-max-microvolt = <1312500>;
                    regulator-ramp-delay = <6250>;
                    regulator-enable-ramp-delay = <220>;
                    regulator-always-on;
                };

                // ..
mt6357_vusb33_reg: ldo-vusb33 {
                    regulator-name = "vusb33";
                    regulator-min-microvolt = <3000000>;
                    regulator-max-microvolt = <3100000>;
                    regulator-enable-ramp-delay = <264>;
                };
            };

            rtc {
                compatible = "mediatek,mt6357-rtc";
            };

            keys {
                compatible = "mediatek,mt6357-keys";
            };
        };
    };
```
```
~~~~

## Documentation/devicetree/bindings/mfd/mediatek,mt6360_cn.yaml
~~~~yaml
下面是给定内容的中文翻译：

```yaml
# SPDX-文件许可标识符: (GPL-2.0 或 BSD-2-Clause)
%YAML 1.2
---
$id: http://devicetree.org/schemas/mfd/mediatek,mt6360.yaml#
$schema: http://devicetree.org/meta-schemas/core.yaml#

标题: 来自联发科的 MT6360 PMIC

维护者:
  - Gene Chen <gene_chen@richtek.com>

描述: |
  MT6360 是一款带有以下子模块的电源管理 IC（PMIC）设备。
  它通过 I2C 接口与主机控制器相连。
  本文档描述了 PMIC 设备及其子模块的绑定。

属性:
  compatible:
    常量: mediatek,mt6360

  reg:
    最大项数: 1

  wakeup-source: 真

  interrupts:
    最大项数: 1

  interrupt-names:
    常量: IRQB

  interrupt-controller: 真

  "#interrupt-cells":
    常量: 1
    描述:
      第一个单元是中断请求（IRQ）编号

稳压器:
    $引用: /schemas/regulator/mt6360-regulator.yaml#

  充电器:
    $引用: /schemas/power/supply/mt6360_charger.yaml#

  tcpc:
    $引用: /schemas/usb/mediatek,mt6360-tcpc.yaml#

  led-controller:
    $引用: /schemas/leds/leds-mt6360.yaml#

必需:
  - compatible
  - reg
  - interrupts
  - interrupt-controller
  - "#interrupt-cells"

附加属性:
  类型: 对象

示例:
  - |
    #include <dt-bindings/interrupt-controller/irq.h>
    #include <dt-bindings/regulator/mediatek,mt6360-regulator.h>
    #include <dt-bindings/leds/common.h>
    #include <dt-bindings/usb/pd.h>
    i2c {
        #address-cells = <1>;
        #size-cells = <0>;

        pmic@34 {
            compatible = "mediatek,mt6360";
            reg = <0x34>;
            wakeup-source;
            interrupts-extended = <&gpio26 0 IRQ_TYPE_LEVEL_LOW>;
            interrupt-names = "IRQB";
            interrupt-controller;
            #interrupt-cells = <1>;

            mt6360_charger: charger {
                compatible = "mediatek,mt6360-chg";
                richtek,vinovp-microvolt = <14500000>;

                otg_vbus_regulator: usb-otg-vbus-regulator {
                    regulator-name = "usb-otg-vbus";
                    regulator-min-microvolt = <4425000>;
                    regulator-max-microvolt = <5825000>;
                };
            };

            led-controller {
                compatible = "mediatek,mt6360-led";
                #address-cells = <1>;
                #size-cells = <0>;

                multi-led@0 {
                    reg = <0>;
                    function = LED_FUNCTION_INDICATOR;
                    color = <LED_COLOR_ID_RGB>;
                    led-max-microamp = <24000>;
                    #address-cells = <1>;
                    #size-cells = <0>;
                    led@0 {
                        reg = <0>;
                        color = <LED_COLOR_ID_RED>;
                    };
                    led@1 {
                        reg = <1>;
                        color = <LED_COLOR_ID_GREEN>;
                    };
                    led@2 {
                        reg = <2>;
                        color = <LED_COLOR_ID_BLUE>;
                    };
                };
                led@3 {
                    reg = <3>;
                    function = LED_FUNCTION_INDICATOR;
                    color = <LED_COLOR_ID_WHITE>;
                    led-max-microamp = <150000>;
                };
                led@4 {
                    reg = <4>;
                    function = LED_FUNCTION_FLASH;
                    color = <LED_COLOR_ID_WHITE>;
                    function-enumerator = <1>;
                    led-max-microamp = <200000>;
                    flash-max-microamp = <500000>;
                    flash-max-timeout-us = <1024000>;
                };
                led@5 {
                    reg = <5>;
                    function = LED_FUNCTION_FLASH;
                    color = <LED_COLOR_ID_WHITE>;
                    function-enumerator = <2>;
                    led-max-microamp = <200000>;
                    flash-max-microamp = <500000>;
                    flash-max-timeout-us = <1024000>;
                };
            };

            regulators {
                compatible = "mediatek,mt6360-regulator";
                LDO_VIN3-supply = <&BUCK2>;
                buck1 {
                    regulator-name = "mt6360,buck1";
                    regulator-min-microvolt = <300000>;
                    regulator-max-microvolt = <1300000>;
                    regulator-allowed-modes = <MT6360_OPMODE_NORMAL
                         MT6360_OPMODE_LP
                         MT6360_OPMODE_ULP>;
                };
                BUCK2: buck2 {
                    regulator-name = "mt6360,buck2";
                    regulator-min-microvolt = <300000>;
                    regulator-max-microvolt = <1300000>;
                    regulator-allowed-modes = <MT6360_OPMODE_NORMAL
                         MT6360_OPMODE_LP
                         MT6360_OPMODE_ULP>;
                };
                ldo6 {
                    regulator-name = "mt6360,ldo6";
                    regulator-min-microvolt = <500000>;
                    regulator-max-microvolt = <2100000>;
                    regulator-allowed-modes = <MT6360_OPMODE_NORMAL
                         MT6360_OPMODE_LP>;
                };
                ldo7 {
                    regulator-name = "mt6360,ldo7";
                    regulator-min-microvolt = <500000>;
                    regulator-max-microvolt = <2100000>;
                    regulator-allowed-modes = <MT6360_OPMODE_NORMAL
                         MT6360_OPMODE_LP>;
                };
                ldo1 {
                    regulator-name = "mt6360,ldo1";
                    regulator-min-microvolt = <1200000>;
                    regulator-max-microvolt = <3600000>;
                    regulator-allowed-modes = <MT6360_OPMODE_NORMAL
                         MT6360_OPMODE_LP>;
                };
                ldo2 {
                    regulator-name = "mt6360,ldo2";
                    regulator-min-microvolt = <1200000>;
                    regulator-max-microvolt = <3600000>;
                    regulator-allowed-modes = <MT6360_OPMODE_NORMAL
                         MT6360_OPMODE_LP>;
                };
                ldo3 {
                    regulator-name = "mt6360,ldo3";
                    regulator-min-microvolt = <1200000>;
                    regulator-max-microvolt = <3600000>;
                    regulator-allowed-modes = <MT6360_OPMODE_NORMAL
                         MT6360_OPMODE_LP>;
                };
                ldo5 {
                    regulator-name = "mt6360,ldo5";
                    regulator-min-microvolt = <2700000>;
                    regulator-max-microvolt = <3600000>;
                    regulator-allowed-modes = <MT6360_OPMODE_NORMAL
                         MT6360_OPMODE_LP>;
                };
            };

            tcpc {
                compatible = "mediatek,mt6360-tcpc";
                interrupts-extended = <&gpio26 3 IRQ_TYPE_LEVEL_LOW>;
                interrupt-names = "PD_IRQB";

                connector {
                    compatible = "usb-c-connector";
                    label = "USB-C";
                    data-role = "dual";
                    power-role = "dual";
                    try-power-role = "sink";
                    source-pdos = <PDO_FIXED(5000, 1000, PDO_FIXED_DUAL_ROLE | PDO_FIXED_DATA_SWAP)>;
                    sink-pdos = <PDO_FIXED(5000, 2000, PDO_FIXED_DUAL_ROLE | PDO_FIXED_DATA_SWAP)>;
                    op-sink-microwatt = <10000000>;

                    ports {
                        #address-cells = <1>;
                        #size-cells = <0>;

                        port@0 {
                            reg = <0>;
                            endpoint {
                                remote-endpoint = <&usb_hs>;
                            };
                        };
                        port@1 {
                            reg = <1>;
                            endpoint {
                                remote-endpoint = <&usb_ss>;
                          };
                        };
                        port@2 {
                            reg = <2>;
                            endpoint {
                                remote-endpoint = <&dp_aux>;
                            };
                        };
                    };
                };
            };
        };
    };
```

请注意，由于 YAML 格式本身对中文字符的支持有限制，上述翻译尽量保持了原有格式的清晰度和可读性。
~~~~
