## Documentation/devicetree/bindings/mfd/mscc,ocelot_cn.yaml
```yaml
# SPDX-License-Identifier: GPL-2.0 OR BSD-2-Clause */
%YAML 1.2
---
$id: http://devicetree.org/schemas/mfd/mscc,ocelot.yaml#
$schema: http://devicetree.org/meta-schemas/core.yaml#

标题: Ocelot 外部控制的以太网交换机

维护者:
  - Colin Foster <colin.foster@in-advantage.com>

描述: |
  Ocelot 以太网交换机家族包含带有内部 CPU 的芯片 (VSC7513, VSC7514) 和不带内部 CPU 的芯片 (VSC7511, VSC7512)。所有交换机都有通过外部接口（如 SPI 或 PCIe）进行外部控制的选项。
  该交换机家族是一个多端口网络交换机，支持多种接口。此外，该设备可以执行引脚控制、MDIO 总线和外部 GPIO 扩展器的操作。

属性:
  compatible:
    枚举:
      - mscc,vsc7512

  reg:
    最大项数: 1

  "#address-cells":
    常量: 1

  "#size-cells":
    常量: 1

  spi-max-frequency:
    最大项数: 1

模式属性:
  "^pinctrl@[0-9a-f]+$":
    类型: 对象
    $ref: /schemas/pinctrl/mscc,ocelot-pinctrl.yaml

  "^gpio@[0-9a-f]+$":
    类型: 对象
    $ref: /schemas/pinctrl/microchip,sparx5-sgpio.yaml
    属性:
      compatible:
        枚举:
          - mscc,ocelot-sgpio

  "^mdio@[0-9a-f]+$":
    类型: 对象
    $ref: /schemas/net/mscc,miim.yaml
    属性:
      compatible:
        枚举:
          - mscc,ocelot-miim

  "^ethernet-switch@[0-9a-f]+$":
    类型: 对象
    $ref: /schemas/net/mscc,vsc7514-switch.yaml
    不评估属性: false
    属性:
      compatible:
        枚举:
          - mscc,vsc7512-switch

必需:
  - compatible
  - reg
  - '#address-cells'
  - '#size-cells'

额外属性: false

示例:
  - |
    ocelot_clock: ocelot-clock {
          compatible = "fixed-clock";
          #clock-cells = <0>;
          clock-frequency = <125000000>;
      };

    spi {
        #address-cells = <1>;
        #size-cells = <0>;

        soc@0 {
            compatible = "mscc,vsc7512";
            spi-max-frequency = <2500000>;
            reg = <0>;
            #address-cells = <1>;
            #size-cells = <1>;

            mdio@7107009c {
                compatible = "mscc,ocelot-miim";
                #address-cells = <1>;
                #size-cells = <0>;
                reg = <0x7107009c 0x24>;

                sw_phy0: ethernet-phy@0 {
                    reg = <0x0>;
                };
            };

            mdio@710700c0 {
                compatible = "mscc,ocelot-miim";
                pinctrl-names = "default";
                pinctrl-0 = <&miim1_pins>;
                #address-cells = <1>;
                #size-cells = <0>;
                reg = <0x710700c0 0x24>;

                sw_phy4: ethernet-phy@4 {
                    reg = <0x4>;
                };
            };

            gpio: pinctrl@71070034 {
                compatible = "mscc,ocelot-pinctrl";
                gpio-controller;
                #gpio-cells = <2>;
                gpio-ranges = <&gpio 0 0 22>;
                reg = <0x71070034 0x6c>;

                sgpio_pins: sgpio-pins {
                    pins = "GPIO_0", "GPIO_1", "GPIO_2", "GPIO_3";
                    function = "sg0";
                };

                miim1_pins: miim1-pins {
                    pins = "GPIO_14", "GPIO_15";
                    function = "miim";
                };
            };

            gpio@710700f8 {
                compatible = "mscc,ocelot-sgpio";
                #address-cells = <1>;
                #size-cells = <0>;
                bus-frequency = <12500000>;
                clocks = <&ocelot_clock>;
                microchip,sgpio-port-ranges = <0 15>;
                pinctrl-names = "default";
                pinctrl-0 = <&sgpio_pins>;
                reg = <0x710700f8 0x100>;

                sgpio_in0: gpio@0 {
                    compatible = "microchip,sparx5-sgpio-bank";
                    reg = <0>;
                    gpio-controller;
                    #gpio-cells = <3>;
                    ngpios = <64>;
                };

                sgpio_out1: gpio@1 {
                    compatible = "microchip,sparx5-sgpio-bank";
                    reg = <1>;
                    gpio-controller;
                    #gpio-cells = <3>;
                    ngpios = <64>;
                };
            };
        };
    };

..
```

## Documentation/devicetree/bindings/mfd/mt6397_cn.txt
~~~~
MediaTek MT6397/MT6323 多功能设备驱动程序

MT6397/MT6323 是一款具有以下子模块的多功能设备：
- 电压调节器（Regulator）
- 实时时钟（RTC）
- 音频编解码器（Audio codec）
- 通用输入输出接口（GPIO）
- 时钟（Clock）
- 发光二极管（LED）
- 按键（Keys）
- 电源控制器（Power controller）

该设备通过SPI接口与主机控制器进行通信，使用一个名为PMIC封装器或pwrap的专有硬件。MT6397/MT6323多功能设备是pwrap的一个子设备。
有关pwrap节点定义，请参阅：`../soc/mediatek/mediatek,pwrap.yaml`

本文档描述了多功能设备及其子模块的绑定规则。
**必需属性**：
- `compatible`：
    - 对于PMIC MT6323，应为 `"mediatek,mt6323"`
    - 对于PMIC MT6331，应为 `"mediatek,mt6331"`
    - 对于PMIC MT6332，应为 `"mediatek,mt6331"` (假设与MT6331兼容)
    - 对于PMIC MT6357，应为 `"mediatek,mt6357"`
    - 对于PMIC MT6358，应为 `"mediatek,mt6358"`
    - 对于PMIC MT6359，应为 `"mediatek,mt6359"`
    - 对于PMIC MT6366，应为 `"mediatek,mt6366"` 或 `"mediatek,mt6358"` (假设与MT6358兼容)
    - 对于PMIC MT6397，应为 `"mediatek,mt6397"`

**可选子节点**：

- `rtc`（实时时钟）：
    - 必需属性：应为以下之一
        - `compatible`: `"mediatek,mt6323-rtc"`
        - `compatible`: `"mediatek,mt6331-rtc"`
        - `compatible`: `"mediatek,mt6358-rtc"`
        - `compatible`: `"mediatek,mt6397-rtc"`
    - 详情请参阅 `../rtc/rtc-mt6397.txt`
- `regulators`（电压调节器）：
    - 必需属性：
        - `compatible`: `"mediatek,mt6323-regulator"`，详情请参阅 `../regulator/mt6323-regulator.txt`
        - `compatible`: `"mediatek,mt6358-regulator"`，详情请参阅 `../regulator/mt6358-regulator.txt`
        - `compatible`: `"mediatek,mt6366-regulator"` 或 `"mediatek-mt6358-regulator"`，详情请参阅 `../regulator/mt6358-regulator.txt`
        - `compatible`: `"mediatek,mt6397-regulator"`，详情请参阅 `../regulator/mt6397-regulator.txt`
- `codec`（音频编解码器）：
    - 必需属性：
        - `compatible`: `"mediatek,mt6397-codec"` 或 `"mediatek,mt6358-sound"`
- `clk`（时钟）：
    - 必需属性：
        - `compatible`: `"mediatek,mt6397-clk"`
- `led`（发光二极管）：
    - 必需属性：
        - `compatible`: `"mediatek,mt6323-led"`，详情请参阅 `../leds/leds-mt6323.txt`
- `keys`（按键）：
    - 必需属性：应为以下之一
        - `compatible`: `"mediatek,mt6323-keys"`
        - `compatible`: `"mediatek,mt6331-keys"`
        - `compatible`: `"mediatek,mt6397-keys"`
    - 详情请参阅 `../input/mtk-pmic-keys.txt`
- `power-controller`（电源控制器）：
    - 必需属性：
        - `compatible`: `"mediatek,mt6323-pwrc"`，详情请参阅 `../power/reset/mt6323-poweroff.txt`
- `pin-controller`（引脚控制器）：
    - 必需属性：
        - `compatible`: `"mediatek,mt6397-pinctrl"`，详情请参阅 `../pinctrl/pinctrl-mt65xx.txt`

**示例**：
```yaml
pwrap: pwrap@1000f000 {
    compatible = "mediatek,mt8135-pwrap";

    ...

    pmic {
        compatible = "mediatek,mt6397";

        codec: mt6397codec {
            compatible = "mediatek,mt6397-codec";
        };

        regulators {
            compatible = "mediatek,mt6397-regulator";

            mt6397_vpca15_reg: buck_vpca15 {
                regulator-compatible = "buck_vpca15";
                regulator-name = "vpca15";
                regulator-min-microvolt = <850000>;
                regulator-max-microvolt = <1400000>;
                regulator-ramp-delay = <12500>;
                regulator-always-on;
            };

            mt6397_vgp4_reg: ldo_vgp4 {
                regulator-compatible = "ldo_vgp4";
                regulator-name = "vgp4";
                regulator-min-microvolt = <1200000>;
                regulator-max-microvolt = <3300000>;
                regulator-enable-ramp-delay = <218>;
            };
        };
    };
};
```
~~~~

## Documentation/devicetree/bindings/mfd/mxs-lradc_cn.txt
~~~~
Freescale MXS LRADC 设备驱动程序

必需属性：
- compatible: 对于 i.MX23 SoC 应为 "fsl,imx23-lradc"，对于 i.MX28 SoC 应为 "fsl,imx28-lradc"
- reg: 设备寄存器集的地址和长度
- interrupts: 包含 LRADC 中断

可选属性：
- fsl,lradc-touchscreen-wires: 用于将触摸屏连接到 LRADC 的电线数量。有效值为 4 或 5。如果未设置此属性，则触摸屏被禁用。仅 i.MX28 SoC 支持 5 根线。
- fsl,ave-ctrl: 每个方向用于计算平均值的样本数。允许的值为 1 到 32，默认值为 4
- fsl,ave-delay: 连续样本之间的延迟。允许的值为 2 到 2048。当 'fsl,ave-ctrl' 大于 1 时使用，计数频率为 2 kHz，默认值为 2（= 1 毫秒）
- fsl,settling: 平板开关切换到下一个样本之间的延迟。允许的值为 1 到 2047。计数频率为 2 kHz，默认值为 10（= 5 毫秒）

i.MX23 SoC 示例：

``` 
lradc@80050000 {
	compatible = "fsl,imx23-lradc";
	reg = <0x80050000 0x2000>;
	interrupts = <36 37 38 39 40 41 42 43 44>;
	fsl,lradc-touchscreen-wires = <4>;
	fsl,ave-ctrl = <4>;
	fsl,ave-delay = <2>;
	fsl,settling = <10>;
};
```

i.MX28 SoC 示例：

``` 
lradc@80050000 {
	compatible = "fsl,imx28-lradc";
	reg = <0x80050000 0x2000>;
	interrupts = <10 14 15 16 17 18 19 20 21 22 23 24 25>;
	fsl,lradc-touchscreen-wires = <5>;
	fsl,ave-ctrl = <4>;
	fsl,ave-delay = <2>;
	fsl,settling = <10>;
};
```
~~~~

## Documentation/devicetree/bindings/mfd/netronix,ntxec_cn.yaml
```yaml
# SPDX-许可证标识符: (GPL-2.0-only 或 BSD-2-Clause)
%YAML 1.2
---
$id: http://devicetree.org/schemas/mfd/netronix,ntxec.yaml#
$schema: http://devicetree.org/meta-schemas/core.yaml#

标题: Netronix 嵌入式控制器

维护者:
  - Jonathan Neuschäfer <j.neuschaefer@gmx.net>

描述: |
  此 EC 存在于多个品牌的电子书阅读器中（例如 Kobo、Tolino），并且
  通常实现为 TI MSP430 微控制器。
属性:
  compatible:
    常量: netronix,ntxec

  reg:
    项目:
      - 描述: EC 的 I2C 地址

  system-power-controller:
    类型: 布尔值
    描述: 参见 Documentation/devicetree/bindings/power/power-controller.txt

  interrupts:
    最小项数: 1
    描述:
      EC 可以通过 GPIO 线发送中断信号

  "#pwm-cells":
    常量: 2
    描述: |
      PWM 规定中的单元格数量
      支持以下 PWM 通道：
        - 0: 由寄存器 0xa1-0xa7 控制的 PWM 通道

必需:
  - compatible
  - reg

额外属性: false

示例:
  - |
    #include <dt-bindings/interrupt-controller/irq.h>
    i2c {
            #address-cells = <1>;
            #size-cells = <0>;

            ec: embedded-controller@43 {
                    pinctrl-names = "default";
                    pinctrl-0 = <&pinctrl_ntxec>;

                    compatible = "netronix,ntxec";
                    reg = <0x43>;
                    system-power-controller;
                    interrupt-parent = <&gpio4>;
                    interrupts = <11 IRQ_TYPE_EDGE_FALLING>;
                    #pwm-cells = <2>;
            };
    };

    backlight {
            compatible = "pwm-backlight";
            pwms = <&ec 0 50000>;
            power-supply = <&backlight_regulator>;
    };

    backlight_regulator: regulator-dummy {
            compatible = "regulator-fixed";
            regulator-name = "backlight";
    };
```

## Documentation/devicetree/bindings/mfd/nxp,bbnsm_cn.yaml
```yaml
# SPDX-许可证标识符: (GPL-2.0-only 或 BSD-2-Clause)
%YAML 1.2
---
$id: http://devicetree.org/schemas/mfd/nxp,bbnsm.yaml#
$schema: http://devicetree.org/meta-schemas/core.yaml#

标题: NXP 电池支持的非安全模块

维护者:
  - Jacky Bai <ping.bai@nxp.com>

描述: |
  NXP BBNSM 作为系统中的非易失性逻辑和存储。
  它集成了实时时钟（RTC）与开/关控制功能。
  即使主芯片断电，RTC 也能保持其状态并继续计数。当实时计数器的最高有效 32 位与时间报警寄存器中的值匹配时，将生成一个时间报警。
  BBNSM 内部的开/关逻辑允许直接连接到电源管理 IC（PMIC）或其他电压调节设备。支持智能 PMIC 模式和简单 PMIC 模式。

属性:
  compatible:
    items:
      - 枚举:
          - nxp,imx93-bbnsm
      - 常量: syscon
      - 常量: simple-mfd

  reg:
    maxItems: 1

  rtc:
    类型: 对象
    $ref: /schemas/rtc/rtc.yaml#

    属性:
      compatible:
        枚举:
          - nxp,imx93-bbnsm-rtc

      interrupts:
        maxItems: 1

      start-year: 真

    必需:
      - compatible
      - interrupts

    额外属性: 错误

  pwrkey:
    类型: 对象
    $ref: /schemas/input/input.yaml#

    属性:
      compatible:
        枚举:
          - nxp,imx93-bbnsm-pwrkey

      interrupts:
        maxItems: 1

      linux,code: 真

    必需:
      - compatible
      - interrupts

    额外属性: 错误

必需:
  - compatible
  - reg
  - rtc
  - pwrkey

额外属性: 错误

示例:
  - |
    #include <dt-bindings/input/linux-event-codes.h>
    #include <dt-bindings/interrupt-controller/arm-gic.h>

    bbnsm: bbnsm@44440000 {
        compatible = "nxp,imx93-bbnsm", "syscon", "simple-mfd";
        reg = <0x44440000 0x10000>;

        bbnsm_rtc: rtc {
            compatible = "nxp,imx93-bbnsm-rtc";
            interrupts = <GIC_SPI 73 IRQ_TYPE_LEVEL_HIGH>;
        };

        bbnsm_pwrkey: pwrkey {
            compatible = "nxp,imx93-bbnsm-pwrkey";
            interrupts = <GIC_SPI 73 IRQ_TYPE_LEVEL_HIGH>;
            linux,code = <KEY_POWER>;
        };
    };
```

## Documentation/devicetree/bindings/mfd/omap-usb-host_cn.txt
```
OMAP 高速 USB 主机

必需属性：

- compatible（兼容性）：应为 "ti,usbhs-host"
- reg（寄存器）：应包含一个寄存器范围，即起始地址和长度
- ti,hwmods（硬件模块）：必须包含 "usb_host_hs"

可选属性：

- num-ports（端口数量）：USB 端口的数量。通常会从 IP 的修订寄存器中自动检测，但可以通过指定此属性来覆盖。当前最多支持 3 个端口。
- portN-mode（端口 N 模式）：字符串，用于指定端口 N 的模式，其中 N 可以是从 1 到 3。如果不指定端口模式，则该端口被视为未使用。当指定了端口模式时，它必须是以下之一：
  - "ehci-phy"
  - "ehci-tll"
  - "ehci-hsic"
  - "ohci-phy-6pin-datse0"
  - "ohci-phy-6pin-dpdm"
  - "ohci-phy-3pin-datse0"
  - "ohci-phy-4pin-dpdm"
  - "ohci-tll-6pin-datse0"
  - "ohci-tll-6pin-dpdm"
  - "ohci-tll-3pin-datse0"
  - "ohci-tll-4pin-dpdm"
  - "ohci-tll-2pin-datse0"
  - "ohci-tll-2pin-dpdm"

- single-ulpi-bypass（单 ULPI 绕过）：如果控制器包含一个单 ULPI 绕过控制位，则必须存在。例如，OMAP3 硅片版本 <= ES2.1。

- clocks（时钟）：每个时钟名称条目的 phandle 和时钟规范对的列表
- clock-names（时钟名称）：应包括：
  - 对于 OMAP3
    * "usbhost_120m_fck" —— 120MHz 功能时钟
  - 对于 OMAP4 及以上
    * "refclk_60m_int" —— 60MHz 内部参考时钟，用于 UTMI 时钟复用器
    * "refclk_60m_ext_p1" —— 60MHz 外部参考时钟，用于端口 1 的 UTMI 时钟复用器
    * "refclk_60m_ext_p2" —— 60MHz 外部参考时钟，用于端口 2 的 UTMI 时钟复用器
    * "utmi_p1_gfclk" —— 端口 1 的 UTMI 时钟复用器
    * "utmi_p2_gfclk" —— 端口 2 的 UTMI 时钟复用器
    * "usb_host_hs_utmi_p1_clk" —— 端口 1 的 UTMI 时钟门控
    * "usb_host_hs_utmi_p2_clk" —— 端口 2 的 UTMI 时钟门控
    * "usb_host_hs_utmi_p3_clk" —— 端口 3 的 UTMI 时钟门控
以下是对提供的英文内容的中文翻译：

* "usb_host_hs_hsic480m_p1_clk" - 端口 1 的 480MHz HSIC 时钟门控
* "usb_host_hs_hsic480m_p2_clk" - 端口 2 的 480MHz HSIC 时钟门控
* "usb_host_hs_hsic480m_p3_clk" - 端口 3 的 480MHz HSIC 时钟门控
* "usb_host_hs_hsic60m_p1_clk" - 端口 1 的 60MHz HSIC 时钟门控
* "usb_host_hs_hsic60m_p2_clk" - 端口 2 的 60MHz HSIC 时钟门控
* "usb_host_hs_hsic60m_p3_clk" - 端口 3 的 60MHz HSIC 时钟门控

如果存在子节点，则需要以下属性：

- #address-cells: 必须为 1
- #size-cells: 必须为 1
- ranges: 必须存在

子节点的属性：

OMAP 高速 USB 主机子系统包含 EHCI 和 OHCI 控制器。
请参阅文档/devicetree/bindings/usb/generic-ehci.yaml 和文档/devicetree/bindings/usb/generic-ohci.yaml
OMAP4 的示例：

usbhshost: usbhshost@4a064000 {
	compatible = "ti,usbhs-host";
	reg = <0x4a064000 0x800>;
	ti,hwmods = "usb_host_hs";
	#address-cells = <1>;
	#size-cells = <1>;
	ranges;

	usbhsohci: ohci@4a064800 {
		compatible = "ti,ohci-omap3";
		reg = <0x4a064800 0x400>;
		interrupt-parent = <&gic>;
		interrupts = <0 76 0x4>;
	};

	usbhsehci: ehci@4a064c00 {
		compatible = "ti,ehci-omap";
		reg = <0x4a064c00 0x400>;
		interrupt-parent = <&gic>;
		interrupts = <0 77 0x4>;
	};
};

&usbhshost {
	port1-mode = "ehci-phy";
	port2-mode = "ehci-tll";
	port3-mode = "ehci-phy";
};

&usbhsehci {
	phys = <&hsusb1_phy 0 &hsusb3_phy>;
};

这段内容描述了一个基于 OMAP（Open Multimedia Applications Platform）架构的高速 USB 主机子系统的设备树配置示例。该示例中包含了对 EHCI (Enhanced Host Controller Interface) 和 OHCI (Open Host Controller Interface) 控制器的配置信息，以及对端口模式和物理层配置的具体说明。
```

## Documentation/devicetree/bindings/mfd/omap-usb-tll_cn.txt
~~~~
OMAP HS USB 主机 TLL (收发器缺失接口)

必需属性：

- compatible（兼容性）: 应该是 "ti,usbhs-tll"
- reg（寄存器）: 应包含一个寄存器范围，即起始地址和长度
- interrupts（中断）: 应包含 TLL 模块的中断
- ti,hwmod：必须包含 "usb_tll_hs"

可选属性：

- clocks（时钟）: 一系列 phandle 和时钟指定符对，每个 clock-names 中的条目对应一个
- clock-names（时钟名称）: 应包括：
  * "usb_tll_hs_usb_ch0_clk" - USB TLL 通道 0 时钟
  * "usb_tll_hs_usb_ch1_clk" - USB TLL 通道 1 时钟
  * "usb_tll_hs_usb_ch2_clk" - USB TLL 通道 2 时钟

示例：

```device-tree
usbhstll: usbhstll@4a062000 {
	compatible = "ti,usbhs-tll";
	reg = <0x4a062000 0x1000>;
	interrupts = <78>;
	ti,hwmods = "usb_tll_hs";
};
```
请注意，`ti,hwmods` 的属性名在示例中写错了，应该是 `ti,hwmod`。
~~~~
