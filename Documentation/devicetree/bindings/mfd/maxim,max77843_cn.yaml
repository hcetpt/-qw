## Documentation/devicetree/bindings/mfd/palmas_cn.txt
~~~~
* Palmas 设备树绑定

TI Palmas 系列当前成员包括：
- twl6035 (palmas)
- twl6037 (palmas)
- tps65913 (palmas)
- tps65914 (palmas)
- tps659038
- tps65917

必需属性：
- `compatible`：应为列表中的一个
  - ti,twl6035
  - ti,twl6036
  - ti,twl6037
  - ti,tps65913
  - ti,tps65914
  - ti,tps80036
  - ti,tps659038
  - ti,tps65917
以及通用系列名称
  - ti,palmas
- `interrupt-controller`：Palmas 有其内部 IRQ
- `#interrupt-cells`：应设置为 2，用于 IRQ 编号和标志
  - 第一个单元是 IRQ 编号
  - 第二个单元是标志，编码为来自
    `Documentation/devicetree/bindings/interrupt-controller/interrupts.txt` 的触发掩码

可选属性：
- `ti,mux-padX`：将 pad 寄存器 X（1-2）设置为硬件的正确复用，如果不设置，则使用 OTP 中的复用

示例：

```plaintext
palmas {
	compatible = "ti,twl6035", "ti,palmas";
	reg = <0x48>
	interrupt-parent = <&intc>;
	interrupt-controller;
	#interrupt-cells = <2>;

	ti,mux-pad1 = <0>;
	ti,mux-pad2 = <0>;

	#address-cells = <1>;
	#size-cells = <0>;

	pmic {
		compatible = "ti,twl6035-pmic", "ti,palmas-pmic";
		...
};
}
```
以上内容描述了如何在设备树中定义与 TI Palmas 系列相关的配置。
~~~~

## Documentation/devicetree/bindings/mfd/qcom,pm8008_cn.yaml
```yaml
下面是给定内容的中文翻译：

# SPDX-文件许可人: GPL-2.0-only 或 BSD-2-Clause
%YAML 1.2
---
$id: http://devicetree.org/schemas/mfd/qcom,pm8008.yaml#
$schema: http://devicetree.org/meta-schemas/core.yaml#

标题: 高通技术公司 PM8008 电源管理集成电路

维护者:
  - Guru Das Srinagesh <quic_gurus@quicinc.com>

描述: |
  高通技术公司的 PM8008 是一款专为相机设计的电源管理集成电路 (PMIC)，它将所有必要的电源管理、看门狗以及接口支持功能集成到了单一芯片中。

属性:
  compatible:
    常量: qcom,pm8008

  reg:
    最大项目数: 1

  interrupts:
    最大项目数: 1

  reset-gpios:
    最大项目数: 1

  vdd-l1-l2-supply: 真
  vdd-l3-l4-supply: 真
  vdd-l5-supply: 真
  vdd-l6-supply: 真
  vdd-l7-supply: 真

  gpio-controller: 真

  "#gpio-cells":
    常量: 2

  gpio-ranges:
    最大项目数: 1

  interrupt-controller: 真

  "#interrupt-cells":
    常量: 2

  "#thermal-sensor-cells":
    常量: 0

  pinctrl:
    类型: 对象
    其他属性: 假
    模式属性:
      "-state$":
        类型: 对象

        全部满足:
          - $ref: /schemas/pinctrl/pinmux-node.yaml
          - $ref: /schemas/pinctrl/pincfg-node.yaml

        属性:
          pins:
            项:
              模式: "^gpio[12]$"

          function:
            项:
              - 枚举:
                  - normal

        必需:
          - pins
          - function

        其他属性: 假

  regulators:
    类型: 对象
    其他属性: 假
    模式属性:
      "^ldo[1-7]$":
        类型: 对象
        $ref: /schemas/regulator/regulator.yaml#
        未评估属性: 假

必需:
  - compatible
  - reg
  - interrupts
  - vdd-l1-l2-supply
  - vdd-l3-l4-supply
  - vdd-l5-supply
  - vdd-l6-supply
  - vdd-l7-supply
  - gpio-controller
  - "#gpio-cells"
  - gpio-ranges
  - interrupt-controller
  - "#interrupt-cells"
  - "#thermal-sensor-cells"

其他属性: 假

示例:
  - |
    #include <dt-bindings/gpio/gpio.h>
    #include <dt-bindings/interrupt-controller/irq.h>

    i2c {
      #address-cells = <1>;
      #size-cells = <0>;

      pm8008: pmic@8 {
        compatible = "qcom,pm8008";
        reg = <0x8>;

        interrupt-parent = <&tlmm>;
        interrupts = <32 IRQ_TYPE_EDGE_RISING>;

        reset-gpios = <&tlmm 42 GPIO_ACTIVE_LOW>;

        vdd-l1-l2-supply = <&vreg_s8b_1p2>;
        vdd-l3-l4-supply = <&vreg_s1b_1p8>;
        vdd-l5-supply = <&vreg_bob>;
        vdd-l6-supply = <&vreg_bob>;
        vdd-l7-supply = <&vreg_bob>;

        gpio-controller;
        #gpio-cells = <2>;
        gpio-ranges = <&pm8008 0 0 2>;

        interrupt-controller;
        #interrupt-cells = <2>;

        #thermal-sensor-cells = <0>;

        pinctrl {
          gpio-keys-state {
            pins = "gpio1";
            function = "normal";
          };
        };

        regulators {
          ldo1 {
            regulator-name = "vreg_l1";
            regulator-min-microvolt = <950000>;
            regulator-max-microvolt = <1300000>;
          };
        };
      };
    };

..
```

## Documentation/devicetree/bindings/mfd/qcom,spmi-pmic_cn.yaml
```yaml
# SPDX-License-Identifier: GPL-2.0-only
%YAML 1.2
---
$id: http://devicetree.org/schemas/mfd/qcom,spmi-pmic.yaml#
$schema: http://devicetree.org/meta-schemas/core.yaml#

title: 高通 SPMI PMICs 多功能设备

description: |
  某些高通 PMICs 与骁龙系列 SoC 结合使用时，通过 SPMI (系统电源管理接口) 总线进行交互。
  支持多个独立功能是通过将 16 位 SPMI 外设地址空间分割成 256 个更小的固定大小区域实现的，每个区域为 256 字节。
  一个功能可以占用这些固定大小寄存器区域中的一个或多个。
  高通 SPMI 系列包括 PM8941、PM8841、PMA8084、PM8998 和其他 PMICs。这些 PMICs 通过 SPMI 接口使用一种“QPNP”方案。
  QPNP 实质上是一种分区方案，用于将 SPMI 扩展寄存器空间分成逻辑块，并在这些区域内定义一组固定的寄存器位置，
  其中某些区域特别用于中断处理。
maintainers:
  - Stephen Boyd <sboyd@kernel.org>

properties:
  $nodename:
    oneOf:
      - pattern: '^pmic@.*$'
      - pattern: '^pm(a|s)?[0-9]*@.*$'
        deprecated: true

  compatible:
    items:
      - enum:
          - qcom,pm2250
          - qcom,pm6125
          - qcom,pm6150
          - qcom,pm6150l
          - qcom,pm6350
          - qcom,pm660
          - qcom,pm660l
          - qcom,pm7250b
          - qcom,pm7550ba
          - qcom,pm7325
          - qcom,pm8004
          - qcom,pm8005
          - qcom,pm8009
          - qcom,pm8010
          - qcom,pm8019
          - qcom,pm8028
          - qcom,pm8110
          - qcom,pm8150
          - qcom,pm8150b
          - qcom,pm8150c
          - qcom,pm8150l
          - qcom,pm8226
          - qcom,pm8350
          - qcom,pm8350b
          - qcom,pm8350c
          - qcom,pm8450
          - qcom,pm8550
          - qcom,pm8550b
          - qcom,pm8550ve
          - qcom,pm8550vs
          - qcom,pm8841
          - qcom,pm8909
          - qcom,pm8916
          - qcom,pm8937
          - qcom,pm8941
          - qcom,pm8950
          - qcom,pm8953
          - qcom,pm8994
          - qcom,pm8998
          - qcom,pma8084
          - qcom,pmc8180
          - qcom,pmc8180c
          - qcom,pmc8380
          - qcom,pmd9635
          - qcom,pmi632
          - qcom,pmi8950
          - qcom,pmi8962
          - qcom,pmi8994
          - qcom,pmi8998
          - qcom,pmk8002
          - qcom,pmk8350
          - qcom,pmk8550
          - qcom,pmm8155au
          - qcom,pmm8654au
          - qcom,pmp8074
          - qcom,pmr735a
          - qcom,pmr735b
          - qcom,pmr735d
          - qcom,pms405
          - qcom,pmx55
          - qcom,pmx65
          - qcom,pmx75
          - qcom,smb2351
          - qcom,smb2360
      - const: qcom,spmi-pmic

  reg:
    minItems: 1
    maxItems: 2

  '#address-cells':
    const: 1

  '#size-cells':
    const: 0

  labibb:
    type: object
    $ref: /schemas/regulator/qcom-labibb-regulator.yaml#

  regulators:
    type: object
    $ref: /schemas/regulator/qcom,spmi-regulator.yaml#

  pwm:
    type: object
    $ref: /schemas/leds/leds-qcom-lpg.yaml#

patternProperties:
  "^adc@[0-9a-f]+$":
    type: object
    oneOf:
      - $ref: /schemas/iio/adc/qcom,spmi-iadc.yaml#
      - $ref: /schemas/iio/adc/qcom,spmi-rradc.yaml#
      - $ref: /schemas/iio/adc/qcom,spmi-vadc.yaml#

  "^adc-tm@[0-9a-f]+$":
    type: object
    # ref 取决于 compatible，见下方 allOf

  "^audio-codec@[0-9a-f]+$":
    type: object
    $ref: /schemas/sound/qcom,pm8916-wcd-analog-codec.yaml#

  "^battery@[0-9a-f]+$":
    type: object
    oneOf:
      - $ref: /schemas/power/supply/qcom,pm8916-bms-vm.yaml#

  "^charger@[0-9a-f]+$":
    type: object
    oneOf:
      - $ref: /schemas/power/supply/qcom,pm8916-lbc.yaml#
      - $ref: /schemas/power/supply/qcom,pm8941-charger.yaml#
      - $ref: /schemas/power/supply/qcom,pm8941-coincell.yaml#
      - $ref: /schemas/power/supply/qcom,pmi8998-charger.yaml#

  "gpio@[0-9a-f]+$":
    type: object
    $ref: /schemas/pinctrl/qcom,pmic-gpio.yaml#

  "^led-controller@[0-9a-f]+$":
    type: object
    $ref: /schemas/leds/qcom,spmi-flash-led.yaml#

  "^nvram@[0-9a-f]+$":
    type: object
    $ref: /schemas/nvmem/qcom,spmi-sdam.yaml#

  "^pbs@[0-9a-f]+$":
    type: object
    $ref: /schemas/soc/qcom/qcom,pbs.yaml#

  "phy@[0-9a-f]+$":
    type: object
    $ref: /schemas/phy/qcom,snps-eusb2-repeater.yaml#

  "pon@[0-9a-f]+$":
    type: object
    $ref: /schemas/power/reset/qcom,pon.yaml#

  "^rtc@[0-9a-f]+$":
    type: object
    $ref: /schemas/rtc/qcom-pm8xxx-rtc.yaml#

  "^temp-alarm@[0-9a-f]+$":
    type: object
    $ref: /schemas/thermal/qcom,spmi-temp-alarm.yaml#

  "^typec@[0-9a-f]+$":
    type: object
    $ref: /schemas/usb/qcom,pmic-typec.yaml#

  "^usb-detect@[0-9a-f]+$":
    type: object
    $ref: /schemas/extcon/qcom,pm8941-misc.yaml#

  "^usb-vbus-regulator@[0-9a-f]+$":
    type: object
    $ref: /schemas/regulator/qcom,usb-vbus-regulator.yaml#

  "^vibrator@[0-9a-f]+$":
    type: object
    $ref: /schemas/input/qcom,pm8xxx-vib.yaml#

  "^mpps@[0-9a-f]+$":
    type: object
    $ref: /schemas/pinctrl/qcom,pmic-mpp.yaml#

  "(.*)?(wled|leds)@[0-9a-f]+$":
    type: object
    $ref: /schemas/leds/backlight/qcom-wled.yaml#
    unevaluatedProperties: false

required:
  - compatible
  - reg

allOf:
  - if:
      properties:
        compatible:
          contains:
            enum:
              - qcom,pm8998
    then:
      patternProperties:
        "^adc-tm@[0-9a-f]+$":
          $ref: /schemas/thermal/qcom-spmi-adc-tm-hc.yaml#
    else:
      patternProperties:
        "^adc-tm@[0-9a-f]+$":
          $ref: /schemas/thermal/qcom-spmi-adc-tm5.yaml#

additionalProperties: false

examples:
  - |
    #include <dt-bindings/spmi/spmi.h>
    #include <dt-bindings/interrupt-controller/irq.h>
    #include <dt-bindings/interrupt-controller/arm-gic.h>

    spmi@c440000 {
        compatible = "qcom,spmi-pmic-arb";
        reg = <0x0c440000 0x1100>,
              <0x0c600000 0x2000000>,
              <0x0e600000 0x100000>,
              <0x0e700000 0xa0000>,
              <0x0c40a000 0x26000>;
        reg-names = "core", "chnls", "obsrvr", "intr", "cnfg";
        interrupt-names = "periph_irq";
        interrupts = <GIC_SPI 481 IRQ_TYPE_LEVEL_HIGH>;
        qcom,ee = <0>;
        qcom,channel = <0>;
        #address-cells = <2>;
        #size-cells = <0>;
        interrupt-controller;
        #interrupt-cells = <4>;

        pmic@2 {
            compatible = "qcom,pmi8998", "qcom,spmi-pmic";
            reg = <0x2 SPMI_USID>;
            #address-cells = <1>;
            #size-cells = <0>;

            gpio@c000 {
                compatible = "qcom,pmi8998-gpio", "qcom,spmi-gpio";
                reg = <0xc000>;
                gpio-controller;
                gpio-ranges = <&pmi8998_gpio 0 0 14>;
                #gpio-cells = <2>;
                interrupt-controller;
                #interrupt-cells = <2>;
            };
        };
    };

  - |
    #include <dt-bindings/input/input.h>
    #include <dt-bindings/interrupt-controller/irq.h>
    #include <dt-bindings/interrupt-controller/arm-gic.h>
    #include <dt-bindings/iio/qcom,spmi-vadc.h>
    #include <dt-bindings/spmi/spmi.h>

    pmic@0 {
        compatible = "qcom,pm6150", "qcom,spmi-pmic";
        reg = <0x0 SPMI_USID>;
        #address-cells = <1>;
        #size-cells = <0>;

        pon@800 {
            compatible = "qcom,pm8998-pon";
            reg = <0x800>;
            mode-bootloader = <0x2>;
            mode-recovery = <0x1>;

            pwrkey {
                compatible = "qcom,pm8941-pwrkey";
                interrupts = <0x0 0x8 0 IRQ_TYPE_EDGE_BOTH>;
                debounce = <15625>;
                bias-pull-up;
                linux,code = <KEY_POWER>;
            };
        };

        temp-alarm@2400 {
            compatible = "qcom,spmi-temp-alarm";
            reg = <0x2400>;
            interrupts = <0x0 0x24 0x0 IRQ_TYPE_EDGE_RISING>;
            io-channels = <&pm6150_adc ADC5_DIE_TEMP>;
            io-channel-names = "thermal";
            #thermal-sensor-cells = <0>;
        };

        pm6150_adc: adc@3100 {
            compatible = "qcom,spmi-adc5";
            reg = <0x3100>;
            interrupts = <0x0 0x31 0x0 IRQ_TYPE_EDGE_RISING>;
            #address-cells = <1>;
            #size-cells = <0>;
            #io-channel-cells = <1>;

            channel@6 {
                reg = <ADC5_DIE_TEMP>;
                label = "die_temp";
            };

            channel@4f {
                reg = <ADC5_AMUX_THM3_100K_PU>;
                qcom,ratiometric;
                qcom,hw-settle-time = <200>;
            };
        };

        adc-tm@3500 {
            compatible = "qcom,spmi-adc-tm5";
            reg = <0x3500>;
            interrupts = <0x0 0x35 0x0 IRQ_TYPE_EDGE_RISING>;
            #thermal-sensor-cells = <1>;
            #address-cells = <1>;
            #size-cells = <0>;

            charger-thermistor@0 {
                reg = <0>;
                io-channels = <&pm6150_adc ADC5_AMUX_THM3_100K_PU>;
                qcom,ratiometric;
                qcom,hw-settle-time-us = <200>;
            };
        };

        gpio@c000 {
            compatible = "qcom,pm6150-gpio", "qcom,spmi-gpio";
            reg = <0xc000>;
            gpio-controller;
            gpio-ranges = <&pm6150_gpio 0 0 10>;
            #gpio-cells = <2>;
            interrupt-controller;
            #interrupt-cells = <2>;
        };
    };
```

## Documentation/devicetree/bindings/mfd/qcom,tcsr_cn.yaml
```yaml
# SPDX-许可证标识符: GPL-2.0-only 或 BSD-2-Clause
%YAML 1.2
---
$id: http://devicetree.org/schemas/mfd/qcom,tcsr.yaml#
$schema: http://devicetree.org/meta-schemas/core.yaml#

title: 高通顶级控制与状态寄存器

maintainers:
  - Bjorn Andersson <bjorn.andersson@linaro.org>

description:
  高通设备有一组寄存器，为它们的外设提供各种控制和状态功能。

properties:
  compatible:
    items:
      - enum:
          - qcom,msm8976-tcsr
          - qcom,msm8998-tcsr
          - qcom,qcm2290-tcsr
          - qcom,qcs404-tcsr
          - qcom,sc7180-tcsr
          - qcom,sc7280-tcsr
          - qcom,sc8280xp-tcsr
          - qcom,sdm630-tcsr
          - qcom,sdm845-tcsr
          - qcom,sdx55-tcsr
          - qcom,sdx65-tcsr
          - qcom,sdx75-tcsr
          - qcom,sm4450-tcsr
          - qcom,sm6115-tcsr
          - qcom,sm8150-tcsr
          - qcom,sm8250-tcsr
          - qcom,sm8350-tcsr
          - qcom,sm8450-tcsr
          - qcom,tcsr-apq8064
          - qcom,tcsr-apq8084
          - qcom,tcsr-ipq5332
          - qcom,tcsr-ipq6018
          - qcom,tcsr-ipq8064
          - qcom,tcsr-ipq8074
          - qcom,tcsr-ipq9574
          - qcom,tcsr-mdm9615
          - qcom,tcsr-msm8226
          - qcom,tcsr-msm8660
          - qcom,tcsr-msm8916
          - qcom,tcsr-msm8953
          - qcom,tcsr-msm8960
          - qcom,tcsr-msm8974
          - qcom,tcsr-msm8996
      - const: syscon

  reg:
    maxItems: 1

required:
  - compatible
  - reg

additionalProperties: false

examples:
  - |
    syscon@1a400000 {
        compatible = "qcom,tcsr-msm8960", "syscon";
        reg = <0x1a400000 0x100>;
    };
```
