## Documentation/devicetree/bindings/mfd/qcom-pm8xxx_cn.yaml
~~~~yaml
```yaml
# SPDX-许可证标识符: (GPL-2.0 或 BSD-2-Clause)
%YAML 1.2
---
$id: http://devicetree.org/schemas/mfd/qcom-pm8xxx.yaml#
$schema: http://devicetree.org/meta-schemas/core.yaml#

标题: 高通 PM8xxx PMIC 多功能设备

维护者:
  - Satya Priya <quic_c_skakit@quicinc.com>

描述: |
  PM8xxx 系列电源管理 IC 用于为高通系统级芯片提供受控电压和其他各种功能。

属性:
  compatible:
    oneOf:
      - enum:
          - qcom,pm8058
          - qcom,pm8821
          - qcom,pm8901
          - qcom,pm8921
      - items:
          - enum:
              - qcom,pm8018
          - const: qcom,pm8921

  reg:
    maxItems: 1

  '#address-cells':
    const: 1

  '#size-cells':
    const: 0

  interrupts:
    maxItems: 1

  '#interrupt-cells':
    const: 2

  interrupt-controller: true

模式匹配属性:
  "gpio@[0-9a-f]+$":
    类型: object
    $ref: /schemas/pinctrl/qcom,pmic-gpio.yaml#

  "keypad@[0-9a-f]+$":
    类型: object
    $ref: /schemas/input/qcom,pm8921-keypad.yaml#

  "led@[0-9a-f]+$":
    类型: object
    $ref: /schemas/leds/qcom,pm8058-led.yaml#

  "mpps@[0-9a-f]+$":
    类型: object
    $ref: /schemas/pinctrl/qcom,pmic-mpp.yaml#

  "pwrkey@[0-9a-f]+$":
    类型: object
    $ref: /schemas/input/qcom,pm8921-pwrkey.yaml#

  "rtc@[0-9a-f]+$":
    类型: object
    $ref: /schemas/rtc/qcom-pm8xxx-rtc.yaml#

  "vibrator@[0-9a-f]+$":
    类型: object
    $ref: /schemas/input/qcom,pm8xxx-vib.yaml#

  "xoadc@[0-9a-f]+$":
    类型: object
    $ref: /schemas/iio/adc/qcom,pm8018-adc.yaml#

必需:
  - compatible
  - '#address-cells'
  - '#size-cells'
  - interrupts
  - '#interrupt-cells'
  - interrupt-controller

其他属性: false

示例:
  - |
    #include <dt-bindings/interrupt-controller/irq.h>
    ssbi {
      #address-cells = <1>;
      #size-cells = <0>;
      pmic@0 {
        compatible = "qcom,pm8921";
        reg = <0>;
        #address-cells = <1>;
        #size-cells = <0>;
        interrupt-controller;
        #interrupt-cells = <2>;

        interrupt-parent = <&tlmm>;
        interrupts = <32 IRQ_TYPE_EDGE_RISING>;
      };
    };
..
```

请注意，某些关键词如 `标题`, `维护者`, `描述`, `属性`, `模式匹配属性`, `必需`, `其他属性` 和 `示例` 是为了适应中文环境而添加的，并非 YAML 标准的一部分。在实际使用中，请使用英文关键词，并按照 YAML 规范书写文档。
~~~~

## Documentation/devicetree/bindings/mfd/qriox_cn.txt
~~~~
KEYMILE qrio 板载控制 CPLD

qrio 是一个多功能设备，它基于 kmp204x 设计来控制 KEYMILE 的板卡。
它包含了一个复位控制器、看门狗定时器、LEDs 和两个具有中断请求（IRQ）能力的 GPIO 模块。
必需的属性：
- 兼容性: "keymile,qriox"
- reg: 在父级本地总线上的访问（芯片选择、芯片选择内的偏移量、大小）

示例：

``` 
board-control@1,0 { 
    compatible = "keymile,qriox"; 
    reg = <1 0 0x80>; 
};
```

这段示例描述了如何在一个设备树中定义一个名为 `board-control` 的设备，并位于地址 `1,0` 处。这个设备与 `"keymile,qriox"` 兼容，表示它是一个 KEYMILE 的 qrio 控制器。`reg` 属性指定了该设备在父级本地总线上的访问方式，这里使用的是芯片选择 1，在该芯片选择中的偏移量为 0，访问大小为 0x80。
~~~~

## Documentation/devicetree/bindings/mfd/retu_cn.txt
~~~~
针对诺基亚 Retu 和 Tahvo 多功能设备的设备树绑定

Retu 和 Tahvo 是在诺基亚互联网平板（770、N800 和 N810）上发现的多功能设备。Retu 芯片提供看门狗定时器和电源按钮控制功能，而 Tahvo 芯片提供 USB 收发器功能。
必需属性：
- compatible: "nokia,retu" 或 "nokia,tahvo"
- reg: 指定 ASIC 芯片的 CBUS 从地址
- interrupts: 设备连接到的中断线

示例：

```
cbus0 {
	compatible = "i2c-cbus-gpio";
	..
	retu: retu@1 {
		compatible = "nokia,retu";
		interrupt-parent = <&gpio4>;
		interrupts = <12 IRQ_TYPE_EDGE_RISING>;
		reg = <0x1>;
	};
};
```
~~~~
