## Documentation/devicetree/bindings/mfd/mediatek,mt6370_cn.yaml
~~~~yaml
下面是给定 YAML 文档的中文翻译：

```yaml
# SPDX-文件许可标识符: (GPL-2.0-only 或 BSD-2-Clause)
%YAML 1.2
---
$id: http://devicetree.org/schemas/mfd/mediatek,mt6370.yaml#
$schema: http://devicetree.org/meta-schemas/core.yaml#

标题: MediaTek MT6370 子电源管理 IC

维护者:
  - ChiYuan Huang <cy_huang@richtek.com>

描述: |
  MT6370 是一款高度集成的智能电源管理 IC，其中包括单节锂离子/锂聚合物开关式电池充电器、USB Type-C 与电源传输(PD)控制器、双闪光 LED 电流源、RGB LED 驱动器、背光 WLED 驱动器、显示器偏置驱动器以及用于便携设备的通用 LDO。
属性:
  compatible:
    常量: mediatek,mt6370

  reg:
    最大项数: 1

  wakeup-source: 真

  interrupts:
    最大项数: 1

  interrupt-controller: 真

  "#interrupt-cells":
    常量: 1

  adc:
    类型: 对象
    不允许额外属性
    描述: |
      提供了9个通道用于系统监控，包括 VBUSDIV5（较低精度，较高测量范围）、VBUSDIV2（较高精度，较低测量范围）、VBAT、VSYS、CHG_VDDP、TS_BAT、IBUS、IBAT 和 TEMP_JC。
属性:
      compatible:
        常量: mediatek,mt6370-adc

      "#io-channel-cells":
        常量: 1

    必需:
      - compatible
      - "#io-channel-cells"

  backlight:
    类型: 对象
    $引用: /schemas/leds/backlight/mediatek,mt6370-backlight.yaml#

  charger:
    类型: 对象
    $引用: /schemas/power/supply/mediatek,mt6370-charger.yaml#

  tcpc:
    类型: 对象
    $引用: /schemas/usb/mediatek,mt6370-tcpc.yaml#

  indicator:
    类型: 对象
    $引用: /schemas/leds/mediatek,mt6370-indicator.yaml#

  flashlight:
    类型: 对象
    $引用: /schemas/leds/mediatek,mt6370-flashlight.yaml#

  regulators:
    类型: 对象
    不允许额外属性
    描述: |
      列出了所有支持的稳压器，它们支持对 DisplayBias 电压的控制和一个通常用于驱动振动马达的通用 LDO。
模式属性:
      "^(dsvbst|vibldo)$":
        $引用: /schemas/regulator/regulator.yaml#
        类型: 对象
        不评估未定义属性

      "^(dsvpos|dsvneg)$":
        $引用: /schemas/regulator/regulator.yaml#
        类型: 对象
        不评估未定义属性

        属性:
          enable-gpios:
            最大项数: 1

必需:
  - compatible
  - reg
  - interrupts
  - interrupt-controller
  - "#interrupt-cells"
  - regulators
  - adc
  - backlight
  - indicator
  - tcpc
  - charger
  - flashlight

不允许额外属性

示例:
  - |
    #include <dt-bindings/interrupt-controller/irq.h>
    #include <dt-bindings/leds/common.h>
    #include <dt-bindings/iio/adc/mediatek,mt6370_adc.h>
    #include <dt-bindings/usb/pd.h>
    i2c {
      #address-cells = <1>;
      #size-cells = <0>;

      pmic@34 {
        compatible = "mediatek,mt6370";
        reg = <0x34>;
        wakeup-source;
        interrupts-extended = <&gpio26 3 IRQ_TYPE_LEVEL_LOW>;
        interrupt-controller;
        #interrupt-cells = <1>;

        mt6370_adc: adc {
          compatible = "mediatek,mt6370-adc";
          #io-channel-cells = <1>;
        };

        backlight {
          compatible = "mediatek,mt6370-backlight";
          mediatek,bled-channel-use = /bits/ 8 <15>;
        };

        charger {
          compatible = "mediatek,mt6370-charger";
          interrupts = <68>, <48>, <6>;
          interrupt-names = "uvp_d_evt", "attach_i", "mivr";
          io-channels = <&mt6370_adc MT6370_CHAN_IBUS>;

          mt6370_otg_vbus: usb-otg-vbus-regulator {
            regulator-name = "mt6370-usb-otg-vbus";
            regulator-min-microvolt = <4350000>;
            regulator-max-microvolt = <5800000>;
            regulator-min-microamp = <500000>;
            regulator-max-microamp = <3000000>;
          };
        };

        indicator {
          compatible = "mediatek,mt6370-indicator";
          #address-cells = <1>;
          #size-cells = <0>;

          multi-led@0 {
            reg = <0>;
            function = LED_FUNCTION_INDICATOR;
            color = <LED_COLOR_ID_RGB>;
            led-max-microamp = <24000>;
            #address-cells = <1>;
            #size-cells = <0>;
            led@0 {
              reg = <0>;
              color = <LED_COLOR_ID_RED>;
            };
            led@1 {
              reg = <1>;
              color = <LED_COLOR_ID_GREEN>;
            };
            led@2 {
              reg = <2>;
              color = <LED_COLOR_ID_BLUE>;
            };
          };
          led@3 {
            reg = <3>;
            function = LED_FUNCTION_INDICATOR;
            color = <LED_COLOR_ID_WHITE>;
            led-max-microamp = <6000>;
          };
        };

        flashlight {
          compatible = "mediatek,mt6370-flashlight";
          #address-cells = <1>;
          #size-cells = <0>;
          led@0 {
            reg = <0>;
            led-sources = <0>;
            function = LED_FUNCTION_FLASH;
            color = <LED_COLOR_ID_WHITE>;
            function-enumerator = <1>;
            led-max-microamp = <200000>;
            flash-max-microamp = <500000>;
            flash-max-timeout-us = <1248000>;
          };
          led@1 {
            reg = <1>;
            led-sources = <1>;
            function = LED_FUNCTION_FLASH;
            color = <LED_COLOR_ID_WHITE>;
            function-enumerator = <2>;
            led-max-microamp = <200000>;
            flash-max-microamp = <500000>;
            flash-max-timeout-us = <1248000>;
          };
        };

        tcpc {
          compatible = "mediatek,mt6370-tcpc";
          interrupts-extended = <&gpio26 4 IRQ_TYPE_LEVEL_LOW>;

          connector {
            compatible = "usb-c-connector";
            label = "USB-C";
            vbus-supply = <&mt6370_otg_vbus>;
            data-role = "dual";
            power-role = "dual";
            try-power-role = "sink";
            source-pdos = <PDO_FIXED(5000, 1000, PDO_FIXED_DUAL_ROLE | PDO_FIXED_DATA_SWAP)>;
            sink-pdos = <PDO_FIXED(5000, 2000, PDO_FIXED_DUAL_ROLE | PDO_FIXED_DATA_SWAP)>;
            op-sink-microwatt = <10000000>;

            ports {
              #address-cells = <1>;
              #size-cells = <0>;

              port@0 {
                reg = <0>;
                endpoint {
                  remote-endpoint = <&usb_hs>;
                };
              };
              port@1 {
                reg = <1>;
                endpoint {
                  remote-endpoint = <&usb_ss>;
                };
              };
              port@2 {
                reg = <2>;
                endpoint {
                  remote-endpoint = <&dp_aux>;
                };
              };
            };
          };
        };

        regulators {
          dsvbst {
            regulator-name = "mt6370-dsv-vbst";
            regulator-min-microvolt = <4000000>;
            regulator-max-microvolt = <6200000>;
          };
          dsvpos {
            regulator-name = "mt6370-dsv-vpos";
            regulator-min-microvolt = <4000000>;
            regulator-max-microvolt = <6000000>;
            regulator-boot-on;
          };
          dsvneg {
            regulator-name = "mt6370-dsv-vneg";
            regulator-min-microvolt = <4000000>;
            regulator-max-microvolt = <6000000>;
            regulator-boot-on;
          };
          vibldo {
            regulator-name = "mt6370-vib-ldo";
            regulator-min-microvolt = <1600000>;
            regulator-max-microvolt = <4000000>;
          };
        };
      };
    };
```

请注意，上述翻译尽量保持了原文的格式和结构，并尽可能地保留了专有名词和技术术语。
~~~~

## Documentation/devicetree/bindings/mfd/mediatek,mt8195-scpsys_cn.yaml
```yaml
# SPDX-License-Identifier: GPL-2.0-only OR BSD-2-Clause
%YAML 1.2
---
$id: http://devicetree.org/schemas/mfd/mediatek,mt8195-scpsys.yaml#
$schema: http://devicetree.org/meta-schemas/core.yaml#

title: 联发科技系统控制处理器系统

maintainers:
  - MandyJH Liu <mandyjh.liu@mediatek.com>

description:
  联发科技系统控制处理器系统 (SCPSYS) 执行多项电源管理任务。这些任务包括 MTCMOS 电源域控制、温度测量、DVFS 等。
properties:
  compatible:
    items:
      - enum:
          - mediatek,mt8167-scpsys
          - mediatek,mt8173-scpsys
          - mediatek,mt8183-scpsys
          - mediatek,mt8186-scpsys
          - mediatek,mt8188-scpsys
          - mediatek,mt8192-scpsys
          - mediatek,mt8195-scpsys
          - mediatek,mt8365-scpsys
      - const: syscon
      - const: simple-mfd

  reg:
    maxItems: 1

  power-controller:
    $ref: /schemas/power/mediatek,power-controller.yaml#

required:
  - compatible
  - reg

additionalProperties: false

examples:
  - |
    #include <dt-bindings/clock/mt8195-clk.h>
    #include <dt-bindings/power/mt8195-power.h>

    syscon@10006000 {
      compatible = "mediatek,mt8195-scpsys", "syscon", "simple-mfd";
      reg = <0x10006000 0x100>;

      spm: power-controller {
        compatible = "mediatek,mt8195-power-controller";
        #address-cells = <1>;
        #size-cells = <0>;
        #power-domain-cells = <1>;

        /* 电源域节点示例 */
        power-domain@MT8195_POWER_DOMAIN_PCIE_PHY {
          reg = <MT8195_POWER_DOMAIN_PCIE_PHY>;
          #power-domain-cells = <0>;
        };

        power-domain@MT8195_POWER_DOMAIN_SSUSB_PCIE_PHY {
          reg = <MT8195_POWER_DOMAIN_SSUSB_PCIE_PHY>;
          #power-domain-cells = <0>;
        };
      };
    };
```

## Documentation/devicetree/bindings/mfd/mfd_cn.txt
~~~~
### 多功能设备 (MFD)

这些设备集成了异构硬件模块的核心，包含了不止一种非唯一但具有不同功能的硬件。

一个典型的MFD可以是：

- 一个混合信号ASIC（专用集成电路），通过外部总线连接，有时是一个PMIC（电源管理集成电路），采用较低的技术节点（粗糙硅）制造，用于处理诸如音频放大器、LED驱动器、电平转换器、PHY（如USB或以太网等物理接口）、稳压器等模拟驱动器。
- 一系列内存寄存器，包含“各种系统寄存器”，也称为系统控制器“syscon”或任何其他包含混合不相关硬件设备的内存范围。

#### 可选属性：

- `compatible`：`"simple-mfd"` — 这表示操作系统应该将MFD设备的所有子节点视为独立的设备，因此不需要父设备提供资源。类似于`"simple-bus"`指示如何将子节点视为简单内存映射总线的子节点。对于更复杂的设备，如果核心驱动需要探测寄存器来确定哪些子设备存在等情况下，不应该使用这种方式。在后一种情况下，子设备将由操作系统决定。
- `ranges`：描述与父设备之间的地址映射关系。应设置子设备的基本地址为0，父设备地址空间内的物理地址，以及地址映射的长度。
- `#address-cells`：指定用于表示物理基地址的单元格数量。如果使用`ranges`，则必须存在。
- `#size-cells`：指定用于表示地址大小的单元格数量。如果使用`ranges`，则必须存在。

#### 示例：

```plaintext
foo@1000 { 
    compatible = "syscon", "simple-mfd";
    reg = <0x01000 0x1000>;

    led@8.0 {
        compatible = "register-bit-led";
        offset = <0x08>;
        mask = <0x01>;
        label = "myled";
        default-state = "on";
    };
};
```
在这个示例中，`foo@1000` 是一个MFD设备，它通过`reg`指定了其地址范围。其中`led@8.0`是该MFD下的一个子设备，是一个寄存器位LED，具有特定的偏移量和掩码，以及默认状态为“打开”的标签。
~~~~

## Documentation/devicetree/bindings/mfd/motorola-cpcap_cn.txt
~~~~
Motorola CPCAP PMIC 设备树绑定

**必需属性:**
- `compatible` : 必须包含 "motorola,cpcap" 或 "ste,6556002" 中的一个或两个
- `reg` : 指定 SPI 芯片选择
- `interrupts` : 设备连接的中断线
- `interrupt-controller` : 标记该设备节点为中断控制器
- `#interrupt-cells` : 描述 IRQ 所需的单元格数，应为 2
- `#address-cells` : 子设备偏移单元格数，应为 1
- `#size-cells` : 子设备大小单元格数，应为 0
- `spi-max-frequency` : 通常设置为 3000000
- `spi-cs-high` : SPI 芯片选择方向

**可选子节点:**

CPCAP 的子功能拥有自己的节点和兼容值，这些值在以下文件中描述：

- 文档/devicetree/bindings/power/supply/cpcap-battery.yaml
- 文档/devicetree/bindings/power/supply/cpcap-charger.yaml
- 文档/devicetree/bindings/regulator/cpcap-regulator.txt
- 文档/devicetree/bindings/phy/phy-cpcap-usb.txt
- 文档/devicetree/bindings/input/cpcap-pwrbutton.txt
- 文档/devicetree/bindings/rtc/cpcap-rtc.txt
- 文档/devicetree/bindings/leds/leds-cpcap.txt
- 文档/devicetree/bindings/iio/adc/motorola,cpcap-adc.yaml

音频编解码器是唯一的例外。其节点名称必须为 "audio-codec"。

**audio-codec 子节点必需的属性:**

- `#sound-dai-cells = <1>;`

音频编解码器提供两个 DAI (数字音频接口)。第一个连接到立体声高保真 DAC，第二个连接到语音 DAC。

**示例:**

```yaml
&mcspi1 {
    cpcap: pmic@0 {  // 使用 cs0 作为 SPI 芯片选择
        compatible = "motorola,cpcap", "ste,6556002";
        reg = <0>;
        interrupt-parent = <&gpio1>;
        interrupts = <7 IRQ_TYPE_EDGE_RISING>;
        interrupt-controller;
        #interrupt-cells = <2>;
        #address-cells = <1>;
        #size-cells = <0>;
        spi-max-frequency = <3000000>;
        spi-cs-high;

        audio-codec {  // 音频编解码器
            #sound-dai-cells = <1>;

            /* HiFi */
            port@0 {
                endpoint {
                    remote-endpoint = <&cpu_dai1>;
                };
            };

            /* Voice */
            port@1 {
                endpoint {
                    remote-endpoint = <&cpu_dai2>;
                };
            };
        };
    };
};
```
以上示例展示了如何在设备树中配置 Motorola CPCAP PMIC，包括必需属性以及音频编解码器的配置。
~~~~

## Documentation/devicetree/bindings/mfd/mps,mp2629_cn.yaml
~~~~yaml
下面是给定内容的中文翻译：

```yaml
# SPDX-文件许可标识符: GPL-2.0-only 或 BSD-2-Clause
%YAML 1.2
---
$id: http://devicetree.org/schemas/mfd/mps,mp2629.yaml#
$schema: http://devicetree.org/meta-schemas/core.yaml#

title: 来自Monolithic Power System的MP2629电池充电器电源管理集成电路
maintainers:
  - Saravanan Sekar <sravanhome@gmail.com>

description: |
  MP2629是一款电源管理集成电路（PMIC），为智能手机、无线相机和便携式设备提供电池充电和供电。该芯片通过I2C进行控制。
  电池充电管理设备处理电池充电控制器以及用于电池、系统电压的ADC IIO设备。

properties:
  compatible:
    enum:
      - mps,mp2629
      - mps,mp2733

  reg:
    maxItems: 1

  interrupts:
    maxItems: 1

  interrupt-controller: true

  "#interrupt-cells":
    const: 2
    description:
      第一个单元是IRQ编号，第二个单元是触发类型
required:
  - compatible
  - reg
  - interrupts
  - interrupt-controller
  - "#interrupt-cells"

additionalProperties: false

examples:
  - |
    #include <dt-bindings/interrupt-controller/irq.h>
    #include <dt-bindings/input/linux-event-codes.h>
    i2c {
        #address-cells = <1>;
        #size-cells = <0>;

        pmic@4b {
            compatible = "mps,mp2629";
            reg = <0x4b>;

            interrupt-controller;
            interrupt-parent = <&gpio2>;
            #interrupt-cells = <2>;
            interrupts = <3 IRQ_TYPE_LEVEL_HIGH>;
        };
    };
```

请注意，上述内容已尽可能忠实地进行了翻译，以保持原文格式和风格的一致性。
~~~~
