## Documentation/devicetree/bindings/mfd/maxim,max77843_cn.yaml
```yaml
# SPDX-许可证标识符: GPL-2.0-only
%YAML 1.2
---
$id: http://devicetree.org/schemas/mfd/maxim,max77843.yaml#
$schema: http://devicetree.org/meta-schemas/core.yaml#

标题: Maxim MAX77843 MicroUSB 和伴侣电源管理 IC

维护者:
  - Krzysztof Kozlowski <krzk@kernel.org>

描述: |
  这是针对 Maxim MAX77843 MicroUSB 集成电路 (MUIC) 的设备树绑定的一部分。
Maxim MAX77843 是一个 MicroUSB 和伴侣电源管理 IC，它包含了电压电流调节器、充电器、电量计、触觉马达驱动器和 MicroUSB 管理 IC。
属性:
  compatible:
    常量: maxim,max77843

  interrupts:
    最大项数: 1

  reg:
    最大项数: 1

  extcon:
    $ref: /schemas/extcon/maxim,max77843.yaml

  motor-driver:
    类型: 对象
    不允许额外属性: true
    属性:
      compatible:
        常量: maxim,max77843-haptic

      haptic-supply:
        描述: 触觉马达的电源供应

      pwms:
        最大项数: 1

    必需:
      - compatible
      - haptic-supply
      - pwms

  regulators:
    $ref: /schemas/regulator/maxim,max77843.yaml

必需:
  - compatible
  - interrupts
  - reg

不允许额外属性: true

示例:
  - |
    #include <dt-bindings/interrupt-controller/irq.h>

    i2c {
        #address-cells = <1>;
        #size-cells = <0>;

        pmic@66 {
            compatible = "maxim,max77843";
            interrupt-parent = <&gpa1>;
            interrupts = <5 IRQ_TYPE_EDGE_FALLING>;
            reg = <0x66>;

            extcon {
                compatible = "maxim,max77843-muic";

                connector {
                    compatible = "samsung,usb-connector-11pin",
                                 "usb-b-connector";
                    label = "micro-USB";
                    type = "micro";

                    ports {
                        #address-cells = <1>;
                        #size-cells = <0>;

                        port@0 {
                            /*
                             * 注意: 此 DTS 的基础文件中没有 port@0，这是必需的属性。端口看起来不完整且需要修正
* 为了满足 dtschema 的要求，添加一个被禁用的端口
*/
                            reg = <0>;
                            status = "disabled";
                        };

                        port@3 {
                            reg = <3>;
                            endpoint {
                                remote-endpoint = <&mhl_to_musb_con>;
                            };
                        };
                    };
                };

                ports {
                    port {
                        endpoint {
                            remote-endpoint = <&usb_to_muic>;
                        };
                    };
                };
            };

            regulators {
                compatible = "maxim,max77843-regulator";

                SAFEOUT1 {
                    regulator-name = "SAFEOUT1";
                    regulator-min-microvolt = <3300000>;
                    regulator-max-microvolt = <4950000>;
                };

                SAFEOUT2 {
                    regulator-name = "SAFEOUT2";
                    regulator-min-microvolt = <3300000>;
                    regulator-max-microvolt = <4950000>;
                };

                CHARGER {
                    regulator-name = "CHARGER";
                    regulator-min-microamp = <100000>;
                    regulator-max-microamp = <3150000>;
                };
            };

            motor-driver {
                compatible = "maxim,max77843-haptic";
                haptic-supply = <&ldo38_reg>;
                pwms = <&pwm 0 33670 0>;
            };
        };
    };
```

## Documentation/devicetree/bindings/mfd/maxim,max8925_cn.yaml
~~~~yaml
下面是给定内容的中文翻译：

```yaml
# SPDX-文件许可标识符: (GPL-2.0-only 或 BSD-2-Clause)
%YAML 1.2
---
$id: http://devicetree.org/schemas/mfd/maxim,max8925.yaml#
$schema: http://devicetree.org/meta-schemas/core.yaml#

title: 来自 Maxim Integrated 的 MAX8925 PMIC
maintainers:
  - Lee Jones <lee@kernel.org>

properties:
  compatible:
    const: maxim,max8925

  reg:
    maxItems: 1

  interrupts:
    maxItems: 1

  interrupt-controller: true

  "#interrupt-cells":
    const: 1
    description:
      单元格为中断号

  maxim,tsc-irq:
    description: 来自 max8925 的第二个中断
    $ref: /schemas/types.yaml#/definitions/uint32

  regulators:
    type: object

    patternProperties:
      "^SDV[1-3]$|^LDO[1-9]$|^LDO1[0-9]$|^LDO20$":
        description: SDV1-3 和 LDO1-20 的稳压器配置
        $ref: /schemas/regulator/regulator.yaml
        unevaluatedProperties: false

    additionalProperties: false

  backlight:
    type: object
    properties:
      maxim,max8925-dual-string:
        description: 设置为 1 支持双串背光
        $ref: /schemas/types.yaml#/definitions/uint32
        enum: [0, 1]
        default: 0

    additionalProperties: false

  charger:
    type: object
    properties:
      batt-detect:
        description: 设置为 1 表示通过 ID 引脚支持电池检测
        $ref: /schemas/types.yaml#/definitions/uint32
        enum: [0, 1]
        default: 0

      topoff-threshold:
        description: 顶充模式下的充电电流，配置 CHG_CNTL1 中的比特位 5-6
        $ref: /schemas/types.yaml#/definitions/uint32
        minimum: 0
        maximum: 3
        default: 0

      fast-charge:
        description: 快充模式下设置充电电流，配置 CHG_CNTL1 中的比特位 0-3
        $ref: /schemas/types.yaml#/definitions/uint32
        minimum: 0
        maximum: 7
        default: 0

      no-temp-support:
        description: 设置为 1 表示不支持温度感应
        $ref: /schemas/types.yaml#/definitions/uint32
        enum: [0, 1]
        default: 0

      no-insert-detect:
        description: 设置为 1 表示不支持交流电检测
        $ref: /schemas/types.yaml#/definitions/uint32
        enum: [0, 1]
        default: 0

    additionalProperties: false

required:
  - compatible
  - reg
  - interrupts
  - interrupt-controller
  - "#interrupt-cells"
  - regulators

additionalProperties: false

examples:
  - |
    i2c {
        #address-cells = <1>;
        #size-cells = <0>;

        pmic@3c {
            compatible = "maxim,max8925";
            reg = <0x3c>;
            interrupts = <1>;
            interrupt-parent = <&intcmux4>;
            interrupt-controller;
            #interrupt-cells = <1>;
            maxim,tsc-irq = <0>;

            regulators {
                SDV1 {
                    regulator-min-microvolt = <637500>;
                    regulator-max-microvolt = <1425000>;
                    regulator-boot-on;
                    regulator-always-on;
                };

                LDO1 {
                    regulator-min-microvolt = <750000>;
                    regulator-max-microvolt = <3900000>;
                    regulator-boot-on;
                    regulator-always-on;
                };
            };

            backlight {
                maxim,max8925-dual-string = <0>;
            };

            charger {
                batt-detect = <0>;
                topoff-threshold = <1>;
                fast-charge = <7>;
                no-temp-support = <0>;
                no-insert-detect = <0>;
            };
        };
    };
```
请注意，由于 YAML 是一种数据序列化格式，并不包含对注释的支持（如 `#`），因此上述例子中的注释部分在实际 YAML 文件中会被忽略。然而，在 Device Tree 的上下文中，这些注释是被允许的。
~~~~

## Documentation/devicetree/bindings/mfd/maxim,max8998_cn.yaml
```yaml
# SPDX-文件许可人: GPL-2.0-only 或 BSD-2-Clause
%YAML 1.2
---
$id: http://devicetree.org/schemas/mfd/maxim,max8998.yaml#
$schema: http://devicetree.org/meta-schemas/core.yaml#

title: Maxim MAX8998, National/TI LP3974 电源管理 IC

maintainers:
  - Krzysztof Kozlowski <krzk@kernel.org>

description:
  Maxim MAX8998 是一款电源管理 IC，其中包括电压/电流稳压器、实时时钟、电池充电控制器以及多个其他子模块。它通过 I2C 接口进行通信。每个子模块由主机系统使用不同的 I2C 从设备地址来寻址。
properties:
  compatible:
    enum:
      - maxim,max8998
      - national,lp3974
      - ti,lp3974

  reg:
    maxItems: 1

  interrupts:
    minItems: 1
    items:
      - description: 主中断
      - description: 上电/断电中断

  max8998,pmic-buck1-dvs-gpios:
    maxItems: 2
    description:
      用于 buck1 动态电压调节 (DVS) 的两个主机 GPIO。
max8998,pmic-buck2-dvs-gpio:
    maxItems: 1
    description:
      用于 buck2 动态电压调节 (DVS) 的主机 GPIO。
max8998,pmic-buck1-default-dvs-idx:
    $ref: /schemas/types.yaml#/definitions/uint32
    enum: [0, 1, 2, 3]
    default: 0
    description:
      从可通过 DVS GPIO 选择的四个选项中选择的默认电压设置。
max8998,pmic-buck2-default-dvs-idx:
    $ref: /schemas/types.yaml#/definitions/uint32
    enum: [0, 1]
    default: 0
    description:
      从可通过 DVS GPIO 选择的两个选项中选择的默认电压设置。
max8998,pmic-buck-voltage-lock:
    type: boolean
    description:
      如果存在，则不允许更改预编程的 buck DVS 电压。
max8998,pmic-buck1-dvs-voltage:
    $ref: /schemas/types.yaml#/definitions/uint32-array
    maxItems: 4
    description:
      可以通过 DVS GPIO 为 buck1 稳压器选择的四个电压值（微伏）。
max8998,pmic-buck2-dvs-voltage:
    $ref: /schemas/types.yaml#/definitions/uint32-array
    maxItems: 2
    description:
      可以通过 DVS GPIO 为 buck2 稳压器选择的两个电压值（微伏）。
regulators:
    type: object
    additionalProperties: false

    properties:
      CHARGER:
        type: object
        $ref: /schemas/regulator/regulator.yaml#
        unevaluatedProperties: false
        description:
          CHARGER 是主电池充电器的电流控制，被错误地表示为稳压器。
properties:
          regulator-min-microamp:
            minimum: 90000
            maximum: 800000

          regulator-max-microamp:
            minimum: 90000
            maximum: 800000

          regulator-min-microvolt: false
          regulator-max-microvolt: false

        required:
          - regulator-name

    patternProperties:
      "^(LDO([2-9]|1[0-7])|BUCK[1-4])$":
        type: object
        $ref: /schemas/regulator/regulator.yaml#
        unevaluatedProperties: false

        required:
          - regulator-name

      "^(EN32KHz-AP|EN32KHz-CP|ENVICHG|ESAFEOUT[12])$":
        type: object
        $ref: /schemas/regulator/regulator.yaml#
        unevaluatedProperties: false
        description: |
          EN32KHz-AP 和 EN32KHz-CP 是 32768 Hz 时钟，被错误地表示为稳压器。
The provided text describes the configuration of a power management system using Device Tree (DT) syntax for specifying hardware properties in embedded systems. Below is a translation and explanation of the key components:

### Overview
`ENVICHG` is an output monitor for battery charging current.

### Properties
- **regulator-min-microvolt**: Not used (false).
- **regulator-max-microvolt**: Not used (false).

### Required Properties
- **regulator-name**: The name of the regulator.

### Dependencies
- **max8998,pmic-buck1-dvs-gpios**: Linked to `max8998,pmic-buck1-dvs-voltage`.
- **max8998,pmic-buck2-dvs-gpio**: Linked to `max8998,pmic-buck2-dvs-voltage`.

### Other Requirements
- **compatible**: Compatibility string.
- **reg**: Register address.
- **regulators**: Regulator configuration.

### Additional Properties
- **additionalProperties**: False, indicating no additional properties are allowed.

### Examples
Here's a breakdown of the example configuration:

#### I2C Bus Configuration
- **#address-cells**: Number of cells to represent an address.
- **#size-cells**: Number of cells to represent a size.

#### Power Management IC (PMIC) Configuration
- **compatible**: Compatibility string indicating the type of PMIC.
- **reg**: Register address of the PMIC.
- **interrupts-extended**: Interrupts configuration.
- **pinctrl-names**: Pin control names.
- **pinctrl-0**: Pin control configuration.

#### DVS (Dynamic Voltage Scaling) Configuration
- **max8998,pmic-buck1-default-dvs-idx**: Default index for Dynamic Voltage Scaling of Buck1.
- **max8998,pmic-buck1-dvs-gpios**: GPIOs controlling the DVS states of Buck1.
- **max8998,pmic-buck1-dvs-voltage**: Voltages for different DVS states of Buck1.
- **max8998,pmic-buck2-default-dvs-idx**: Default index for Dynamic Voltage Scaling of Buck2.
- **max8998,pmic-buck2-dvs-gpio**: GPIO controlling the DVS states of Buck2.
- **max8998,pmic-buck2-dvs-voltage**: Voltages for different DVS states of Buck2.

#### Regulator Configuration
Each regulator has a name, minimum voltage (`regulator-min-microvolt`), maximum voltage (`regulator-max-microvolt`), and flags like `regulator-always-on` or `regulator-boot-on`.

- **LDO2** to **LDO17**: Low Dropout (LDO) regulators with fixed voltages.
- **BUCK1**, **BUCK2**, **BUCK3**, and **BUCK4**: Switching regulators with adjustable voltage ranges.
- **EN32KHz-AP** and **EN32KHz-CP**: 32KHz regulators, one always on, the other not.
- **ENVICHG**: Represents the battery charging current monitor output, named as `VICHG`.
- **ESAFEOUT1** and **ESAFEOUT2**: Safe output regulators, with the latter enabled at boot.

This example shows a detailed configuration for a PMIC that includes various voltage regulators, including the battery charging current monitor `ENVICHG`.
```
