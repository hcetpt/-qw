## Documentation/devicetree/bindings/mfd/atmel,sama5d2-flexcom_cn.yaml
```yaml
# SPDX-许可证标识符: (GPL-2.0-only 或 BSD-2-Clause)
%YAML 1.2
---
$id: http://devicetree.org/schemas/mfd/atmel,sama5d2-flexcom.yaml#
$schema: http://devicetree.org/meta-schemas/core.yaml#

标题: Microchip Flexcom (灵活串行通信单元)

维护者:
  - Kavyasree Kotagiri <kavyasree.kotagiri@microchip.com>

描述:
  Microchip Flexcom 实质上是一个封装了 SPI 控制器、I2C 控制器和 USART 的封装。每次只能使用一个功能，并且根据设备树在启动时选择。
属性:
  compatible:
    oneOf:
      - const: atmel,sama5d2-flexcom
      - items:
          - const: microchip,sam9x7-flexcom
          - const: atmel,sama5d2-flexcom
      - items:
          - const: microchip,sama7g5-flexcom
          - const: atmel,sama5d2-flexcom

  reg:
    maxItems: 1

  clocks:
    maxItems: 1

  "#address-cells":
    const: 1

  "#size-cells":
    const: 1

  ranges:
    描述:
      对于整个 I/O 寄存器区域的一个范围。（包括 USART、TWI 和 SPI 寄存器）
    items:
      maxItems: 3

  atmel,flexcom-mode:
    描述: |
      指定 Flexcom 模式如下：
      1: USART
      2: SPI
      3: I2C
    $ref: /schemas/types.yaml#/definitions/uint32
    enum: [1, 2, 3]

模式匹配属性:
  "^serial@[0-9a-f]+$":
    类型: object
    描述:
      描述 USART 的子节点。有关 USART 绑定的详细信息，请参阅 atmel-usart.txt
"^spi@[0-9a-f]+$":
    类型: object
    描述:
      描述 SPI 的子节点。有关 SPI 绑定的详细信息，请参阅 ../spi/spi_atmel.txt
"^i2c@[0-9a-f]+$":
    $ref: /schemas/i2c/atmel,at91sam-i2c.yaml
    描述:
      描述 I2C 的子节点

必需:
  - compatible
  - reg
  - clocks
  - "#address-cells"
  - "#size-cells"
  - ranges
  - atmel,flexcom-mode

额外属性: false

示例:
  - |
    #include <dt-bindings/interrupt-controller/arm-gic.h>

    flx0: flexcom@f8034000 {
        compatible = "atmel,sama5d2-flexcom";
        reg = <0xf8034000 0x200>;
        clocks = <&flx0_clk>;
        #address-cells = <1>;
        #size-cells = <1>;
        ranges = <0x0 0xf8034000 0x800>;
        atmel,flexcom-mode = <2>;
    };
..
```

## Documentation/devicetree/bindings/mfd/atmel-gpbr_cn.txt
```
*针对 Atmel GPBR（通用备份寄存器）的设备树绑定

GPBR 是一组由电池支持的寄存器。
必需的属性：
- compatible（兼容性）：应为以下选项之一：
            "atmel,at91sam9260-gpbr", "syscon"
            "microchip,sam9x60-gpbr", "syscon"
            "microchip,sam9x7-gpbr", "microchip,sam9x60-gpbr", "syscon"
- reg（寄存器）：包含 GPBR 内存区域的偏移量/长度值
示例：

gpbr: gpbr@fffffd50 {
    compatible = "atmel,at91sam9260-gpbr", "syscon";
    reg = <0xfffffd50 0x10>;
};
```

## Documentation/devicetree/bindings/mfd/atmel-matrix_cn.txt
~~~~
*针对 Atmel 总线矩阵的设备树绑定*

总线矩阵寄存器用于配置 Atmel 系统芯片（SoC）内部总线的行为（主从优先级、未定义的突发长度类型等）。

必需的属性：
- compatible: 应该是以下选项之一
            - "atmel,at91sam9260-matrix", "syscon"
            - "atmel,at91sam9261-matrix", "syscon"
            - "atmel,at91sam9263-matrix", "syscon"
            - "atmel,at91sam9rl-matrix", "syscon"
            - "atmel,at91sam9g45-matrix", "syscon"
            - "atmel,at91sam9n12-matrix", "syscon"
            - "atmel,at91sam9x5-matrix", "syscon"
            - "atmel,sama5d3-matrix", "syscon"
            - "microchip,sam9x60-matrix", "syscon"
            - "microchip,sam9x7-matrix", "atmel,at91sam9x5-matrix", "syscon"
- reg: 包含总线矩阵内存区域的偏移量/长度值
示例：

```
matrix: matrix@ffffec00 {
    compatible = "atmel,sama5d3-matrix", "syscon";
    reg = <0xffffec00 0x200>;
};
```
~~~~

## Documentation/devicetree/bindings/mfd/atmel-smc_cn.txt
```
Atmel SMC（静态内存控制器）的设备树绑定

SMC 寄存器用于配置 Atmel EBI（外部总线接口），以与标准内存设备（如 NAND、NOR、SRAM 或 FPGA 等专用设备）进行接口。
所需属性：
- compatible：         应为以下之一
			"atmel,at91sam9260-smc", "syscon"
			"atmel,sama5d3-smc", "syscon"
			"atmel,sama5d2-smc", "syscon"
			"microchip,sam9x60-smc", "syscon"
			"microchip,sam9x7-smc", "atmel,at91sam9260-smc", "syscon"
- reg：			包含 SMC 内存区域的偏移/长度值
示例：

smc: smc@ffffc000 {
	compatible = "atmel,sama5d3-smc", "syscon";
	reg = <0xffffc000 0x1000>;
};
```

## Documentation/devicetree/bindings/mfd/bfticu_cn.txt
~~~~
这段英文描述了 KEYMILE bfticu Chassis Management FPGA 的一些特性以及其在设备树(Device Tree)中的配置示例。下面是翻译成中文的内容：

### KEYMILE bfticu 机箱管理 FPGA

bfticu 是一个多功能设备，用于管理整个机箱。
其主要功能是从整个机箱收集中断请求（IRQs）并将这些中断信号发送给单一的控制器。

#### 必需的属性：
- `compatible`: "keymile,bfticu"，表明该设备与 keymile,bfticu 兼容；
- `interrupt-controller`: 表明 bfticu FPGA 是一个中断控制器；
- `interrupts`: 主中断线，用于将收集到的中断信号发出；
- `#interrupt-cells`: 为 2，其使用方式符合文档 `Documentation/devicetree/bindings/interrupt-controller/interrupts.txt` 中所描述的 2 单元变体；
- `reg`: 在父级本地总线上的访问（芯片选择、芯片选择内的偏移量、大小）。

#### 示例：

```plaintext
chassis-mgmt@3,0 {    // 这里指定了设备在地址空间中的位置
    compatible = "keymile,bfticu";    // 兼容性
    interrupt-controller;             // 中断控制器
    #interrupt-cells = <2>;           // 中断单元数量
    reg = <3 0 0x100>;                // 注册器地址
    interrupt-parent = <&mpic>;       // 中断父节点
    interrupts = <6 1 0 0>;           // 中断信号
};
```

在这个例子中，`chassis-mgmt@3,0` 指定了该设备在地址空间中的位置。`reg = <3 0 0x100>` 指定其在父级总线上的访问范围，即芯片选择为 3，偏移量为 0，大小为 0x100。`interrupts = <6 1 0 0>` 表示主中断线，这里具体含义可能需要参考相关的文档或上下文来理解。
~~~~

## Documentation/devicetree/bindings/mfd/brcm,bcm59056_cn.txt
```
BCM590xx电源管理单元
-------------------------------

必需属性：
- compatible: "brcm,bcm59056"
- reg: I2C从设备地址
- interrupts: 用于PMU的中断。通用中断客户端节点绑定在interrupt-controller/interrupts.txt中描述。

------------------
电压调节器
------------------

可选子节点：
- regulators: 遵循regulator/regulator.txt中的通用电压调节器绑定的容器节点

对于BCM59056，有效的电压调节器节点名称为：
  	rfldo, camldo1, camldo2, simldo1, simldo2, sdldo, sdxldo,
	mmcldo1, mmcldo2, audldo, micldo, usbldo, vibldo,
	csr, iosr1, iosr2, msr, sdsr1, sdsr2, vsr,
	gpldo1, gpldo2, gpldo3, gpldo4, gpldo5, gpldo6,
	vbus

示例：
	pmu: bcm59056@8 {
		compatible = "brcm,bcm59056";
		reg = <0x08>;
		interrupts = <GIC_SPI 215 IRQ_TYPE_LEVEL_HIGH>;
		regulators {
			rfldo_reg: rfldo {
				regulator-min-microvolt = <1200000>;
				regulator-max-microvolt = <3300000>;
			};

			..
		};
	};
```

## Documentation/devicetree/bindings/mfd/brcm,bcm6318-gpio-sysctl_cn.yaml
```yaml
# SPDX-许可证标识符: (GPL-2.0-only 或 BSD-2-Clause)
%YAML 1.2
---
$id: http://devicetree.org/schemas/mfd/brcm,bcm6318-gpio-sysctl.yaml#
$schema: http://devicetree.org/meta-schemas/core.yaml#

标题: Broadcom BCM6318 GPIO 系统控制器

维护者:
  - Álvaro Fernández Rojas <noltari@gmail.com>
  - Jonas Gorski <jonas.gorski@gmail.com>

描述:
  Broadcom BCM6318 SoC GPIO 系统控制器提供了用于控制 SoC 的 GPIO 和引脚的寄存器映射。
属性:
  "#address-cells": true

  "#size-cells": true

  compatible:
    items:
      - const: brcm,bcm6318-gpio-sysctl
      - const: syscon
      - const: simple-mfd

  ranges:
    maxItems: 1

  reg:
    maxItems: 1

模式属性:
  "^gpio@[0-9a-f]+$":
    # 子节点
    类型: 对象
    $ref: /schemas/gpio/brcm,bcm63xx-gpio.yaml
    描述:
      SoC GPIOs 的 GPIO 控制器。此子节点定义应遵循
      文档/devicetree/bindings/gpio/brcm,bcm63xx-gpio.yaml 中指定的绑定。
"^pinctrl@[0-9a-f]+$":
    # 子节点
    类型: 对象
    $ref: /schemas/pinctrl/brcm,bcm6318-pinctrl.yaml
    描述:
      SoC 引脚的针脚控制器。此子节点定义应遵循
      文档/devicetree/bindings/pinctrl/brcm,bcm6318-pinctrl.yaml 中指定的绑定。
必需:
  - "#address-cells"
  - compatible
  - ranges
  - reg
  - "#size-cells"

额外属性: false

示例:
  - |
    syscon@10000080 {
      #address-cells = <1>;
      #size-cells = <1>;
      compatible = "brcm,bcm6318-gpio-sysctl", "syscon", "simple-mfd";
      reg = <0x10000080 0x80>;
      ranges = <0 0x10000080 0x80>;

      gpio@0 {
        compatible = "brcm,bcm6318-gpio";
        reg-names = "dirout", "dat";
        reg = <0x0 0x8>, <0x8 0x8>;

        gpio-controller;
        gpio-ranges = <&pinctrl 0 0 50>;
        #gpio-cells = <2>;
      };

      pinctrl: pinctrl@10 {
        compatible = "brcm,bcm6318-pinctrl";
        reg = <0x18 0x10>, <0x54 0x18>;

        pinctrl_ephy0_spd_led: ephy0_spd_led-pins {
          function = "ephy0_spd_led";
          pins = "gpio0";
        };

        ... (省略了其他 pinctrl 定义以节省空间) ...

        pinctrl_usb_active: usb_active-pins {
          function = "usb_active";
          pins = "gpio40";
        };
      };
    };
```

## Documentation/devicetree/bindings/mfd/brcm,bcm63268-gpio-sysctl_cn.yaml
```yaml
# SPDX-许可证标识符: (GPL-2.0-only 或 BSD-2-Clause)
%YAML 1.2
---
$id: http://devicetree.org/schemas/mfd/brcm,bcm63268-gpio-sysctl.yaml#
$schema: http://devicetree.org/meta-schemas/core.yaml#

标题: Broadcom BCM63268 GPIO 系统控制器

维护者:
  - Álvaro Fernández Rojas <noltari@gmail.com>
  - Jonas Gorski <jonas.gorski@gmail.com>

描述:
  Broadcom BCM63268 系统级芯片的 GPIO 系统控制器，提供用于控制系统级芯片的 GPIO 和引脚的寄存器映射。
属性:
  "#address-cells": true

  "#size-cells": true

  compatible:
    items:
      - const: brcm,bcm63268-gpio-sysctl
      - const: syscon
      - const: simple-mfd

  ranges:
    maxItems: 1

  reg:
    maxItems: 1

模式属性:
  "^gpio@[0-9a-f]+$":
    # 子节点
    类型: 对象
    $ref: /schemas/gpio/brcm,bcm63xx-gpio.yaml
    描述:
      用于系统级芯片 GPIO 的 GPIO 控制器。此子节点定义应遵循在
      文档/devicetree/bindings/gpio/brcm,bcm63xx-gpio.yaml 中指定的绑定。
"^pinctrl@[0-9a-f]+$":
    # 子节点
    类型: 对象
    $ref: /schemas/pinctrl/brcm,bcm63268-pinctrl.yaml
    描述:
      用于系统级芯片引脚的引脚控制器。此子节点定义应遵循在
      文档/devicetree/bindings/pinctrl/brcm,bcm63268-pinctrl.yaml 中指定的绑定。
必需:
  - "#address-cells"
  - compatible
  - ranges
  - reg
  - "#size-cells"

额外属性: false

示例:
  - |
    syscon@100000c0 {
      #address-cells = <1>;
      #size-cells = <1>;
      compatible = "brcm,bcm63268-gpio-sysctl", "syscon", "simple-mfd";
      reg = <0x100000c0 0x80>;
      ranges = <0 0x100000c0 0x80>;

      gpio@0 {
        compatible = "brcm,bcm63268-gpio";
        reg-names = "dirout", "dat";
        reg = <0x0 0x8>, <0x8 0x8>;

        gpio-controller;
        gpio-ranges = <&pinctrl 0 0 52>;
        #gpio-cells = <2>;
      };

      pinctrl: pinctrl@10 {
        compatible = "brcm,bcm63268-pinctrl";
        reg = <0x10 0x4>, <0x18 0x8>, <0x38 0x4>;

        pinctrl_serial_led: serial_led-pins {
          pinctrl_serial_led_clk: serial_led_clk-pins {
            function = "serial_led_clk";
            pins = "gpio0";
          };

          pinctrl_serial_led_data: serial_led_data-pins {
            function = "serial_led_data";
            pins = "gpio1";
          };
        };

        ... (省略部分示例代码以简化)

        pinctrl_dsl_gpio9: dsl_gpio9-pins {
          function = "dsl_gpio9";
          pins = "dsl_gpio9";
        };
      };
    };
```

## Documentation/devicetree/bindings/mfd/brcm,bcm6328-gpio-sysctl_cn.yaml
```yaml
以下是提供的 YAML 文件的中文翻译：

---

SPDX 许可证标识符: (GPL-2.0-only 或 BSD-2-Clause)

YAML 1.2
---
$id: http://devicetree.org/schemas/mfd/brcm,bcm6328-gpio-sysctl.yaml#
$schema: http://devicetree.org/meta-schemas/core.yaml#

标题: Broadcom BCM6328 GPIO 系统控制器

维护者:
  - Álvaro Fernández Rojas <noltari@gmail.com>
  - Jonas Gorski <jonas.gorski@gmail.com>

描述:
  Broadcom BCM6328 SoC 的 GPIO 系统控制器提供了用于控制 SoC 的 GPIO 和引脚的寄存器映射。

属性:
  "#address-cells": 必须

  "#size-cells": 必须

  compatible:
    项目:
      - 常量: brcm,bcm6328-gpio-sysctl
      - 常量: syscon
      - 常量: simple-mfd

  ranges:
    最大项数: 1

  reg:
    最大项数: 1

模式属性:
  "^gpio@[0-9a-f]+$":
    # 子节点
    类型: 对象
    $ref: /schemas/gpio/brcm,bcm63xx-gpio.yaml
    描述:
      SoC GPIO 的 GPIO 控制器。此子节点定义应遵循
      Documentation/devicetree/bindings/gpio/brcm,bcm63xx-gpio.yaml 中指定的绑定。
"^pinctrl@[0-9a-f]+$":
    # 子节点
    类型: 对象
    $ref: /schemas/pinctrl/brcm,bcm6328-pinctrl.yaml
    描述:
      SoC 引脚的引脚控制器。此子节点定义应遵循
      Documentation/devicetree/bindings/pinctrl/brcm,bcm6328-pinctrl.yaml 中指定的绑定。
所需:
  - "#address-cells"
  - compatible
  - ranges
  - reg
  - "#size-cells"

额外属性: 不允许

示例:
  - |
    syscon@10000080 {
      #address-cells = <1>;
      #size-cells = <1>;
      compatible = "brcm,bcm6328-gpio-sysctl", "syscon", "simple-mfd";
      reg = <0x10000080 0x80>;
      ranges = <0 0x10000080 0x80>;

      gpio@0 {
        compatible = "brcm,bcm6328-gpio";
        reg-names = "dirout", "dat";
        reg = <0x0 0x8>, <0x8 0x8>;

        gpio-controller;
        gpio-ranges = <&pinctrl 0 0 32>;
        #gpio-cells = <2>;
      };

      pinctrl: pinctrl@18 {
        compatible = "brcm,bcm6328-pinctrl";
        reg = <0x18 0x10>;

        pinctrl_serial_led: serial_led-pins {
          pinctrl_serial_led_data: serial_led_data-pins {
            function = "serial_led_data";
            pins = "gpio6";
          };

          pinctrl_serial_led_clk: serial_led_clk-pins {
            function = "serial_led_clk";
            pins = "gpio7";
          };
        };

        pinctrl_inet_act_led: inet_act_led-pins {
          function = "inet_act_led";
          pins = "gpio11";
        };

        pinctrl_pcie_clkreq: pcie_clkreq-pins {
          function = "pcie_clkreq";
          pins = "gpio16";
        };

        pinctrl_ephy0_spd_led: ephy0_spd_led-pins {
          function = "led";
          pins = "gpio17";
        };

        pinctrl_ephy1_spd_led: ephy1_spd_led-pins {
          function = "led";
          pins = "gpio18";
        };

        pinctrl_ephy2_spd_led: ephy2_spd_led-pins {
          function = "led";
          pins = "gpio19";
        };

        pinctrl_ephy3_spd_led: ephy3_spd_led-pins {
          function = "led";
          pins = "gpio20";
        };

        pinctrl_ephy0_act_led: ephy0_act_led-pins {
          function = "ephy0_act_led";
          pins = "gpio25";
        };

        pinctrl_ephy1_act_led: ephy1_act_led-pins {
          function = "ephy1_act_led";
          pins = "gpio26";
        };

        pinctrl_ephy2_act_led: ephy2_act_led-pins {
          function = "ephy2_act_led";
          pins = "gpio27";
        };

        pinctrl_ephy3_act_led: ephy3_act_led-pins {
          function = "ephy3_act_led";
          pins = "gpio28";
        };

        pinctrl_hsspi_cs1: hsspi_cs1-pins {
          function = "hsspi_cs1";
          pins = "hsspi_cs1";
        };

        pinctrl_usb_port1_device: usb_port1_device-pins {
          function = "usb_device_port";
          pins = "usb_port1";
        };

        pinctrl_usb_port1_host: usb_port1_host-pins {
          function = "usb_host_port";
          pins = "usb_port1";
        };
      };
    };
```
