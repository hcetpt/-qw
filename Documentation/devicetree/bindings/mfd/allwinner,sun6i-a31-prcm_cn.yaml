## Documentation/devicetree/bindings/mfd/brcm,bcm6358-gpio-sysctl_cn.yaml
```yaml
# SPDX-许可证标识符: (GPL-2.0-only 或 BSD-2-Clause)
%YAML 1.2
---
$id: http://devicetree.org/schemas/mfd/brcm,bcm6358-gpio-sysctl.yaml#
$schema: http://devicetree.org/meta-schemas/core.yaml#

标题: Broadcom BCM6358 GPIO 系统控制器

维护者:
  - Álvaro Fernández Rojas <noltari@gmail.com>
  - Jonas Gorski <jonas.gorski@gmail.com>

描述:
  Broadcom BCM6358 SoC GPIO 系统控制器提供了用于控制 SoC 的 GPIO 和引脚的寄存器映射。
属性:
  "#address-cells": true

  "#size-cells": true

  compatible:
    items:
      - const: brcm,bcm6358-gpio-sysctl
      - const: syscon
      - const: simple-mfd

  ranges:
    maxItems: 1

  reg:
    maxItems: 1

模式属性:
  "^gpio@[0-9a-f]+$":
    # 子节点
    类型: 对象
    $ref: /schemas/gpio/brcm,bcm63xx-gpio.yaml
    描述:
      SoC GPIOs 的 GPIO 控制器。此子节点定义应遵循
      文档/devicetree/bindings/gpio/brcm,bcm63xx-gpio.yaml 中指定的绑定。
"^pinctrl@[0-9a-f]+$":
    # 子节点
    类型: 对象
    $ref: /schemas/pinctrl/brcm,bcm6358-pinctrl.yaml
    描述:
      SoC 引脚的 Pin 控制器。此子节点定义应遵循
      文档/devicetree/bindings/pinctrl/brcm,bcm6358-pinctrl.yaml 中指定的绑定。
必需:
  - "#address-cells"
  - compatible
  - ranges
  - reg
  - "#size-cells"

额外属性: false

示例:
  - |
    syscon@fffe0080 {
      #address-cells = <1>;
      #size-cells = <1>;
      compatible = "brcm,bcm6358-gpio-sysctl", "syscon", "simple-mfd";
      reg = <0xfffe0080 0x80>;
      ranges = <0 0xfffe0080 0x80>;

      gpio@0 {
        compatible = "brcm,bcm6358-gpio";
        reg-names = "dirout", "dat";
        reg = <0x0 0x8>, <0x8 0x8>;

        gpio-controller;
        gpio-ranges = <&pinctrl 0 0 40>;
        #gpio-cells = <2>;
      };

      pinctrl: pinctrl@18 {
        compatible = "brcm,bcm6358-pinctrl";
        reg = <0x18 0x4>;

        pinctrl_ebi_cs: ebi_cs-pins {
          function = "ebi_cs";
          groups = "ebi_cs_grp";
        };

        pinctrl_uart1: uart1-pins {
          function = "uart1";
          groups = "uart1_grp";
        };

        pinctrl_serial_led: serial_led-pins {
          function = "serial_led";
          groups = "serial_led_grp";
        };

        pinctrl_legacy_led: legacy_led-pins {
          function = "legacy_led";
          groups = "legacy_led_grp";
        };

        pinctrl_led: led-pins {
          function = "led";
          groups = "led_grp";
        };

        pinctrl_spi_cs_23: spi_cs-pins {
          function = "spi_cs";
          groups = "spi_cs_grp";
        };

        pinctrl_utopia: utopia-pins {
          function = "utopia";
          groups = "utopia_grp";
        };

        pinctrl_pwm_syn_clk: pwm_syn_clk-pins {
          function = "pwm_syn_clk";
          groups = "pwm_syn_clk_grp";
        };

        pinctrl_sys_irq: sys_irq-pins {
          function = "sys_irq";
          groups = "sys_irq_grp";
        };
      };
    };
```

## Documentation/devicetree/bindings/mfd/brcm,misc_cn.yaml
```yaml
# SPDX-许可证标识符: GPL-2.0-only 或 BSD-2-Clause
%YAML 1.2
---
$id: http://devicetree.org/schemas/mfd/brcm,misc.yaml#
$schema: http://devicetree.org/meta-schemas/core.yaml#

标题: Broadcom 的 MISC 块

维护者:
  - Rafał Miłecki <rafal@milecki.pl>

描述: |
  Broadcom 的 MISC 是一个在某些系统级芯片上使用的硬件块（例如 bcm63xx 和 bcm4908）。它用于实现一些简单的功能，如看门狗、PCIe 重置、UniMAC 控制等。
属性:
  compatible:
    items:
      - 常量: brcm,misc
      - 常量: simple-mfd

  reg:
    描述: MISC 块寄存器

  ranges: 真

  "#address-cells":
    常量: 1

  "#size-cells":
    常量: 1

模式属性:
  '^reset-controller@[a-f0-9]+$':
    $ref: /schemas/reset/brcm,bcm4908-misc-pcie-reset.yaml

其他属性: 假

必需:
  - reg
  - '#address-cells'
  - '#size-cells'

示例:
  - |
    misc@ff802600 {
        compatible = "brcm,misc", "simple-mfd";
        reg = <0xff802600 0xe4>;

        #address-cells = <1>;
        #size-cells = <1>;
        ranges = <0x0 0x0 0xe4>;

        reset-controller@44 {
            compatible = "brcm,bcm4908-misc-pcie-reset";
            reg = <0x44 0x4>;
            #reset-cells = <1>;
        };
    };
```

## Documentation/devicetree/bindings/mfd/brcm,twd_cn.yaml
```yaml
# SPDX-许可证标识符: GPL-2.0-only 或 BSD-2-Clause
%YAML 1.2
---
$id: http://devicetree.org/schemas/mfd/brcm,twd.yaml#
$schema: http://devicetree.org/meta-schemas/core.yaml#

标题: Broadcom 的定时器-看门狗（简称 TWD）

维护者:
  - Rafał Miłecki <rafal@milecki.pl>

描述: |
  Broadcom 在多个系统级芯片中使用了一种定时器-看门狗模块（例如，BCM4908、BCM63xx、BCM7038）。
  存在几种不同的变体（它们在寄存器布局上略有不同）。此模块包括：定时器、看门狗以及可选的软件复位处理程序。

属性:
  compatible:
    项:
      - 枚举:
          - brcm,bcm4908-twd
          - brcm,bcm7038-twd
      - 常量: simple-mfd
      - 常量: syscon

  reg:
    最大项数: 1

  ranges: 真

  "#address-cells":
    常量: 1

  "#size-cells":
    常量: 1

模式属性:
  '^timer@[a-f0-9]+$':
    $ref: /schemas/timer/brcm,bcmbca-timer.yaml

  '^watchdog@[a-f0-9]+$':
    $ref: /schemas/watchdog/brcm,bcm7038-wdt.yaml

其他属性: 假

必需:
  - reg

示例:
  - |
    timer-mfd@ff800400 {
        compatible = "brcm,bcm4908-twd", "simple-mfd", "syscon";
        reg = <0xff800400 0x4c>;
        ranges = <0x00000000 0xff800400 0x4c>;

        #address-cells = <1>;
        #size-cells = <1>;

        timer@0 {
            compatible = "brcm,bcm63138-timer";
            reg = <0x0 0x28>;
        };

        watchdog@28 {
            compatible = "brcm,bcm7038-wdt";
            reg = <0x28 0x8>;
        };
    };
```

## Documentation/devicetree/bindings/mfd/canaan,k210-sysctl_cn.yaml
```yaml
下面是给定内容的中文翻译：

# SPDX-许可证标识符: (GPL-2.0-only 或 BSD-2-Clause)
%YAML 1.2
---
$id: http://devicetree.org/schemas/mfd/canaan,k210-sysctl.yaml#
$schema: http://devicetree.org/meta-schemas/core.yaml#

标题: Canaan Kendryte K210 系统控制器

维护者:
  - Damien Le Moal <dlemoal@kernel.org>

描述:
  Canaan Inc. Kendryte K210 SoC 系统控制器提供了用于控制 SoC 的时钟、复位信号和引脚电源域的寄存器映射。
属性:
  compatible:
    items:
      - 常量: canaan,k210-sysctl
      - 常量: syscon
      - 常量: simple-mfd

  clocks:
    最大项数: 1
    描述:
      系统控制器高级电源总线 (APB) 接口时钟源
clock-names:
    items:
      - 常量: pclk

  reg:
    最大项数: 1

  clock-controller:
    # 子节点
    类型: 对象
    $ref: /schemas/clock/canaan,k210-clk.yaml
    描述:
      用于 SoC 时钟的时钟控制器。此子节点定义应遵循指定于
      文档/devicetree/bindings/clock/canaan,k210-clk.yaml 中的绑定规则。
reset-controller:
    # 子节点
    类型: 对象
    $ref: /schemas/reset/canaan,k210-rst.yaml
    描述:
      用于 SoC 的复位控制器。此子节点定义应遵循指定于
      文档/devicetree/bindings/reset/canaan,k210-rst.yaml 中的绑定规则。
syscon-reboot:
    # 子节点
    类型: 对象
    $ref: /schemas/power/reset/syscon-reboot.yaml
    描述:
      用于 SoC 的重启方法。此子节点定义应遵循指定于
      文档/devicetree/bindings/power/reset/syscon-reboot.yaml 中的绑定规则。
必需:
  - compatible
  - clocks
  - reg
  - clock-controller

其他属性: false

示例:
  - |
    #include <dt-bindings/clock/k210-clk.h>
    #include <dt-bindings/reset/k210-rst.h>

    clocks {
      in0: oscllator {
        compatible = "fixed-clock";
        #clock-cells = <0>;
        clock-frequency = <26000000>;
      };
    };

    sysctl: syscon@50440000 {
      compatible = "canaan,k210-sysctl",
                   "syscon", "simple-mfd";
      reg = <0x50440000 0x100>;
      clocks = <&sysclk K210_CLK_APB1>;
      clock-names = "pclk";

      sysclk: clock-controller {
        #clock-cells = <1>;
        compatible = "canaan,k210-clk";
        clocks = <&in0>;
      };

      sysrst: reset-controller {
        compatible = "canaan,k210-rst";
        #reset-cells = <1>;
      };

      reboot: syscon-reboot {
        compatible = "syscon-reboot";
        regmap = <&sysctl>;
        offset = <48>;
        mask = <1>;
        value = <1>;
      };
    };
```

## Documentation/devicetree/bindings/mfd/cirrus,lochnagar_cn.yaml
```yaml
# SPDX-文件许可人: GPL-2.0-only 或 BSD-2-Clause
%YAML 1.2
---
$id: http://devicetree.org/schemas/mfd/cirrus,lochnagar.yaml#
$schema: http://devicetree.org/meta-schemas/core.yaml#

标题: Cirrus Logic Lochnagar 音频开发板

维护者:
  - patches@opensource.cirrus.com

描述: |
  Lochnagar 是用于评估和开发 Cirrus Logic 智能 CODEC 和放大器设备的平台。它允许通过迷你卡连接大多数 Cirrus Logic 设备，并且还允许连接各种应用处理器系统，以提供一个完整的评估平台。音频系统的拓扑结构、时钟和电源都可以通过 Lochnagar 进行控制，使得被测设备可以在多种可能的应用场景中使用。
还可以参阅以下文档获取通用绑定信息：
    [1] GPIO : ../gpio/gpio.txt

  以及这些文档获取相关定义：
    [2] include/dt-bindings/pinctrl/lochnagar.h
    [3] include/dt-bindings/clock/lochnagar.h

  并且参阅以下文档获取所需的子节点绑定详情：
    [4] 时钟: ../clock/cirrus,lochnagar.yaml
    [5] 引脚控制器: ../pinctrl/cirrus,lochnagar.yaml
    [6] 声音: ../sound/cirrus,lochnagar.yaml
    [7] 硬件监控: ../hwmon/cirrus,lochnagar.yaml

allOf:
  - 如果:
      属性:
        compatible:
          枚举:
            - cirrus,lochnagar2
    则:
      属性:
        lochnagar-hwmon:
          类型: 对象
          $ref: /schemas/hwmon/cirrus,lochnagar.yaml#

        lochnagar-sc:
          类型: 对象
          $ref: /schemas/sound/cirrus,lochnagar.yaml#

属性:
  compatible:
    枚举:
      - cirrus,lochnagar1
      - cirrus,lochnagar2

  reg:
    常量: 0x22

  reset-gpios:
    最大项数: 1

  present-gpios:
    描述: |
      主机在位信号线，指示主机系统的在位情况，参见 [1]。如果硬件上已经固定在位信号线，则可以省略此配置
最大项数: 1

  lochnagar-clk:
    类型: 对象
    $ref: /schemas/clock/cirrus,lochnagar.yaml#

  lochnagar-pmic32k:
    类型: 对象
    $ref: /schemas/clock/fixed-clock.yaml#
    属性:
      clock-frequency:
        常量: 32768

  lochnagar-clk12m:
    类型: 对象
    $ref: /schemas/clock/fixed-clock.yaml#
    属性:
      clock-frequency:
        常量: 12288000

  lochnagar-clk11m:
    类型: 对象
    $ref: /schemas/clock/fixed-clock.yaml#
    属性:
      clock-frequency:
        常量: 11298600

  lochnagar-clk24m:
    类型: 对象
    $ref: /schemas/clock/fixed-clock.yaml#
    属性:
      clock-frequency:
        常量: 24576000

  lochnagar-clk22m:
    类型: 对象
    $ref: /schemas/clock/fixed-clock.yaml#
    属性:
      clock-frequency:
        常量: 22579200

  lochnagar-clk8m:
    类型: 对象
    $ref: /schemas/clock/fixed-clock.yaml#
    属性:
      clock-frequency:
        常量: 8192000

  lochnagar-usb24m:
    类型: 对象
    $ref: /schemas/clock/fixed-clock.yaml#
    属性:
      clock-frequency:
        常量: 24576000

  lochnagar-usb12m:
    类型: 对象
    $ref: /schemas/clock/fixed-clock.yaml#
    属性:
      clock-frequency:
        常量: 12288000

  pinctrl:
    类型: 对象
    $ref: /schemas/pinctrl/cirrus,lochnagar.yaml#

  lochnagar-hwmon:
    类型: 对象
    $ref: /schemas/hwmon/cirrus,lochnagar.yaml#

  lochnagar-sc:
    类型: 对象
    $ref: /schemas/sound/cirrus,lochnagar.yaml#

  VDDCORE:
    描述:
      VDDCORE 调节器的初始化数据，该调节器为 CODEC 的数字核心供电（如果不由内部调节器供电的话）
类型: 对象
    $ref: /schemas/regulator/regulator.yaml#
    未评估属性: false
    属性:
      compatible:
        枚举:
          - cirrus,lochnagar2-vddcore

      SYSVDD-supply:
        描述:
          Lochnagar 的主电源供应
必需:
      - compatible

  MICVDD:
    描述:
      MICVDD 调节器的初始化数据，该调节器为 CODEC 的 MICVDD 供电
类型: 对象
    $ref: /schemas/regulator/regulator.yaml#
    未评估属性: false
    属性:
      compatible:
        枚举:
          - cirrus,lochnagar2-micvdd

      SYSVDD-supply:
        描述:
          Lochnagar 的主电源供应
必需:
      - compatible

  MIC1VDD:
    描述:
      MIC1VDD 供电的初始化数据
类型: 对象
    $ref: /schemas/regulator/regulator.yaml#
    未评估属性: false
    属性:
      compatible:
        枚举:
          - cirrus,lochnagar2-mic1vdd

      cirrus,micbias-input:
        描述:
          选择应使用哪个 CODEC 迷你卡输出的 micbias
$ref: /schemas/types.yaml#/definitions/uint32
        最小值: 1
        最大值: 4

      MICBIAS1-supply:
        描述:
          MIC1VDD 输出的调节器供电，为数字麦克风供电，通常由连接的 CODEC 提供
必需:
      - compatible

  MIC2VDD:
    描述:
      MIC2VDD 供电的初始化数据
The provided text describes device tree bindings for a hardware configuration using YAML-like syntax. Below is the translation into Chinese:

类型: 对象
    $ref: /schemas/regulator/regulator.yaml#
    不评估的属性: false
    属性:
      兼容性:
        枚举:
          - cirrus,lochnagar2-mic2vdd

      cirrus,micbias-input:
        描述:
          一个用于选择CODEC微型卡micbias输出中哪一个应该被使用的属性

$ref: /schemas/types.yaml#/definitions/uint32
        最小值: 1
        最大值: 4

      MICBIAS2-supply:
        描述:
          为MIC2VDD输出供电的稳压器，为数字麦克风供电，通常由连接的CODEC供电
必需:
      - 兼容性

  VDD1V8:
    描述:
      推荐的VDD1V8稳压器固定稳压器，它为CODEC的模拟和1.8V数字供电提供电源
类型: 对象
    $ref: /schemas/regulator/regulator.yaml#
    不评估的属性: false
    属性:
      兼容性:
        枚举:
          - regulator-fixed

      regulator-min-microvolt:
        常量: 1800000

      regulator-max-microvolt:
        常量: 1800000

      vin-supply:
        描述:
          应该设置为与SYSVDD相同的电源
必需:
      - 兼容性
      - regulator-min-microvolt
      - regulator-max-microvolt
      - regulator-boot-on
      - regulator-always-on
      - vin-supply

必需:
  - 兼容性
  - 寄存器
  - 重置GPIOs
  - lochnagar时钟
  - 引脚控制器

额外属性: false

示例:
  - |
    #include <dt-bindings/clock/lochnagar.h>
    #include <dt-bindings/pinctrl/lochnagar.h>
    i2c@e0004000 {
        #地址单元格 = <1>;
        #大小单元格 = <0>;
        寄存器 = <0xe0004000 0x1000>;

        lochnagar: lochnagar@22 {
            兼容性 = "cirrus,lochnagar2";
            寄存器 = <0x22>;

            重置GPIOs = <&gpio0 55 0>;
            在位GPIOs = <&gpio0 60 0>;

            lochnagarclk: lochnagar-clk {
                兼容性 = "cirrus,lochnagar2-clk";

                #时钟单元格 = <1>;
                时钟 = <&clkaudio>, <&clkpmic>;
                时钟名称 = "ln-gf-mclk2", "ln-pmic-32k";

                分配时钟 = <&lochnagarclk LOCHNAGAR_CDC_MCLK1>,
                                  <&lochnagarclk LOCHNAGAR_CDC_MCLK2>;
                分配时钟父级 = <&clkaudio>, <&clkpmic>;
            };

            clkpmic: lochnagar-pmic32k {
                兼容性 = "fixed-clock";
                #时钟单元格 = <0>;
                时钟频率 = <32768>;
            };

            pinctrl {
                兼容性 = "cirrus,lochnagar-pinctrl";

                GPIO控制器;
                #GPIO单元格 = <2>;
                GPIO范围 = <&lochnagar 0 0 LOCHNAGAR2_PIN_NUM_GPIOS>;

                引脚控制器名称 = "默认";
                引脚控制器-0 = <&pinsettings>;

                pinsettings: 引脚设置 {
                    ap2aif-pins {
                        输入使能;
                        组 = "gf-aif1";
                        功能 = "codec-aif3";
                    };
                    codec2aif-pins {
                        输出使能;
                        组 = "codec-aif3";
                        功能 = "gf-aif1";
                    };
                };
            };

            lochnagar-sc {
                兼容性 = "cirrus,lochnagar2-soundcard";

                #声音D-AI单元格 = <1>;

                时钟 = <&lochnagarclk LOCHNAGAR_SOUNDCARD_MCLK>;
                时钟名称 = "mclk";
            };

            lochnagar-hwmon {
                兼容性 = "cirrus,lochnagar2-hwmon";
            };

            MIC1VDD {
                兼容性 = "cirrus,lochnagar2-mic1vdd";

                cirrus,micbias-input = <3>;
            };

            MICVDD {
                兼容性 = "cirrus,lochnagar2-micvdd";

                SYSVDD供电 = <&wallvdd>;

                稳压器最小微伏特 = <3300000>;
                稳压器最大微伏特 = <3300000>;
            };

            VDD1V8 {
                兼容性 = "regulator-fixed";

                稳压器名称 = "VDD1V8";
                稳压器最小微伏特 = <1800000>;
                稳压器最大微伏特 = <1800000>;
                稳压器启动时开启;
                稳压器始终开启;

                vin供电 = <&wallvdd>;
            };
        };
    };
```
