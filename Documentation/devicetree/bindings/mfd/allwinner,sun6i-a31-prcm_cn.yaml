## Documentation/devicetree/bindings/mfd/arm,dev-platforms-syscon_cn.yaml
```yaml
# SPDX-许可证标识符: (GPL-2.0-only 或 BSD-2-Clause)
%YAML 1.2
---
$id: http://devicetree.org/schemas/mfd/arm,dev-platforms-syscon.yaml#
$schema: http://devicetree.org/meta-schemas/core.yaml#

标题: Arm 有限公司 开发者平台系统控制器

维护者:
  - Linus Walleij <linus.walleij@linaro.org>

描述:
  Arm 有限公司的Integrator、Realview和Versatile系列开发者平台包含各种系统控制器模块。这些模块通常作为子板或主板模块的一部分。
属性:
  compatible:
    oneOf:
      - items:
          - enum:
              - arm,integrator-ap-syscon
              - arm,integrator-cp-syscon
              - arm,integrator-sp-syscon
              - arm,im-pd1-syscon
          - const: syscon
      - items:
          - enum:
              - arm,core-module-integrator
              - arm,integrator-ap-syscon
              - arm,integrator-cp-syscon
              - arm,integrator-sp-syscon
              - arm,realview-eb-syscon
              - arm,realview-pb1176-syscon
              - arm,realview-pb11mp-syscon
              - arm,realview-pba8-syscon
              - arm,realview-pbx-syscon
              - arm,versatile-ib2-syscon
          - const: syscon
          - const: simple-mfd
      - items:
          - enum:
              - arm,realview-eb11mp-revb-syscon
              - arm,realview-eb11mp-revc-syscon
          - const: arm,realview-eb-syscon
          - const: syscon
          - const: simple-mfd

  reg:
    maxItems: 1

  ranges: true

  '#address-cells':
    const: 1

  '#size-cells':
    const: 1

必需:
  - compatible
  - reg

附加属性:
  类型: 对象

..
```

## Documentation/devicetree/bindings/mfd/as3722_cn.txt
~~~~
* ams AS3722 电源管理集成电路 (IC)
所需属性：
-------------------
- compatible: 必须为 "ams,as3722"
- reg: I2C 设备地址
- interrupt-controller: AS3722 内置中断控制器，该控制器接收来自内部子模块（如实时时钟 (RTC)、稳压器、通用输入输出 (GPIO) 等）以及外部输入的中断请求
- #interrupt-cells: 应设置为 2，分别用于中断编号和标志位
  第一个单元是中断编号。AS3722 不同中断源的中断编号定义在 dt-bindings/mfd/as3722.h 中
  第二个单元是标志位，根据中断文档 interrupts.txt 中的触发掩码编码，并使用 dt-bindings/irq 进行表示
可选属性：
--------------------
- ams,enable-internal-int-pullup: 布尔属性，用于启用中断引脚上的内部上拉电阻。如果缺少此属性，则禁用 INT 引脚上的内部上拉电阻
- ams,enable-internal-i2c-pullup: 布尔属性，用于启用 I2C SCL/SDA 引脚上的内部上拉电阻。如果缺少此属性，则禁用 I2C SCL/SDA 线路上的内部上拉电阻
- ams,enable-ac-ok-power-on: 布尔属性，用于启用通过 AC_OK 引脚退出关机模式的功能（即在关机模式下使能该引脚）
可选子模块及其属性：
=======================================
引脚复用与 GPIO：
===============
该设备有 8 个 GPIO 引脚，这些引脚可以配置为 GPIO 或特殊 I/O 功能
请参阅本目录下的 `pinctrl-bindings.txt` 文件以了解客户端设备常用的 pinctrl 绑定的详细信息，包括“引脚配置节点”这一术语的含义。
如果需要 GPIO 和 pinmux 功能，则需要以下属性：
### 必需属性：
- `gpio-controller`: 标记该设备节点为 GPIO 控制器
- `#gpio-cells`: GPIO 单元的数量。请参考绑定文档 `gpio/gpio.txt`

### 可选属性：
如果在启动时需要设置引脚控制，则需要以下属性：
- `pinctrl-names`: 应定义一个名为“default”的 pinctrl 状态，使用 `pinctrl/pinctrl-bindings.txt` 中的绑定
- `pinctrl[0...n]`: 包含指向不同引脚控制设置节点的 phandle 的属性。这些节点表示从状态 0 到状态 n 的引脚控制设置。每个这样的节点包含不同的子节点来表示一系列引脚的一些期望配置。这种配置可以包括选定的那些引脚上的复用功能以及各种引脚配置参数，如上拉、开漏等
每个子节点具有以下属性：
#### 必需属性：
- `pins`: 引脚列表。引脚属性的有效值为：
  - gpio0, gpio1, gpio2, gpio3, gpio4, gpio5,
  - gpio6, gpio7

#### 可选属性：
- `function`, `bias-disable`, `bias-pull-up`, `bias-pull-down`,
  `bias-high-impedance`, `drive-open-drain`
`function` 属性的有效值为：
  - gpio, interrupt-out, gpio-in-interrupt,
  - vsup-vbat-low-undebounce-out,
  - vsup-vbat-low-debounce-out,
  - voltage-in-standby, oc-pg-sd0, oc-pg-sd6,
  - powergood-out, pwm-in, pwm-out, clk32k-out,
  - watchdog-in, soft-reset-in

### 电压调节器：
====
设备具有多个 DCDC 和 LDO。如果需要电压调节器功能，则需要 `regulators` 节点。
以下是电压调节器子节点的属性：
#### 可选属性：
电压调节器的输入电源是电压调节器节点上的可选属性。这些电压调节器的输入电源通过以下属性提供：
- `vsup-sd2-supply`: SD2 的输入电源
- `vsup-sd3-supply`: SD3 的输入电源
vsup-sd4-supply: 为 SD4 提供的输入电源
vsup-sd5-supply: 为 SD5 提供的输入电源
vin-ldo0-supply: 为 LDO0 提供的输入电源
vin-ldo1-6-supply: 为 LDO1 和 LDO6 提供的输入电源
vin-ldo2-5-7-supply: 为 LDO2、LDO5 和 LDO7 提供的输入电源
vin-ldo3-4-supply: 为 LDO3 和 LDO4 提供的输入电源
vin-ldo9-10-supply: 为 LDO9 和 LDO10 提供的输入电源
vin-ldo11-supply: 为 LDO11 提供的输入电源

可选的电压调节器子节点：
---------------------------------
子节点的名称就是该电压调节器的名称，必须是以下之一：
sd[0-6]、ldo[0-7]、ldo[9-11]

每个子节点应该包含对该电压调节器的约束和初始化信息。有关这些子节点的标准属性描述，请参阅 regulator.txt
下面列出了额外的可选自定义属性。
这段文档描述了如何在设备树(Device Tree, DT)中配置 AS3722 芯片，特别是关于其外部控制和电源关闭功能的部分。下面是翻译的内容：

### 外部控制 (ams,ext-control)
用于外部控制该电源轨的属性。此属性的值将指定哪个外部输入正在控制该电源轨。有效值为 0、1、2 和 3：
- 0: 此电源轨没有外部控制。
- 1: 通过 ENABLE1 输入引脚控制电源轨。
- 2: 通过 ENABLE2 输入引脚控制电源轨。
- 3: 通过 ENABLE3 输入引脚控制电源轨。
如果设备树(Device Tree, DT)中缺失此属性，则默认认为没有外部控制。外部控制引脚的宏定义位于 `dt-bindings/mfd/as3722.h` 文件中。

### 与 SD1 同步跟踪 (ams,enable-tracking)
仅支持 LDO3 的与 SD1 进行同步跟踪的功能。

### 电源关闭
#### 系统电源关闭
AS3722 支持通过关闭所有电源轨来实现系统电源关闭。为了启用此功能，设备节点应该包含以下属性：
- ams,system-power-controller: 布尔值，用于通过此设备启用电源关闭功能。

### 示例
```dtl
#include <dt-bindings/mfd/as3722.h>
...

ams3722 {
	compatible = "ams,as3722";
	reg = <0x48>;

	ams,system-power-controller;

	interrupt-parent = <&intc>;
	interrupt-controller;
	#interrupt-cells = <2>;

	gpio-controller;
	#gpio-cells = <2>;

	pinctrl-names = "default";
	pinctrl-0 = <&as3722_default>;

	as3722_default: pinmux {
			gpio0 {
				pins = "gpio0";
				function = "gpio";
				bias-pull-down;
			};

			gpio1_2_4_7 {
				pins = "gpio1", "gpio2", "gpio4", "gpio7";
				function = "gpio";
				bias-pull-up;
			};

			gpio5 {
				pins = "gpio5";
				function = "clk32k_out";
			};
	}

	regulators {
			vsup-sd2-supply = <...>;
			...
}
```

在这个示例中，`ams3722` 是 AS3722 芯片的设备树节点名称。该节点包含了必要的配置以启用 AS3722 的功能，包括电源关闭功能和其他GPIO设置。
这段文本描述了设备树(Device Tree)中的电源管理配置，用于定义不同硬件组件的电压供应特性。下面是翻译后的中文版本：

```plaintext
sd0 {
    regulator-name = "vdd_cpu";  // 电压调节器名称为 "vdd_cpu"
    regulator-min-microvolt = <700000>;  // 最小输出电压为 700000 微伏特
    regulator-max-microvolt = <1400000>;  // 最大输出电压为 1400000 微伏特
    regulator-always-on;  // 该电压调节器始终开启
    ams,ext-control = <2>;  // 使用外部控制，值为 2
};

sd1 {
    regulator-name = "vdd_core";  // 电压调节器名称为 "vdd_core"
    regulator-min-microvolt = <700000>;  // 最小输出电压为 700000 微伏特
    regulator-max-microvolt = <1400000>;  // 最大输出电压为 1400000 微伏特
    regulator-always-on;  // 该电压调节器始终开启
    ams,ext-control = <1>;  // 使用外部控制，值为 1
};

sd2 {
    regulator-name = "vddio_ddr";  // 电压调节器名称为 "vddio_ddr"
    regulator-min-microvolt = <1350000>;  // 最小输出电压为 1350000 微伏特
    regulator-max-microvolt = <1350000>;  // 最大输出电压为 1350000 微伏特
    regulator-always-on;  // 该电压调节器始终开启
};

sd4 {
    regulator-name = "avdd-hdmi-pex";  // 电压调节器名称为 "avdd-hdmi-pex"
    regulator-min-microvolt = <1050000>;  // 最小输出电压为 1050000 微伏特
    regulator-max-microvolt = <1050000>;  // 最大输出电压为 1050000 微伏特
    regulator-always-on;  // 该电压调节器始终开启
};

sd5 {
    regulator-name = "vdd-1v8";  // 电压调节器名称为 "vdd-1v8"
    regulator-min-microvolt = <1800000>;  // 最小输出电压为 1800000 微伏特
    regulator-max-microvolt = <1800000>;  // 最大输出电压为 1800000 微伏特
    regulator-always-on;  // 该电压调节器始终开启
};

// 其他类似的配置项
};
```

这段配置定义了不同的电压调节器及其参数，如最小和最大输出电压等，并指定了这些调节器始终处于开启状态。这对于确保系统稳定运行至关重要。
~~~~

## Documentation/devicetree/bindings/mfd/aspeed,ast2x00-scu_cn.yaml
```yaml
# SPDX-许可证标识符: GPL-2.0
%YAML 1.2
---
$id: http://devicetree.org/schemas/mfd/aspeed,ast2x00-scu.yaml#
$schema: http://devicetree.org/meta-schemas/core.yaml#

title: Aspeed 系统控制单元

description:
  Aspeed 系统控制单元管理 SoC 的全局行为，配置诸如时钟、引脚复用和复位等元素。
maintainers:
  - Joel Stanley <joel@jms.id.au>
  - Andrew Jeffery <andrew@aj.id.au>

properties:
  compatible:
    items:
      - enum:
          - aspeed,ast2400-scu
          - aspeed,ast2500-scu
          - aspeed,ast2600-scu
      - const: syscon
      - const: simple-mfd

  reg:
    maxItems: 1

  ranges: true

  '#address-cells':
    const: 1

  '#size-cells':
    const: 1

  '#clock-cells':
    const: 1

  '#reset-cells':
    const: 1

patternProperties:
  '^p2a-control@[0-9a-f]+$':
    description: 请参阅 Documentation/devicetree/bindings/misc/aspeed-p2a-ctrl.txt
    type: object

  '^pinctrl(@[0-9a-f]+)?$':
    type: object
    additionalProperties: true
    properties:
      compatible:
        contains:
          enum:
            - aspeed,ast2400-pinctrl
            - aspeed,ast2500-pinctrl
            - aspeed,ast2600-pinctrl

    required:
      - compatible

  '^interrupt-controller@[0-9a-f]+$':
    description: 请参阅 Documentation/devicetree/bindings/interrupt-controller/aspeed,ast2xxx-scu-ic.txt
    type: object

  '^silicon-id@[0-9a-f]+$':
    description: SoC 内的唯一硬件硅标识符
    type: object
    additionalProperties: false

    properties:
      compatible:
        items:
          - enum:
              - aspeed,ast2400-silicon-id
              - aspeed,ast2500-silicon-id
              - aspeed,ast2600-silicon-id
          - const: aspeed,silicon-id

      reg:
        description:
          reg 应为唯一的硅 ID 寄存器，并非例如在 2600 中的向后兼容版本
minItems: 1
        items:
          - description: 硅 ID 信息寄存器
          - description: 唯一芯片 ID 寄存器

required:
  - compatible
  - reg
  - ranges
  - '#address-cells'
  - '#size-cells'
  - '#clock-cells'
  - '#reset-cells'

additionalProperties: false

examples:
  - |
    syscon@1e6e2000 {
        compatible = "aspeed,ast2400-scu", "syscon", "simple-mfd";
        reg = <0x1e6e2000 0x1a8>;
        #clock-cells = <1>;
        #reset-cells = <1>;

        #address-cells = <1>;
        #size-cells = <1>;
        ranges = <0x0 0x1e6e2000 0x1000>;

        silicon-id@7c {
            compatible = "aspeed,ast2500-silicon-id", "aspeed,silicon-id";
            reg = <0x7c 0x4>, <0x150 0x8>;
        };
    };
..
```

## Documentation/devicetree/bindings/mfd/aspeed-gfx_cn.txt
~~~~
Aspeed SoC 显示控制器（GFX）的设备树绑定

Aspeed SoC 显示控制器主要如其名称所示处理显示功能，但在 g5 系统芯片上也会参与引脚复用请求。因此，它被视为一个系统控制器（syscon）设备。

必需属性：
- compatible: 必须包含 "aspeed,ast2500-gfx" 和 "syscon"
- reg: 包含 GFX 内存区域的偏移量/长度值

示例：

```
gfx: display@1e6e6000 {
	compatible = "aspeed,ast2500-gfx", "syscon";
	reg = <0x1e6e6000 0x1000>;
};
```
~~~~

## Documentation/devicetree/bindings/mfd/aspeed-lpc_cn.yaml
```yaml
# SPDX-License-Identifier: (GPL-2.0-only OR BSD-2-Clause)
# 版权所有 (c) 2021 Aspeed Technology Inc
%YAML 1.2
---
$id: http://devicetree.org/schemas/mfd/aspeed-lpc.yaml#
$schema: http://devicetree.org/meta-schemas/core.yaml#

标题: Aspeed 低引脚数 (LPC) 总线控制器

维护者:
  - Andrew Jeffery <andrew@aj.id.au>
  - Chia-Wei Wang <chiawei_wang@aspeedtech.com>

描述:
  LPC 总线是一种用于桥接主机 CPU 到多个低带宽外围设备的方式，在 PCI[0] 时代取代了 ISA 总线的使用。Aspeed LPC 控制器的主要用途是在总线上作为从属设备（通常在基板管理控制器 SoC 中），但在某些条件下，它也可以承担总线主控的角色。
LPC 控制器作为一个多功能设备来表示，以涵盖其混合功能，包括但不限于：

  * IPMI 块传输[2] 控制器

  * LPC 主机接口控制器管理向主机暴露的功能，例如 LPC 固件中心周期、LPC 至 AHB 映射配置、UART 管理和总线监听配置
* 一组 SuperIO[3] 暂存寄存器，允许实现例如主机与基板管理控制器之间交接的自定义硬件管理协议
此外，LPC 控制器的状态影响了管脚复用配置，因此控制器的主机部分作为 syscon 暴露，作为一种仲裁访问的方式。
属性:
  compatible:
    items:
      - enum:
          - aspeed,ast2400-lpc-v2
          - aspeed,ast2500-lpc-v2
          - aspeed,ast2600-lpc-v2
      - const: simple-mfd
      - const: syscon

  reg:
    maxItems: 1

  "#address-cells":
    const: 1

  "#size-cells":
    const: 1

  ranges: true

模式属性:
  "^lpc-ctrl@[0-9a-f]+$":
    类型: 对象
    additionalProperties: false

    描述: |
      LPC 主机接口控制器管理向主机暴露的功能，例如
      LPC 固件中心周期、LPC 至 AHB 映射配置、UART 管理和总线监听配置
属性:
      compatible:
        items:
          - enum:
              - aspeed,ast2400-lpc-ctrl
              - aspeed,ast2500-lpc-ctrl
              - aspeed,ast2600-lpc-ctrl

      reg:
        maxItems: 1

      clocks:
        maxItems: 1

      memory-region:
        maxItems: 1
        描述: LPC 至 AHB 映射区域的内存预留句柄

      flash:
        $ref: /schemas/types.yaml#/definitions/phandle
        描述: 包含要通过 LPC 至 AHB 映射暴露的闪存的 SPI 闪存控制器

    required:
      - compatible
      - clocks

  "^reset-controller@[0-9a-f]+$":
    类型: 对象
    additionalProperties: false

    描述:
      ASPEED SoC 中的 UART 可能会将其复位与 LPC 总线的复位状态绑定在一起。某些系统可能选择修改此配置

    属性:
      compatible:
        items:
          - enum:
              - aspeed,ast2400-lpc-reset
              - aspeed,ast2500-lpc-reset
              - aspeed,ast2600-lpc-reset

      reg:
        maxItems: 1

      '#reset-cells':
        const: 1

    required:
      - compatible
      - '#reset-cells'

  "^lpc-snoop@[0-9a-f]+$":
    类型: 对象
    additionalProperties: false

    描述:
      LPC 监听接口允许 BMC 监听并记录主机写入目标 LPC I/O 端口的数据字节
属性:
      compatible:
        items:
          - enum:
              - aspeed,ast2400-lpc-snoop
              - aspeed,ast2500-lpc-snoop
              - aspeed,ast2600-lpc-snoop

      reg:
        maxItems: 1

      interrupts:
        maxItems: 1

      snoop-ports:
        $ref: /schemas/types.yaml#/definitions/uint32-array
        描述: 要监听的 LPC I/O 端口

    required:
      - compatible
      - interrupts
      - snoop-ports

  "^uart-routing@[0-9a-f]+$":
    $ref: /schemas/soc/aspeed/uart-routing.yaml#
    描述: LPC 寄存器空间下的 UART 路由控制

必需:
  - compatible
  - reg
  - "#address-cells"
  - "#size-cells"
  - ranges

additionalProperties:
  类型: 对象

示例:
  - |
    #include <dt-bindings/interrupt-controller/arm-gic.h>
    #include <dt-bindings/clock/ast2600-clock.h>

    lpc: lpc@1e789000 {
        compatible = "aspeed,ast2600-lpc-v2", "simple-mfd", "syscon";
        reg = <0x1e789000 0x1000>;

        #address-cells = <1>;
        #size-cells = <1>;
        ranges = <0x0 0x1e789000 0x1000>;

        lpc_ctrl: lpc-ctrl@80 {
            compatible = "aspeed,ast2600-lpc-ctrl";
            reg = <0x80 0x80>;
            clocks = <&syscon ASPEED_CLK_GATE_LCLK>;
            memory-region = <&flash_memory>;
            flash = <&spi>;
        };

        lpc_reset: reset-controller@98 {
            compatible = "aspeed,ast2600-lpc-reset";
            reg = <0x98 0x4>;
            #reset-cells = <1>;
        };

        lpc_snoop: lpc-snoop@90 {
            compatible = "aspeed,ast2600-lpc-snoop";
            reg = <0x90 0x8>;
            interrupts = <GIC_SPI 144 IRQ_TYPE_LEVEL_HIGH>;
            snoop-ports = <0x80>;
        };
    };
```

## Documentation/devicetree/bindings/mfd/atmel,hlcdc_cn.yaml
```yaml
# SPDX-许可证标识符: (GPL-2.0 或 BSD-2-Clause)
%YAML 1.2
---
$id: http://devicetree.org/schemas/mfd/atmel,hlcdc.yaml#
$schema: http://devicetree.org/meta-schemas/core.yaml#

标题: Atmel 的 HLCD 控制器

维护者:
  - Nicolas Ferre <nicolas.ferre@microchip.com>
  - Alexandre Belloni <alexandre.belloni@bootlin.com>
  - Claudiu Beznea <claudiu.beznea@tuxon.dev>

描述:
  在 Atmel 系统芯片上可用的 Atmel HLCDC（HLCD 控制器）IP 暴露了两个子设备，一个 PWM 芯片和一个显示控制器。

属性:
  compatible:
    枚举:
      - atmel,at91sam9n12-hlcdc
      - atmel,at91sam9x5-hlcdc
      - atmel,sama5d2-hlcdc
      - atmel,sama5d3-hlcdc
      - atmel,sama5d4-hlcdc
      - microchip,sam9x60-hlcdc
      - microchip,sam9x75-xlcdc

  reg:
    最大项数: 1

  interrupts:
    最大项数: 1

  clocks:
    最小项数: 3

  clock-names:
    项:
      - 常量: periph_clk
      - 常量: sys_clk
      - 常量: slow_clk
      - 常量: lvds_pll_clk
    最小项数: 3

  display-controller:
    $ref: /schemas/display/atmel/atmel,hlcdc-display-controller.yaml

  pwm:
    $ref: /schemas/pwm/atmel,hlcdc-pwm.yaml

必需:
  - compatible
  - reg
  - clocks
  - clock-names
  - interrupts

额外属性: false

示例:
  - |
    #include <dt-bindings/clock/at91.h>
    #include <dt-bindings/dma/at91.h>
    #include <dt-bindings/interrupt-controller/arm-gic.h>

    lcd_controller: lcd-controller@f0030000 {
      compatible = "atmel,sama5d3-hlcdc";
      reg = <0xf0030000 0x2000>;
      clocks = <&lcdc_clk>, <&lcdck>, <&clk32k>;
      clock-names = "periph_clk", "sys_clk", "slow_clk";
      interrupts = <36 IRQ_TYPE_LEVEL_HIGH 0>;

      display-controller {
        compatible = "atmel,hlcdc-display-controller";
        pinctrl-names = "default";
        pinctrl-0 = <&pinctrl_lcd_base &pinctrl_lcd_rgb888>;
        #address-cells = <1>;
        #size-cells = <0>;

        port@0 {
          #address-cells = <1>;
          #size-cells = <0>;
          reg = <0>;

          hlcdc_panel_output: endpoint@0 {
            reg = <0>;
            remote-endpoint = <&panel_input>;
          };
        };
      };

      pwm {
        compatible = "atmel,hlcdc-pwm";
        pinctrl-names = "default";
        pinctrl-0 = <&pinctrl_lcd_pwm>;
        #pwm-cells = <3>;
      };
    };
```
