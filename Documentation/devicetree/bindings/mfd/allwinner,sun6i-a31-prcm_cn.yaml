## Documentation/devicetree/bindings/mfd/allwinner,sun6i-a31-prcm_cn.yaml
```yaml
# SPDX-许可证标识符: GPL-2.0
%YAML 1.2
---
$id: http://devicetree.org/schemas/mfd/allwinner,sun6i-a31-prcm.yaml#
$schema: http://devicetree.org/meta-schemas/core.yaml#

标题: Allwinner A31 PRCM

维护者:
  - 陈宇蔡 <wens@csie.org>
  - 马克西姆·里帕德 <mripard@kernel.org>

废弃: true

属性:
  compatible:
    常量: allwinner,sun6i-a31-prcm

  reg:
    最大项目数: 1

模式属性:
  "^.*-(clk|rst)$":
    类型: 对象
    未评估属性: false

    属性:
      compatible:
        枚举:
          - allwinner,sun4i-a10-mod0-clk
          - allwinner,sun6i-a31-apb0-clk
          - allwinner,sun6i-a31-apb0-gates-clk
          - allwinner,sun6i-a31-ar100-clk
          - allwinner,sun6i-a31-clock-reset
          - 固定因子时钟

    必需:
      - compatible

    全部:
      - 如果:
          属性:
            compatible:
              包含:
                常量: 固定因子时钟

        那么:
          $ref: /schemas/clock/fixed-factor-clock.yaml#

      - 如果:
          属性:
            compatible:
              包含:
                常量: allwinner,sun4i-a10-mod0-clk

        那么:
          属性:
            "#clock-cells":
              常量: 0

            clocks:
              最大项目数: 2

            clock-output-names:
              最大项目数: 1

          必需:
            - "#clock-cells"
            - clocks
            - clock-output-names

      - 如果:
          属性:
            compatible:
              包含:
                常量: allwinner,sun6i-a31-apb0-clk

        那么:
          属性:
            "#clock-cells":
              常量: 0

            clocks:
              最大项目数: 1

            clock-output-names:
              最大项目数: 1

          必需:
            - "#clock-cells"
            - clocks
            - clock-output-names

      - 如果:
          属性:
            compatible:
              包含:
                常量: allwinner,sun6i-a31-apb0-gates-clk

        那么:
          属性:
            "#clock-cells":
              常量: 1
              描述: >
                传递给该时钟的这个额外参数是
                控制该特定门的位在寄存器中的偏移量
            clocks:
              最大项目数: 1

            clock-output-names:
              最小项目数: 1
              最大项目数: 32

          必需:
            - "#clock-cells"
            - clocks
            - clock-output-names

      - 如果:
          属性:
            compatible:
              包含:
                常量: allwinner,sun6i-a31-ar100-clk

        那么:
          属性:
            "#clock-cells":
              常量: 0

            clocks:
              最大项目数: 4
              描述: >
                父级顺序必须与硬件编程
                顺序匹配
            clock-output-names:
              最大项目数: 1

          必需:
            - "#clock-cells"
            - clocks
            - clock-output-names

      - 如果:
          属性:
            compatible:
              包含:
                常量: allwinner,sun6i-a31-clock-reset

        那么:
          属性:
            "#reset-cells":
              常量: 1

          必需:
            - "#reset-cells"

必需:
  - compatible
  - reg

附加属性: false

示例:
  - |
    #include <dt-bindings/clock/sun6i-a31-ccu.h>

    prcm@1f01400 {
        compatible = "allwinner,sun6i-a31-prcm";
        reg = <0x01f01400 0x200>;

        ar100: ar100-clk {
            compatible = "allwinner,sun6i-a31-ar100-clk";
            #clock-cells = <0>;
            clocks = <&rtc 0>, <&osc24M>,
                     <&ccu CLK_PLL_PERIPH>,
                     <&ccu CLK_PLL_PERIPH>;
            clock-output-names = "ar100";
        };

        ahb0: ahb0-clk {
            compatible = "fixed-factor-clock";
            #clock-cells = <0>;
            clock-div = <1>;
            clock-mult = <1>;
            clocks = <&ar100>;
            clock-output-names = "ahb0";
        };

        apb0: apb0-clk {
            compatible = "allwinner,sun6i-a31-apb0-clk";
            #clock-cells = <0>;
            clocks = <&ahb0>;
            clock-output-names = "apb0";
        };

        apb0_gates: apb0-gates-clk {
            compatible = "allwinner,sun6i-a31-apb0-gates-clk";
            #clock-cells = <1>;
            clocks = <&apb0>;
            clock-output-names = "apb0_pio", "apb0_ir",
                                 "apb0_timer", "apb0_p2wi",
                                 "apb0_uart", "apb0_1wire",
                                 "apb0_i2c";
        };

        ir_clk: ir-clk {
            #clock-cells = <0>;
            compatible = "allwinner,sun4i-a10-mod0-clk";
            clocks = <&rtc 0>, <&osc24M>;
            clock-output-names = "ir";
        };

        apb0_rst: apb0-rst {
            compatible = "allwinner,sun6i-a31-clock-reset";
            #reset-cells = <1>;
        };
    };
```

## Documentation/devicetree/bindings/mfd/allwinner,sun8i-a23-prcm_cn.yaml
```yaml
下面是给定 YAML 文档的中文翻译：

# SPDX-许可证标识符: GPL-2.0+
%YAML 1.2
---
$id: http://devicetree.org/schemas/mfd/allwinner,sun8i-a23-prcm.yaml#
$schema: http://devicetree.org/meta-schemas/core.yaml#

title: Allwinner A23 PRCM

maintainers:
  - 陈宇蔡 <wens@csie.org>
  - 马克西姆·里帕德 <mripard@kernel.org>

deprecated: true

properties:
  compatible:
    const: allwinner,sun8i-a23-prcm

  reg:
    maxItems: 1

patternProperties:
  "^.*(clk|rst|codec).*$":
    type: object
    unevaluatedProperties: false

    properties:
      compatible:
        enum:
          - 固定因子时钟
          - allwinner,sun8i-a23-apb0-clk
          - allwinner,sun8i-a23-apb0-gates-clk
          - allwinner,sun6i-a31-clock-reset
          - allwinner,sun8i-a23-codec-analog

    required:
      - compatible

    allOf:
      - if:
          properties:
            compatible:
              contains:
                const: 固定因子时钟

        then:
          $ref: /schemas/clock/fixed-factor-clock.yaml#

      - if:
          properties:
            compatible:
              contains:
                const: allwinner,sun8i-a23-apb0-clk

        then:
          properties:
            "#clock-cells":
              const: 0

            clocks:
              maxItems: 1

            clock-output-names:
              maxItems: 1

          required:
            - "#clock-cells"
            - clocks
            - clock-output-names

      - if:
          properties:
            compatible:
              contains:
                const: allwinner,sun8i-a23-apb0-gates-clk

        then:
          properties:
            "#clock-cells":
              const: 1
              description: >
                这个附加参数传递给该时钟，是
                控制这个特定门控位在寄存器中的偏移量。
            clocks:
              maxItems: 1

            clock-output-names:
              minItems: 1
              maxItems: 32

          required:
            - "#clock-cells"
            - clocks
            - clock-output-names

      - if:
          properties:
            compatible:
              contains:
                const: allwinner,sun6i-a31-clock-reset

        then:
          properties:
            "#reset-cells":
              const: 1

          required:
            - "#reset-cells"

required:
  - compatible
  - reg

additionalProperties: false

examples:
  - |
    prcm@1f01400 {
        compatible = "allwinner,sun8i-a23-prcm";
        reg = <0x01f01400 0x200>;

        ar100: ar100_clk {
            compatible = "固定因子时钟";
            #clock-cells = <0>;
            clock-div = <1>;
            clock-mult = <1>;
            clocks = <&osc24M>;
            clock-output-names = "ar100";
        };

        ahb0: ahb0_clk {
            compatible = "固定因子时钟";
            #clock-cells = <0>;
            clock-div = <1>;
            clock-mult = <1>;
            clocks = <&ar100>;
            clock-output-names = "ahb0";
        };

        apb0: apb0_clk {
            compatible = "allwinner,sun8i-a23-apb0-clk";
            #clock-cells = <0>;
            clocks = <&ahb0>;
            clock-output-names = "apb0";
        };

        apb0_gates: apb0_gates_clk {
            compatible = "allwinner,sun8i-a23-apb0-gates-clk";
            #clock-cells = <1>;
            clocks = <&apb0>;
            clock-output-names = "apb0_pio", "apb0_timer",
                                 "apb0_rsb", "apb0_uart",
                                 "apb0_i2c";
        };

        apb0_rst: apb0_rst {
            compatible = "allwinner,sun6i-a31-clock-reset";
            #reset-cells = <1>;
        };

        codec_analog: codec-analog {
            compatible = "allwinner,sun8i-a23-codec-analog";
        };
    };
```

## Documentation/devicetree/bindings/mfd/altera-a10sr_cn.txt
```
* Altera Arria10 开发套件系统资源芯片

所需父设备属性：
- compatible		: "altr,a10sr"
- spi-max-frequency	: 最大 SPI 频率
- reg			: Arria10 系统资源芯片的 SPI 芯片选择地址
- interrupts		: 设备所连接的中断线
- interrupt-controller	: 标记该设备节点为一个中断控制器
- #interrupt-cells	: 描述一个 IRQ 所需的单元格数量，应为 2
第一个单元格是 IRQ 编号
第二个单元格是标志，编码为来自 ../interrupt-controller/interrupts.txt 中的触发掩码
A10SR 包含以下子设备：

设备                   描述
------                   ----------
a10sr_gpio              GPIO 控制器
a10sr_rst               重置控制器

Arria10 GPIO
所需属性：
- compatible        : 应为 "altr,a10sr-gpio"
- gpio-controller   : 标记该设备节点为一个 GPIO 控制器
- #gpio-cells       : 应为两个。第一个单元格是针脚编号，第二个单元格用于指定标志
更多信息请参见 ../gpio/gpio.txt
Arria10 外设 PHY 重置
所需属性：
- compatible        : 应为 "altr,a10sr-reset"
- #reset-cells      : 应为一个
示例：

        resource-manager@0 {
		兼容性 = "altr,a10sr";
		注册器 = <0>;
		spi-最大频率 = <100000>;
		中断父设备 = <&portb>;
		中断 = <5 IRQ_TYPE_LEVEL_LOW>;
		中断控制器;
		#中断单元格 = <2>;

		a10sr_gpio: gpio控制器 {
			兼容性 = "altr,a10sr-gpio";
			gpio控制器;
			#gpio单元格 = <2>;
		};

		a10sr_rst: 重置控制器 {
			兼容性 = "altr,a10sr-reset";
			#重置单元格 = <1>;
		};
	};

请注意，上述翻译将一些专业术语直接进行了翻译，而在实际硬件文档或代码中可能会使用行业内的标准术语。例如，“注册器”可能更常被翻译为“地址空间”，“spi-最大频率”通常被描述为“SPI最大频率”，“中断控制器”和“gpio控制器”等是行业内常用的专业术语，一般不进行翻译。因此，这段翻译更适合理解为意译版本。
```

## Documentation/devicetree/bindings/mfd/ampere,smpro_cn.yaml
~~~~yaml
```yaml
# SPDX-许可证标识符: (GPL-2.0-only 或 BSD-2-Clause)
%YAML 1.2
---
$id: http://devicetree.org/schemas/mfd/ampere,smpro.yaml#
$schema: http://devicetree.org/meta-schemas/core.yaml#

title: Ampere Altra SMPro 固件驱动程序

maintainers:
  - Quan Nguyen <quan@os.amperecomputing.com>

description: |
  Ampere Altra SMPro 固件可能包含不同的模块，如硬件监控、错误监控和其他各种功能。
properties:
  compatible:
    enum:
      - ampere,smpro

  reg:
    description:
      I2C 设备地址
maxItems: 1

required:
  - compatible
  - reg

additionalProperties: false

examples:
  - |
    i2c {
        #address-cells = <1>;
        #size-cells = <0>;

        smpro@4f {
            compatible = "ampere,smpro";
            reg = <0x4f>;
        };
    };
```

以上是您提供的 YAML 文件的中文翻译。请注意，由于 YAML 是一种数据序列化格式，其语法结构在翻译过程中保持不变。仅对注释和描述性文本进行了翻译。
~~~~

## Documentation/devicetree/bindings/mfd/ams,as3711_cn.yaml
```yaml
# SPDX-文件许可人: (GPL-2.0-only 或 BSD-2-Clause)
%YAML 1.2
---
$id: http://devicetree.org/schemas/mfd/ams,as3711.yaml#
$schema: http://devicetree.org/meta-schemas/core.yaml#

title: 奥地利微系统 AS3711 四路降压高电流电源管理芯片带充电器

maintainers:
  - Guennadi Liakhovetski <guennadi.liakhovetski@linux.intel.com>

description:
  AS3711 是奥地利微系统公司的一款通过 I2C 控制的电源管理芯片（PMIC），包含多个 DC/DC 和 LDO 电源供应、电池充电器和实时时钟（RTC）。目前仅定义了两个升压 DC/DC 转换器的绑定。
properties:
  compatible:
    const: ams,as3711

  reg:
    maxItems: 1

  backlight:
    description:
      升压转换器配置，用于作为背光源
    type: object
    additionalProperties: false
    properties:
      compatible:
        const: ams,as3711-bl

      su1-dev:
        description: 第一个升压转换器的帧缓冲区 phandle
        $ref: /schemas/types.yaml#/definitions/phandle

      su1-max-uA:
        description: 第一个升压转换器的最大电流
        $ref: /schemas/types.yaml#/definitions/uint32

      su2-dev:
        description: 第二个升压转换器的帧缓冲区 phandle
        $ref: /schemas/types.yaml#/definitions/phandle

      su2-max-uA:
        description: 第二个升压转换器的最大电流
        $ref: /schemas/types.yaml#/definitions/uint32

      su2-feedback-voltage:
        description: 第二个升压转换器使用电压反馈
        type: boolean

      su2-feedback-curr1:
        description: 第二个升压转换器使用 CURR1 输入进行电流反馈
        type: boolean

      su2-feedback-curr2:
        description: 第二个升压转换器使用 CURR2 输入进行电流反馈
        type: boolean

      su2-feedback-curr3:
        description: 第二个升压转换器使用 CURR3 输入进行电流反馈
        type: boolean

      su2-feedback-curr-auto:
        description: 第二个升压转换器使用自动电流反馈选择
        type: boolean

      su2-fbprot-lx-sd4:
        description: 第二个升压转换器使用 LX_SD4 进行过电压保护
        type: boolean

      su2-fbprot-gpio2:
        description: 第二个升压转换器使用 GPIO2 进行过电压保护
        type: boolean

      su2-fbprot-gpio3:
        description: 第二个升压转换器使用 GPIO3 进行过电压保护
        type: boolean

      su2-fbprot-gpio4:
        description: 第二个升压转换器使用 GPIO4 进行过电压保护
        type: boolean

      su2-auto-curr1:
        description: 第二个升压转换器使用 CURR1 输入进行自动电流反馈
        type: boolean

      su2-auto-curr2:
        description: 第二个升压转换器使用 CURR2 输入进行自动电流反馈
        type: boolean

      su2-auto-curr3:
        description: 第二个升压转换器使用 CURR3 输入进行自动电流反馈
        type: boolean

    required:
      - compatible

    dependentRequired:
      # 要将 SU1 转换器用作背光源，必须提供以下两个属性：
      su1-dev: [ su1-max-uA ]
      su1-max-uA: [ su1-dev ]

      # 要将 SU2 转换器用作背光源，必须提供以下两个属性：
      su2-dev: [ su2-max-uA ]
      su2-max-uA: [ su2-dev ]

      su2-feedback-voltage: [ su2-dev ]
      su2-feedback-curr1: [ su2-dev ]
      su2-feedback-curr2: [ su2-dev ]
      su2-feedback-curr3: [ su2-dev ]
      su2-feedback-curr-auto: [ su2-dev ]
      su2-fbprot-lx-sd4: [ su2-dev ]
      su2-fbprot-gpio2: [ su2-dev ]
      su2-fbprot-gpio3: [ su2-dev ]
      su2-fbprot-gpio4: [ su2-dev ]
      su2-auto-curr1: [ su2-feedback-curr-auto ]
      su2-auto-curr2: [ su2-feedback-curr-auto ]
      su2-auto-curr3: [ su2-feedback-curr-auto ]

    dependentSchemas:
      su2-dev:
        allOf:
          - oneOf:
              - required:
                  - su2-feedback-voltage
              - required:
                  - su2-feedback-curr1
              - required:
                  - su2-feedback-curr2
              - required:
                  - su2-feedback-curr3
              - required:
                  - su2-feedback-curr-auto
          - oneOf:
              - required:
                  - su2-fbprot-lx-sd4
              - required:
                  - su2-fbprot-gpio2
              - required:
                  - su2-fbprot-gpio3
              - required:
                  - su2-fbprot-gpio4

      su2-feedback-curr-auto:
        anyOf:
          - required:
              - su2-auto-curr1
          - required:
              - su2-auto-curr2
          - required:
              - su2-auto-curr3

  regulators:
    description: 其他 DC/DC 和 LDO 电源
    type: object
    unevaluatedProperties: false
    patternProperties:
      "^(sd[1-4]|ldo[1-8])$":
        type: object
        $ref: /schemas/regulator/regulator.yaml#
        unevaluatedProperties: false

required:
  - compatible
  - reg

additionalProperties: false

examples:
  - |
    i2c {
        #address-cells = <1>;
        #size-cells = <0>;

        pmic@40 {
            compatible = "ams,as3711";
            reg = <0x40>;

            regulators {
                sd4 {
                    regulator-name = "1.215V";
                    regulator-min-microvolt = <1215000>;
                    regulator-max-microvolt = <1235000>;
                };
                ldo2 {
                    regulator-name = "2.8V CPU";
                    regulator-min-microvolt = <2800000>;
                    regulator-max-microvolt = <2800000>;
                    regulator-always-on;
                    regulator-boot-on;
                };
            };

            backlight {
                compatible = "ams,as3711-bl";
                su2-dev = <&lcdc>;
                su2-max-uA = <36000>;
                su2-feedback-curr-auto;
                su2-fbprot-gpio4;
                su2-auto-curr1;
                su2-auto-curr2;
                su2-auto-curr3;
            };
        };
    };
```
