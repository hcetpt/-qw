## Documentation/devicetree/bindings/mfd/max77650_cn.yaml
```yaml
# SPDX-许可证标识符: GPL-2.0
%YAML 1.2
---
$id: http://devicetree.org/schemas/mfd/max77650.yaml#
$schema: http://devicetree.org/meta-schemas/core.yaml#

标题: 来自Maxim Integrated的MAX77650超低功耗电源管理集成电路（PMIC）
维护者:
  - Bartosz Golaszewski <bgolaszewski@baylibre.com>

描述: |
  MAX77650 是一款超低功耗PMIC，为低功耗IoT和可穿戴设备提供电池充电和电源供应。
  GPIO控制器模块作为顶级PMIC节点的一部分表示。该设备暴露一条GPIO线。
  对于其他子模块（稳压器、电源、LED和按键）的设备树绑定，请参阅相应子系统目录下的绑定文档。
属性:
  compatible:
    常量: maxim,max77650

  reg:
    描述:
      I2C设备地址
    最大项数: 1

  interrupts:
    最大项数: 1

  interrupt-controller: true

  "#interrupt-cells":
    常量: 2
    描述:
      第一个单元是IRQ编号，第二个单元是触发类型
  gpio-controller: true

  "#gpio-cells":
    常量: 2
    描述:
      第一个单元是引脚编号，第二个单元用于指定GPIO活动状态
  gpio-line-names:
    最大项数: 1
    描述:
      包含GPIO线名称的单个字符串
  regulators:
    $ref: /schemas/regulator/max77650-regulator.yaml

  charger:
    $ref: /schemas/power/supply/max77650-charger.yaml

  leds:
    $ref: /schemas/leds/leds-max77650.yaml

  onkey:
    $ref: /schemas/input/max77650-onkey.yaml

必需:
  - compatible
  - reg
  - interrupts
  - interrupt-controller
  - "#interrupt-cells"
  - gpio-controller
  - "#gpio-cells"

额外属性: false

示例:
  - |
    #include <dt-bindings/interrupt-controller/irq.h>
    #include <dt-bindings/input/linux-event-codes.h>
    i2c {
        #address-cells = <1>;
        #size-cells = <0>;

        pmic@48 {
            compatible = "maxim,max77650";
            reg = <0x48>;

            interrupt-controller;
            interrupt-parent = <&gpio2>;
            #interrupt-cells = <2>;
            interrupts = <3 IRQ_TYPE_LEVEL_LOW>;

            gpio-controller;
            #gpio-cells = <2>;
            gpio-line-names = "max77650-charger";

            regulators {
                compatible = "maxim,max77650-regulator";

                max77650_ldo: regulator-ldo {
                    regulator-name = "max77650-ldo";
                    regulator-min-microvolt = <1350000>;
                    regulator-max-microvolt = <2937500>;
                };

                max77650_sbb0: regulator-sbb0 {
                    regulator-name = "max77650-sbb0";
                    regulator-min-microvolt = <800000>;
                    regulator-max-microvolt = <1587500>;
                };
            };

            charger {
                compatible = "maxim,max77650-charger";
                input-voltage-min-microvolt = <4200000>;
                input-current-limit-microamp = <285000>;
            };

            leds {
                compatible = "maxim,max77650-led";
                #address-cells = <1>;
                #size-cells = <0>;

                led@0 {
                    reg = <0>;
                    label = "blue:usr0";
                };

                led@1 {
                    reg = <1>;
                    label = "red:usr1";
                    linux,default-trigger = "heartbeat";
                };

                led@2 {
                    reg = <2>;
                    label = "green:usr2";
                };
            };

            onkey {
                compatible = "maxim,max77650-onkey";
                linux,code = <KEY_END>;
                maxim,onkey-slide;
            };
        };
    };
```

## Documentation/devicetree/bindings/mfd/maxim,max14577_cn.yaml
```yaml
# SPDX-License-Identifier: GPL-2.0-only
%YAML 1.2
---
$id: http://devicetree.org/schemas/mfd/maxim,max14577.yaml#
$schema: http://devicetree.org/meta-schemas/core.yaml#

标题: Maxim MAX14577/MAX77836 微型USB和配套电源管理集成电路

维护者:
  - Krzysztof Kozlowski <krzk@kernel.org>

描述: |
  这是针对Maxim MAX14577/MAX77836微型USB集成电路(MUIC)的设备树绑定的一部分。
Maxim MAX14577是一个包含电压安全输出稳压器、充电器和微型USB管理集成电路的微型USB及配套电源管理集成电路。
Maxim MAX77836是一个包含电压安全输出稳压器和LDO稳压器、充电器、电量计和微型USB管理集成电路的微型USB及配套电源管理集成电路。
属性:
  compatible:
    枚举:
      - maxim,max14577
      - maxim,max77836

  interrupts:
    最大项目数: 1

  reg:
    最大项目数: 1

  wakeup-source: 真实

  charger:
    $引用: /schemas/power/supply/maxim,max14577.yaml

  extcon:
    类型: 对象
    不允许额外属性
    属性:
      compatible:
        枚举:
          - maxim,max14577-muic
          - maxim,max77836-muic

    必需:
      - compatible

  regulators:
    $引用: /schemas/regulator/maxim,max14577.yaml

必需:
  - compatible
  - interrupts
  - reg
  - charger

allOf:
  - 如果:
      属性:
        compatible:
          包含:
            常量: maxim,max14577
    那么:
      属性:
        charger:
          属性:
            compatible:
              常量: maxim,max14577-charger
        extcon:
          属性:
            compatible:
              常量: maxim,max14577-muic
        regulator:
          属性:
            compatible:
              常量: maxim,max14577-regulator
    否则:
      属性:
        charger:
          属性:
            compatible:
              常量: maxim,max77836-charger
        extcon:
          属性:
            compatible:
              常量: maxim,max77836-muic
        regulator:
          属性:
            compatible:
              常量: maxim,max77836-regulator

不允许额外属性

示例:
  - |
    #include <dt-bindings/interrupt-controller/irq.h>

    i2c {
        #address-cells = <1>;
        #size-cells = <0>;

        pmic@25 {
            compatible = "maxim,max14577";
            reg = <0x25>;
            interrupt-parent = <&gpx1>;
            interrupts = <5 IRQ_TYPE_LEVEL_LOW>;

            extcon {
                compatible = "maxim,max14577-muic";
            };

            regulators {
                compatible = "maxim,max14577-regulator";

                SAFEOUT {
                    regulator-name = "SAFEOUT";
                };

                CHARGER {
                    regulator-name = "CHARGER";
                    regulator-min-microamp = <90000>;
                    regulator-max-microamp = <950000>;
                    regulator-boot-on;
                };
            };

            charger {
                compatible = "maxim,max14577-charger";

                maxim,constant-uvolt = <4350000>;
                maxim,fast-charge-uamp = <450000>;
                maxim,eoc-uamp = <50000>;
                maxim,ovp-uvolt = <6500000>;
            };
        };
    };

  - |
    #include <dt-bindings/interrupt-controller/irq.h>

    i2c {
        #address-cells = <1>;
        #size-cells = <0>;

        pmic@25 {
            compatible = "maxim,max77836";
            interrupt-parent = <&gpx1>;
            interrupts = <5 IRQ_TYPE_NONE>;
            reg = <0x25>;
            wakeup-source;

            extcon {
                compatible = "maxim,max77836-muic";
            };

            regulators {
                compatible = "maxim,max77836-regulator";

                SAFEOUT {
                    regulator-name = "SAFEOUT";
                };

                CHARGER {
                    regulator-name = "CHARGER";
                    regulator-min-microamp = <45000>;
                    regulator-max-microamp = <475000>;
                    regulator-boot-on;
                };

                LDO1 {
                    regulator-name = "MOT_2.7V";
                    regulator-min-microvolt = <1100000>;
                    regulator-max-microvolt = <2700000>;
                };

                LDO2 {
                    regulator-name = "UNUSED_LDO2";
                    regulator-min-microvolt = <800000>;
                    regulator-max-microvolt = <3950000>;
                };
            };

            charger {
                compatible = "maxim,max77836-charger";

                maxim,constant-uvolt = <4350000>;
                maxim,fast-charge-uamp = <225000>;
                maxim,eoc-uamp = <7500>;
                maxim,ovp-uvolt = <6500000>;
            };
        };
    };
```

## Documentation/devicetree/bindings/mfd/maxim,max5970_cn.yaml
```yaml
下面是给定内容的中文翻译：

# SPDX-许可证标识符: (GPL-2.0 或 BSD-2-Clause)
%YAML 1.2
---
$id: http://devicetree.org/schemas/mfd/maxim,max5970.yaml#
$schema: http://devicetree.org/meta-schemas/core.yaml#

title: Maxim Integrated 的 MAX5970 智能开关调节器

maintainers:
  - Patrick Rudolph <patrick.rudolph@9elements.com>

description: |
  该智能开关不提供输出调节，但提供了独立的故障保护以及电压和电流检测功能。
  编程通过 I2C 总线进行。
数据手册：
    https://datasheets.maximintegrated.com/en/ds/MAX5970.pdf
    https://datasheets.maximintegrated.com/en/ds/MAX5978.pdf

properties:
  compatible:
    enum:
      - maxim,max5970
      - maxim,max5978

  reg:
    maxItems: 1

  interrupts:
    maxItems: 1

  leds:
    type: object
    description:
      四个 LED 的属性
properties:
      "#address-cells":
        const: 1

      "#size-cells":
        const: 0

    patternProperties:
      "^led@[0-3]$":
        $ref: /schemas/leds/common.yaml#
        unevaluatedProperties: false
        type: object

        properties:
          reg:
            maximum: 3

    additionalProperties: false

  vss1-supply:
    description: 第一个通道的供电

vss2-supply:
    description: 第二个通道的供电

regulators:
    type: object
    description:
      热插拔控制/开关的属性
patternProperties:
      "^sw[0-1]$":
        $ref: /schemas/regulator/regulator.yaml#
        type: object
        properties:
          shunt-resistor-micro-ohms:
            description: |
              电流检测电阻的微欧姆值
required:
          - shunt-resistor-micro-ohms

        unevaluatedProperties: false

    additionalProperties: false

required:
  - compatible
  - reg
  - regulators
  - vss1-supply

allOf:
  - if:
      properties:
        compatible:
          enum:
            - maxim,max5970
    then:
      required:
        - vss2-supply

additionalProperties: false

examples:
  - |
    i2c {
        #address-cells = <1>;
        #size-cells = <0>;
        regulator@3a {
            compatible = "maxim,max5978";
            reg = <0x3a>;
            vss1-supply = <&p3v3>;

            regulators {
                sw0_ref_0: sw0 {
                    shunt-resistor-micro-ohms = <12000>;
                };
            };

            leds {
                #address-cells = <1>;
                #size-cells = <0>;
                led@0 {
                    reg = <0>;
                    label = "led0";
                    default-state = "on";
                };
                led@1 {
                    reg = <1>;
                    label = "led1";
                    default-state = "on";
                };
            };
        };
    };

  - |
    i2c {
        #address-cells = <1>;
        #size-cells = <0>;

        regulator@3a {
            compatible = "maxim,max5970";
            reg = <0x3a>;
            vss1-supply = <&p3v3>;
            vss2-supply = <&p5v>;

            regulators {
                sw0_ref_1: sw0 {
                    shunt-resistor-micro-ohms = <12000>;
                };
                sw1_ref_1: sw1 {
                    shunt-resistor-micro-ohms = <10000>;
                };
            };
        };
    };
```

## Documentation/devicetree/bindings/mfd/maxim,max77686_cn.yaml
~~~~yaml
```yaml
# SPDX-许可证标识符: GPL-2.0-only 或 BSD-2-Clause
%YAML 1.2
---
$id: http://devicetree.org/schemas/mfd/maxim,max77686.yaml#
$schema: http://devicetree.org/meta-schemas/core.yaml#

title: Maxim MAX77686 电源管理集成电路

maintainers:
  - Chanwoo Choi <cw00.choi@samsung.com>
  - Krzysztof Kozlowski <krzk@kernel.org>

description: |
  这是针对 Maxim MAX77686 电源管理集成电路 (PMIC) 的设备树绑定的一部分。
Maxim MAX77686 是一款电源管理集成电路，其中包括电压和电流调节器、实时时钟 (RTC) 和时钟输出。
MAX77686 提供了三个 32.768kHz 的时钟输出，这些输出可以通过 I2C 控制（使能/禁用）。时钟 ID 在 dt-bindings/clock/maxim,max77686.h 中定义为预处理器宏。
properties:
  compatible:
    const: maxim,max77686

  '#clock-cells':
    const: 1

  interrupts:
    maxItems: 1

  reg:
    maxItems: 1

  voltage-regulators:
    $ref: /schemas/regulator/maxim,max77686.yaml
    description:
      指定调节器的子节点列表
wakeup-source: true

required:
  - compatible
  - '#clock-cells'
  - reg

additionalProperties: false

examples:
  - |
    #include <dt-bindings/gpio/gpio.h>
    #include <dt-bindings/interrupt-controller/irq.h>

    i2c {
        #address-cells = <1>;
        #size-cells = <0>;

        max77686: pmic@9 {
            compatible = "maxim,max77686";
            reg = <0x09>;

            interrupt-parent = <&gpx0>;
            interrupts = <7 IRQ_TYPE_LEVEL_LOW>;
            pinctrl-0 = <&max77686_irq>;
            pinctrl-names = "default";
            wakeup-source;
            #clock-cells = <1>;

            voltage-regulators {
                LDO1 {
                    regulator-name = "VALIVE_1.0V_AP";
                    regulator-min-microvolt = <1000000>;
                    regulator-max-microvolt = <1000000>;
                    regulator-always-on;
                };

                LDO2 {
                    regulator-name = "VM1M2_1.2V_AP";
                    regulator-min-microvolt = <1200000>;
                    regulator-max-microvolt = <1200000>;
                    regulator-always-on;
                    regulator-state-mem {
                        regulator-on-in-suspend;
                    };
                };

                // ..
LDO22 {
                    regulator-name = "VMEM_VDD_2.8V";
                    regulator-min-microvolt = <2800000>;
                    regulator-max-microvolt = <2800000>;
                    maxim,ena-gpios = <&gpk0 2 GPIO_ACTIVE_HIGH>;
                };

                // ..
BUCK1 {
                    regulator-name = "VDD_MIF";
                    regulator-min-microvolt = <850000>;
                    regulator-max-microvolt = <1100000>;
                    regulator-always-on;
                    regulator-boot-on;
                    regulator-state-mem {
                        regulator-off-in-suspend;
                    };
                };

                BUCK2 {
                    regulator-name = "VDD_ARM";
                    regulator-min-microvolt = <850000>;
                    regulator-max-microvolt = <1500000>;
                    regulator-always-on;
                    regulator-boot-on;
                    regulator-state-mem {
                        regulator-on-in-suspend;
                    };
                };

                // ..
BUCK9 {
                    regulator-name = "CAM_ISP_CORE_1.2V";
                    regulator-min-microvolt = <1000000>;
                    regulator-max-microvolt = <1200000>;
                    maxim,ena-gpios = <&gpm0 3 GPIO_ACTIVE_HIGH>;
                };
            };
        };
    };
```
~~~~

## Documentation/devicetree/bindings/mfd/maxim,max77714_cn.yaml
~~~~yaml
下面是给定内容的中文翻译：

```yaml
# SPDX-文件许可标识符: GPL-2.0-only 或 BSD-2-Clause
%YAML 1.2
---
$id: http://devicetree.org/schemas/mfd/maxim,max77714.yaml#
$schema: http://devicetree.org/meta-schemas/core.yaml#

title: 来自 Maxim Integrated 的 MAX77714 PMIC，带有 GPIO、RTC 和看门狗
maintainers:
  - Luca Ceresoli <luca.ceresoli@bootlin.com>

description: |
  MAX77714 是一款电源管理 IC，包含 4 路降压稳压器、9 路低压降稳压器、8 个 GPIO、实时时钟（RTC）和看门狗。
properties:
  compatible:
    const: maxim,max77714

  reg:
    maxItems: 1

  interrupts:
    maxItems: 1

  interrupt-controller: true

  "#interrupt-cells":
    const: 2
    description:
      第一个单元是中断号，第二个单元是触发类型
regulators:
    type: object
    additionalProperties: false

    patternProperties:
      '^(buck[0-3]|ldo[0-8])$':
        type: object
        unevaluatedProperties: false
        $ref: /schemas/regulator/regulator.yaml#

required:
  - compatible
  - reg
  - interrupts
  - interrupt-controller
  - "#interrupt-cells"

additionalProperties: false

examples:
  - |
    #include <dt-bindings/interrupt-controller/irq.h>
    i2c {
        #address-cells = <1>;
        #size-cells = <0>;

        pmic@1c {
            compatible = "maxim,max77714";
            reg = <0x1c>;
            interrupt-parent = <&gpio2>;
            interrupts = <3 IRQ_TYPE_LEVEL_LOW>;

            interrupt-controller;
            #interrupt-cells = <2>;
        };
    };
```

请注意，由于 YAML 文件中的某些元素（如注释和描述）通常不会直接翻译，因此我保留了原始英文文本以保持其含义不变。此外，代码示例部分未进行翻译，因为它们通常使用英文关键字和符号，并且在其他语言中保持一致以确保正确性。
~~~~
