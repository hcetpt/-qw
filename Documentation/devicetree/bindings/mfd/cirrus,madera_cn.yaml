## Documentation/devicetree/bindings/mfd/iqs62x_cn.yaml
```yaml
下面是给定内容的中文翻译：

# SPDX-许可证标识符: (GPL-2.0 或 BSD-2-Clause)
%YAML 1.2
---
$id: http://devicetree.org/schemas/mfd/iqs62x.yaml#
$schema: http://devicetree.org/meta-schemas/core.yaml#

标题: Azoteq IQS620A/621/622/624/625 多功能传感器

维护者:
  - 杰夫·拉邦迪 <jeff@labundy.com>

描述: |
  Azoteq IQS620A、IQS621、IQS622、IQS624 和 IQS625 多功能传感器
  在单一封装中集成了多种传感技术。
数据手册链接: https://www.azoteq.com/

属性:
  compatible:
    枚举:
      - azoteq,iqs620a
      - azoteq,iqs621
      - azoteq,iqs622
      - azoteq,iqs624
      - azoteq,iqs625

  reg:
    最大项数: 1

  interrupts:
    最大项数: 1

  firmware-name:
    最大项数: 1
    描述:
      指定由驱动程序选择的校准和配置文件的名称。如果省略此属性，则名称将基于设备名称，并以 ".bin" 作为扩展名（例如，对于 IQS620A，名称为 iqs620a.bin）

键:
    $ref: /schemas/input/iqs62x-keys.yaml

  pwm:
    $ref: /schemas/pwm/iqs620a-pwm.yaml

必需:
  - compatible
  - reg
  - interrupts

额外属性: false

示例:
  - |
    /*
     * 双电容按钮具有接近激活功能、单极盖开关和面板安装LED
*/
    #include <dt-bindings/input/input.h>
    #include <dt-bindings/interrupt-controller/irq.h>

    i2c {
            #address-cells = <1>;
            #size-cells = <0>;

            iqs620a@44 {
                    compatible = "azoteq,iqs620a";
                    reg = <0x44>;
                    interrupt-parent = <&gpio>;
                    interrupts = <17 IRQ_TYPE_LEVEL_LOW>;

                    keys {
                            compatible = "azoteq,iqs620a-keys";

                            linux,keycodes = <KEY_SELECT>,
                                             <KEY_MENU>,
                                             <KEY_OK>,
                                             <KEY_MENU>;

                            hall-switch-south {
                                    linux,code = <SW_LID>;
                                    azoteq,use-prox;
                            };
                    };

                    iqs620a_pwm: pwm {
                            compatible = "azoteq,iqs620a-pwm";
                            #pwm-cells = <2>;
                    };
            };
    };

    pwmleds {
            compatible = "pwm-leds";

            led-1 {
                    pwms = <&iqs620a_pwm 0 1000000>;
                    max-brightness = <255>;
            };
    };

  - |
    /* 单个感应按钮与双极坞站/平板模式开关。 */
    #include <dt-bindings/input/input.h>
    #include <dt-bindings/interrupt-controller/irq.h>

    i2c {
            #address-cells = <1>;
            #size-cells = <0>;

            iqs620a@44 {
                    compatible = "azoteq,iqs620a";
                    reg = <0x44>;
                    interrupt-parent = <&gpio>;
                    interrupts = <17 IRQ_TYPE_LEVEL_LOW>;

                    firmware-name = "iqs620a_coil.bin";

                    keys {
                            compatible = "azoteq,iqs620a-keys";

                            linux,keycodes = <0>,
                                             <0>,
                                             <0>,
                                             <0>,
                                             <0>,
                                             <0>,
                                             <KEY_MUTE>;

                            hall-switch-north {
                                    linux,code = <SW_DOCK>;
                            };

                            hall-switch-south {
                                    linux,code = <SW_TABLET_MODE>;
                            };
                    };
            };
    };

  - |
    /* 双电容按钮带音量旋钮。 */
    #include <dt-bindings/input/input.h>
    #include <dt-bindings/interrupt-controller/irq.h>

    i2c {
            #address-cells = <1>;
            #size-cells = <0>;

            iqs624@44 {
                    compatible = "azoteq,iqs624";
                    reg = <0x44>;
                    interrupt-parent = <&gpio>;
                    interrupts = <17 IRQ_TYPE_LEVEL_LOW>;

                    keys {
                            compatible = "azoteq,iqs624-keys";

                            linux,keycodes = <BTN_0>,
                                             <0>,
                                             <BTN_1>,
                                             <0>,
                                             <0>,
                                             <0>,
                                             <0>,
                                             <0>,
                                             <0>,
                                             <0>,
                                             <0>,
                                             <0>,
                                             <0>,
                                             <0>,
                                             <KEY_VOLUMEUP>,
                                             <KEY_VOLUMEDOWN>;
                    };
            };
    };

..
```

## Documentation/devicetree/bindings/mfd/khadas,mcu_cn.yaml
~~~~yaml
```yaml
# SPDX-许可证标识符: (GPL-2.0-only 或 BSD-2-Clause)
%YAML 1.2
---
$id: http://devicetree.org/schemas/mfd/khadas,mcu.yaml#
$schema: http://devicetree.org/meta-schemas/core.yaml#

title: Khadas 板载微控制器

maintainers:
  - Neil Armstrong <neil.armstrong@linaro.org>

description: |
  Khadas 在其 VIM 和 Edge 系列板上集成了一个微控制器，增加了某些
  系统功能，如 PWM 风扇控制（对于 VIM2 rev14 或 VIM3），用户存储，
  红外/按键唤醒控制，系统电源指示灯控制等。

properties:
  compatible:
    enum:
      - khadas,mcu # 微控制器版本可被发现

  "#cooling-cells": # 对于具有风扇控制功能的板卡才需要
    const: 2

  reg:
    maxItems: 1

required:
  - compatible
  - reg

additionalProperties: false

examples:
  - |
    i2c {
      #address-cells = <1>;
      #size-cells = <0>;
      khadas_mcu: system-controller@18 {
        compatible = "khadas,mcu";
        reg = <0x18>;
        #cooling-cells = <2>;
      };
    };
```

请注意，代码块中的注释和内容已尽可能翻译为中文。由于 YAML 通常使用英文，为了保持一致性，`$id`、`$schema` 和其他 YAML 属性未进行翻译。
~~~~

## Documentation/devicetree/bindings/mfd/kontron,sl28cpld_cn.yaml
~~~~yaml
以下是提供的 YAML 文件的中文翻译：

```yaml
# SPDX-许可证标识符: (GPL-2.0-only 或 BSD-2-Clause)
%YAML 1.2
---
$id: http://devicetree.org/schemas/mfd/kontron,sl28cpld.yaml#
$schema: http://devicetree.org/meta-schemas/core.yaml#

标题: Kontron 的 sl28cpld 板载管理控制器

维护者:
  - Michael Walle <michael@walle.cc>

描述: |
  板载管理控制器可能包含不同的 IP 模块，例如看门狗、风扇监控、PWM 控制器、中断控制器和一个 GPIO 控制器。
属性:
  compatible:
    常量: kontron,sl28cpld

  reg:
    描述:
      I2C 设备地址
最大项数: 1

  "#address-cells":
    常量: 1

  "#size-cells":
    常量: 0

  "#interrupt-cells":
    常量: 2

  interrupts:
    最大项数: 1

  interrupt-controller: true

模式属性:
  "^gpio(@[0-9a-f]+)?$":
    $引用: /schemas/gpio/kontron,sl28cpld-gpio.yaml

  "^hwmon(@[0-9a-f]+)?$":
    $引用: /schemas/hwmon/kontron,sl28cpld-hwmon.yaml

  "^interrupt-controller(@[0-9a-f]+)?$":
    $引用: /schemas/interrupt-controller/kontron,sl28cpld-intc.yaml

  "^pwm(@[0-9a-f]+)?$":
    $引用: /schemas/pwm/kontron,sl28cpld-pwm.yaml

  "^watchdog(@[0-9a-f]+)?$":
    $引用: /schemas/watchdog/kontron,sl28cpld-wdt.yaml

必需:
  - "#address-cells"
  - "#size-cells"
  - compatible
  - reg

额外属性: false

示例:
  - |
    #include <dt-bindings/interrupt-controller/irq.h>
    i2c {
        #address-cells = <1>;
        #size-cells = <0>;

        sl28cpld@4a {
            compatible = "kontron,sl28cpld";
            reg = <0x4a>;
            #address-cells = <1>;
            #size-cells = <0>;

            watchdog@4 {
                compatible = "kontron,sl28cpld-wdt";
                reg = <0x4>;
                kontron,assert-wdt-timeout-pin;
            };

            hwmon@b {
                compatible = "kontron,sl28cpld-fan";
                reg = <0xb>;
            };

            pwm@c {
                compatible = "kontron,sl28cpld-pwm";
                reg = <0xc>;
                #pwm-cells = <2>;
            };

            pwm@e {
                compatible = "kontron,sl28cpld-pwm";
                reg = <0xe>;
                #pwm-cells = <2>;
            };

            gpio@10 {
                compatible = "kontron,sl28cpld-gpio";
                reg = <0x10>;
                interrupts-extended = <&gpio2 6
                               IRQ_TYPE_EDGE_FALLING>;

                gpio-controller;
                #gpio-cells = <2>;
                gpio-line-names = "a", "b", "c";

                interrupt-controller;
                #interrupt-cells = <2>;
            };

            gpio@15 {
                compatible = "kontron,sl28cpld-gpio";
                reg = <0x15>;
                interrupts-extended = <&gpio2 6
                               IRQ_TYPE_EDGE_FALLING>;

                gpio-controller;
                #gpio-cells = <2>;

                interrupt-controller;
                #interrupt-cells = <2>;
            };

            gpio@1a {
                compatible = "kontron,sl28cpld-gpo";
                reg = <0x1a>;

                gpio-controller;
                #gpio-cells = <2>;
            };

            gpio@1b {
                compatible = "kontron,sl28cpld-gpi";
                reg = <0x1b>;

                gpio-controller;
                #gpio-cells = <2>;
            };

            interrupt-controller@1c {
                compatible = "kontron,sl28cpld-intc";
                reg = <0x1c>;
                interrupts-extended = <&gpio2 6
                               IRQ_TYPE_EDGE_FALLING>;

                interrupt-controller;
                #interrupt-cells = <2>;
            };
        };
    };
```
请注意，此翻译尽可能保持了原有结构和内容的一致性，但由于 YAML 的特性（如缩进、符号等），某些部分的格式可能与原文略有不同。
~~~~

## Documentation/devicetree/bindings/mfd/lp3943_cn.txt
~~~~
TI/National Semiconductor LP3943 MFD 驱动

所需属性：
  - compatible: "ti,lp3943"
  - reg: I2C 从设备地址。范围从 0x60 到 0x67
LP3943 包含两个子设备，lp3943-gpio 和 lp3943-pwm
关于 LP3943 GPIO 的属性，请参考：
Documentation/devicetree/bindings/gpio/gpio-lp3943.txt

关于 LP3943 PWM 的属性，请参考：
Documentation/devicetree/bindings/pwm/pwm-lp3943.txt

示例：

```dt
lp3943@60 {
	compatible = "ti,lp3943";
	reg = <0x60>;

	gpioex: gpio {
		compatible = "ti,lp3943-gpio";
		gpio-controller;
		#gpio-cells = <2>;
	};

	pwm3943: pwm {
		compatible = "ti,lp3943-pwm";
		#pwm-cells = <2>;
		ti,pwm0 = <8 9 10>;
		ti,pwm1 = <15>;
	};
};
```
请注意，此示例展示了如何在 Device Tree 中定义 LP3943 设备及其 GPIO 和 PWM 子设备。这些定义允许操作系统正确识别和配置硬件组件。
~~~~

## Documentation/devicetree/bindings/mfd/marvell,88pm886-a1_cn.yaml
```yaml
下面是给定内容的中文翻译：

# SPDX-文件许可标识符: (GPL-2.0-only 或 BSD-2-Clause)
%YAML 1.2
---
$id: http://devicetree.org/schemas/mfd/marvell,88pm886-a1.yaml#
$schema: http://devicetree.org/meta-schemas/core.yaml#

标题: Marvell 88PM886 电源管理 IC 核心

维护者:
  - Karel Balej <balejk@matfyz.cz>

描述:
  Marvell 88PM886 是一款电源管理 IC，提供了多种功能，如开机键控制、稳压器以及电池和充电器管理。

属性:
  compatible:
    常量: marvell,88pm886-a1

  reg:
    最大项数: 1

  interrupts:
    最大项数: 1

  wakeup-source: true

  regulators:
    类型: 对象
    不允许附加属性
    模式属性:
      "^(ldo(1[0-6]|[1-9])|buck[1-5])$":
        类型: 对象
        $ref: /schemas/regulator/regulator.yaml#
        描述: LDO 或降压稳压器
未评估属性: false

必需:
  - compatible
  - reg
  - interrupts

不允许附加属性: false

示例:
  - |
    #include <dt-bindings/interrupt-controller/irq.h>
    i2c {
      #address-cells = <1>;
      #size-cells = <0>;
      pmic@30 {
        compatible = "marvell,88pm886-a1";
        reg = <0x30>;
        interrupts = <0 4 IRQ_TYPE_LEVEL_HIGH>;
        interrupt-parent = <&gic>;
        wakeup-source;

        regulators {
          ldo2: ldo2 {
            regulator-min-microvolt = <3100000>;
            regulator-max-microvolt = <3300000>;
          };

          ldo15: ldo15 {
            regulator-min-microvolt = <3300000>;
            regulator-max-microvolt = <3300000>;
          };

          buck2: buck2 {
            regulator-min-microvolt = <1800000>;
            regulator-max-microvolt = <1800000>;
          };
        };
      };
    };
..
```

## Documentation/devicetree/bindings/mfd/max77620_cn.txt
~~~~
Maxim Semiconductor 的 MAX77620 电源管理 IC。

必需属性：
-------------------
- compatible: 必须为以下之一
    "maxim,max77620"
    "maxim,max20024"
    "maxim,max77663"
- reg: I2C 设备地址

可选属性：
-------------------
- interrupts: 控制器所连接的父设备上的中断
- interrupt-controller: 标记该设备节点为一个中断控制器
- #interrupt-cells: 是 <2>，并且其使用方式符合位于 <../interrupt-controller/interrupts.txt> 中描述的 2 单元变体。针对 MAX77620 不同中断源的 IRQ 编号在 dt-bindings/mfd/max77620.h 中定义。
- system-power-controller: 表明此 PMIC 正在控制系统电源，更多详情参见 [1]
[1] 文档/devicetree/bindings/power/power-controller.txt

可选子节点及其属性：
=======================================

灵活的电源序列配置：
--------------------------------------
灵活电源序列器（FPS）允许每个稳压器在硬件或软件控制下上电。此外，每个稳压器可以独立上电或与其他一组稳压器一起上电，并且可以调整上电和断电延迟（序列）。GPIO1、GPIO2 和 GPIO3 可以被编程成为序列的一部分，使得外部稳压器可以与内部稳压器一起进行序列化。32KHz 时钟也可以被编程成为序列的一部分。
灵活的序列结构包括两个硬件使能输入（EN0、EN1），以及三个主序列定时器，称为 FPS0、FPS1 和 FPS2。
每个主序列定时器都可以通过其配置寄存器被编程为具有硬件使能源（EN1 或 EN2）或软件使能源（SW）。当被启用/禁用时，主序列定时器会在不同的时间间隔生成八个序列事件，这些时间间隔被称为槽位。这些槽位之间的时间间隔可以在配置寄存器中进行编程。
每个稳压器、GPIO1、GPIO2、GPIO3 以及 32KHz 时钟都具有一个灵活电源序列从属寄存器，这允许指定其使能源为一个灵活电源序列定时器或一个软件位。当一个由稳压器、GPIO 和时钟组成的 FPS 源指定其使能源为一个灵活电源序列定时器时，可以在稳压器、GPIO 和时钟的灵活电源序列配置寄存器中指定上电和断电延迟。
当FPS事件被清除（设置为低电平）时，在与其灵活序列器配置寄存器相对应的序列事件中，稳压器、GPIO和32KHz时钟将被置于以下状态：

睡眠状态：在此状态下，稳压器、GPIO和32KHz时钟在序列事件中被禁用。

全局低功耗模式(GLPM)：在此状态下，稳压器在序列事件中被设置为低功耗模式。

FPS的配置参数通过子节点“fps”及其子节点提供，专用于FPS。FPS的子节点名称分别为“fps0”、“fps1”和“fps2”，分别对应FPS0、FPS1和FPS2。
FPS配置，如FPS源、稳压器、GPIO和32kHz时钟的上电与断电时段等，均在其各自配置节点中提供，并在相应的子系统DT绑定文档中进行解释。
根据系统状态的不同，需要不同的FPS配置参数，例如从活动状态变为挂起状态或从活动状态变为关机状态。

可选属性：
--------------
-maxim,fps-event-source: u32, FPS事件源，如外部硬件输入到电源管理集成电路(PMIC)，即EN0、EN1或软件(SW)。
这些宏定义在`dt-bindings/mfd/max77620.h`文件中，针对不同的控制源：

- `MAX77620_FPS_EVENT_SRC_EN0` 对应硬件输入引脚EN0
- `MAX77620_FPS_EVENT_SRC_EN1` 对应硬件输入引脚EN1
- `MAX77620_FPS_EVENT_SRC_SW`：用于软件控制
- `maxim,shutdown-fps-time-period-us`：u32 类型，系统进入关机状态时的 FPS 时间周期（微秒）
- `maxim,suspend-fps-time-period-us`：u32 类型，系统进入挂起状态时的 FPS 时间周期（微秒）
- `maxim,device-state-on-disabled-event`：u32 类型，描述 FPS 事件被清除时 PMIC 的状态，是否应该进入睡眠状态或低功耗状态。有效值包括：
  - `MAX77620_FPS_INACTIVE_STATE_SLEEP`：将 PMIC 状态设置为睡眠
  - `MAX77620_FPS_INACTIVE_STATE_LOW_POWER`：将 PMIC 状态设置为低功耗
  如果缺少此属性或其他值，则当 FPS 事件被清除时设备状态不会改变

设备支持的时间周期（微秒）如下：
- `MAX77620` 支持 40、80、160、320、640、1280、2560 和 5120 微秒
- `MAX20024` 支持 20、40、80、160、320、640、1280 和 2540 微秒
- `MAX77663` 支持 20、40、80、160、320、640、1280 和 2540 微秒
- `maxim,power-ok-control`：配置映射电源正常位
  - 1：启用 POK（电源正常）来控制 nRST_IO 和 GPIO1 的 POK 功能
翻译如下：

0: 禁用 POK (Power OK) 控制
如果缺少该属性，则不配置 MPOK 位
如果为 GPIO1/nRST_IO 启用了 POK 映射，则
			只有当所有启用了 POK 控制的电源轨都处于高电平时，
			GPIO1/nRST_IO 引脚才保持高电平状态
如果有任何启用了 POK 控制的电源轨下降，则
			GPIO1/nRST_IO 引脚将变为低电平
此属性仅适用于 max20024
对于不同子模块（如 GPIO、引脚控制、稳压器、电源等）的设备树绑定详情，请参阅各自子系统目录下的相应设备树绑定文档。

示例：
-------
```device_tree
#include <dt-bindings/mfd/max77620.h>

max77620@3c {
	compatible = "maxim,max77620";
	reg = <0x3c>;

	interrupt-parent = <&intc>;
	interrupts = <0 86 IRQ_TYPE_NONE>;

	interrupt-controller;
	#interrupt-cells = <2>;

	fps {
		fps0 {
			maxim,shutdown-fps-time-period-us = <1280>;
			maxim,fps-event-source = <MAX77620_FPS_EVENT_SRC_EN1>;
		};

		fps1 {
			maxim,shutdown-fps-time-period-us = <1280>;
			maxim,fps-event-source = <MAX77620_FPS_EVENT_SRC_EN0>;
		};

		fps2 {
			maxim,shutdown-fps-time-period-us = <1280>;
			maxim,fps-event-source = <MAX77620_FPS_EVENT_SRC_SW>;
		};
	};
};
```

请注意，这里的示例是设备树中的一个片段，用于定义与 max77620 芯片相关的配置。
~~~~
