## Documentation/devicetree/bindings/mfd/maxim,max77802_cn.yaml
```yaml
# SPDX-许可证标识符: GPL-2.0-only
%YAML 1.2
---
$id: http://devicetree.org/schemas/mfd/maxim,max77802.yaml#
$schema: http://devicetree.org/meta-schemas/core.yaml#

title: Maxim MAX77802 电源管理集成电路

maintainers:
  - Javier Martinez Canillas <javier@dowhile0.org>
  - Krzysztof Kozlowski <krzk@kernel.org>

description: |
  这是Maxim MAX77802 电源管理集成电路(PMIC)的设备树绑定的一部分。
Maxim MAX77802 是一款电源管理集成电路，其中包含电压和电流调节器（10个高效率降压调节器和32个低压差线性稳压器(LDO)）、实时时钟(RTC)和时钟输出。
MAX77802 提供了两个32.768kHz时钟输出，这些输出可以通过I²C进行控制（开启/关闭）。时钟ID定义为预处理器宏，位于 dt-bindings/clock/maxim,max77802.h 中。

属性:
  compatible:
    常量: maxim,max77802

  '#clock-cells':
    常量: 1

  interrupts:
    最大项数: 1

  reg:
    最大项数: 1

  regulators:
    $ref: /schemas/regulator/maxim,max77802.yaml
    描述:
      指定调节器的子节点列表

inb1-supply:
    描述: 为buck1供电的电源
  inb2-supply:
    描述: 为buck2供电的电源
  inb3-supply:
    描述: 为buck3供电的电源
  inb4-supply:
    描述: 为buck4供电的电源
  inb5-supply:
    描述: 为buck5供电的电源
  inb6-supply:
    描述: 为buck6供电的电源
  inb7-supply:
    描述: 为buck7供电的电源
  inb8-supply:
    描述: 为buck8供电的电源
  inb9-supply:
    描述: 为buck9供电的电源
  inb10-supply:
    描述: 为buck10供电的电源

  inl1-supply:
    描述: 为LDO8、LDO15供电的电源
  inl2-supply:
    描述: 为LDO17、LDO27、LDO30、LDO35供电的电源
  inl3-supply:
    描述: 为LDO3、LDO5、LDO7、LDO7供电的电源
  inl4-supply:
    描述: 为LDO10、LDO11、LDO13、LDO14供电的电源
  inl5-supply:
    描述: 为LDO9、LDO19供电的电源
  inl6-supply:
    描述: 为LDO4、LDO21、LDO24、LDO33供电的电源
  inl7-supply:
    描述: 为LDO18、LDO20、LDO28、LDO29供电的电源
  inl9-supply:
    描述: 为LDO12、LDO23、LDO25、LDO26、LDO32、LDO34供电的电源
  inl10-supply:
    描述: 为LDO1、LDO2供电的电源

  wakeup-source: true

必需:
  - compatible
  - '#clock-cells'
  - reg

其他属性: false

示例:
  - |
    #include <dt-bindings/interrupt-controller/irq.h>
    #include <dt-bindings/regulator/maxim,max77802.h>

    i2c {
        #address-cells = <1>;
        #size-cells = <0>;

        pmic@9 {
            compatible = "maxim,max77802";
            interrupt-parent = <&gpx3>;
            interrupts = <1 IRQ_TYPE_NONE>;
            pinctrl-names = "default";
            pinctrl-0 = <&max77802_irq>, <&pmic_selb>,
                        <&pmic_dvs_1>, <&pmic_dvs_2>, <&pmic_dvs_3>;
            wakeup-source;
            reg = <0x9>;
            #clock-cells = <1>;

            inb1-supply = <&tps65090_dcdc2>;
            inb2-supply = <&tps65090_dcdc1>;
            inb3-supply = <&tps65090_dcdc2>;
            inb4-supply = <&tps65090_dcdc2>;
            inb5-supply = <&tps65090_dcdc1>;
            inb6-supply = <&tps65090_dcdc2>;
            inb7-supply = <&tps65090_dcdc1>;
            inb8-supply = <&tps65090_dcdc1>;
            inb9-supply = <&tps65090_dcdc1>;
            inb10-supply = <&tps65090_dcdc1>;

            inl1-supply = <&buck5_reg>;
            inl2-supply = <&buck7_reg>;
            inl3-supply = <&buck9_reg>;
            inl4-supply = <&buck9_reg>;
            inl5-supply = <&buck9_reg>;
            inl6-supply = <&tps65090_dcdc2>;
            inl7-supply = <&buck9_reg>;
            inl9-supply = <&tps65090_dcdc2>;
            inl10-supply = <&buck7_reg>;

            regulators {
                BUCK1 {
                    regulator-name = "vdd_mif";
                    regulator-min-microvolt = <800000>;
                    regulator-max-microvolt = <1300000>;
                    regulator-always-on;
                    regulator-boot-on;
                    regulator-ramp-delay = <12500>;
                    regulator-state-mem {
                        regulator-off-in-suspend;
                    };
                };

                BUCK2 {
                    regulator-name = "vdd_arm";
                    regulator-min-microvolt = <800000>;
                    regulator-max-microvolt = <1500000>;
                    regulator-always-on;
                    regulator-boot-on;
                    regulator-ramp-delay = <12500>;
                    regulator-coupled-with = <&buck3_reg>;
                    regulator-coupled-max-spread = <300000>;
                    regulator-state-mem {
                        regulator-off-in-suspend;
                    };
                };

                // ..
BUCK10 {
                    regulator-name = "vdd_1v8";
                    regulator-min-microvolt = <1800000>;
                    regulator-max-microvolt = <1800000>;
                    regulator-always-on;
                    regulator-boot-on;
                    regulator-state-mem {
                        regulator-on-in-suspend;
                    };
                };

                LDO1 {
                    regulator-name = "vdd_1v0";
                    regulator-min-microvolt = <1000000>;
                    regulator-max-microvolt = <1000000>;
                    regulator-always-on;
                    regulator-initial-mode = <MAX77802_OPMODE_NORMAL>;
                    regulator-state-mem {
                        regulator-on-in-suspend;
                        regulator-mode = <MAX77802_OPMODE_LP>;
                    };
                };

                // ..
LDO35 {
                    regulator-name = "ldo_35";
                    regulator-min-microvolt = <1200000>;
                    regulator-max-microvolt = <1200000>;
                };
            };
        };
    };
```
