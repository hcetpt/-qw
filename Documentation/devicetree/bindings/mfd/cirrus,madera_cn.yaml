## Documentation/devicetree/bindings/mfd/gateworks-gsc_cn.yaml
```yaml
# SPDX-许可证标识符: GPL-2.0-only 或 BSD-2-Clause
%YAML 1.2
---
$id: http://devicetree.org/schemas/mfd/gateworks-gsc.yaml#
$schema: http://devicetree.org/meta-schemas/core.yaml#

title: Gateworks 系统控制器

description: |
  Gateworks 系统控制器 (GSC) 是一个设备，存在于多个 Gateworks 产品系列中，
  提供了一系列与系统相关的功能，例如以下功能（请参考板卡硬件用户手册以查看具备哪些功能）：
   - 看门狗定时器
   - GPIO
   - 按钮控制器
   - 带有温度和电压轨的 ADC 的硬件监控器以及风扇控制器

maintainers:
  - Tim Harvey <tharvey@gateworks.com>

properties:
  $nodename:
    pattern: "gsc@[0-9a-f]{1,2}"
  compatible:
    const: gw,gsc

  reg:
    description: I2C 设备地址
    maxItems: 1

  interrupts:
    maxItems: 1

  interrupt-controller: true

  "#interrupt-cells":
    const: 1

  "#address-cells":
    const: 1

  "#size-cells":
    const: 0

  adc:
    type: object
    additionalProperties: false
    description: 可选的硬件监控模块

    properties:
      compatible:
        const: gw,gsc-adc

      "#address-cells":
        const: 1

      "#size-cells":
        const: 0

    patternProperties:
      "^channel@[0-9a-f]+$":
        type: object
        additionalProperties: false
        description: |
          单个 ADC 的属性，可以报告处理后的值
          （例如基于热敏电阻的温度传感器），原始值
          （例如带有预分压电阻的电压轨）
properties:
          reg:
            description: ADC 寄存器
            maxItems: 1

          label:
            description: ADC 输入名称

          gw,mode:
            description: |
              转换模式：
                0 - 温度，单位为摄氏度 * 10
                1 - 预分压的 24 位电压值
                2 - 基于可选分压电阻和可选偏移量的电压值
                3 - 预分压的 16 位电压值
                4 - 风扇转速输入以报告转数每分钟
            $ref: /schemas/types.yaml#/definitions/uint32
            enum: [0, 1, 2, 3, 4]

          gw,voltage-divider-ohms:
            description: 分压器上原始 ADC 输入的电阻值
            maxItems: 2
            items:
              minimum: 1000
              maximum: 1000000

          gw,voltage-offset-microvolt:
            description: |
              应用于原始 ADC 的正电压偏移
              （例如补偿二极管压降）
minimum: 0
            maximum: 1000000

        required:
          - gw,mode
          - reg
          - label

    required:
      - compatible
      - "#address-cells"
      - "#size-cells"

patternProperties:
  "^fan-controller@[0-9a-f]+$":
    type: object
    additionalProperties: false
    description: 可选的风扇控制器

    properties:
      compatible:
        const: gw,gsc-fan

      reg:
        description: 风扇控制器基地址
        maxItems: 1

    required:
      - compatible
      - reg

required:
  - compatible
  - reg
  - interrupts
  - interrupt-controller
  - "#interrupt-cells"
  - "#address-cells"
  - "#size-cells"

additionalProperties: false

examples:
  - |
    #include <dt-bindings/gpio/gpio.h>
    #include <dt-bindings/interrupt-controller/irq.h>
    i2c {
        #address-cells = <1>;
        #size-cells = <0>;

        gsc@20 {
            compatible = "gw,gsc";
            reg = <0x20>;
            interrupt-parent = <&gpio1>;
            interrupts = <4 IRQ_TYPE_LEVEL_LOW>;
            interrupt-controller;
            #interrupt-cells = <1>;
            #address-cells = <1>;
            #size-cells = <0>;

            adc {
                compatible = "gw,gsc-adc";
                #address-cells = <1>;
                #size-cells = <0>;

                channel@0 { /* A0: 板载温度 */
                    reg = <0x00>;
                    label = "temp";
                    gw,mode = <0>;
                };

                channel@2 { /* A1: 输入电压（原始 ADC） */
                    reg = <0x02>;
                    label = "vdd_vin";
                    gw,mode = <1>;
                    gw,voltage-divider-ohms = <22100 1000>;
                    gw,voltage-offset-microvolt = <800000>;
                };

                channel@b { /* A2: 电池电压 */
                    reg = <0x0b>;
                    label = "vdd_bat";
                    gw,mode = <1>;
                };
            };

            fan-controller@2c {
                compatible = "gw,gsc-fan";
                reg = <0x2c>;
            };
        };
    };
```

## Documentation/devicetree/bindings/mfd/google,cros-ec_cn.yaml
```yaml
# SPDX-许可证标识符: (GPL-2.0-only 或 BSD-2-Clause)
%YAML 1.2
---
$id: http://devicetree.org/schemas/mfd/google,cros-ec.yaml#
$schema: http://devicetree.org/meta-schemas/core.yaml#

标题: ChromeOS 嵌入式控制器

维护者:
  - Benson Leung <bleung@chromium.org>
  - Guenter Roeck <groeck@chromium.org>

描述:
  Google 的 ChromeOS EC 是一个与应用处理器 (AP) 进行通信并实现多种功能（如键盘控制和电池充电）的微控制器。
EC 可以通过各种接口（I2C、SPI 等）连接，兼容字符串指定了正在使用的接口。
属性:
  compatible:
    oneOf:
      - 描述:
          对于通过 I2C 连接的 EC 实现
        const: google,cros-ec-i2c
      - 描述:
          对于通过 SPI 连接的 EC 实现
        const: google,cros-ec-spi
      - 描述:
          对于通过 SPI 连接的 FPMCU 实现
        items:
          - const: google,cros-ec-fp
          - const: google,cros-ec-spi
      - 描述:
          对于通过 RPMSG 连接的 EC 实现
        const: google,cros-ec-rpmsg
      - 描述:
          对于通过 UART 连接的 EC 实现
        const: google,cros-ec-uart

  controller-data: true

  google,cros-ec-spi-pre-delay:
    描述:
      此属性指定 CS 信号被激活与第一个时钟脉冲之间的时间延迟（单位：微秒）
    $ref: /schemas/types.yaml#/definitions/uint32
    默认值: 0

  google,cros-ec-spi-msg-delay:
    描述:
      此属性指定消息之间的延迟时间（单位：微秒）
    $ref: /schemas/types.yaml#/definitions/uint32
    默认值: 0

  google,has-vbc-nvram:
    描述:
      一些 EC 实现包含一小段非易失性内存空间，用于存储验证引导上下文数据。此布尔标志用于指定该非易失性内存是否存在。
Here's the translation into Chinese:

类型: 布尔值

mediatek,rpmsg-name:
描述:
  如果cros-ec是一个针对联发科ARM Cortex M4协处理器的rpmsg设备，则必须定义。包含rpmsg设备的名称。用于匹配子节点与SCP宣布的rpmsg设备。
$ref: /schemas/types.yaml#/definitions/string

spi-max-frequency: 真

reg:
最大项数: 1

interrupts:
最大项数: 1

reset-gpios:
最大项数: 1

boot0-gpios:
最大项数: 1
描述: 断言进入引导加载程序模式
vdd-supply: 真

wakeup-source:
描述: 按钮可以唤醒系统
'#address-cells':
常量: 1

'#size-cells':
常量: 0

'#gpio-cells':
常量: 2

gpio-controller: 真

typec:
$ref: /schemas/chrome/google,cros-ec-typec.yaml#

ec-pwm:
$ref: /schemas/pwm/google,cros-ec-pwm.yaml#
废弃: 真

pwm:
$ref: /schemas/pwm/google,cros-ec-pwm.yaml#

kbd-led-backlight:
$ref: /schemas/chrome/google,cros-kbd-led-backlight.yaml#

keyboard-controller:
$ref: /schemas/input/google,cros-ec-keyb.yaml#

proximity:
$ref: /schemas/iio/proximity/google,cros-ec-mkbp-proximity.yaml#

codecs:
类型: 对象
附加属性: 假

属性:
  '#address-cells':
    常量: 2

  '#size-cells':
    常量: 1

模式属性:
  "^ec-codec@[a-f0-9]+$":
    类型: 对象
    $ref: /schemas/sound/google,cros-ec-codec.yaml#

必需:
  - "#address-cells"
  - "#size-cells"

cbas:
类型: 对象

描述:
  此设备用于在Chrome OS平板电脑连接可拆卸底座时发送信号。此设备无法在运行时检测到。
属性:
  compatible:
    常量: google,cros-cbas

必需:
  - compatible

附加属性: 假

模式属性:
  "^i2c-tunnel[0-9]*$":
    类型: 对象
    $ref: /schemas/i2c/google,cros-ec-i2c-tunnel.yaml#

  "^regulator@[0-9]+$":
    类型: 对象
    $ref: /schemas/regulator/google,cros-ec-regulator.yaml#

  "^extcon[0-9]*$":
    类型: 对象
    $ref: /schemas/extcon/extcon-usbc-cros-ec.yaml#

必需:
  - compatible

allOf:
  - 如果:
      属性:
        compatible:
          不:
            包含:
              常量: google,cros-ec-spi
    那么:
      属性:
        controller-data: 假
        google,cros-ec-spi-pre-delay: 假
        google,cros-ec-spi-msg-delay: 假
        spi-max-frequency: 假
    否则:
      $ref: /schemas/spi/spi-peripheral-props.yaml

  - 如果:
      属性:
        compatible:
          不:
            包含:
              枚举:
                - google,cros-ec-rpmsg
                - google,cros-ec-uart
    那么:
      属性:
        mediatek,rpmsg-name: 假

  - 如果:
      属性:
        compatible:
          不:
            包含:
              枚举:
                - google,cros-ec-rpmsg
                - google,cros-ec-uart
    那么:
      必需:
        - reg
        - interrupts

  - 如果:
      属性:
        compatible:
          包含:
            常量: google,cros-ec-fp
    那么:
      属性:
        '#address-cells': 假
        '#size-cells': 假
        typec: 假
        ec-pwm: 假
        kbd-led-backlight: 假
        keyboard-controller: 假
        proximity: 假
        codecs: 假
        cbas: 假

      模式属性:
        "^i2c-tunnel[0-9]*$": 假
        "^regulator@[0-9]+$": 假
        "^extcon[0-9]*$": 假

      # 使用additionalProperties: false和列出真属性不起作用

      必需:
        - reset-gpios
        - boot0-gpios
        - vdd-supply
    否则:
      属性:
        reset-gpios: 假
        boot0-gpios: 假
        vdd-supply: 假

附加属性: 假

示例:
  # I2C 示例
  - |
    #include <dt-bindings/gpio/gpio.h>
    #include <dt-bindings/interrupt-controller/irq.h>

    i2c {
        #address-cells = <1>;
        #size-cells = <0>;

        cros-ec@1e {
            compatible = "google,cros-ec-i2c";
            reg = <0x1e>;
            interrupts = <6 0>;
            interrupt-parent = <&gpio0>;
        };
    };

  # SPI 示例
  - |
    #include <dt-bindings/gpio/gpio.h>
    #include <dt-bindings/interrupt-controller/irq.h>

    spi {
        #address-cells = <1>;
        #size-cells = <0>;

        cros-ec@0 {
            compatible = "google,cros-ec-spi";
            reg = <0x0>;
            google,cros-ec-spi-msg-delay = <30>;
            google,cros-ec-spi-pre-delay = <10>;
            interrupts = <99 0>;
            interrupt-parent = <&gpio7>;
            spi-max-frequency = <5000000>;
            #gpio-cells = <2>;
            gpio-controller;

            proximity {
                compatible = "google,cros-ec-mkbp-proximity";
            };

            cbas {
                compatible = "google,cros-cbas";
            };
        };
    };

  # RPMSG 示例
  - |
    scp0 {
        cros-ec {
            compatible = "google,cros-ec-rpmsg";
        };
    };

  # FPMCU 示例
  - |
    spi {
      #address-cells = <0x1>;
      #size-cells = <0x0>;

      ec@0 {
        compatible = "google,cros-ec-fp", "google,cros-ec-spi";
        reg = <0x0>;
        interrupt-parent = <&gpio_controller>;
        interrupts = <4 IRQ_TYPE_LEVEL_LOW>;
        spi-max-frequency = <3000000>;
        reset-gpios = <&gpio_controller 5 GPIO_ACTIVE_LOW>;
        boot0-gpios = <&gpio_controller 10 GPIO_ACTIVE_HIGH>;
        vdd-supply = <&pp3300_fp_mcu>;
      };
    };

  # UART 示例
  - |
    serial {
        cros-ec {
            compatible = "google,cros-ec-uart";
        };
    };
```

## Documentation/devicetree/bindings/mfd/hi6421_cn.txt
~~~~
* Hisilicon有限公司的HI6421多功能设备（MFD）
所需父设备属性：
- compatible    ：以下芯片特定字符串之一：
    "hisilicon,hi6421-pmic"；
    "hisilicon,hi6421v530-pmic"；
- reg           ：hi6421的寄存器范围空间；

支持的Hi6421子设备包括：

设备                     中断名称                供电名称       描述
------                     ---------              ------------   -----------
稳压器               :  无                   : 无             : 稳压器

所需子设备属性：
无

示例：
``` 
hi6421 {
	compatible = "hisilicon,hi6421-pmic";
	reg = <0xfcc00000 0x0180>; /* 0x60 << 2 */

	稳压器 {
		// 为MLC NAND/ eMMC供电
		hi6421_vout0_reg: hi6421_vout0 {
			regulator-name = "VOUT0";
			regulator-min-microvolt = <2850000>;
			regulator-max-microvolt = <2850000>;
		};

		// 为26M振荡器供电
		hi6421_vout1_reg: hi6421_vout1 {
			regulator-name = "VOUT1";
			regulator-min-microvolt = <1700000>;
			regulator-max-microvolt = <2000000>;
			regulator-boot-on;
			regulator-always-on;
		};
	};
};
```
请注意，这里的“稳压器”是根据上下文翻译的，但通常在这样的上下文中会使用“regulators”。此外，“IRQ Names”和“Supply Names”可能分别被翻译为“中断名称”和“供电名称”，以更符合中文习惯。
~~~~

## Documentation/devicetree/bindings/mfd/hisilicon,hi655x_cn.txt
~~~~
海思Hi655x电源管理集成电路（PMIC）

从应用处理器SoC Hi6220访问PMIC Hi655x的硬件布局
在PMIC Hi655x和Hi6220之间，物理信号通道是SSI
我们可以使用内存映射I/O进行通信
+----------------+             +-------------+
|                |             |             |
|    Hi6220      |   SSI bus   |   Hi655x    |
|                |-------------|             |
|                |(REGMAP_MMIO)|             |
+----------------+             +-------------+

必需属性：
- compatible:           应该设置为"hisilicon,hi655x-pmic"
- reg:                  在Hi6220 SoC上的PMIC基地址
- interrupt-controller: Hi655x具有内部中断（有自己的中断域）
- pmic-gpios:           PMIC中断使用的GPIO
- #clock-cells:         来自通用时钟绑定；应该设置为0

可选属性：
- clock-output-names: 来自通用时钟绑定以覆盖默认输出时钟名称

示例：
```
pmic: pmic@f8000000 {
	compatible = "hisilicon,hi655x-pmic";
	reg = <0x0 0xf8000000 0x0 0x1000>;
	interrupt-controller;
	#interrupt-cells = <2>;
	pmic-gpios = <&gpio1 2 GPIO_ACTIVE_HIGH>;
	#clock-cells = <0>;
}
```
~~~~
