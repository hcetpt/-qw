## Documentation/devicetree/bindings/mfd/dlg,da9063_cn.yaml
```yaml
以下是提供的 YAML 文档的中文翻译：

# SPDX-许可证标识符: (GPL-2.0-only 或 BSD-2-Clause)
%YAML 1.2
---
$id: http://devicetree.org/schemas/mfd/dlg,da9063.yaml#
$schema: http://devicetree.org/meta-schemas/core.yaml#

标题: Dialog DA906{3L,3,2,1} 电源管理集成电路 (PMIC)

维护者:
  - Steve Twiss <stwiss.opensource@diasemi.com>

描述: |
  对于其他子模块的设备树绑定，请参阅相应子系统目录下的绑定文档。
  使用 regulator-{uv,ov}-{warn,error,protection}-microvolt 需要特殊处理：首先，当使用 GP_FB2 时，必须确保任何时候都至少有一个电压监视器处于启用状态。其次，由于 da9063 只支持欠压 (UV) 和过压 (OV) 监视，因此两者必须设置相同的严重性和值（0：禁用，1：启用）。
  DA906{3L,3,2,1} 设备的产品信息可在此处找到：
  - https://www.dialog-semiconductor.com/products/da9063l
  - https://www.dialog-semiconductor.com/products/da9063
  - https://www.dialog-semiconductor.com/products/da9062
  - https://www.dialog-semiconductor.com/products/da9061

属性:
  compatible:
    枚举:
      - dlg,da9061
      - dlg,da9062
      - dlg,da9063
      - dlg,da9063l

  reg:
    最大项数: 1

  interrupts:
    最大项数: 1

  interrupt-controller: true

  "#interrupt-cells":
    常量: 2

  gpio-controller: true

  "#gpio-cells":
    常量: 2

  gpio:
    类型: 对象
    不允许附加属性: true
    属性:
      compatible:
        常量: dlg,da9062-gpio

  onkey:
    $引用: /schemas/input/dlg,da9062-onkey.yaml

  regulators:
    类型: 对象
    不允许附加属性: true
    模式属性:
      "^(ldo([1-9]|1[01])|bcore([1-2]|s-merged)|b(pro|mem|io|peri)|bmem-bio-merged|buck[1-4])$":
        $引用: /schemas/regulator/regulator.yaml
        不评估的属性: false

  rtc:
    类型: 对象
    $引用: /schemas/rtc/rtc.yaml#
    不评估的属性: false
    属性:
      compatible:
        枚举:
          - dlg,da9062-rtc
          - dlg,da9063-rtc

  thermal:
    $引用: /schemas/thermal/dlg,da9062-thermal.yaml

  watchdog:
    $引用: /schemas/watchdog/dlg,da9062-watchdog.yaml

模式属性:
  "^(.+-hog(-[0-9]+)?)$":
    类型: 对象

    必需:
      - gpio-hog

必需:
  - compatible
  - reg

allOf:
  - 如果:
      属性:
        compatible:
          包含:
            枚举:
              - dlg,da9063
              - dlg,da9063l
    则:
      属性:
        gpio-controller: false
        "#gpio-cells": false
        gpio: false
        regulators:
          模式属性:
            "^buck[1-4]$": false
        thermal: false
      必需:
        - interrupts
        - interrupt-controller
        - '#interrupt-cells'

  - 如果:
      属性:
        compatible:
          包含:
            枚举:
              - dlg,da9062
    则:
      属性:
        regulators:
          模式属性:
            "^(ldo([5-9]|10|11)|bcore([1-2]|s-merged)|b(pro|mem|io|peri)|bmem-bio-merged)$": false
      必需:
        - gpio
        - onkey
        - rtc
        - thermal
        - watchdog

  - 如果:
      属性:
        compatible:
          包含:
            枚举:
              - dlg,da9061
    则:
      属性:
        gpio-controller: false
        "#gpio-cells": false
        gpio: false
        regulators:
          模式属性:
            "^(ldo([5-9]|10|11)|bcore([1-2]|s-merged)|b(pro|mem|io|peri)|bmem-bio-merged|buck4)$": false
        rtc: false
      必需:
        - onkey
        - thermal
        - watchdog

不允许附加属性: true

示例:
  - |
    #include <dt-bindings/interrupt-controller/irq.h>
    i2c {
      #address-cells = <1>;
      #size-cells = <0>;
      pmic@58 {
        compatible = "dlg,da9063";
        reg = <0x58>;
        interrupt-parent = <&gpio6>;
        interrupts = <11 IRQ_TYPE_LEVEL_LOW>;
        interrupt-controller;
        #interrupt-cells = <2>;

        rtc {
          compatible = "dlg,da9063-rtc";
        };

        watchdog {
          compatible = "dlg,da9063-watchdog";
        };

        onkey {
          compatible = "dlg,da9063-onkey";
          dlg,disable-key-power;
        };

        regulators {
          bcore1 {
            regulator-name = "BCORE1";
            regulator-min-microvolt = <300000>;
            regulator-max-microvolt = <1570000>;
            regulator-min-microamp = <500000>;
            regulator-max-microamp = <2000000>;
            regulator-boot-on;
          };
          ldo6 {
            /* 未使用 */
            regulator-name = "LDO_6";
            regulator-uv-protection-microvolt = <0>;
            regulator-ov-protection-microvolt = <0>;
          };
          ldo11 {
            regulator-name = "LDO_11";
            regulator-min-microvolt = <900000>;
            regulator-max-microvolt = <900000>;
            regulator-uv-protection-microvolt = <1>;
            regulator-ov-protection-microvolt = <1>;
            regulator-always-on;
          };
        };
      };
    };

  - |
    #include <dt-bindings/interrupt-controller/irq.h>
    #include <dt-bindings/regulator/dlg,da9063-regulator.h>
    i2c {
      #address-cells = <1>;
      #size-cells = <0>;
      pmic@58 {
        compatible = "dlg,da9062";
        reg = <0x58>;
        gpio-controller;
        #gpio-cells = <2>;

        sd0-pwr-sel-hog {
          gpio-hog;
          gpios = <1 0>;
          input;
          line-name = "SD0_PWR_SEL";
        };

        sd1-pwr-sel-hog {
          gpio-hog;
          gpios = <2 0>;
          input;
          line-name = "SD1_PWR_SEL";
        };

        sw-et0-en-hog {
          gpio-hog;
          gpios = <3 0>;
          input;
          line-name = "SW_ET0_EN#";
        };

        pmic-good-hog {
          gpio-hog;
          gpios = <4 0>;
          output-high;
          line-name = "PMIC_PGOOD";
        };

        gpio {
          compatible = "dlg,da9062-gpio";
        };

        onkey {
          compatible = "dlg,da9062-onkey";
        };

        regulators {
          buck1 {
            regulator-name = "vdd_arm";
            regulator-min-microvolt = <925000>;
            regulator-max-microvolt = <1380000>;
            regulator-initial-mode = <DA9063_BUCK_MODE_SYNC>;
            regulator-always-on;
          };
          buck2 {
            regulator-name = "vdd_soc";
            regulator-min-microvolt = <1150000>;
            regulator-max-microvolt = <1380000>;
            regulator-initial-mode = <DA9063_BUCK_MODE_SYNC>;
            regulator-always-on;
          };
          buck3 {
            regulator-name = "vdd_ddr3";
            regulator-min-microvolt = <1500000>;
            regulator-max-microvolt = <1500000>;
            regulator-initial-mode = <DA9063_BUCK_MODE_SYNC>;
            regulator-always-on;
          };
          buck4 {
            regulator-name = "vdd_eth";
            regulator-min-microvolt = <1200000>;
            regulator-max-microvolt = <1200000>;
            regulator-initial-mode = <DA9063_BUCK_MODE_SYNC>;
            regulator-always-on;
          };
          ldo1 {
            regulator-name = "vdd_snvs";
            regulator-min-microvolt = <3000000>;
            regulator-max-microvolt = <3000000>;
            regulator-always-on;
          };
          ldo2 {
            regulator-name = "vdd_high";
            regulator-min-microvolt = <3000000>;
            regulator-max-microvolt = <3000000>;
            regulator-always-on;
          };
          ldo3 {
            regulator-name = "vdd_eth_io";
            regulator-min-microvolt = <2500000>;
            regulator-max-microvolt = <2500000>;
          };
          ldo4 {
            regulator-name = "vdd_emmc";
            regulator-min-microvolt = <1800000>;
            regulator-max-microvolt = <1800000>;
            regulator-always-on;
          };
        };

        rtc {
          compatible = "dlg,da9062-rtc";
        };

        thermal {
          compatible = "dlg,da9062-thermal";
        };

        watchdog {
          compatible = "dlg,da9062-watchdog";
          dlg,use-sw-pm;
        };
      };
    };
```

## Documentation/devicetree/bindings/mfd/ene-kb3930_cn.yaml
```yaml
# SPDX-许可证标识符: GPL-2.0-only 或 BSD-2-Clause
%YAML 1.2
---
$id: http://devicetree.org/schemas/mfd/ene-kb3930.yaml#
$schema: http://devicetree.org/meta-schemas/core.yaml#

title: ENE KB3930 嵌入式控制器

description: |
  此绑定描述了连接到 I2C 总线的 ENE KB3930 嵌入式控制器。
maintainers:
  - Lubomir Rintel <lkundrak@v3.sk>

properties:
  compatible:
    items:
      - enum:
          - dell,wyse-ariel-ec  # Dell Wyse Ariel 板卡 (3020)
      - const: ene,kb3930
  reg:
    maxItems: 1

  off-gpios:
    description: 在 Ariel 上用于关机协议的 GPIO
    maxItems: 2

  system-power-controller: true

required:
  - compatible
  - reg

additionalProperties: false

examples:
  - |
    #include <dt-bindings/gpio/gpio.h>

    i2c {
      #address-cells = <1>;
      #size-cells = <0>;

      embedded-controller@58 {
        compatible = "dell,wyse-ariel-ec", "ene,kb3930";
        reg = <0x58>;
        system-power-controller;

        off-gpios = <&gpio 126 GPIO_ACTIVE_HIGH>,
                    <&gpio 127 GPIO_ACTIVE_HIGH>;
      };
    };
```

## Documentation/devicetree/bindings/mfd/fsl,imx8qxp-csr_cn.yaml
```yaml
下面是给定内容的中文翻译：

# SPDX-文件许可标识符: (GPL-2.0-only 或 BSD-2-Clause)
%YAML 1.2
---
$id: http://devicetree.org/schemas/mfd/fsl,imx8qxp-csr.yaml#
$schema: http://devicetree.org/meta-schemas/core.yaml#

标题: Freescale i.MX8qm/qxp 控制与状态寄存器模块

维护者:
  - Liu Ying <victor.liu@nxp.com>

描述: |
  作为系统控制器，Freescale i.MX8qm/qxp 控制与状态寄存器(CSR)模块代表了特定子系统的杂项寄存器集合。它可能为该子系统内的各种独立硬件设备提供控制和/或状态报告接口。一个典型的用例是其他节点通过 phandle 获取对 syscon 节点的引用，另一个典型用例是操作系统应当将 CSR 模块的所有子节点视为独立的子设备。

属性:
  $nodename:
    模式: "^syscon@[0-9a-f]+$"

  compatible:
    项目:
      - 枚举:
          - fsl,imx8qxp-mipi-lvds-csr
          - fsl,imx8qm-lvds-csr
      - 常量: syscon
      - 常量: simple-mfd

  reg:
    最大项数: 1

  clocks:
    最大项数: 1

  clock-names:
    常量: ipg

模式属性:
  "^(ldb|phy|pxl2dpi)$":
    类型: 对象
    描述: CSR 模块可能的子设备

必需:
  - compatible
  - reg
  - clocks
  - clock-names

allOf:
  - 如果:
      属性:
        compatible:
          包含:
            常量: fsl,imx8qxp-mipi-lvds-csr
    那么:
      必需:
        - pxl2dpi
        - ldb

  - 如果:
      属性:
        compatible:
          包含:
            常量: fsl,imx8qm-lvds-csr
    那么:
      必需:
        - phy
        - ldb

附加属性: false

示例:
  - |
    #include <dt-bindings/clock/imx8-lpcg.h>
    #include <dt-bindings/firmware/imx/rsrc.h>
    mipi_lvds_0_csr: syscon@56221000 {
        compatible = "fsl,imx8qxp-mipi-lvds-csr", "syscon", "simple-mfd";
        reg = <0x56221000 0x1000>;
        clocks = <&mipi_lvds_0_di_mipi_lvds_regs_lpcg IMX_LPCG_CLK_4>;
        clock-names = "ipg";

        mipi_lvds_0_pxl2dpi: pxl2dpi {
            compatible = "fsl,imx8qxp-pxl2dpi";
            fsl,sc-resource = <IMX_SC_R_MIPI_0>;
            power-domains = <&pd IMX_SC_R_MIPI_0>;

            ports {
                #address-cells = <1>;
                #size-cells = <0>;

                port@0 {
                    #address-cells = <1>;
                    #size-cells = <0>;
                    reg = <0>;

                    mipi_lvds_0_pxl2dpi_dc0_pixel_link0: endpoint@0 {
                        reg = <0>;
                        remote-endpoint = <&dc0_pixel_link0_mipi_lvds_0_pxl2dpi>;
                    };

                    mipi_lvds_0_pxl2dpi_dc0_pixel_link1: endpoint@1 {
                        reg = <1>;
                        remote-endpoint = <&dc0_pixel_link1_mipi_lvds_0_pxl2dpi>;
                    };
                };

                port@1 {
                    #address-cells = <1>;
                    #size-cells = <0>;
                    reg = <1>;

                    mipi_lvds_0_pxl2dpi_mipi_lvds_0_ldb_ch0: endpoint@0 {
                        reg = <0>;
                        remote-endpoint = <&mipi_lvds_0_ldb_ch0_mipi_lvds_0_pxl2dpi>;
                    };

                    mipi_lvds_0_pxl2dpi_mipi_lvds_0_ldb_ch1: endpoint@1 {
                        reg = <1>;
                        remote-endpoint = <&mipi_lvds_0_ldb_ch1_mipi_lvds_0_pxl2dpi>;
                    };
                };
            };
        };

        mipi_lvds_0_ldb: ldb {
            #address-cells = <1>;
            #size-cells = <0>;
            compatible = "fsl,imx8qxp-ldb";
            clocks = <&clk IMX_SC_R_LVDS_0 IMX_SC_PM_CLK_MISC2>,
                     <&clk IMX_SC_R_LVDS_0 IMX_SC_PM_CLK_BYPASS>;
            clock-names = "pixel", "bypass";
            power-domains = <&pd IMX_SC_R_LVDS_0>;

            channel@0 {
                #address-cells = <1>;
                #size-cells = <0>;
                reg = <0>;
                phys = <&mipi_lvds_0_phy>;
                phy-names = "lvds_phy";

                port@0 {
                    reg = <0>;

                    mipi_lvds_0_ldb_ch0_mipi_lvds_0_pxl2dpi: endpoint {
                        remote-endpoint = <&mipi_lvds_0_pxl2dpi_mipi_lvds_0_ldb_ch0>;
                    };
                };

                port@1 {
                    reg = <1>;

                    /* ... */
                };
            };

            channel@1 {
                #address-cells = <1>;
                #size-cells = <0>;
                reg = <1>;
                phys = <&mipi_lvds_0_phy>;
                phy-names = "lvds_phy";

                port@0 {
                    reg = <0>;

                    mipi_lvds_0_ldb_ch1_mipi_lvds_0_pxl2dpi: endpoint {
                        remote-endpoint = <&mipi_lvds_0_pxl2dpi_mipi_lvds_0_ldb_ch1>;
                    };
                };

                port@1 {
                    reg = <1>;

                    /* ... */
                };
            };
        };
    };

    mipi_lvds_0_phy: phy@56228300 {
        compatible = "fsl,imx8qxp-mipi-dphy";
        reg = <0x56228300 0x100>;
        clocks = <&clk IMX_SC_R_LVDS_0 IMX_SC_PM_CLK_PHY>;
        clock-names = "phy_ref";
        #phy-cells = <0>;
        fsl,syscon = <&mipi_lvds_0_csr>;
        power-domains = <&pd IMX_SC_R_MIPI_0>;
    };
```

## Documentation/devicetree/bindings/mfd/fsl-imx25-tsadc_cn.txt
~~~~
飞思卡尔MX25 ADC/触摸屏控制器多功能设备 (MFD)

此设备结合了两个通用转换队列，其中一个用于通用ADC，另一个用于触摸屏。
所需属性：
- compatible：		应为"fsl,imx25-tsadc"
- reg：				设备内存区域的起始地址和大小
- interrupts：		此设备的中断
					（参见：../interrupt-controller/interrupts.txt）
- clocks：			一个'ipg'时钟（参见：../clock/clock-bindings.txt）
- interrupt-controller：	此设备是一个中断控制器。它
						控制两个转换队列的中断
- #interrupt-cells：		应为'<1>'
- #address-cells：		应为'<1>'
- #size-cells：			应为'<1>'

此设备包含两个转换队列，可以作为子节点添加
第一个队列用于触摸屏，第二个用于通用ADC
示例：
``` 
tscadc: tscadc@50030000 {
	compatible = "fsl,imx25-tsadc";
	reg = <0x50030000 0xc>;
	interrupts = <46>;
	clocks = <&clks 119>;
	clock-names = "ipg";
	interrupt-controller;
	#interrupt-cells = <1>;
	#address-cells = <1>;
	#size-cells = <1>;
	ranges;

	tsc: tcq@50030400 {		// 触摸屏队列
		compatible = "fsl,imx25-tcq";
		reg = <0x50030400 0x60>;
		..
};

	adc: gcq@50030800 {		// 通用ADC队列
		compatible = "fsl,imx25-gcq";
		reg = <0x50030800 0x60>;
		..
};
```
以上内容描述了一个设备配置示例，其中`tscadc`是主设备，而`tsc`和`adc`分别是其下的触摸屏转换队列和通用ADC转换队列。
您提供的文本似乎不完整或者不含实际的内容以进行翻译。如果您能提供完整的句子或者明确需要翻译的内容，我将非常乐意帮助您！例如，如果有英文句子或者其他语言的句子需要翻译成中文，您可以告诉我。
~~~~
