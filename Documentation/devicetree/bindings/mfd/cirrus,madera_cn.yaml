## Documentation/devicetree/bindings/mfd/cirrus,madera_cn.yaml
~~~~yaml
# SPDX-文件许可人: GPL-2.0-only 或 BSD-2-Clause
%YAML 1.2
---
$id: http://devicetree.org/schemas/mfd/cirrus,madera.yaml#
$schema: http://devicetree.org/meta-schemas/core.yaml#

标题: Cirrus Logic Madera 类音频编解码器多功能设备

维护者:
  - patches@opensource.cirrus.com

描述: |
  这些设备是具备广泛数字功能及一系列模拟输入/输出的音频系统芯片。
更多信息参见以下子驱动绑定：

    bindings/pinctrl/cirrus,madera.yaml
    bindings/regulator/wlf,arizona.yaml
    bindings/sound/cirrus,madera.yaml

allOf:
  - $ref: /schemas/pinctrl/cirrus,madera.yaml#
  - $ref: /schemas/regulator/wlf,arizona.yaml#
  - $ref: /schemas/sound/cirrus,madera.yaml#
  - 如果:
      属性:
        compatible:
          包含:
            枚举:
              - cirrus,cs47l85
              - wlf,wm1840
    那么:
      属性:
        SPKVDDL-supply:
          描述:
            左侧扬声器驱动电源供应
SPKVDDR-supply:
          描述:
            右侧扬声器驱动电源供应
必需:
        - SPKVDDL-supply
        - SPKVDDR-supply
    否则:
      必需:
        - DCVDD-supply
  - 如果:
      属性:
        compatible:
          包含:
            枚举:
              - cirrus,cs47l15
              - cirrus,cs47l35
    那么:
      属性:
        SPKVDD-supply:
          描述:
            单声道扬声器驱动电源供应
必需:
        - SPKVDD-supply
  - 如果:
      属性:
        compatible:
          包含:
            枚举:
              - cirrus,cs47l35
              - cirrus,cs47l85
              - cirrus,cs47l90
              - cirrus,cs47l91
              - wlf,wm1840
    那么:
      属性:
        DBVDD2-supply:
          描述:
            数据总线电源供应
必需:
        - DBVDD2-supply
  - 如果:
      属性:
        compatible:
          包含:
            枚举:
              - cirrus,cs47l85
              - cirrus,cs47l90
              - cirrus,cs47l91
              - wlf,wm1840
    那么:
      属性:
        DBVDD3-supply:
          描述:
            数据总线电源供应
DBVDD4-supply:
          描述:
            数据总线电源供应
  - 如果:
      属性:
        compatible:
          包含:
            枚举:
              - cirrus,cs47l15
    那么:
      必需:
        - MICVDD-supply
    否则:
      属性:
        CPVDD2-supply:
          描述:
            辅助电荷泵电源供应
必需:
        - CPVDD2-supply

属性:
  compatible:
    枚举:
      - cirrus,cs47l15
      - cirrus,cs47l35
      - cirrus,cs47l85
      - cirrus,cs47l90
      - cirrus,cs47l91
      - cirrus,cs42l92
      - cirrus,cs47l92
      - cirrus,cs47l93
      - cirrus,wm1840

  reg:
    最大项数: 1

  gpio-controller: true

  '#gpio-cells':
    描述:
      第一个单元是引脚编号。第二个单元为将来使用预留，必须为零
    常量: 2

  interrupt-controller: true

  '#interrupt-cells':
    描述:
      第一个单元是IRQ编号
      第二个单元是标志位，编码为来自
      bindings/interrupt-controller/interrupts.txt 中的触发掩码
    常量: 2

  interrupts:
    最大项数: 1

  reset-gpios:
    描述:
      一个条目指定控制 /RESET 的 GPIO。根据
      bindings/gpio.txt 定义。虽然可选，但强烈建议使用硬件复位
下面是提供的 YAML 格式的配置描述翻译为中文：

### 配置项说明
- `maxItems`: 1

  - `clocks`:
    - **描述**:
      - 应该引用在 MCLK1、MCLK2 和 MCLK3 上提供的时钟。
    - `minItems`: 1
    - `maxItems`: 3

  - `clock-names`:
    - **描述**: 
      - 可以包含最多三个字符串：
        - `"mclk1"` 对于 MCLK1 上提供的时钟，推荐为高质量音频参考时钟
        - `"mclk2"` 对于 MCLK2 上提供的时钟，要求为始终开启的 32k 时钟
        - `"mclk3"` 对于 MCLK3 上提供的时钟
    - **一个示例**:
      - `items`:
          - `const`: mclk1
      - `items`:
          - `const`: mclk2
      - `items`:
          - `const`: mclk3
      - `items`:
          - `const`: mclk1
          - `const`: mclk2
      - `items`:
          - `const`: mclk1
          - `const`: mclk3
      - `items`:
          - `const`: mclk2
          - `const`: mclk3
      - `items`:
          - `const`: mclk1
          - `const`: mclk2
          - `const`: mclk3

  - `AVDD-supply`:
    - **描述**: 模拟电源供应

  - `DBVDD1-supply`:
    - **描述**: 数据总线电源供应

  - `CPVDD1-supply`:
    - **描述**: 充电泵电源供应

  - `DCVDD-supply`:
    - **描述**: 数字电源供应，在 CS47L85 和 WM1840 中可选，可以内部提供

  - `MICVDD-supply`:
    - **描述**: 麦克风电源供应，通常内部提供，除了在 cs47l24 和 wm1831 中是必需的

- **必需项**:
  - `compatible`
  - `gpio-controller`
  - `#gpio-cells`
  - `interrupt-controller`
  - `#interrupt-cells`
  - `interrupts`
  - `AVDD-supply`
  - `DBVDD1-supply`
  - `CPVDD1-supply`

- `unevaluatedProperties`: false

### 示例
```yaml
- |
  #include <dt-bindings/sound/madera.h>
  i2c@e0004000 {
      #address-cells = <1>;
      #size-cells = <0>;
      reg = <0xe0004000 0x1000>;

      cs47l85: codec@1a {
          compatible = "cirrus,cs47l85";
          reg = <0x1a>;

          reset-gpios = <&gpio 0>;
          wlf,ldoena = <&gpio 1>;

          interrupt-controller;
          #interrupt-cells = <2>;
          interrupts = <4 1 0>;

          gpio-controller;
          #gpio-cells = <2>;

          AVDD-supply = <&vdd1v8>;
          DBVDD1-supply = <&vdd1v8>;
          DBVDD2-supply = <&vdd1v8>;
          DBVDD3-supply = <&vdd1v8>;
          DBVDD4-supply = <&vdd1v8>;
          CPVDD1-supply = <&vdd1v8>;
          CPVDD2-supply = <&vdd1v2>;
          SPKVDDL-supply = <&vdd5v>;
          SPKVDDR-supply = <&vdd5v>;

          clocks = <&clks 0>, <&clks 1>, <&clks 2>;
          clock-names = "mclk1", "mclk2", "mclk3";

          cirrus,dmic-ref = <0 0 MADERA_DMIC_REF_MICBIAS1>;
          cirrus,inmode = <
              MADERA_INMODE_SE   MADERA_INMODE_SE
              MADERA_INMODE_SE   MADERA_INMODE_SE
              MADERA_INMODE_DIFF MADERA_INMODE_DIFF
          >;
          cirrus,max-channels-clocked = <2 0 0>;

          pinctrl-names = "default";
          pinctrl-0 = <&pinsettings>;

          pinsettings: pin-settings {
              aif1-pins {
                  groups = "aif1";
                  function = "aif1";
                  bias-bus-hold;
              };

              aif2-pins {
                  groups = "aif2";
                  function = "aif2";
                  bias-bus-hold;
              };

              aif3-pins {
                  groups = "aif3";
                  function = "aif3";
                  bias-bus-hold;
              };
          };
      };
  };
```
以上内容翻译了给定 YAML 文件中的配置项和示例。
~~~~

## Documentation/devicetree/bindings/mfd/da9052-i2c_cn.txt
```
* 对话 DA9052/53 电源管理集成电路 (PMIC)

必需属性：
- compatible ：应设置为 "dlg,da9052"、"dlg,da9053-aa"、
               "dlg,da9053-ab" 或 "dlg,da9053-bb"

可选属性：
- dlg,tsi-as-adc ：布尔值，如果设置，则X+、X-、Y+、Y- 触摸屏
                   输入线将用作通用模拟输入
- tsiref-supply: 指向调节器的句柄，该调节器提供TSIREF引脚所需的参考
                 电压。当触摸屏引脚用于ADC目的时必须提供

子节点：
- regulators : 包含调节器节点。DA9052/53 的调节器使用以下列出的名字进行绑定：

    buck1     : 调节器 BUCK CORE
    buck2     : 调节器 BUCK PRO
    buck3     : 调节器 BUCK MEM
    buck4     : 调节器 BUCK PERI
    ldo1      : 调节器 LDO1
    ldo2      : 调节器 LDO2
    ldo3      : 调节器 LDO3
    ldo4      : 调节器 LDO4
    ldo5      : 调节器 LDO5
    ldo6      : 调节器 LDO6
    ldo7      : 调节器 LDO7
    ldo8      : 调节器 LDO8
    ldo9      : 调节器 LDO9
    ldo10     : 调节器 LDO10

  各个调节器设备的具体绑定细节可以在以下文档中找到：
  文档/devicetree/bindings/regulator/regulator.txt

示例：

i2c@63fc8000 { /* I2C1 */

	pmic: dialog@48 {
		compatible = "dlg,da9053-aa";
		reg = <0x48>;

		regulators {
			buck1 {
				regulator-min-microvolt = <500000>;
				regulator-max-microvolt = <2075000>;
			};

			buck2 {
				regulator-min-microvolt = <500000>;
				regulator-max-microvolt = <2075000>;
			};

			buck3 {
				regulator-min-microvolt = <925000>;
				regulator-max-microvolt = <2500000>;
			};

			buck4 {
				regulator-min-microvolt = <925000>;
				regulator-max-microvolt = <2500000>;
			};
		};
	};
};
```

## Documentation/devicetree/bindings/mfd/da9055_cn.txt
~~~~
*Dialog DA9055 电源管理集成电路 (PMIC)

DA9055 包含了一个庞大且多样的子设备组（仅 I2C）：

| 设备 | 供电名称 | 描述 |
|------|------------|-----------|
| da9055-gpio | - | GPIOs |
| da9055-regulator | - | 调压器 |
| da9055-onkey | - | 开机键 |
| da9055-rtc | - | 实时时钟 (RTC) |
| da9055-hwmon | - | 模数转换器 (ADC) |
| da9055-watchdog | - | 看门狗 |

DA9055 中的 CODEC 设备具有独立、可配置的 I2C 地址，因此与 PMIC 分开实例化。
关于配套的 CODEC I2C 设备的详细信息，请参阅以下文档：
`Documentation/devicetree/bindings/sound/da9055.txt`

------

**必需属性：**
- `compatible`：应为 `"dlg,da9055-pmic"`
- `reg`：指定 I2C 从设备地址（默认为 0x5a，但可以修改）
- `interrupts`：DA9055 芯片的中断线信息
- `interrupt-controller`：DA9055 内置中断（有自己的中断域）
- `#interrupt-cells`：应为 1，是 DA9055 的本地中断编号
**子节点：**
- `regulators`：包含调压器节点。DA9055 的调压器使用下面列出的名字进行绑定：

    `buck1` ：调压器 BUCK1
    `buck2` ：调压器 BUCK2
    `ldo1`  ：调压器 LDO1
    `ldo2`  ：调压器 LDO2
    `ldo3`  ：调压器 LDO3
    `ldo4`  ：调压器 LDO4
    `ldo5`  ：调压器 LDO5
    `ldo6`  ：调压器 LDO6

  单个调压器设备的具体绑定详情可以在以下文件中找到：
  `Documentation/devicetree/bindings/regulator/regulator.txt`

**示例：**

```text
pmic: da9055-pmic@5a {
    compatible = "dlg,da9055-pmic";
    reg = <0x5a>;
    interrupt-parent = <&intc>;
    interrupts = <5 IRQ_TYPE_LEVEL_LOW>;
    interrupt-controller;
    #interrupt-cells = <1>;

    regulators {
        buck1: BUCK1 {
            regulator-min-microvolt = <725000>;
            regulator-max-microvolt = <2075000>;
        };
        buck2: BUCK2 {
            regulator-min-microvolt = <925000>;
            regulator-max-microvolt = <2500000>;
        };
        ldo1: LDO1 {
            regulator-min-microvolt = <900000>;
            regulator-max-microvolt = <3300000>;
        };
    };
};
```
以上示例展示了如何定义一个 DA9055 PMIC 设备及其部分调压器配置。
~~~~

## Documentation/devicetree/bindings/mfd/da9150_cn.txt
~~~~
Dialog Semiconductor DA9150 充电器/电量计 MFD 绑定文件

DA9150 包含一组子设备：

| 设备          | 描述                     |
|---------------|--------------------------|
| da9150-gpadc  | 通用 ADC                 |
| da9150-charger| 电池充电器               |
| da9150-fg     | 电池电量计               |

### 必需的属性：
- compatible：应为 "dlg,da9150"
- reg：指定 I2C 从设备地址
- interrupts：da9150 芯片的 IRQ 线信息
- interrupt-controller：da9150 内部包含 IRQ（有自己的 IRQ 域）
（有关中断属性的更多信息，请参阅 ../interrupt-controller/interrupts.txt）

### 子设备：
- da9150-gpadc：请参阅 ../iio/adc/da9150-gpadc.txt
- da9150-charger：请参阅 ../power/da9150-charger.txt
- da9150-fg：请参阅 ../power/da9150-fg.txt

### 示例：

```yaml
charger_fg: da9150@58 {
    compatible = "dlg,da9150";
    reg = <0x58>;
    interrupt-parent = <&gpio6>;
    interrupts = <11 IRQ_TYPE_LEVEL_LOW>;
    interrupt-controller;

    gpadc: da9150-gpadc {
        compatible = "dlg,da9150-gpadc";
        #io-channel-cells = <1>;
    };

    charger {
        compatible = "dlg,da9150-charger";

        io-channels = <&gpadc 0>,
                      <&gpadc 2>,
                      <&gpadc 8>,
                      <&gpadc 5>;
        io-channel-names = "CHAN_IBUS",
                           "CHAN_VBUS",
                           "CHAN_TJUNC",
                           "CHAN_VBAT";
    };

    fuel-gauge {
        compatible = "dlg,da9150-fuel-gauge";

        dlg,update-interval = <10000>;
        dlg,warn-soc-level = /bits/ 8 <15>;
        dlg,crit-soc-level = /bits/ 8 <5>
    };
};
```
以上示例展示了如何配置 DA9150 芯片及其相关子设备。
~~~~

## Documentation/devicetree/bindings/mfd/delta,tn48m-cpld_cn.yaml
```yaml
下面是给定内容的中文翻译：

# SPDX-文件许可标识符: (GPL-2.0-only 或 BSD-2-Clause)
%YAML 1.2
---
$id: http://devicetree.org/schemas/mfd/delta,tn48m-cpld.yaml#
$schema: http://devicetree.org/meta-schemas/core.yaml#

标题: Delta Networks TN48M CPLD 控制器

维护者:
  - Robert Marko <robert.marko@sartura.hr>

描述: |
  安装在 TN48M 交换机上的 Lattice CPLD 用于系统管理。
  它提供了关于硬件模型、修订版本、PSU 状态等信息。
  同时也被用作 GPIO 扩展器和交换机 MAC 及其他外设的复位控制器。

属性:
  compatible:
    常量: delta,tn48m-cpld

  reg:
    描述:
      I2C 设备地址
    最大项数: 1

  "#address-cells":
    常量: 1

  "#size-cells":
    常量: 0

必需项:
  - compatible
  - reg
  - "#address-cells"
  - "#size-cells"

模式属性:
  "^gpio(@[0-9a-f]+)?$":
    引用: /schemas/gpio/delta,tn48m-gpio.yaml

  "^reset-controller?$":
    引用: /schemas/reset/delta,tn48m-reset.yaml

额外属性: false

示例:
  - |
    i2c {
        #address-cells = <1>;
        #size-cells = <0>;

        cpld@41 {
            compatible = "delta,tn48m-cpld";
            reg = <0x41>;
            #address-cells = <1>;
            #size-cells = <0>;

            gpio@31 {
                compatible = "delta,tn48m-gpo";
                reg = <0x31>;
                gpio-controller;
                #gpio-cells = <2>;
            };

            gpio@3a {
                compatible = "delta,tn48m-gpi";
                reg = <0x3a>;
                gpio-controller;
                #gpio-cells = <2>;
            };

            gpio@40 {
                compatible = "delta,tn48m-gpi";
                reg = <0x40>;
                gpio-controller;
                #gpio-cells = <2>;
            };

            reset-controller {
              compatible = "delta,tn48m-reset";
              #reset-cells = <1>;
            };
        };
    };
```
