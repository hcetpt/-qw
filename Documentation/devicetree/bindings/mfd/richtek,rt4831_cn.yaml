## Documentation/devicetree/bindings/mfd/rockchip,rk817_cn.yaml
~~~~yaml
# SPDX-许可证标识符: GPL-2.0-only 或 BSD-2-Clause
%YAML 1.2
---
$id: http://devicetree.org/schemas/mfd/rockchip,rk817.yaml#
$schema: http://devicetree.org/meta-schemas/core.yaml#

标题: RK809/RK817 电源管理集成电路

维护者:
  - Chris Zhong <zyw@rock-chips.com>
  - Zhang Qing <zhangqing@rock-chips.com>

描述: |
  Rockchip RK809/RK817 系列 PMIC。该设备包括一个通过 I²C 控制的多功能设备，其中包含稳压器、实时时钟 (RTC)、电源按钮和音频编解码器。
RK817 变体还提供了一个电池充电器管理器。
属性:
  compatible:
    枚举:
      - rockchip,rk809
      - rockchip,rk817

  reg:
    最大项目数: 1

  interrupts:
    最大项目数: 1

  '#clock-cells':
    描述:
      查看 <dt-bindings/clock/rockchip,rk808.h> 获取时钟 ID
minimum: 0
    最大值: 1

  clocks:
    最大项目数: 1

  clock-names:
    项目:
      - 常量: mclk

  clock-output-names:
    描述:
      根据通用时钟绑定覆盖默认输出时钟名称
rockchip,system-power-controller:
    类型: 布尔值
    过时: true
    描述:
      指示此 PMIC 是否控制系统电源
'#sound-dai-cells':
    常量: 0

  system-power-controller: true

  wakeup-source:
    类型: 布尔值
    描述:
      设备可用作唤醒源
vcc1-supply:
    描述:
      DCDC_REG1 的输入供电
vcc2-supply:
    描述:
      DCDC_REG2 的输入供电
vcc3-supply:
    描述:
      DCDC_REG3 的输入供电
vcc4-supply:
    描述:
      DCDC_REG4 的输入供电
以下是提供的英文描述翻译成中文：

`vcc5-supply`:
    描述:
      LDO_REG1、LDO_REG2 和 LDO_REG3 的输入电源

`vcc6-supply`:
    描述:
      LDO_REG4、LDO_REG5 和 LDO_REG6 的输入电源

`vcc7-supply`:
    描述:
      LDO_REG7、LDO_REG8 和 LDO_REG9 的输入电源

`vcc8-supply`:
    描述:
      RK817 上 BOOST 的输入电源，或 RK809 上 SWITCH_REG2 的输入电源

`vcc9-supply`:
    描述:
      RK817 上 OTG_SWITCH 的输入电源，
      或 RK809 上 DCDC_REG5 和 SWITCH_REG1 的输入电源

`regulators`:
    类型: 对象
    模式属性:
      "^((LDO_REG[1-9])|(DCDC_REG[1-5])|(BOOST)|(OTG_SWITCH)|(SWITCH_REG[1-2]))$":
        引用: /schemas/regulator/regulator.yaml
        不评估的属性: false
    额外属性: false

`codec`:
    类型: 对象
    额外属性: false
    属性:
      `rockchip,mic-in-differential`:
        类型: 布尔值
        描述:
          描述麦克风是否使用差分模式

`charger`:
    类型: 对象
    引用: /schemas/power/supply/power-supply.yaml
    属性:
      `monitored-battery`:
        描述: |
          指向一个被监控电池节点的句柄，该节点包含以下有效值：
          charge-full-design-microamp-hours（设计满电微安时数），
          charge-term-current-microamp（充电终止电流微安），
          constant-charge-current-max-microamp（恒定充电最大电流微安），
          constant-charge-voltage-max-microvolt（恒定充电最大电压微伏），
          voltage-max-design-microvolt（设计最大电压微伏），
          voltage-min-design-microvolt（设计最小电压微伏），
          以及一个有效的 ocv-capacity 表
      `rockchip,resistor-sense-micro-ohms`:
        描述: |
          电池感应电阻的微欧姆值。此值由驱动程序用于设置正确的除数值以将 ADC 读数转换为正确的测量单位
枚举: [10000, 20000]
      
      `rockchip,sleep-enter-current-microamp`:
        描述: |
          充电器进入睡眠状态时的微安值
该值由驱动程序用于校准放松阈值
这段文本定义了一个设备树片段，描述了Rockchip RK817电源管理IC (PMIC)的配置。下面是对其中特定部分的中文翻译和解释：

### rockchip,sleep-filter-current-microamp:
- **描述**: 充电器睡眠滤波电流的微安值。
- **用途**: 驱动程序使用该值来推导所需的睡眠采样电流。

### 必需属性:
- **monitored-battery**: 指定被监控的电池节点。
- **rockchip,resistor-sense-micro-ohms**: 感知电阻的微欧姆值。
- **rockchip,sleep-enter-current-microamp**: 进入睡眠模式时的电流阈值（微安）。
- **rockchip,sleep-filter-current-meroamp**: 睡眠滤波电流（微安）。

### 示例:
```yaml
# 包含必要的绑定文件
#include <dt-bindings/clock/px30-cru.h>
#include <dt-bindings/pinctrl/rockchip.h>
#include <dt-bindings/interrupt-controller/irq.h>
#include <dt-bindings/gpio/gpio.h>

# I2C 总线配置
i2c {
    #address-cells = <1>; # 地址单元数
    #size-cells = <0>; # 大小单元数

    # PMIC 节点
    rk817: pmic@20 {
        compatible = "rockchip,rk817"; # 兼容性声明
        reg = <0x20>; # 寄存器地址
        interrupt-parent = <&gpio0>; # 中断父节点
        interrupts = <RK_PB2 IRQ_TYPE_LEVEL_LOW>; # 中断配置
        clock-output-names = "rk808-clkout1", "xin32k"; # 时钟输出名称
        clock-names = "mclk"; # 时钟名称
        clocks = <&cru SCLK_I2S1_OUT>; # 时钟源
        pinctrl-names = "default"; # 引脚控制名称
        pinctrl-0 = <&pmic_int>, <&i2s1_2ch_mclk>; # 引脚控制配置
        wakeup-source; # 唤醒源
        #clock-cells = <1>; # 时钟单元数
        #sound-dai-cells = <0>; # 音频子系统单元数

        # 供电信息
        vcc1-supply = <&vccsys>;
        vcc2-supply = <&vccsys>;
        vcc3-supply = <&vccsys>;
        vcc4-supply = <&vccsys>;
        vcc5-supply = <&vccsys>;
        vcc6-supply = <&vccsys>;
        vcc7-supply = <&vccsys>;

        # 调节器配置
        regulators {
            # DCDC调节器
            vdd_logic: DCDC_REG1 { ... };
            vdd_arm: DCDC_REG2 { ... };
            vcc_ddr: DCDC_REG3 { ... };
            vcc_3v3: DCDC_REG4 { ... };
            
            # LDO调节器
            vcc_1v8: LDO_REG2 { ... };
            vdd_1v0: LDO_REG3 { ... };
            vcc3v3_pmu: LDO_REG4 { ... };
            vccio_sd: LDO_REG5 { ... };
            vcc_sd: LDO_REG6 { ... };
            vcc_bl: LDO_REG7 { ... };
            vcc_lcd: LDO_REG8 { ... };
            vcc_cam: LDO_REG9 { ... };
        };

        # 充电器配置
        rk817_charger: charger {
            monitored-battery = <&battery>; # 监控电池
            rockchip,resistor-sense-micro-ohms = <10000>; # 感知电阻（微欧姆）
            rockchip,sleep-enter-current-microamp = <300000>; # 进入睡眠模式时的电流阈值（微安）
            rockchip,sleep-filter-current-microamp = <100000>; # 睡眠滤波电流（微安）
        };

        # 编码解码器配置
        rk817_codec: codec {
            rockchip,mic-in-differential; # 差分麦克风输入
        };
    };
};
```

这个示例详细地配置了一个基于Rockchip RK817的电源管理IC，包括其内部的DC-DC转换器、低压差稳压器(LDOs)、充电器和音频编解码器等组件。它还指定了与电池监控相关的参数，例如进入睡眠模式时的电流阈值以及睡眠滤波电流等。
~~~~

## Documentation/devicetree/bindings/mfd/rockchip,rk818_cn.yaml
~~~~yaml
# SPDX-许可证标识符: GPL-2.0-only 或 BSD-2-Clause
%YAML 1.2
---
$id: http://devicetree.org/schemas/mfd/rockchip,rk818.yaml#
$schema: http://devicetree.org/meta-schemas/core.yaml#

标题: RK818 电源管理集成电路

维护者:
  - Chris Zhong <zyw@rock-chips.com>
  - Zhang Qing <zhangqing@rock-chips.com>

描述: |
  Rockchip RK818 系列 PMIC。此设备包含一个通过 I²C 控制的多功能设备 (MFD)，其中包括稳压器、实时时钟 (RTC) 和电源按钮。
属性:
  compatible:
    枚举:
      - rockchip,rk818

  reg:
    最大项数: 1

  interrupts:
    最大项数: 1

  '#clock-cells':
    描述: |
      查看 <dt-bindings/clock/rockchip,rk808.h> 获取时钟 ID
    常量: 1

  clock-output-names:
    描述:
      从通用时钟绑定中覆盖默认输出时钟名称
    最大项数: 2

  rockchip,system-power-controller:
    类型: 布尔值
    已废弃: true
    描述:
      指示该 PMIC 是否控制系统电源
    system-power-controller: true

  wakeup-source:
    类型: 布尔值
    描述:
      设备可以作为唤醒源使用

  vcc1-supply:
    描述:
      DCDC_REG1 的输入电源

  vcc2-supply:
    描述:
      DCDC_REG2 的输入电源

  vcc3-supply:
    描述:
      DCDC_REG3 的输入电源

  vcc4-supply:
    描述:
      DCDC_REG4 的输入电源

  boost-supply:
    描述:
      DCDC_BOOST 的输入电源

  vcc6-supply:
    描述:
      LDO_REG1 和 LDO_REG2 的输入电源
下面是提供的描述和示例的中文翻译：

### 描述：
`vcc7-supply`:  
- LDO_REG3、LDO_REG5 和 LDO_REG7 的输入电源。

`vcc8-supply`:  
- LDO_REG4、LDO_REG6 和 LDO_REG8 的输入电源。

`vcc9-supply`:  
- LDO_REG9 和 SWITCH_REG 的输入电源。

`vddio-supply`:  
- 数字 IO 的输入电源。

`h_5v-supply`:  
- HDMI_SWITCH 的输入电源。

`usb-supply`:  
- OTG_SWITCH 的输入电源。

`regulators`:  
- 类型：对象
- `patternProperties`:  
  - `"^(DCDC_REG[1-4]|DCDC_BOOST|LDO_REG[1-9]|SWITCH_REG|HDMI_SWITCH|OTG_SWITCH)$"`:
    - 类型：对象
    - `$ref`: `/schemas/regulator/regulator.yaml#`
    - `unevaluatedProperties`: `false`
- `unevaluatedProperties`: `false`

### 必须包含的字段：
- `compatible`
- `reg`
- `interrupts`
- `#clock-cells`

### 其他属性：
- `additionalProperties`: `false`

### 示例：
```yaml
#include <dt-bindings/clock/px30-cru.h>
#include <dt-bindings/pinctrl/rockchip.h>
#include <dt-bindings/interrupt-controller/irq.h>
#include <dt-bindings/gpio/gpio.h>

i2c {
    #address-cells = <1>;
    #size-cells = <0>;

    rk818: pmic@1c {
        compatible = "rockchip,rk818";
        reg = <0x1c>;
        interrupt-parent = <&gpio0>;
        interrupts = <4 IRQ_TYPE_LEVEL_LOW>;
        pinctrl-names = "default";
        pinctrl-0 = <&pmic_int>;
        rockchip,system-power-controller;
        wakeup-source;
        #clock-cells = <1>;

        vcc1-supply = <&vdd_sys>;
        vcc2-supply = <&vdd_sys>;
        vcc3-supply = <&vdd_sys>;
        vcc4-supply = <&vdd_sys>;
        boost-supply = <&vdd_in_otg_out>;
        vcc6-supply = <&vdd_sys>;
        vcc7-supply = <&vdd_misc_1v8>;
        vcc8-supply = <&vdd_misc_1v8>;
        vcc9-supply = <&vdd_3v3_io>;
        vddio-supply = <&vdd_3v3_io>;

        regulators {
            vdd_log: DCDC_REG1 {
                regulator-name = "vdd_log";
                regulator-always-on;
                regulator-boot-on;
                regulator-min-microvolt = <1100000>;
                regulator-max-microvolt = <1100000>;
                regulator-state-mem {
                    regulator-off-in-suspend;
                };
            };

            vdd_gpu: DCDC_REG2 {
                regulator-name = "vdd_gpu";
                regulator-always-on;
                regulator-boot-on;
                regulator-min-microvolt = <800000>;
                regulator-max-microvolt = <1250000>;
                regulator-state-mem {
                    regulator-on-in-suspend;
                    regulator-suspend-microvolt = <1000000>;
                };
            };

            // ... (省略其他部分，以保持简洁)

            vdd_io_sd: LDO_REG9 {
                regulator-name = "vdd_io_sd";
                regulator-always-on;
                regulator-boot-on;
                regulator-min-microvolt = <1800000>;
                regulator-max-microvolt = <3300000>;
                regulator-state-mem {
                    regulator-off-in-suspend;
                };
            };
        };
    };
};
```

请注意，此翻译主要关注于描述部分及其对应的中文解释。示例中的具体配置（如电压值等）未进行详细翻译。
~~~~

## Documentation/devicetree/bindings/mfd/rohm,bd71815-pmic_cn.yaml
```yaml
# SPDX-许可证标识符: GPL-2.0-only OR BSD-2-Clause
%YAML 1.2
---
$id: http://devicetree.org/schemas/mfd/rohm,bd71815-pmic.yaml#
$schema: http://devicetree.org/meta-schemas/core.yaml#

title: ROHM BD71815 电源管理集成电路

maintainers:
  - Matti Vaittinen <mazziesaccount@gmail.com>

description: |
  BD71815AGW 是一款用于电池供电便携式设备的单芯片电源管理 IC。
  它集成了 5 个降压转换器、8 个 LDO（低压差稳压器）、一个用于 LED 的升压驱动器和一个 500 mA 单节线性充电器。此外还包括了一个库仑计数器、一个实时时钟（RTC）以及一个 32.768 kHz 时钟门控和两个 GPO。
properties:
  compatible:
    const: rohm,bd71815

  reg:
    description:
      I2C 从机地址
maxItems: 1

  interrupts:
    maxItems: 1

  gpio-controller: true

  "#gpio-cells":
    const: 2
    description: |
      第一个单元是引脚编号，第二个单元用于指定标志。更多信息请参见 ../gpio/gpio.txt
clocks:
    maxItems: 1

  "#clock-cells":
    const: 0

  clock-output-names:
    const: bd71815-32k-out

  rohm,clkout-open-drain:
    description: clk32kout 模式。设置为 1 表示“开漏”或 0 表示“cmos”
$ref: /schemas/types.yaml#/definitions/uint32
    minimum: 0
    maximum: 1

  rohm,charger-sense-resistor-ohms:
    minimum: 10000000
    maximum: 50000000
    description: |
      BD71827 和 BD71828 具有 SAR ADC 用于测量充电电流
外部感应电阻（数据手册中的 RSENSE）应被使用。如果使用了除 30MΩ 以外的其他电阻值，则应在此处以欧姆为单位给出该值。
默认: 30000000

  regulators:
    $ref: /schemas/regulator/rohm,bd71815-regulator.yaml
    description:
      列出指定稳压器的子节点
gpio-reserved-ranges:
    description: |
      可通过 OTP 改变 BD71828 GPIO 引脚的用途。此属性可用于标记不应配置为 GPIO 的引脚。更多信息请参阅 ../gpio/gpio.txt
rohm,enable-hidden-gpo:
    description: |
      BD71815 在引脚 E5 上有一个未记录的 GPO。在数据手册中该引脚标记为 GND，因为其位置在 GND 引脚中间，使得在 PCB 上难以使用。如果你的板卡成功地使用了这个引脚，可以通过定义此属性来启用第二个 GPO。如果你不确定 E5 引脚在你的板卡上是如何连接的，请不要启用此选项。
type: boolean

required:
  - compatible
  - reg
  - interrupts
  - clocks
  - "#clock-cells"
  - regulators
  - gpio-controller
  - "#gpio-cells"

additionalProperties: false

examples:
  - |
    #include <dt-bindings/interrupt-controller/irq.h>
    #include <dt-bindings/leds/common.h>
    i2c {
        #address-cells = <1>;
        #size-cells = <0>;
        pmic: pmic@4b {
            compatible = "rohm,bd71815";
            reg = <0x4b>;

            interrupt-parent = <&gpio1>;
            interrupts = <29 IRQ_TYPE_LEVEL_LOW>;

            clocks = <&osc 0>;
            #clock-cells = <0>;
            clock-output-names = "bd71815-32k-out";

            gpio-controller;
            #gpio-cells = <2>;

            rohm,charger-sense-resistor-ohms = <10000000>;

            regulators {
                buck1: buck1 {
                    regulator-name = "buck1";
                    regulator-min-microvolt = <800000>;
                    regulator-max-microvolt = <2000000>;
                    regulator-always-on;
                    regulator-ramp-delay = <1250>;
                    rohm,dvs-run-voltage = <1150000>;
                    rohm,dvs-suspend-voltage = <950000>;
                };
                buck2: buck2 {
                    regulator-name = "buck2";
                    regulator-min-microvolt = <800000>;
                    regulator-max-microvolt = <2000000>;
                    regulator-always-on;
                    regulator-ramp-delay = <1250>;
                    rohm,dvs-run-voltage = <1150000>;
                    rohm,dvs-suspend-voltage = <950000>;
                };
                buck3: buck3 {
                    regulator-name = "buck3";
                    regulator-min-microvolt = <1200000>;
                    regulator-max-microvolt = <2700000>;
                    regulator-always-on;
                };
                buck4: buck4 {
                    regulator-name = "buck4";
                    regulator-min-microvolt = <1100000>;
                    regulator-max-microvolt = <1850000>;
                    regulator-always-on;
                };
                buck5: buck5 {
                    regulator-name = "buck5";
                    regulator-min-microvolt = <1800000>;
                    regulator-max-microvolt = <3300000>;
                    regulator-always-on;
                };
                ldo1: ldo1 {
                    regulator-name = "ldo1";
                    regulator-min-microvolt = <800000>;
                    regulator-max-microvolt = <3300000>;
                    regulator-always-on;
                };
                ldo2: ldo2 {
                    regulator-name = "ldo2";
                    regulator-min-microvolt = <800000>;
                    regulator-max-microvolt = <3300000>;
                    regulator-always-on;
                };
                ldo3: ldo3 {
                    regulator-name = "ldo3";
                    regulator-min-microvolt = <800000>;
                    regulator-max-microvolt = <3300000>;
                    regulator-always-on;
                };
                ldo4: ldo4 {
                    regulator-name = "ldo4";
                    regulator-min-microvolt = <800000>;
                    regulator-max-microvolt = <3300000>;
                    regulator-always-on;
                };
                ldo5: ldo5 {
                    regulator-name = "ldo5";
                    regulator-min-microvolt = <800000>;
                    regulator-max-microvolt = <3300000>;
                    regulator-always-on;
                };
                ldo6: ldodvref {
                    regulator-name = "ldodvref";
                    regulator-always-on;
                };
                ldo7: ldolpsr {
                    regulator-name = "ldolpsr";
                    regulator-always-on;
                };

                boost: wled {
                    regulator-name = "wled";
                    regulator-min-microamp = <10>;
                    regulator-max-microamp = <25000>;
                };
            };
        };
    };
```
