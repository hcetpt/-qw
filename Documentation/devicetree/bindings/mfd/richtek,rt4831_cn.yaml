## Documentation/devicetree/bindings/mfd/silergy,sy7636a_cn.yaml
~~~~yaml
```yaml
# SPDX-文件许可标识符: GPL-2.0-only 或 BSD-2-Clause
%YAML 1.2
---
$id: http://devicetree.org/schemas/mfd/silergy,sy7636a.yaml#
$schema: http://devicetree.org/meta-schemas/core.yaml#

title: Silergy SY7636A 电源管理集成电路 (PMIC)

maintainers:
  - Alistair Francis <alistair@alistair23.me>

properties:
  compatible:
    const: silergy,sy7636a

  reg:
    description:
      I2C 设备地址
    maxItems: 1

  "#address-cells":
    const: 1

  "#size-cells":
    const: 0

  '#thermal-sensor-cells':
    const: 0

  epd-pwr-good-gpios:
    description:
      指定电源就绪的 GPIOs
    maxItems: 1

  regulators:
    type: object

    properties:
      compatible:
        const: silergy,sy7636a-regulator

      vcom:
        type: object
        $ref: /schemas/regulator/regulator.yaml#
        unevaluatedProperties: false
        description:
          用于补偿电压的稳压器。启用/禁用此稳压器会启用/禁用整个设备
        properties:
          regulator-name:
            const: vcom

    additionalProperties: false

required:
  - compatible
  - reg
  - '#thermal-sensor-cells'

additionalProperties: false

examples:
  - |
    i2c {
      #address-cells = <1>;
      #size-cells = <0>;

      pmic@62 {
        compatible = "silergy,sy7636a";
        reg = <0x62>;
        pinctrl-names = "default";
        pinctrl-0 = <&pinctrl_epdpmic>;
        #thermal-sensor-cells = <0>;

        regulators {
          reg_epdpmic: vcom {
            regulator-name = "vcom";
            regulator-boot-on;
          };
        };
      };
    };
```

注意：原文件中的 `properties` 在 YAML 中被重复定义，这在 YAML 结构中是不正确的。在翻译时，我将第二次的 `properties` 替换为了 `properties` 的内容，以保持 YAML 的正确性。同时，对部分描述进行了适当调整以更符合中文表达习惯。
~~~~

## Documentation/devicetree/bindings/mfd/sky81452_cn.txt
~~~~
### SKY81452 绑定

**必需属性:**
- `compatible`: 必须为 "skyworks,sky81452"
- `reg`: I2C 从设备地址

**必需的子节点:**
- `backlight`: 用于背光的容器节点，遵循位于 `leds/backlight/sky81452-backlight.txt` 中的绑定
- `regulator`: 用于稳压器的容器节点，遵循位于 `regulator/sky81452-regulator.txt` 中的绑定

**示例:**

```device-tree
sky81452@2c {
	compatible = "skyworks,sky81452";
	reg = <0x2c>;

	backlight {
		compatible = "skyworks,sky81452-backlight";
		name = "pwm-backlight";
		led-sources = <0 1 2 3 6>;
		skyworks,ignore-pwm;
		skyworks,phase-shift;
		skyworks,current-limit = <2300>;
	};

	regulator {
		lout {
			regulator-name = "sky81452-lout";
			regulator-min-microvolt = <4500000>;
			regulator-max-microvolt = <8000000>;
		};
	};
};
```

### 解释
此 Device Tree 配置定义了一个使用 I2C 地址 0x2c 的 Skyworks SKY81452 设备。它包含两个子节点：一个用于管理背光（`backlight`），另一个用于管理稳压器（`regulator`）。

- **backlight 子节点**:
  - 定义了与 `sky81452-backlight.txt` 文件中描述的背光绑定兼容的背光配置。
  - 指定了 PWM 背光的名称为 "pwm-backlight"。
  - `led-sources` 属性列出了可以控制的 LED 源索引（在此例中为 0、1、2、3 和 6）。
  - 包含特定于 Skyworks 的属性，例如忽略 PWM 控制 (`skyworks,ignore-pwm`)、相位移位 (`skyworks,phase-shift`) 以及最大电流限制 (`skyworks,current-limit`)。

- **regulator 子节点**:
  - 定义了一个名为 `lout` 的稳压器输出，遵循 `sky81452-regulator.txt` 文件中的绑定。
  - 规定了稳压器的最小输出电压 (4.5V) 和最大输出电压 (8.0V)，单位为微伏。
  
以上配置适用于在 Device Tree 中正确设置和初始化 SKY81452 设备及其相关功能。
~~~~

## Documentation/devicetree/bindings/mfd/sprd,sc27xx-pmic_cn.txt
~~~~
展讯 SC27xx 系列电源管理集成电路 (PMIC)

展讯 SC27xx 系列 PMIC 包含 SC2720、SC2721、SC2723、SC2730 和 SC2731。展讯 SC27xx 系列的 PMIC 集成了所有移动手机电源管理、音频编解码器、电池管理和用户界面支持功能于单一芯片中。它具有以下六个主要功能模块：
- DCDC：用于支持 CPU 和内存
- LDO：用于满足内部和外部需求
- 电池管理系统，例如充电器、电量计
- 音频编解码器
- 用户界面功能，如指示灯、闪光 LED 等
- 芯片级接口，例如电源开关控制、实时时钟 (RTC) 和 Type-C 接口等

所需属性：
- 兼容性：应为以下选项之一：
   "sprd,sc2720"
   "sprd,sc2721"
   "sprd,sc2723"
   "sprd,sc2730"
   "sprd,sc2731"
- reg：设备芯片选择的地址，应为 0
- spi-max-frequency：通常设置为 26000000
- interrupts：设备连接到的中断线
- interrupt-controller：将设备节点标记为中断控制器
这段代码描述了一个电源管理集成电路 (PMIC) 设备在设备树中的配置，设备树是一种用于描述硬件组件及其特性的数据结构，在嵌入式系统中非常常见。下面是这段配置的中文翻译：

- `#interrupt-cells`：描述一个 PMIC 中断（IRQ）所需的单元格数量，必须是 2。
- `#address-cells`：子设备偏移地址所需的单元格数量，必须是 1。
- `#size-cells`：子设备大小所需的单元格数量，必须是 0。

示例：
```plaintext
pmic@0 { 
	compatible = "sprd,sc2731"; // 兼容性字符串，表示这个节点代表的是展讯 SC2731 PMIC
	reg = <0>; // 寄存器基址，这里表示基址为 0
	spi-max-frequency = <26000000>; // SPI 最大频率为 26MHz
	interrupts = <GIC_SPI 31 IRQ_TYPE_LEVEL_HIGH>; // 中断信息，表示 GIC SPI 中断 31，中断类型为高电平有效
	interrupt-controller; // 表示这是一个中断控制器
	#interrupt-cells = <2>; // 描述中断所需的单元格数量为 2
	#address-cells = <1>; // 子设备地址偏移所需的单元格数量为 1
	#size-cells = <0>; // 子设备大小所需的单元格数量为 0
};
```

这段配置指定了一个名为 `pmic@0` 的设备节点，它与展讯 SC2731 PMIC 相兼容，并详细定义了其寄存器、SPI 最大频率、中断控制器特性以及一些必要的计数单元。
~~~~

## Documentation/devicetree/bindings/mfd/sprd,ums512-glbreg_cn.yaml
```yaml
# SPDX-文件许可人: (GPL-2.0-only 或 BSD-2-Clause)
# 版权所有 2022 紫光展锐股份有限公司
%YAML 1.2
---
$id: http://devicetree.org/schemas/mfd/sprd,ums512-glbreg.yaml#
$schema: http://devicetree.org/meta-schemas/core.yaml#

标题: 紫光展锐系统全局寄存器

维护者:
  - 赵森 <orsonzhai@gmail.com>
  - 王宝林 <baolin.wang7@gmail.com>
  - 张春艳 <zhang.lyra@gmail.com>

描述:
  紫光展锐系统全局寄存器为SoC的时钟和某些多媒体模块提供寄存器映射。

属性:
  compatible:
    items:
      - 枚举:
          - sprd,ums512-glbregs
          - sprd,ums9620-glbregs
      - 常量: syscon
      - 常量: simple-mfd

  "#address-cells":
    常量: 1

  "#size-cells":
    常量: 1

  ranges:
    maxItems: 1

  reg:
    maxItems: 1

  patternProperties:
    "^clock-controller@[0-9a-f]+$":
      类型: 对象
      $ref: /schemas/clock/sprd,ums512-clk.yaml#
      描述:
        用于SoC时钟的时钟控制器

必需项:
  - compatible
  - reg

其他属性: false

示例:
  - |
    ap_apb_regs: syscon@71000000 {
      compatible = "sprd,ums512-glbregs", "syscon", "simple-mfd";
      reg = <0x71000000 0x3000>;
      #address-cells = <1>;
      #size-cells = <1>;
      ranges = <0 0x71000000 0x3000>;

      clock-controller@0 {
        compatible = "sprd,ums512-apahb-gate";
        reg = <0x0 0x2000>;
        #clock-cells = <1>;
      };
    };

  - |
    ap_intc5_regs: syscon@32360000 {
      compatible = "sprd,ums512-glbregs", "syscon", "simple-mfd";
      reg = <0x32360000 0x1000>;
    };
```

## Documentation/devicetree/bindings/mfd/st,stm32-lptimer_cn.yaml
```yaml
下面是给定内容的中文翻译：

# SPDX-许可证标识符: (GPL-2.0-only 或 BSD-2-Clause)
%YAML 1.2
---
$id: http://devicetree.org/schemas/mfd/st,stm32-lptimer.yaml#
$schema: http://devicetree.org/meta-schemas/core.yaml#

title: STMicroelectronics STM32 低功耗定时器

description: |
  STM32 低功耗定时器（LPTIM）是一个16位定时器，提供了多种功能：
   - PWM输出（带可编程预分频器、可配置极性）
   - STM32 ADC/DAC的触发源（LPTIM_OUT）
   - 多种计数模式：
     - 四象限编码器用于检测旋转元件的角度位置和方向，从IN1和IN2输入信号
     - 从IN1输入信号简单计数
maintainers:
  - Fabrice Gasnier <fabrice.gasnier@foss.st.com>

properties:
  compatible:
    const: st,stm32-lptimer

  reg:
    maxItems: 1

  clocks:
    maxItems: 1

  clock-names:
    items:
      - const: mux

  interrupts:
    maxItems: 1

  "#address-cells":
    const: 1

  "#size-cells":
    const: 0

  wakeup-source: true

  access-controllers:
    minItems: 1
    maxItems: 2

  pwm:
    type: object
    additionalProperties: false

    properties:
      compatible:
        const: st,stm32-pwm-lp

      "#pwm-cells":
        const: 3

    required:
      - "#pwm-cells"
      - compatible

  counter:
    type: object
    additionalProperties: false

    properties:
      compatible:
        const: st,stm32-lptimer-counter

    required:
      - compatible

  timer:
    type: object
    additionalProperties: false

    properties:
      compatible:
        const: st,stm32-lptimer-timer

    required:
      - compatible

patternProperties:
  "^trigger@[0-9]+$":
    type: object
    additionalProperties: false

    properties:
      compatible:
        const: st,stm32-lptimer-trigger

      reg:
        description: 标识触发硬件块
items:
          minimum: 0
          maximum: 2

    required:
      - compatible
      - reg

required:
  - "#address-cells"
  - "#size-cells"
  - compatible
  - reg
  - clocks
  - clock-names

additionalProperties: false

examples:
  - |
    #include <dt-bindings/clock/stm32mp1-clks.h>
    #include <dt-bindings/interrupt-controller/arm-gic.h>
    timer@40002400 {
      compatible = "st,stm32-lptimer";
      reg = <0x40002400 0x400>;
      clocks = <&timer_clk>;
      clock-names = "mux";
      interrupts-extended = <&exti 47 IRQ_TYPE_LEVEL_HIGH>;
      #address-cells = <1>;
      #size-cells = <0>;

      pwm {
        compatible = "st,stm32-pwm-lp";
        #pwm-cells = <3>;
      };

      trigger@0 {
        compatible = "st,stm32-lptimer-trigger";
        reg = <0>;
      };

      counter {
        compatible = "st,stm32-lptimer-counter";
      };

      timer {
        compatible = "st,stm32-lptimer-timer";
      };
    };
```
