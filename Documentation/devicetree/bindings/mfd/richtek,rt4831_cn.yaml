## Documentation/devicetree/bindings/mfd/rohm,bd96801-pmic_cn.yaml
```yaml
罗姆 BD96801 可扩展电源管理集成电路

维护者:
  - Matti Vaittinen <matti.vaittinen@fi.rohmeurope.com>

描述:
  BD96801 是一款车规级单芯片电源管理集成电路 (PMIC)
  它集成了 4 个降压转换器和 3 个低压差稳压器 (LDO)，具备过压/欠压检测、过流检测和看门狗等安全特性。

属性:
  compatible:
    常量: rohm,bd96801

  reg:
    最大项目数: 1

  interrupts:
    描述:
      PMIC 提供了 intb 和 errb 中断线。errb 中断线用于致命中断，这将导致 PMIC 关闭电源输出。
      在许多系统中，这会关闭控制 PMIC 的片上系统 (SoC) 并且可以省略连接/处理 errb。
      然而，在 SoC 不由 PMIC 供电或具有短时备份能量来处理关键硬件关机的情况下，
      连接并处理 errb 可能是有用的。
    最小项目数: 1
    最大项目数: 2

  interrupt-names:
    最小项目数: 1
    项目:
      - 枚举: [intb, errb]
      - 常量: errb

  rohm,hw-timeout-ms:
    描述:
      看门狗超时值。第一个值是超时限制。第二个值（可选）为窗口超时模式下的“过早”看门狗重置值。
    最小项目数: 1
    最大项目数: 2

  rohm,wdg-action:
    描述:
      当看门狗失败是否必须关闭稳压器电源输出还是仅切换 INTB 线。
    枚举:
      - prstb
      - intb-only

  timeout-sec:
    最大项目数: 2

  regulators:
    引用: /schemas/regulator/rohm,bd96801-regulator.yaml
    描述:
      指定稳压器的子节点列表

必需项:
  - compatible
  - reg
  - interrupts
  - interrupt-names
  - regulators

附加属性: 不允许

示例:
  - |
    #include <dt-bindings/interrupt-controller/irq.h>
    #include <dt-bindings/leds/common.h>
    i2c {
        #address-cells = <1>;
        #size-cells = <0>;
        pmic: pmic@60 {
            reg = <0x60>;
            compatible = "rohm,bd96801";
            interrupt-parent = <&gpio1>;
            interrupts = <29 IRQ_TYPE_LEVEL_LOW>, <6 IRQ_TYPE_LEVEL_LOW>;
            interrupt-names = "intb", "errb";

            regulators {
                buck1 {
                    regulator-name = "buck1";
                    regulator-ramp-delay = <1250>;
                    /* 0.5V 最小初始值 - 150 mV 调节 */
                    regulator-min-microvolt = <350000>;
                    /* 3.3V + 150mV 调节 */
                    regulator-max-microvolt = <3450000>;

                    /* 这些只能在 PMIC 处于待机模式时设置 */
                    rohm,initial-voltage-microvolt = <500000>;
                    regulator-ov-error-microvolt = <230000>;
                    regulator-uv-error-microvolt = <230000>;
                    regulator-temp-protection-kelvin = <1>;
                    regulator-temp-warn-kelvin = <0>;
                };
                buck2 {
                    regulator-name = "buck2";
                    regulator-min-microvolt = <350000>;
                    regulator-max-microvolt = <3450000>;

                    rohm,initial-voltage-microvolt = <3000000>;
                    regulator-ov-error-microvolt = <18000>;
                    regulator-uv-error-microvolt = <18000>;
                    regulator-temp-protection-kelvin = <1>;
                    regulator-temp-warn-kelvin = <1>;
                };
                buck3 {
                    regulator-name = "buck3";
                    regulator-min-microvolt = <350000>;
                    regulator-max-microvolt = <3450000>;

                    rohm,initial-voltage-microvolt = <600000>;
                    regulator-ov-warn-microvolt = <18000>;
                    regulator-uv-warn-microvolt = <18000>;
                    regulator-temp-protection-kelvin = <1>;
                    regulator-temp-error-kelvin = <0>;
                };
                buck4 {
                    regulator-name = "buck4";
                    regulator-min-microvolt = <350000>;
                    regulator-max-microvolt = <3450000>;

                    rohm,initial-voltage-microvolt = <600000>;
                    regulator-ov-warn-microvolt = <18000>;
                    regulator-uv-warn-microvolt = <18000>;
                    regulator-temp-protection-kelvin = <1>;
                    regulator-temp-error-kelvin = <0>;
                };
                ldo5 {
                    regulator-name = "ldo5";
                    regulator-min-microvolt = <300000>;
                    regulator-max-microvolt = <3300000>;

                    rohm,initial-voltage-microvolt = <500000>;
                    regulator-ov-error-microvolt = <36000>;
                    regulator-uv-error-microvolt = <34000>;
                    regulator-temp-protection-kelvin = <1>;
                    regulator-temp-warn-kelvin = <0>;
                };
                ldo6 {
                    regulator-name = "ldo6";
                    regulator-min-microvolt = <300000>;
                    regulator-max-microvolt = <3300000>;

                    rohm,initial-voltage-microvolt = <300000>;
                    regulator-ov-error-microvolt = <36000>;
                    regulator-uv-error-microvolt = <34000>;
                    regulator-temp-protection-kelvin = <1>;
                    regulator-temp-warn-kelvin = <0>;
                };
                ldo7 {
                    regulator-name = "ldo7";
                    regulator-min-microvolt = <300000>;
                    regulator-max-microvolt = <3300000>;

                    rohm,initial-voltage-microvolt = <500000>;
                    regulator-ov-error-microvolt = <36000>;
                    regulator-uv-error-microvolt = <34000>;
                    regulator-temp-protection-kelvin = <1>;
                    regulator-temp-warn-kelvin = <0>;
                };
            };
        };
    };
```

## Documentation/devicetree/bindings/mfd/samsung,exynos5433-lpass_cn.yaml
```yaml
# SPDX-许可证标识符: (GPL-2.0-only 或 BSD-2-Clause)
%YAML 1.2
---
$id: http://devicetree.org/schemas/mfd/samsung,exynos5433-lpass.yaml#
$schema: http://devicetree.org/meta-schemas/core.yaml#

标题: Samsung Exynos 系统级芯片低功耗音频子系统 (LPASS)

维护者:
  - Krzysztof Kozlowski <krzk@kernel.org>
  - Sylwester Nawrocki <s.nawrocki@samsung.com>

属性:
  compatible:
    常量: samsung,exynos5433-lpass

  '#address-cells':
    常量: 1

  clocks:
    最大项数: 1

  clock-names:
    项:
      - 常量: sfr0_ctrl

  power-domains:
    最大项数: 1

  ranges: 真

  reg:
    最少项数: 2
    最大项数: 2

  '#size-cells':
    常量: 1

模式属性:
  "^dma-controller@[0-9a-f]+$":
    $ref: /schemas/dma/arm,pl330.yaml

  "^i2s@[0-9a-f]+$":
    $ref: /schemas/sound/samsung-i2s.yaml

  "^serial@[0-9a-f]+$":
    $ref: /schemas/serial/samsung_uart.yaml

必需:
  - compatible
  - '#address-cells'
  - clocks
  - clock-names
  - ranges
  - reg
  - '#size-cells'

额外属性: 错误

示例:
  - |
    #include <dt-bindings/clock/exynos5433.h>
    #include <dt-bindings/interrupt-controller/arm-gic.h>

    audio-subsystem@11400000 {
        compatible = "samsung,exynos5433-lpass";
        reg = <0x11400000 0x100>, <0x11500000 0x08>;
        clocks = <&cmu_aud CLK_PCLK_SFR0_CTRL>;
        clock-names = "sfr0_ctrl";
        power-domains = <&pd_aud>;
        #address-cells = <1>;
        #size-cells = <1>;
        ranges;

        dma-controller@11420000 {
            compatible = "arm,pl330", "arm,primecell";
            reg = <0x11420000 0x1000>;
            interrupts = <GIC_SPI 73 IRQ_TYPE_LEVEL_HIGH>;
            clocks = <&cmu_aud CLK_ACLK_DMAC>;
            clock-names = "apb_pclk";
            #dma-cells = <1>;
            dma-channels = <8>;
            dma-requests = <32>;
            power-domains = <&pd_aud>;
        };

        i2s@11440000 {
            compatible = "samsung,exynos5433-i2s", "samsung,exynos7-i2s";
            reg = <0x11440000 0x100>;
            dmas = <&adma 0>, <&adma 2>;
            dma-names = "tx", "rx";
            interrupts = <GIC_SPI 70 IRQ_TYPE_LEVEL_HIGH>;
            #address-cells = <1>;
            #size-cells = <0>;
            clocks = <&cmu_aud CLK_PCLK_AUD_I2S>,
                     <&cmu_aud CLK_SCLK_AUD_I2S>,
                     <&cmu_aud CLK_SCLK_I2S_BCLK>;
            clock-names = "iis", "i2s_opclk0", "i2s_opclk1";
            #clock-cells = <1>;
            pinctrl-names = "default";
            pinctrl-0 = <&i2s0_bus>;
            power-domains = <&pd_aud>;
            #sound-dai-cells = <1>;
        };

        serial@11460000 {
            compatible = "samsung,exynos5433-uart";
            reg = <0x11460000 0x100>;
            interrupts = <GIC_SPI 67 IRQ_TYPE_LEVEL_HIGH>;
            clocks = <&cmu_aud CLK_PCLK_AUD_UART>,
                     <&cmu_aud CLK_SCLK_AUD_UART>;
            clock-names = "uart", "clk_uart_baud0";
            pinctrl-names = "default";
            pinctrl-0 = <&uart_aud_bus>;
            power-domains = <&pd_aud>;
        };
    };
```

## Documentation/devicetree/bindings/mfd/samsung,s2mpa01_cn.yaml
~~~~yaml
```yaml
# SPDX-许可证标识符: GPL-2.0-only 或 BSD-2-Clause
%YAML 1.2
---
$id: http://devicetree.org/schemas/mfd/samsung,s2mpa01.yaml#
$schema: http://devicetree.org/meta-schemas/core.yaml#

标题: Samsung S2MPA01 电源管理集成电路

维护者:
  - Krzysztof Kozlowski <krzk@kernel.org>

描述: |
  这是S2M和S5M系列电源管理集成电路(PMIC)设备树绑定的一部分。
  Samsung S2MPA01 是一款电源管理集成电路，它包含了电压和电流稳压器、实时时钟、时钟输出以及其他子模块。
属性:
  compatible:
    常量: samsung,s2mpa01-pmic

  interrupts:
    最大项数: 1

  reg:
    最大项数: 1

  regulators:
    $引用: /schemas/regulator/samsung,s2mpa01.yaml
    描述:
      指定稳压器的子节点列表
唤醒源: 真

必需:
  - compatible
  - reg
  - regulators

附加属性: 错误

示例:
  - |
    #include <dt-bindings/interrupt-controller/irq.h>

    i2c {
        #address-cells = <1>;
        #size-cells = <0>;

        pmic@66 {
            compatible = "samsung,s2mpa01-pmic";
            reg = <0x66>;

            regulators {
                ldo1_reg: LDO1 {
                    regulator-name = "VDD_ALIVE";
                    regulator-min-microvolt = <1000000>;
                    regulator-max-microvolt = <1000000>;
                };

                ldo2_reg: LDO2 {
                    regulator-name = "VDDQ_MMC2";
                    regulator-min-microvolt = <2800000>;
                    regulator-max-microvolt = <2800000>;
                    regulator-always-on;
                };

                // ..
buck1_reg: BUCK1 {
                    regulator-name = "vdd_mif";
                    regulator-min-microvolt = <950000>;
                    regulator-max-microvolt = <1350000>;
                    regulator-always-on;
                    regulator-boot-on;
                };

                buck2_reg: BUCK2 {
                    regulator-name = "vdd_arm";
                    regulator-min-microvolt = <950000>;
                    regulator-max-microvolt = <1350000>;
                    regulator-always-on;
                    regulator-boot-on;
                    regulator-ramp-delay = <50000>;
                };

                // ..
};
        };
    };
```

注意：以上翻译尽量保持了原文的结构和风格，但请注意 YAML 的语法在中文环境中可能不如英文直观。
~~~~
