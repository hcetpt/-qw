## Documentation/devicetree/bindings/mfd/rockchip,rk808_cn.yaml
```yaml
# SPDX-许可证标识符: GPL-2.0-only 或 BSD-2-Clause
%YAML 1.2
---
$id: http://devicetree.org/schemas/mfd/rockchip,rk808.yaml#
$schema: http://devicetree.org/meta-schemas/core.yaml#

标题: RK808 电源管理集成电路

维护者:
  - Chris Zhong <zyw@rock-chips.com>
  - Zhang Qing <zhangqing@rock-chips.com>

描述: |
  Rockchip RK808 系列 PMIC。此设备包含一个由 I2C 控制的多功能设备 (MFD)，其中包括稳压器、实时时钟 (RTC) 和电源按钮。
属性:
  compatible:
    枚举:
      - rockchip,rk808

  reg:
    最大项数: 1

  interrupts:
    最大项数: 1

  '#clock-cells':
    描述:
      查看 <dt-bindings/clock/rockchip,rk808.h> 获取时钟 ID
    常量: 1

  clock-output-names:
    描述:
      根据通用时钟绑定来覆盖默认输出时钟名称
    最大项数: 2

  rockchip,system-power-controller:
    类型: 布尔值
    已废弃: 是
    描述:
      指示该 PMIC 是否控制系统电源
    system-power-controller: true

  wakeup-source:
    类型: 布尔值
    描述:
      设备可以作为唤醒源使用

  vcc1-supply:
    描述:
      DCDC_REG1 的输入电源

  vcc2-supply:
    描述:
      DCDC_REG2 的输入电源

  vcc3-supply:
    描述:
      DCDC_REG3 的输入电源

  vcc4-supply:
    描述:
      DCDC_REG4 的输入电源

  vcc6-supply:
    描述:
      LDO_REG1 和 LDO_REG2 的输入电源
下面是给定内容的中文翻译：

`vcc7-supply`:
    描述:
      LDO_REG3 和 LDO_REG7 的输入电源。

`vcc8-supply`:
    描述:
      SWITCH_REG1 的输入电源。

`vcc9-supply`:
    描述:
      LDO_REG4 和 LDO_REG5 的输入电源。

`vcc10-supply`:
    描述:
      LDO_REG6 的输入电源。

`vcc11-supply`:
    描述:
      LDO_REG8 的输入电源。

`vcc12-supply`:
    描述:
      SWITCH_REG2 的输入电源。

`vddio-supply`:
    描述:
      数字 IO 的输入电源。

`dvs-gpios`:
    描述: |
      buck1/2 可以通过 DVS GPIO 进行控制，这是用于两个主机 GPIO 的 GPIO 指定符。GPIO 指定符的格式取决于 GPIO 控制器。如果不存在 DVS GPIO，则电压变化将非常快，没有缓慢上升的时间。
最大项数: 2

  `regulators`:
    类型: 对象
    匹配属性模式:
      "^(DCDC_REG[1-4]|LDO_REG[1-8]|SWITCH_REG[1-2])$":
        类型: 对象
        $ref: /schemas/regulator/regulator.yaml#
        不评估的属性: false
    不评估的属性: false

必需项:
  - 兼容性
  - 寄存器
  - 中断
  - "#clock-cells"

额外属性: false

示例:
  - |
    #include <dt-bindings/pinctrl/rockchip.h>
    #include <dt-bindings/interrupt-controller/irq.h>
    #include <dt-bindings/gpio/gpio.h>
    i2c {
        #address-cells = <1>;
        #size-cells = <0>;

        rk808: pmic@1b {
            compatible = "rockchip,rk808";
            clock-output-names = "xin32k", "rk808-clkout2";
            interrupt-parent = <&gpio0>;
            interrupts = <4 IRQ_TYPE_LEVEL_LOW>;
            pinctrl-names = "default";
            pinctrl-0 = <&pmic_int &dvs_1 &dvs_2>;
            dvs-gpios = <&gpio7 11 GPIO_ACTIVE_HIGH>,
                <&gpio7 15 GPIO_ACTIVE_HIGH>;
            reg = <0x1b>;
            rockchip,system-power-controller;
            wakeup-source;
            #clock-cells = <1>;

            vcc8-supply = <&vcc_18>;
            vcc9-supply = <&vcc_io>;
            vcc10-supply = <&vcc_io>;
            vcc12-supply = <&vcc_io>;
            vddio-supply = <&vccio_pmu>;

            regulators {
                vdd_cpu: DCDC_REG1 {
                    regulator-always-on;
                    regulator-boot-on;
                    regulator-min-microvolt = <750000>;
                    regulator-max-microvolt = <1300000>;
                    regulator-name = "vdd_arm";
                };

                vdd_gpu: DCDC_REG2 {
                    regulator-always-on;
                    regulator-boot-on;
                    regulator-min-microvolt = <850000>;
                    regulator-max-microvolt = <1250000>;
                    regulator-name = "vdd_gpu";
                };

                vcc_ddr: DCDC_REG3 {
                    regulator-always-on;
                    regulator-boot-on;
                    regulator-name = "vcc_ddr";
                };

                vcc_io: DCDC_REG4 {
                    regulator-always-on;
                    regulator-boot-on;
                    regulator-min-microvolt = <3300000>;
                    regulator-max-microvolt = <3300000>;
                    regulator-name = "vcc_io";
                };

                vccio_pmu: LDO_REG1 {
                    regulator-always-on;
                    regulator-boot-on;
                    regulator-min-microvolt = <3300000>;
                    regulator-max-microvolt = <3300000>;
                    regulator-name = "vccio_pmu";
                };

                vcc_tp: LDO_REG2 {
                    regulator-always-on;
                    regulator-boot-on;
                    regulator-min-microvolt = <3300000>;
                    regulator-max-microvolt = <3300000>;
                    regulator-name = "vcc_tp";
                };

                vdd_10: LDO_REG3 {
                    regulator-always-on;
                    regulator-boot-on;
                    regulator-min-microvolt = <1000000>;
                    regulator-max-microvolt = <1000000>;
                    regulator-name = "vdd_10";
                };

                vcc18_lcd: LDO_REG4 {
                    regulator-always-on;
                    regulator-boot-on;
                    regulator-min-microvolt = <1800000>;
                    regulator-max-microvolt = <1800000>;
                    regulator-name = "vcc18_lcd";
                };

                vccio_sd: LDO_REG5 {
                    regulator-always-on;
                    regulator-boot-on;
                    regulator-min-microvolt = <1800000>;
                    regulator-max-microvolt = <3300000>;
                    regulator-name = "vccio_sd";
                };

                vdd10_lcd: LDO_REG6 {
                    regulator-always-on;
                    regulator-boot-on;
                    regulator-min-microvolt = <1000000>;
                    regulator-max-microvolt = <1000000>;
                    regulator-name = "vdd10_lcd";
                };

                vcc_18: LDO_REG7 {
                    regulator-always-on;
                    regulator-boot-on;
                    regulator-min-microvolt = <1800000>;
                    regulator-max-microvolt = <1800000>;
                    regulator-name = "vcc_18";
                };

                vcca_codec: LDO_REG8 {
                    regulator-always-on;
                    regulator-boot-on;
                    regulator-min-microvolt = <3300000>;
                    regulator-max-microvolt = <3300000>;
                    regulator-name = "vcca_codec";
                };

                vcc_wl: SWITCH_REG1 {
                    regulator-always-on;
                    regulator-boot-on;
                    regulator-name = "vcc_wl";
                };

                vcc_lcd: SWITCH_REG2 {
                    regulator-always-on;
                    regulator-boot-on;
                    regulator-name = "vcc_lcd";
                };
            };
        };
    };
```

## Documentation/devicetree/bindings/mfd/rockchip,rk816_cn.yaml
~~~~yaml
# SPDX-许可证标识符: GPL-2.0-only 或 BSD-2-Clause
%YAML 1.2
---
$id: http://devicetree.org/schemas/mfd/rockchip,rk816.yaml#
$schema: http://devicetree.org/meta-schemas/core.yaml#

标题: RK816 电源管理集成电路

维护者:
  - Chris Zhong <zyw@rock-chips.com>
  - Zhang Qing <zhangqing@rock-chips.com>

描述:
  Rockchip RK816 系列电源管理 IC (PMIC)。该设备包含一个通过 I2C 控制的多功能设备 (MFD)，其中包括稳压器、实时时钟 (RTC)、GPIO 控制器、电源按钮以及电池充电器管理和电量计。
属性:
  compatible:
    枚举:
      - rockchip,rk816

  reg:
    最大项数: 1

  interrupts:
    最大项数: 1

  '#clock-cells':
    描述:
      参见 <dt-bindings/clock/rockchip,rk808.h> 获取时钟 ID
    常量: 1

  clock-output-names:
    最大项数: 2

  gpio-controller: true

  '#gpio-cells':
    常量: 2

  system-power-controller:
    类型: 布尔值
    描述:
      指明此 PMIC 是否控制着系统电源

  wakeup-source:
    类型: 布尔值

  vcc1-supply:
    描述:
      DCDC1 的输入供电

  vcc2-supply:
    描述:
      DCDC2 的输入供电

  vcc3-supply:
    描述:
      DCDC3 的输入供电

  vcc4-supply:
    描述:
      DCDC4 的输入供电

  vcc5-supply:
    描述:
      LDO1, LDO2 和 LDO3 的输入供电

  vcc6-supply:
    描述:
      LDO4, LDO5 和 LDO6 的输入供电

  vcc7-supply:
    描述:
      Boost 的输入供电
这段文本描述了一个设备树(Device Tree)的配置片段，主要用于嵌入式系统中硬件资源的描述。下面是该配置片段的中文翻译：

### vcc8-supply:
- **description**:
  - 为OTG开关提供的输入电源。

### regulators:
- **type**: 对象
- **patternProperties**:
  - `^(boost|dcdc[1-4]|ldo[1-6]|otg-switch)$`:
    - **type**: 对象
    - **$ref**: `/schemas/regulator/regulator.yaml#`
    - **unevaluatedProperties**: false

### patternProperties:
- `-pins$`:
  - **type**: 对象
  - **additionalProperties**: false
  - **$ref**: `/schemas/pinctrl/pinmux-node.yaml`

  - **properties**:
    - **function**:
      - 枚举值: [gpio, thermistor]
    - **pins**:
      - **$ref**: `/schemas/types.yaml#/definitions/string`
      - **const**: gpio0

### required:
- 兼容性 (`compatible`)
- 寄存器地址 (`reg`)
- 中断 (`interrupts`)
- 时钟单元数量 (`#clock-cells`)

### additionalProperties: false

### examples:
```yaml
- |
  #include <dt-bindings/pinctrl/rockchip.h>
  #include <dt-bindings/interrupt-controller/irq.h>
  #include <dt-bindings/gpio/gpio.h>

  i2c {
      #address-cells = <1>;
      #size-cells = <0>;

      rk816: pmic@1a {
          compatible = "rockchip,rk816";
          reg = <0x1a>;
          interrupt-parent = <&gpio0>;
          interrupts = <RK_PA2 IRQ_TYPE_LEVEL_LOW>;
          clock-output-names = "xin32k", "rk816-clkout2";
          pinctrl-names = "default";
          pinctrl-0 = <&pmic_int_l>;
          gpio-controller;
          system-power-controller;
          wakeup-source;
          #clock-cells = <1>;
          #gpio-cells = <2>;

          vcc1-supply = <&vcc_sys>;
          vcc2-supply = <&vcc_sys>;
          vcc3-supply = <&vcc_sys>;
          vcc4-supply = <&vcc_sys>;
          vcc5-supply = <&vcc33_io>;
          vcc6-supply = <&vcc_sys>;

          regulators {
              vdd_cpu: dcdc1 {
                  regulator-name = "vdd_cpu";
                  regulator-min-microvolt = <750000>;
                  regulator-max-microvolt = <1450000>;
                  regulator-ramp-delay = <6001>;
                  regulator-initial-mode = <1>;
                  regulator-always-on;
                  regulator-boot-on;

                  regulator-state-mem {
                      regulator-off-in-suspend;
                  };
              };

              // ... 其他调节器定义 ...

              vccio_sd: ldo5 {
                  regulator-min-microvolt = <1800000>;
                  regulator-max-microvolt = <3300000>;
                  regulator-name = "vccio_sd";

                  regulator-state-mem {
                      regulator-on-in-suspend;
                      regulator-suspend-microvolt = <3300000>;
                  };
              };

              vdd10_lcd: ldo6 {
                  regulator-min-microvolt = <1000000>;
                  regulator-max-microvolt = <1000000>;
                  regulator-name = "vdd10_lcd";

                  regulator-state-mem {
                      regulator-on-in-suspend;
                      regulator-suspend-microvolt = <1000000>;
                  };
              };
          };

          rk816_gpio_pins: gpio-pins {
              function = "gpio";
              pins = "gpio0";
          };
      };
  };
```

请注意，这个翻译主要关注于整体结构和关键信息的理解，并非逐字逐句的翻译。在实际使用中，您可能需要根据具体上下文进一步调整以适应特定需求。
~~~~
