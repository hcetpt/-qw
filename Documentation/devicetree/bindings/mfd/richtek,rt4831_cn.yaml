## Documentation/devicetree/bindings/mfd/rohm,bd71828-pmic_cn.yaml
```yaml
# SPDX-许可证标识符: GPL-2.0-only OR BSD-2-Clause
%YAML 1.2
---
$id: http://devicetree.org/schemas/mfd/rohm,bd71828-pmic.yaml#
$schema: http://devicetree.org/meta-schemas/core.yaml#

title: ROHM BD71828 电源管理集成电路

maintainers:
  - Matti Vaittinen <mazziesaccount@gmail.com>

description: |
  BD71828GW 是一款用于电池供电便携式设备的单芯片电源管理集成电路。
  该集成电路集成了 7 个降压转换器、7 个 LDO（低压差稳压器）和一个 1500 毫安单节线性充电器。还包括一个库仑计数器、一个实时时钟 (RTC) 和一个 32.768 千赫时钟门。

properties:
  compatible:
    oneOf:
      - const: rohm,bd71828

      - items:
          - const: rohm,bd71879
          - const: rohm,bd71828

  reg:
    description:
      I2C 从机地址
maxItems: 1

  interrupts:
    maxItems: 1

  gpio-controller: true

  "#gpio-cells":
    const: 2
    description: |
      第一个单元是引脚编号，第二个单元用于指定标志。更多信息请参见 ../gpio/gpio.txt
clocks:
    maxItems: 1

  "#clock-cells":
    const: 0

  clock-output-names:
    const: bd71828-32k-out

  rohm,clkout-open-drain:
    description: clk32kout 模式。设置为 1 表示“开漏”，设置为 0 表示“cmos”
$ref: /schemas/types.yaml#/definitions/uint32
    minimum: 0
    maximum: 1

  rohm,charger-sense-resistor-ohms:
    minimum: 10000000
    maximum: 50000000
    description: |
      BD71827 和 BD71828 配备 SAR ADC 以测量充电电流。
      外部检测电阻器 (RSENSE 在数据手册中) 应当被使用。如果使用了除 30 兆欧姆之外的其他电阻器，则应在此处给出电阻值（单位：欧姆）
regulators:
    $ref: /schemas/regulator/rohm,bd71828-regulator.yaml
    description:
      指定稳压器的子节点列表
leds:
    $ref: /schemas/leds/rohm,bd71828-leds.yaml

  gpio-reserved-ranges:
    description: |
      可通过 OTP 更改 BD71828 GPIO 引脚的用途。此属性可用于标记那些不应配置为 GPIO 的引脚。更多信息请参见 ../gpio/gpio.txt
system-power-controller: true

required:
  - compatible
  - reg
  - interrupts
  - clocks
  - "#clock-cells"
  - regulators
  - gpio-controller
  - "#gpio-cells"

additionalProperties: false

examples:
  - |
    #include <dt-bindings/interrupt-controller/irq.h>
    #include <dt-bindings/leds/common.h>
    i2c {
        #address-cells = <1>;
        #size-cells = <0>;
        pmic: pmic@4b {
            compatible = "rohm,bd71828";
            reg = <0x4b>;

            interrupt-parent = <&gpio1>;
            interrupts = <29 IRQ_TYPE_LEVEL_LOW>;

            clocks = <&osc 0>;
            #clock-cells = <0>;
            clock-output-names = "bd71828-32k-out";

            gpio-controller;
            #gpio-cells = <2>;
            gpio-reserved-ranges = <0 1>, <2 1>;

            rohm,charger-sense-resistor-ohms = <10000000>;

            regulators {
                buck1: BUCK1 {
                    regulator-name = "buck1";
                    regulator-min-microvolt = <500000>;
                    regulator-max-microvolt = <2000000>;
                    regulator-ramp-delay = <2500>;
                };
                buck2: BUCK2 {
                    regulator-name = "buck2";
                    regulator-min-microvolt = <500000>;
                    regulator-max-microvolt = <2000000>;
                    regulator-ramp-delay = <2500>;
                };
                buck3: BUCK3 {
                    regulator-name = "buck3";
                    regulator-min-microvolt = <1200000>;
                    regulator-max-microvolt = <2000000>;
                };
                buck4: BUCK4 {
                    regulator-name = "buck4";
                    regulator-min-microvolt = <1000000>;
                    regulator-max-microvolt = <1800000>;
                };
                buck5: BUCK5 {
                    regulator-name = "buck5";
                    regulator-min-microvolt = <2500000>;
                    regulator-max-microvolt = <3300000>;
                };
                buck6: BUCK6 {
                    regulator-name = "buck6";
                    regulator-min-microvolt = <500000>;
                    regulator-max-microvolt = <2000000>;
                    regulator-ramp-delay = <2500>;
                };
                buck7: BUCK7 {
                    regulator-name = "buck7";
                    regulator-min-microvolt = <500000>;
                    regulator-max-microvolt = <2000000>;
                    regulator-ramp-delay = <2500>;
                };
                ldo1: LDO1 {
                    regulator-name = "ldo1";
                    regulator-min-microvolt = <800000>;
                    regulator-max-microvolt = <3300000>;
                };
                ldo2: LDO2 {
                    regulator-name = "ldo2";
                    regulator-min-microvolt = <800000>;
                    regulator-max-microvolt = <3300000>;
                };
                ldo3: LDO3 {
                    regulator-name = "ldo3";
                    regulator-min-microvolt = <800000>;
                    regulator-max-microvolt = <3300000>;
                };
                ldo4: LDO4 {
                    regulator-name = "ldo4";
                    regulator-min-microvolt = <800000>;
                    regulator-max-microvolt = <3300000>;
                };
                ldo5: LDO5 {
                    regulator-name = "ldo5";
                    regulator-min-microvolt = <800000>;
                    regulator-max-microvolt = <3300000>;
                };
                ldo6: LDO6 {
                    regulator-name = "ldo6";
                    regulator-min-microvolt = <1800000>;
                    regulator-max-microvolt = <1800000>;
                };
                ldo7_reg: LDO7 {
                    regulator-name = "ldo7";
                    regulator-min-microvolt = <800000>;
                    regulator-max-microvolt = <3300000>;
                };
            };

            leds {
                compatible = "rohm,bd71828-leds";

                led-1 {
                    rohm,led-compatible = "bd71828-grnled";
                    function = LED_FUNCTION_INDICATOR;
                    color = <LED_COLOR_ID_GREEN>;
                };
                led-2 {
                    rohm,led-compatible = "bd71828-ambled";
                    function = LED_FUNCTION_CHARGING;
                    color = <LED_COLOR_ID_AMBER>;
                };
            };
        };
    };
```

## Documentation/devicetree/bindings/mfd/rohm,bd71837-pmic_cn.yaml
~~~~yaml
以下是给定内容的中文翻译：

```yaml
# SPDX-文件许可标识符: GPL-2.0-only 或 BSD-2-Clause
%YAML 1.2
---
$id: http://devicetree.org/schemas/mfd/rohm,bd71837-pmic.yaml#
$schema: http://devicetree.org/meta-schemas/core.yaml#

标题: ROHM BD71837 电源管理集成电路

维护者:
  - Matti Vaittinen <mazziesaccount@gmail.com>

描述: |
  BD71837MWV 是可编程电源管理集成电路，用于为单核、双核和四核SoC（如NXP-i.MX 8M）供电。它针对低成本BOM和紧凑型解决方案尺寸进行了优化。BD71837MWV 集成了8个降压稳压器和7个LDO。
BD71837的数据手册可在以下网址获取：
  https://www.rohm.com/products/power-management/power-management-ic-for-system/industrial-consumer-applications/nxp-imx/bd71837amwv-product

属性:
  compatible:
    常量: rohm,bd71837

  reg:
    描述:
      I2C从设备地址
maxItems: 1

  interrupts:
    maxItems: 1

  clocks:
    maxItems: 1

  clock-names:
    常量: osc

  "#clock-cells":
    常量: 0

  clock-output-names:
    常量: pmic_clk

# BD718x7支持两种不同的硬件状态作为复位目标状态。这些状态称为SNVS和READY。在READY状态下，PMIC的所有电源输出下降且OTP重新加载。在SNVS状态下，除了SNVS电源域之外，所有其他逻辑和外部设备都被关闭。关于SNVS状态的更多信息，请参阅NXP i.MX8文档。当通过SNVS状态进行复位时，PMIC的OTP数据不会重新加载。这会导致受软件控制的电源输出在复位切换到SNVS状态后保持低电平。如果通过READY状态进行复位，则通过OTP加载将电源输出返回到硬件控制。因此，默认设置复位目标状态为READY。如果使用SNVS状态，则必须在调节器节点中设置regulator-always-on和regulator-boot-on属性，以确保启动关键调节器正常工作。
rohm,reset-snvs-powered:
    描述: |
      在复位时将PMIC转移到SNVS状态
    类型: 布尔值

# 为电源按钮配置“短按”和“长按”定时器
# 值被舍入到硬件支持的数值
# 短按：
#   最短10ms，下一个500ms，然后是500ms的倍数直到7.5秒
# 长按：
#   最短10ms，下一个1000ms，然后是1000ms的倍数直到15秒
# 如果这些属性不存在，则不更改现有配置（来自引导加载程序或OTP）
rohm,short-press-ms:
    描述:
      短按持续时间（毫秒）
    枚举:
      - 10
      - 500
      - 1000
      - 1500
      - 2000
      - 2500
      - 3000
      - 3500
      - 4000
      - 4500
      - 5000
      - 5500
      - 6000
      - 6500
      - 7000

  rohm,long-press-ms:
    描述:
      长按持续时间（毫秒）
    枚举:
      - 10
      - 1000
      - 2000
      - 3000
      - 4000
      - 5000
      - 6000
      - 7000
      - 8000
      - 9000
      - 10000
      - 11000
      - 12000
      - 13000
      - 14000

  regulators:
    $ref: /schemas/regulator/rohm,bd71837-regulator.yaml
    描述:
      指定调节器的子节点列表
required:
  - compatible
  - reg
  - interrupts
  - clocks
  - "#clock-cells"
  - regulators

additionalProperties: false

示例:
  - |
    #include <dt-bindings/interrupt-controller/irq.h>
    #include <dt-bindings/leds/common.h>

    i2c {
        #address-cells = <1>;
        #size-cells = <0>;
        pmic: pmic@4b {
            compatible = "rohm,bd71837";
            reg = <0x4b>;
            interrupt-parent = <&gpio1>;
            interrupts = <29 IRQ_TYPE_LEVEL_LOW>;
            #clock-cells = <0>;
            clocks = <&osc 0>;
            rohm,reset-snvs-powered;
            rohm,short-press-ms = <10>;
            rohm,long-press-ms = <2000>;

            regulators {
                buck1: BUCK1 {
                    regulator-name = "buck1";
                    regulator-min-microvolt = <700000>;
                    regulator-max-microvolt = <1300000>;
                    regulator-boot-on;
                    regulator-always-on;
                    regulator-ramp-delay = <1250>;
                    rohm,dvs-run-voltage = <900000>;
                    rohm,dvs-idle-voltage = <850000>;
                    rohm,dvs-suspend-voltage = <800000>;
                };
                buck2: BUCK2 {
                    regulator-name = "buck2";
                    regulator-min-microvolt = <700000>;
                    regulator-max-microvolt = <1300000>;
                    regulator-boot-on;
                    regulator-always-on;
                    regulator-ramp-delay = <1250>;
                    rohm,dvs-run-voltage = <1000000>;
                    rohm,dvs-idle-voltage = <900000>;
                };
                buck3: BUCK3 {
                    regulator-name = "buck3";
                    regulator-min-microvolt = <700000>;
                    regulator-max-microvolt = <1300000>;
                    regulator-boot-on;
                    rohm,dvs-run-voltage = <1000000>;
                };
                buck4: BUCK4 {
                    regulator-name = "buck4";
                    regulator-min-microvolt = <700000>;
                    regulator-max-microvolt = <1300000>;
                    regulator-boot-on;
                    rohm,dvs-run-voltage = <1000000>;
                };
                buck5: BUCK5 {
                    regulator-name = "buck5";
                    regulator-min-microvolt = <700000>;
                    regulator-max-microvolt = <1350000>;
                    regulator-boot-on;
                };
                buck6: BUCK6 {
                    regulator-name = "buck6";
                    regulator-min-microvolt = <3000000>;
                    regulator-max-microvolt = <3300000>;
                    regulator-boot-on;
                };
                buck7: BUCK7 {
                    regulator-name = "buck7";
                    regulator-min-microvolt = <1605000>;
                    regulator-max-microvolt = <1995000>;
                    regulator-boot-on;
                };
                buck8: BUCK8 {
                    regulator-name = "buck8";
                    regulator-min-microvolt = <800000>;
                    regulator-max-microvolt = <1400000>;
                };

                ldo1: LDO1 {
                    regulator-name = "ldo1";
                    regulator-min-microvolt = <3000000>;
                    regulator-max-microvolt = <3300000>;
                    regulator-boot-on;
                };
                ldo2: LDO2 {
                    regulator-name = "ldo2";
                    regulator-min-microvolt = <900000>;
                    regulator-max-microvolt = <900000>;
                    regulator-boot-on;
                };
                ldo3: LDO3 {
                    regulator-name = "ldo3";
                    regulator-min-microvolt = <1800000>;
                    regulator-max-microvolt = <3300000>;
                };
                ldo4: LDO4 {
                    regulator-name = "ldo4";
                    regulator-min-microvolt = <900000>;
                    regulator-max-microvolt = <1800000>;
                };
                ldo5: LDO5 {
                    regulator-name = "ldo5";
                    regulator-min-microvolt = <1800000>;
                    regulator-max-microvolt = <3300000>;
                };
                ldo6: LDO6 {
                    regulator-name = "ldo6";
                    regulator-min-microvolt = <900000>;
                    regulator-max-microvolt = <1800000>;
                };
                ldo7_reg: LDO7 {
                    regulator-name = "ldo7";
                    regulator-min-microvolt = <1800000>;
                    regulator-max-microvolt = <3300000>;
                };
            };
        };
    };
```
~~~~
