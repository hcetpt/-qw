## Documentation/devicetree/bindings/mfd/samsung,s2mps11_cn.yaml
~~~~yaml
以下是提供的 YAML 文件翻译成中文：

```yaml
# SPDX 许可证标识符: GPL-2.0-only
%YAML 1.2
---
$id: http://devicetree.org/schemas/mfd/samsung,s2mps11.yaml#
$schema: http://devicetree.org/meta-schemas/core.yaml#

title: 三星 S2MPS11/13/14/15 和 S2MPU02 电源管理 IC

maintainers:
  - Krzysztof Kozlowski <krzk@kernel.org>

description: |
  这是针对 S2M 和 S5M 系列电源管理 IC (PMIC) 的设备树绑定的一部分。
  三星 S2MPS11/13/14/15 和 S2MPU02 是一系列电源管理 IC，其中包含电压和电流稳压器、实时时钟、时钟输出以及其他子模块。

properties:
  compatible:
    enum:
      - samsung,s2mps11-pmic
      - samsung,s2mps13-pmic
      - samsung,s2mps14-pmic
      - samsung,s2mps15-pmic
      - samsung,s2mpu02-pmic

  clocks:
    $ref: /schemas/clock/samsung,s2mps11.yaml
    description:
      描述时钟提供者的子节点

interrupts:
    maxItems: 1

  reg:
    maxItems: 1

  regulators:
    type: object
    description:
      指定稳压器的子节点列表

samsung,s2mps11-acokb-ground:
    description: |
      表示 S2MPS11 PMIC 的 ACOKB 引脚连接到地。因此，必须手动设置 CTRL1 寄存器中的 PWRHOLD 位来关闭电源。通常 ACOKB 会被上拉至 VBATT，当 PWRHOLD 引脚变低时，ACOKB 上升将触发电源关闭。
type: boolean

  samsung,s2mps11-wrstbi-ground:
    description: |
      表示 PMIC 的 WRSTBI 引脚被下拉。当系统处于挂起状态时，它会一直变低，从而触发不需要的降压暖重置（将降压电压设置为默认值）。
type: boolean

  wakeup-source: true

required:
  - compatible
  - reg
  - regulators

additionalProperties: false

allOf:
  - if:
      properties:
        compatible:
          contains:
            const: samsung,s2mps11-pmic
    then:
      properties:
        regulators:
          $ref: /schemas/regulator/samsung,s2mps11.yaml
        samsung,s2mps11-wrstbi-ground: false

  - if:
      properties:
        compatible:
          contains:
            const: samsung,s2mps13-pmic
    then:
      properties:
        regulators:
          $ref: /schemas/regulator/samsung,s2mps13.yaml
        samsung,s2mps11-acokb-ground: false

  - if:
      properties:
        compatible:
          contains:
            const: samsung,s2mps14-pmic
    then:
      properties:
        regulators:
          $ref: /schemas/regulator/samsung,s2mps14.yaml
        samsung,s2mps11-acokb-ground: false
        samsung,s2mps11-wrstbi-ground: false

  - if:
      properties:
        compatible:
          contains:
            const: samsung,s2mps15-pmic
    then:
      properties:
        regulators:
          $ref: /schemas/regulator/samsung,s2mps15.yaml
        samsung,s2mps11-acokb-ground: false
        samsung,s2mps11-wrstbi-ground: false

  - if:
      properties:
        compatible:
          contains:
            const: samsung,s2mpu02-pmic
    then:
      properties:
        regulators:
          $ref: /schemas/regulator/samsung,s2mpu02.yaml
        samsung,s2mps11-acokb-ground: false
        samsung,s2mps11-wrstbi-ground: false

examples:
  - |
    #include <dt-bindings/interrupt-controller/irq.h>

    i2c {
        #address-cells = <1>;
        #size-cells = <0>;

        pmic@66 {
            compatible = "samsung,s2mps11-pmic";
            reg = <0x66>;

            interrupt-parent = <&gpx0>;
            interrupts = <4 IRQ_TYPE_LEVEL_LOW>;
            pinctrl-names = "default";
            pinctrl-0 = <&s2mps11_irq>;
            samsung,s2mps11-acokb-ground;
            wakeup-source;

            clocks {
                compatible = "samsung,s2mps11-clk";
                #clock-cells = <1>;
                clock-output-names = "s2mps11_ap", "s2mps11_cp", "s2mps11_bt";
            };

            regulators {
                LDO1 {
                    regulator-name = "vdd_ldo1";
                    regulator-min-microvolt = <1000000>;
                    regulator-max-microvolt = <1000000>;
                    regulator-always-on;
                };

                LDO4 {
                    regulator-name = "vdd_adc";
                    regulator-min-microvolt = <1800000>;
                    regulator-max-microvolt = <1800000>;

                    regulator-state-mem {
                        regulator-off-in-suspend;
                    };
                };

                // ...
BUCK1 {
                    regulator-name = "vdd_mif";
                    regulator-min-microvolt = <800000>;
                    regulator-max-microvolt = <1300000>;
                    regulator-always-on;
                    regulator-boot-on;

                    regulator-state-mem {
                        regulator-off-in-suspend;
                    };
                };

                BUCK2 {
                    regulator-name = "vdd_arm";
                    regulator-min-microvolt = <800000>;
                    regulator-max-microvolt = <1500000>;
                    regulator-always-on;
                    regulator-boot-on;
                    regulator-coupled-with = <&buck3_reg>;
                    regulator-coupled-max-spread = <300000>;

                    regulator-state-mem {
                        regulator-off-in-suspend;
                    };
                };

                BUCK3 {
                    regulator-name = "vdd_int";
                    regulator-min-microvolt = <800000>;
                    regulator-max-microvolt = <1400000>;
                    regulator-always-on;
                    regulator-boot-on;
                    regulator-coupled-with = <&buck2_reg>;
                    regulator-coupled-max-spread = <300000>;

                    regulator-state-mem {
                        regulator-off-in-suspend;
                    };
                };

                // ..
};
        };
    };

  - |
    #include <dt-bindings/interrupt-controller/irq.h>

    i2c {
        #address-cells = <1>;
        #size-cells = <0>;

        pmic@66 {
            compatible = "samsung,s2mps14-pmic";
            reg = <0x66>;

            interrupt-parent = <&gpx0>;
            interrupts = <7 IRQ_TYPE_LEVEL_LOW>;
            wakeup-source;

            clocks {
                compatible = "samsung,s2mps14-clk";
                #clock-cells = <1>;
                clock-output-names = "s2mps14_ap", "unused", "s2mps14_bt";
            };

            regulators {
                LDO1 {
                    regulator-name = "VLDO1_1.0V";
                    regulator-min-microvolt = <1000000>;
                    regulator-max-microvolt = <1000000>;
                    regulator-always-on;

                    regulator-state-mem {
                        regulator-on-in-suspend;
                    };
                };

                // ..
BUCK1 {
                    regulator-name = "VBUCK1_1.0V";
                    regulator-min-microvolt = <800000>;
                    regulator-max-microvolt = <1000000>;
                    regulator-always-on;

                    regulator-state-mem {
                        regulator-off-in-suspend;
                    };
                };

                // ..
};
        };
    };
```
请注意，上述翻译尽可能保留了原文的技术术语和格式。对于某些专有名词和技术细节，建议根据实际应用场景进行适当调整。
您的文本似乎是编程语言或者是一种格式错误的代码片段，而不是可以直接翻译成中文的句子。如果您提供具体的语句或者上下文信息，我很乐意帮您翻译。如果这是代码，请确认是否有误，并提供更多信息以便我能更好地帮助您。
~~~~

## Documentation/devicetree/bindings/mfd/samsung,s5m8767_cn.yaml
```yaml
# SPDX-许可证标识符: GPL-2.0-only OR BSD-2-Clause
%YAML 1.2
---
$id: http://devicetree.org/schemas/mfd/samsung,s5m8767.yaml#
$schema: http://devicetree.org/meta-schemas/core.yaml#

标题: Samsung S5M8767 电源管理集成电路

维护者:
  - Krzysztof Kozlowski <krzk@kernel.org>

描述: |
  这是S2M和S5M系列电源管理集成电路(PMIC)设备树绑定的一部分。
Samsung S5M8767 是一种电源管理集成电路，其中包含电压和电流稳压器、实时时钟、时钟输出和其他子模块。
属性:
  compatible:
    常量: samsung,s5m8767-pmic

  clocks:
    $ref: /schemas/clock/samsung,s2mps11.yaml
    描述:
      描述时钟提供者的子节点
中断:
    最大项数: 1

  reg:
    最大项数: 1

  regulators:
    $ref: /schemas/regulator/samsung,s5m8767.yaml
    描述:
      指定稳压器的子节点列表
s5m8767,pmic-buck2-dvs-voltage:
    $ref: /schemas/types.yaml#/definitions/uint32-array
    最小项数: 8
    最大项数: 8
    描述: |
      当使用GPIO动态电压调整(buck2)时，8个电压值（微伏单位）
s5m8767,pmic-buck3-dvs-voltage:
    $ref: /schemas/types.yaml#/definitions/uint32-array
    最小项数: 8
    最大项数: 8
    描述: |
      当使用GPIO动态电压调整(buck3)时，8个电压值（微伏单位）
s5m8767,pmic-buck4-dvs-voltage:
    $ref: /schemas/types.yaml#/definitions/uint32-array
    最小项数: 8
    最大项数: 8
    描述: |
      当使用GPIO动态电压调整(buck4)时，8个电压值（微伏单位）
s5m8767,pmic-buck-ds-gpios:
    最小项数: 3
    最大项数: 3
    描述: |
      用于选择GPIO动态电压调整线路的主机GPIO标识符
它与dvs GPIO线路一一对应
s5m8767,pmic-buck2-uses-gpio-dvs:
    类型: 布尔
    描述: buck2可以通过GPIO动态电压调整进行控制
Here is the translation into Chinese:

`s5m8767,pmic-buck3-uses-gpio-dvs`:
    类型: 布尔值
    描述: buck3 可以通过 GPIO DVS 控制
`s5m8767,pmic-buck4-uses-gpio-dvs`:
    类型: 布尔值
    描述: buck4 可以通过 GPIO DVS 控制
`s5m8767,pmic-buck-default-dvs-idx`:
    引用: /schemas/types.yaml#definitions/uint32-array
    最小值: 0
    最大值: 7
    默认值: 0
    描述: |
      从可通过 DVS GPIO 选择的 8 种可能电压设置中选出的默认电压设置。
      此属性的值应在 0 到 7 之间。如果没有指定或超出范围，则此属性的默认值为 0。
`s5m8767,pmic-buck-dvs-gpios`:
    最少项目数: 3
    最多项目数: 3
    描述: |
      用于 DVS 的三个主机 GPIO 的规格
`vinb1-supply`:
    描述: buck1 的电源供应
`vinb2-supply`:
    描述: buck2 的电源供应
`vinb3-supply`:
    描述: buck3 的电源供应
`vinb4-supply`:
    描述: buck4 的电源供应
`vinb5-supply`:
    描述: buck5 的电源供应
`vinb6-supply`:
    描述: buck6 的电源供应
`vinb7-supply`:
    描述: buck7 的电源供应
`vinb8-supply`:
    描述: buck8 的电源供应
`vinb9-supply`:
    描述: buck9 的电源供应

`vinl1-supply`:
    描述: LDO3、LDO10、LDO26、LDO27 的电源供应
`vinl2-supply`:
    描述: LDO13、LDO16、LDO25、LDO28 的电源供应
`vinl3-supply`:
    描述: LDO11、LDO14 的电源供应
`vinl4-supply`:
    描述: LDO4、LDO9 的电源供应
`vinl5-supply`:
    描述: LDO12、LDO17、LDO19、LDO23 的电源供应
`vinl6-supply`:
    描述: LDO18、LDO20、LDO21、LDO24 的电源供应
`vinl7-supply`:
    描述: LDO5、LDO22 的电源供应
`vinl8-supply`:
    描述: LDO1、LDO6、LDO7、LDO8、LDO15 的电源供应
`vinl9-supply`:
    描述: LDO2 的电源供应

`wakeup-source`: 真

必须包含:
  - 兼容性
  - 地址范围
  - 调节器
  - `s5m8767,pmic-buck-ds-gpios`

依赖关系:
  `s5m8767,pmic-buck2-dvs-voltage`: ['s5m8767,pmic-buck-dvs-gpios']
  `s5m8767,pmic-buck3-dvs-voltage`: ['s5m8767,pmic-buck-dvs-gpios']
  `s5m8767,pmic-buck4-dvs-voltage`: ['s5m8767,pmic-buck-dvs-gpios']
  `s5m8767,pmic-buck2-uses-gpio-dvs`: ['s5m8767,pmic-buck-dvs-gpios', 's5m8767,pmic-buck2-dvs-voltage']
  `s5m8767,pmic-buck3-uses-gpio-dvs`: ['s5m8767,pmic-buck-dvs-gpios', 's5m8767,pmic-buck3-dvs-voltage']
  `s5m8767,pmic-buck4-uses-gpio-dvs`: ['s5m8767,pmic-buck-dvs-gpios', 's5m8767,pmic-buck4-dvs-voltage']

不允许额外属性

所有内容需满足:
  - 不允许同时要求:
      - `s5m8767,pmic-buck2-uses-gpio-dvs`
      - `s5m8767,pmic-buck3-uses-gpio-dvs`
  - 不允许同时要求:
      - `s5m8767,pmic-buck2-uses-gpio-dvs`
      - `s5m8767,pmic-buck4-uses-gpio-dvs`
  - 不允许同时要求:
      - `s5m8767,pmic-buck3-uses-gpio-dvs`
      - `s5m8767,pmic-buck4-uses-gpio-dvs`

示例:
  - |
    #include <dt-bindings/gpio/gpio.h>
    #include <dt-bindings/interrupt-controller/irq.h>

    i2c {
        #address-cells = <1>;
        #size-cells = <0>;

        pmic@66 {
            compatible = "samsung,s5m8767-pmic";
            reg = <0x66>;

            interrupt-parent = <&gpx3>;
            interrupts = <2 IRQ_TYPE_LEVEL_LOW>;
            pinctrl-names = "default";
            pinctrl-0 = <&s5m8767_irq &s5m8767_dvs &s5m8767_ds>;
            wakeup-source;

            s5m8767,pmic-buck-default-dvs-idx = <3>;
            s5m8767,pmic-buck2-uses-gpio-dvs;

            s5m8767,pmic-buck-dvs-gpios = <&gpd1 0 GPIO_ACTIVE_LOW>,
                                          <&gpd1 1 GPIO_ACTIVE_LOW>,
                                          <&gpd1 2 GPIO_ACTIVE_LOW>;

            s5m8767,pmic-buck-ds-gpios = <&gpx2 3 GPIO_ACTIVE_LOW>,
                                         <&gpx2 4 GPIO_ACTIVE_LOW>,
                                         <&gpx2 5 GPIO_ACTIVE_LOW>;

            s5m8767,pmic-buck2-dvs-voltage = <1350000>, <1300000>,
                                             <1250000>, <1200000>,
                                             <1150000>, <1100000>,
                                             <1000000>, <950000>;

            s5m8767,pmic-buck3-dvs-voltage = <1100000>, <1100000>,
                                             <1100000>, <1100000>,
                                             <1000000>, <1000000>,
                                             <1000000>, <1000000>;

            s5m8767,pmic-buck4-dvs-voltage = <1200000>, <1200000>,
                                             <1200000>, <1200000>,
                                             <1200000>, <1200000>,
                                             <1200000>, <1200000>;

            clocks {
                compatible = "samsung,s5m8767-clk";
                #clock-cells = <1>;
                clock-output-names = "en32khz_ap", "en32khz_cp", "en32khz_bt";
            };

            regulators {
                LDO1 {
                    regulator-name = "VDD_ALIVE";
                    regulator-min-microvolt = <1100000>;
                    regulator-max-microvolt = <1100000>;
                    regulator-always-on;
                    regulator-boot-on;
                    op_mode = <1>; /* 正常模式 */
                };

                // ..
BUCK1 {
                    regulator-name = "VDD_MIF";
                    regulator-min-microvolt = <950000>;
                    regulator-max-microvolt = <1100000>;
                    regulator-always-on;
                    regulator-boot-on;
                    op_mode = <1>; /* 正常模式 */
                };

                BUCK2 {
                    regulator-name = "VDD_ARM";
                    regulator-min-microvolt = <900000>;
                    regulator-max-microvolt = <1350000>;
                    regulator-always-on;
                    regulator-boot-on;
                    op_mode = <1>; /* 正常模式 */
                };

                // ..
};
        };
    };

  - |
    #include <dt-bindings/gpio/gpio.h>
    #include <dt-bindings/interrupt-controller/irq.h>

    i2c {
        #address-cells = <1>;
        #size-cells = <0>;

        pmic@66 {
            compatible = "samsung,s5m8767-pmic";
            reg = <0x66>;

            interrupt-parent = <&gpx3>;
            interrupts = <2 IRQ_TYPE_LEVEL_LOW>;
            pinctrl-names = "default";
            pinctrl-0 = <&s5m8767_irq &s5m8767_dvs &s5m8767_ds>;
            wakeup-source;

            s5m8767,pmic-buck-ds-gpios = <&gpx2 3 GPIO_ACTIVE_LOW>,
                                         <&gpx2 4 GPIO_ACTIVE_LOW>,
                                         <&gpx2 5 GPIO_ACTIVE_LOW>;

            clocks {
                compatible = "samsung,s5m8767-clk";
                #clock-cells = <1>;
                clock-output-names = "en32khz_ap", "en32khz_cp", "en32khz_bt";
            };

            regulators {
                LDO1 {
                    regulator-name = "VDD_ALIVE";
                    regulator-min-microvolt = <1100000>;
                    regulator-max-microvolt = <1100000>;
                    regulator-always-on;
                    regulator-boot-on;
                    op_mode = <1>; /* 正常模式 */
                };

                // ..
};
        };
    };
```
