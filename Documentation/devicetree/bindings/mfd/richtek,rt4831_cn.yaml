## Documentation/devicetree/bindings/mfd/rohm,bd71847-pmic_cn.yaml
```yaml
以下是给定内容的中文翻译：

# SPDX-许可证标识符: GPL-2.0-only OR BSD-2-Clause
%YAML 1.2
---
$id: http://devicetree.org/schemas/mfd/rohm,bd71847-pmic.yaml#
$schema: http://devicetree.org/meta-schemas/core.yaml#

标题: ROHM BD71847 和 BD71850 电源管理集成芯片

维护者:
  - Matti Vaittinen <mazziesaccount@gmail.com>

描述: |
  BD71847AMWV 和 BD71850MWV 是可编程的电源管理集成电路，用于为单核、双核和四核SoC（例如NXP-i.MX 8M）供电。它针对低物料清单成本和紧凑型解决方案尺寸进行了优化。BD71847MWV 和 BD71850MWV 集成了6个降压稳压器和6个低压差线性稳压器(LDO)。
数据手册可在以下网址获取：
  https://www.rohm.com/products/power-management/power-management-ic-for-system/industrial-consumer-applications/nxp-imx/bd71847amwv-product
  https://www.rohm.com/products/power-management/power-management-ic-for-system/industrial-consumer-applications/nxp-imx/bd71850mwv-product

属性:
  compatible:
    枚举:
      - rohm,bd71847
      - rohm,bd71850

  reg:
    描述:
      I2C从机地址
最大项数: 1

  interrupts:
    最大项数: 1

  clocks:
    最大项数: 1

  "#clock-cells":
    常量: 0

  clock-output-names:
    最大项数: 1

# BD71847 和 BD71850 支持两种不同的硬件状态作为复位目标状态。这些状态被称为SNVS和READY。在READY状态下，所有PMIC电源输出下降且一次性可编程(OTP)数据重新加载。在SNVS状态下，除了SNVS电源域之外的所有其他逻辑和外部设备都被关闭。有关SNVS状态的更多信息，请参阅NXP i.MX8文档。当通过SNVS状态进行复位时，PMIC OTP数据不会重新加载，这导致在软件控制下的电源输出在复位将电源状态切换到SNVS后保持关闭。如果通过READY状态进行复位，则通过加载OTP数据将电源输出恢复到硬件控制下。因此，默认情况下设置复位目标状态为READY。如果使用SNVS状态，则必须在调节器节点中为启动关键的稳压器设置regulator-always-on和regulator-boot-on属性。
rohm,reset-snvs-powered:
    描述:
      在复位时将PMIC转移到SNVS状态
类型: 布尔值

# 为电源按钮配置“短按”和“长按”定时器
# 值已舍入到硬件支持的数值
# 短按：
#   最短为10毫秒，接下来是500毫秒，然后是500毫秒的倍数直到7.5秒
# 长按：
#   最短为10毫秒，接下来是1000毫秒，然后是1000毫秒的倍数直到15秒
# 如果这些属性不存在，则不修改现有的配置（来自引导加载程序或OTP）
rohm,short-press-ms:
    描述:
      短按持续时间（毫秒）
    枚举:
      - 10
      - 500
      - 1000
      - 1500
      - 2000
      - 2500
      - 3000
      - 3500
      - 4000
      - 4500
      - 5000
      - 5500
      - 6000
      - 6500
      - 7000
      - 7500

  rohm,long-press-ms:
    描述:
      长按持续时间（毫秒）
    枚举:
      - 10
      - 1000
      - 2000
      - 3000
      - 4000
      - 5000
      - 6000
      - 7000
      - 8000
      - 9000
      - 10000
      - 11000
      - 12000
      - 13000
      - 14000
      - 15000

  regulators:
    $ref: ../regulator/rohm,bd71847-regulator.yaml
    描述:
      指定稳压器的子节点列表
必需:
  - compatible
  - reg
  - interrupts
  - regulators

附加属性: false

依赖关系:
  '#clock-cells': [clocks]
  clocks: ['#clock-cells']

示例:
  - |
    #include <dt-bindings/interrupt-controller/irq.h>

    i2c {
        #address-cells = <1>;
        #size-cells = <0>;
        pmic: pmic@4b {
            compatible = "rohm,bd71847";
            reg = <0x4b>;
            interrupt-parent = <&gpio1>;
            interrupts = <29 IRQ_TYPE_LEVEL_LOW>;
            #clock-cells = <0>;
            clocks = <&osc 0>;
            rohm,reset-snvs-powered;
            rohm,short-press-ms = <10>;
            rohm,long-press-ms = <2000>;

            regulators {
                buck1: BUCK1 {
                    regulator-name = "buck1";
                    regulator-min-microvolt = <700000>;
                    regulator-max-microvolt = <1300000>;
                    regulator-boot-on;
                    regulator-always-on;
                    regulator-ramp-delay = <1250>;
                    rohm,dvs-run-voltage = <900000>;
                    rohm,dvs-idle-voltage = <850000>;
                    rohm,dvs-suspend-voltage = <800000>;
                };
                buck2: BUCK2 {
                    regulator-name = "buck2";
                    regulator-min-microvolt = <700000>;
                    regulator-max-microvolt = <1300000>;
                    regulator-boot-on;
                    regulator-always-on;
                    regulator-ramp-delay = <1250>;
                    rohm,dvs-run-voltage = <1000000>;
                    rohm,dvs-idle-voltage = <900000>;
                };
                buck3: BUCK3 {
                    regulator-name = "buck3";
                    regulator-min-microvolt = <550000>;
                    regulator-max-microvolt = <1350000>;
                    regulator-boot-on;
                };
                buck4: BUCK4 {
                    regulator-name = "buck4";
                    regulator-min-microvolt = <2600000>;
                    regulator-max-microvolt = <3300000>;
                    regulator-boot-on;
                };
                buck5: BUCK5 {
                    regulator-name = "buck5";
                    regulator-min-microvolt = <1605000>;
                    regulator-max-microvolt = <1995000>;
                    regulator-boot-on;
                };
                buck8: BUCK6 {
                    regulator-name = "buck6";
                    regulator-min-microvolt = <800000>;
                    regulator-max-microvolt = <1400000>;
                };

                ldo1: LDO1 {
                    regulator-name = "ldo1";
                    regulator-min-microvolt = <1600000>;
                    regulator-max-microvolt = <3300000>;
                    regulator-boot-on;
                };
                ldo2: LDO2 {
                    regulator-name = "ldo2";
                    regulator-min-microvolt = <800000>;
                    regulator-max-microvolt = <900000>;
                    regulator-boot-on;
                };
                ldo3: LDO3 {
                    regulator-name = "ldo3";
                    regulator-min-microvolt = <1800000>;
                    regulator-max-microvolt = <3300000>;
                };
                ldo4: LDO4 {
                    regulator-name = "ldo4";
                    regulator-min-microvolt = <900000>;
                    regulator-max-microvolt = <1800000>;
                };
                ldo5: LDO5 {
                    regulator-name = "ldo5";
                    regulator-min-microvolt = <800000>;
                    regulator-max-microvolt = <3300000>;
                };
                ldo6: LDO6 {
                    regulator-name = "ldo6";
                    regulator-min-microvolt = <900000>;
                    regulator-max-microvolt = <1800000>;
                };
            };
        };
    };
```

## Documentation/devicetree/bindings/mfd/rohm,bd9571mwv_cn.yaml
```yaml
# SPDX-许可证标识符: (GPL-2.0-only 或 BSD-2-Clause)
%YAML 1.2
---
$id: http://devicetree.org/schemas/mfd/rohm,bd9571mwv.yaml#
$schema: http://devicetree.org/meta-schemas/core.yaml#

title: ROHM BD9571MWV/BD9574MWF 电源管理集成电路 (PMIC)

maintainers:
  - Marek Vasut <marek.vasut@gmail.com>

properties:
  compatible:
    enum:
      - rohm,bd9571mwv
      - rohm,bd9574mwf

  reg:
    maxItems: 1

  interrupts:
    maxItems: 1

  interrupt-controller: true

  '#interrupt-cells':
    const: 2

  gpio-controller: true

  '#gpio-cells':
    const: 2

  rohm,ddr-backup-power:
    $ref: /schemas/types.yaml#/definitions/uint32
    minimum: 0x0
    maximum: 0xf
    description: |
      用于DDR备份电源的值（默认为0）
这是一个位掩码，用于指定在进入备份模式时需要保持供电的哪些DDR电源轨，以供系统挂起：
        - 位 0: DDR0
        - 位 1: DDR1
        - 位 2: DDR0C
        - 位 3: DDR1C
这些位与文档中“BKUP 模式 Cnt”寄存器的 KEEPON_DDR* 位相匹配。
  rohm,rstbmode-level:
    $ref: /schemas/types.yaml#/definitions/flag
    description:
      配置RSTB信号为电平模式，以适应切换电源开关（RSTBMODE引脚被拉低）
  rohm,rstbmode-pulse:
    $ref: /schemas/types.yaml#/definitions/flag
    description:
      配置RSTB信号为脉冲模式，以适应瞬时电源开关（RSTBMODE引脚被拉高）
  regulators:
    type: object
    description:
      指定稳压器初始化数据的子节点列表
子节点必须按照其硬件对应物命名
patternProperties:
      "^(vd09|vd18|vd25|vd33|dvfs)$":
        type: object
        $ref: /schemas/regulator/regulator.yaml#

        properties:
          regulator-name:
            pattern: "^(vd09|vd18|vd25|vd33|dvfs)$"

        unevaluatedProperties: false

    additionalProperties: false

additionalProperties: false

required:
  - compatible
  - reg
  - interrupts
  - interrupt-controller
  - '#interrupt-cells'
  - gpio-controller
  - '#gpio-cells'

oneOf:
  - required:
      - rohm,rstbmode-level
  - required:
      - rohm,rstbmode-pulse

examples:
  - |
    #include <dt-bindings/interrupt-controller/irq.h>

    i2c {
          #address-cells = <1>;
          #size-cells = <0>;

          pmic: pmic@30 {
                  compatible = "rohm,bd9571mwv";
                  reg = <0x30>;
                  interrupt-parent = <&gpio2>;
                  interrupts = <0 IRQ_TYPE_LEVEL_LOW>;
                  interrupt-controller;
                  #interrupt-cells = <2>;
                  gpio-controller;
                  #gpio-cells = <2>;
                  rohm,ddr-backup-power = <0xf>;
                  rohm,rstbmode-pulse;

                  regulators {
                          dvfs: dvfs {
                                  regulator-name = "dvfs";
                                  regulator-min-microvolt = <750000>;
                                  regulator-max-microvolt = <1030000>;
                                  regulator-boot-on;
                                  regulator-always-on;
                          };
                  };
          };
    };
```

## Documentation/devicetree/bindings/mfd/rohm,bd9576-pmic_cn.yaml
~~~~yaml
# SPDX-许可证标识符: GPL-2.0-only 或 BSD-2-Clause
%YAML 1.2
---
$id: http://devicetree.org/schemas/mfd/rohm,bd9576-pmic.yaml#
$schema: http://devicetree.org/meta-schemas/core.yaml#

标题: ROHM BD9576MUF 和 BD9573MUF 电源管理集成芯片

维护者:
  - Matti Vaittinen <mazziesaccount@gmail.com>

描述: |
  BD9576MUF 和 BD9573MUF 是主要用于为 R-Car 系列处理器供电的电源管理 IC。
  该 IC 提供了 6 路可配置序列和安全监控的电源输出。还包含了具有慢速脉冲/窗口模式的看门狗逻辑。
属性:
  compatible:
    枚举:
      - rohm,bd9576
      - rohm,bd9573

  reg:
    描述:
      I2C 从设备地址
最大项数: 1

  interrupts:
    最大项数: 1

  rohm,vout1-en-low:
    描述:
      BD9576 和 BD9573 的 VOUT1 稳压器启用状态可以通过一个 GPIO 进行单独控制。
      这是由 PMIC 启动期间 vout1-en 引脚的状态决定的。如果在 PMIC 启动期间 vout1-en 为低电平，
      则 VOUT1 启用状态将通过此引脚进行控制。如果 vout1-en 在 PMIC 启动时被拉低，请设置此属性。
类型: 布尔值

  rohm,vout1-en-gpios:
    描述:
      GPIO 规定以指定与 vout1-en 连接的 GPIO，用于控制 vout1 的开/关状态
最大项数: 1

  rohm,ddr-sel-low:
    描述:
      BD9576 和 BD9573 对于 DDR 的输出电压可以通过设置 ddr-sel 引脚为低电平或高电平来选择。
      如果 ddr-sel 被接地，请设置此属性。
类型: 布尔值

  rohm,watchdog-enable-gpios:
    描述: 用于启用看门狗的 GPIO 线
最大项数: 1

  rohm,watchdog-ping-gpios:
    描述: 用于向看门狗发送脉冲的 GPIO 线
最大项数: 1

  rohm,hw-timeout-ms:
    最大项数: 2
    描述:
      看门狗超时时间（毫秒）。如果给出单个值，则是最大超时时间。
      例如，如果在此时间内未完成向看门狗发送脉冲，则将触发看门狗。
      如果给出了两个值，则将配置看门狗为“窗口模式”。此时第一个值是短脉冲的限制。
      例如，如果看门狗被更早地脉冲，则将触发看门狗。当给出两个值时，第二个值是最大超时时间。
```yaml
# (硬件) 短超时时间的最小值为 2 毫秒，最大值为 220 毫秒
# (硬件) 最大超时时间的最小值为 4 毫秒，最大值为 4416 毫秒
regulators:
    $ref: /schemas/regulator/rohm,bd9576-regulator.yaml
    description:
      规定了描述稳压器的子节点列表
required:
  - compatible
  - reg
  - regulators

additionalProperties: false

examples:
  - |
    #include <dt-bindings/gpio/gpio.h>
    #include <dt-bindings/leds/common.h>
    i2c {
        #address-cells = <1>;
        #size-cells = <0>;
        pmic: pmic@30 {
            compatible = "rohm,bd9576";
            reg = <0x30>;
            rohm,vout1-en-low;
            rohm,vout1-en-gpios = <&gpio2 6 GPIO_ACTIVE_HIGH>;
            rohm,ddr-sel-low;
            rohm,watchdog-enable-gpios = <&gpio2 6 GPIO_ACTIVE_HIGH>;
            rohm,watchdog-ping-gpios = <&gpio2 7 GPIO_ACTIVE_HIGH>;
            rohm,hw-timeout-ms = <150>, <2300>;

            regulators {
                boost1: regulator-vd50 {
                    regulator-name = "VD50";
                };
                buck1: regulator-vd18 {
                    regulator-name = "VD18";
                };
                buck2: regulator-vdddr {
                    regulator-name = "VDDDR";
                };
                buck3: regulator-vd10 {
                    regulator-name = "VD10";
                };
                ldo: regulator-voutl1 {
                    regulator-name = "VOUTL1";
                };
                sw: regulator-vouts1 {
                    regulator-name = "VOUTS1";
                };
            };
        };
    };
```

这段 YAML 格式的文本描述了设备树配置中与 ROHM BD9576 稳压器相关的部分。其中指出了短超时时间和最大超时时间的限制，并给出了一个具体的例子来说明如何在设备树中定义该稳压器以及其相关的控制引脚和子稳压器。
~~~~
