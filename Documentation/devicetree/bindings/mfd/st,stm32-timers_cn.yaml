## Documentation/devicetree/bindings/mfd/ti-keystone-devctrl_cn.txt
```
针对德州仪器 (Texas Instruments) Keystone 设备状态控制的设备树绑定

Keystone II 系列设备有一组寄存器用于控制其外设的状态。此节点旨在允许访问这些功能。
必需属性：

- compatible:        "ti,keystone-devctrl", "syscon"

- reg:              包含设备状态控制寄存器空间的偏移量/长度值
示例：

devctrl: device-state-control@02620000 {
	compatible = "ti,keystone-devctrl", "syscon";
	reg = <0x02620000 0x1000>;
};
```

## Documentation/devicetree/bindings/mfd/ti-lmu_cn.txt
~~~~
TI LMU（照明管理单元）设备树绑定

TI LMU 驱动支持以下照明设备：
名称                  子节点
------      ---------------------------------
LM3631       背光和稳压器
LM3632       背光和稳压器
LM3633       背光、LED 和故障监控
LM3695       背光
LM36274      背光和稳压器

必需属性：
- compatible：应为以下之一：
                "ti,lm3631"
                "ti,lm3632"
                "ti,lm3633"
                "ti,lm3695"
                "ti,lm36274"
- reg：I2C 从设备地址
0x11 对于 LM3632
         0x29 对于 LM3631
         0x36 对于 LM3633
         0x63 对于 LM3695
         0x11 对于 LM36274

可选属性：
- enable-gpios：硬件使能引脚的 GPIO 指定符
- ramp-up-us：电流从一个亮度级别到较高亮度级别的渐变时间
范围从 2048 微秒至 117.44 秒
- ramp-down-us：电流从一个亮度级别到较低亮度级别的渐变时间
                 范围从 2048 微秒至 117.44 秒
- ti,brightness-resolution - 这决定了是使用 8 位亮度模式还是 11 位亮度模式。如果未设置此值，则设备默认为数据手册第 7.3.4.1 节中所推荐的 8 位亮度模式。此设置可以位于父节点中或作为 LED 子节点的一部分。这取决于部件本身，如果字符串具有公共亮度寄存器或单独的亮度寄存器。
可能的值为 255（8 位）或 2047（11 位）

必需节点：
- backlight：所有 LMU 设备都有背光子节点
对于属性的具体信息，请参见 [1]

可选节点：
- fault-monitor：LM3633 和 LM3697 的硬件故障监控驱动程序
### Required Properties:

- `compatible`: 应为以下之一：
                    "ti,lm3633-fault-monitor"
- `leds`: LM3633 的 LED 属性。请参考 [2]
          LM36274 的 LED 属性。请参考 [4]
- `regulators`: LM3631 和 LM3632 的稳压器属性。请参考 [3]

#### 参考资料
[1] ../leds/backlight/ti-lmu-backlight.txt
[2] ../leds/leds-lm3633.txt
[3] ../regulator/lm363x-regulator.txt
[4] ../leds/leds-lm36274.txt

```text
lm3631@29 {
    compatible = "ti,lm3631";
    reg = <0x29>;

    regulators {
        compatible = "ti,lm363x-regulator";

        vboost {
            regulator-name = "lcd_boost";
            regulator-min-microvolt = <4500000>;
            regulator-max-microvolt = <6350000>;
            regulator-always-on;
        };

        vcont {
            regulator-name = "lcd_vcont";
            regulator-min-microvolt = <1800000>;
            regulator-max-microvolt = <3300000>;
        };

        voref {
            regulator-name = "lcd_voref";
            regulator-min-microvolt = <4000000>;
            regulator-max-microvolt = <6000000>;
        };

        vpos {
            regulator-name = "lcd_vpos";
            regulator-min-microvolt = <4000000>;
            regulator-max-microvolt = <6000000>;
            regulator-boot-on;
        };

        vneg {
            regulator-name = "lcd_vneg";
            regulator-min-microvolt = <4000000>;
            regulator-max-microvolt = <6000000>;
            regulator-boot-on;
        };
    };

    backlight {
        compatible = "ti,lm3631-backlight";

        lcd_bl {
            led-sources = <0 1>;
            ramp-up-us = <300000>;
        };
    };
};

lm3632@11 {
    compatible = "ti,lm3632";
    reg = <0x11>;

    enable-gpios = <&pioC 2 GPIO_ACTIVE_HIGH>; /* PC2 */

    regulators {
        compatible = "ti,lm363x-regulator";

        enable-gpios = <&pioC 0 GPIO_ACTIVE_HIGH>,
                       <&pioC 1 GPIO_ACTIVE_HIGH>;

        vboost {
            regulator-name = "lcd_boost";
            regulator-min-microvolt = <4500000>;
            regulator-max-microvolt = <6400000>;
            regulator-always-on;
        };

        vpos {
            regulator-name = "lcd_vpos";
            regulator-min-microvolt = <4000000>;
            regulator-max-microvolt = <6000000>;
        };

        vneg {
            regulator-name = "lcd_vneg";
            regulator-min-microvolt = <4000000>;
            regulator-max-microvolt = <6000000>;
        };
    };

    backlight {
        compatible = "ti,lm3632-backlight";

        pwms = <&pwm0 0 10000 0>; /* pwm number, period, polarity */
        pwm-names = "lmu-backlight";

        lcd {
            led-sources = <0 1>;
            pwm-period = <10000>;
        };
    };
};

lm3633@36 {
    compatible = "ti,lm3633";
    reg = <0x36>;

    enable-gpios = <&pioC 2 GPIO_ACTIVE_HIGH>;

    backlight {
        compatible = "ti,lm3633-backlight";

        main {
            label = "main_lcd";
            led-sources = <1 2>;
            ramp-up-us = <500000>;
            ramp-down-us = <500000>;
        };

        front {
            label = "front_lcd";
            led-sources = <0>;
            ramp-up-us = <1000000>;
            ramp-down-us = <0>;
        };
    };

    leds {
        compatible = "ti,lm3633-leds";

        chan1 {
            label = "status";
            led-sources = <1>;
            led-max-microamp = <6000>;
        };

        chan345 {
            label = "rgb";
            led-sources = <3 4 5>;
            led-max-microamp = <10000>;
        };
    };

    fault-monitor {
        compatible = "ti,lm3633-fault-monitor";
    };
};

lm3695@63 {
    compatible = "ti,lm3695";
    reg = <0x63>;

    enable-gpios = <&pioC 2 GPIO_ACTIVE_HIGH>;

    backlight {
        compatible = "ti,lm3695-backlight";

        lcd {
            label = "bl";
            led-sources = <0 1>;
        };
    };
};

lm36274@11 {
    compatible = "ti,lm36274";
    #address-cells = <1>;
    #size-cells = <0>;
    reg = <0x11>;

    enable-gpios = <&pioC 2 GPIO_ACTIVE_HIGH>;
    regulators {
        #address-cells = <1>;
        #size-cells = <0>;
        compatible = "ti,lm363x-regulator";

        enable-gpios = <&pioC 0 GPIO_ACTIVE_HIGH>,
                       <&pioC 1 GPIO_ACTIVE_HIGH>;

        vboost {
            regulator-name = "lcd_boost";
            regulator-min-microvolt = <4000000>;
            regulator-max-microvolt = <7150000>;
            regulator-always-on;
        };

        vpos {
            regulator-name = "lcd_vpos";
            regulator-min-microvolt = <4000000>;
            regulator-max-microvolt = <6500000>;
        };

        vneg {
            regulator-name = "lcd_vneg";
            regulator-min-microvolt = <4000000>;
            regulator-max-microvolt = <6500000>;
        };
    };

    backlight {
        #address-cells = <1>;
        #size-cells = <0>;
        compatible = "ti,lm36274-backlight";

        led@0 {
            reg = <0>;
            led-sources = <0 2>;
            label = "white:backlight_cluster";
            linux,default-trigger = "backlight";
        };
    };
};
```

以上内容描述了不同设备（LM3631、LM3632、LM3633、LM3695 和 LM36274）的配置细节，包括它们的兼容性声明、GPIO 配置、稳压器配置以及背光和 LED 控制特性。这些设备用于控制显示背光和其他 LED 灯。每个设备都有特定的配置选项来满足其功能需求。
~~~~

## Documentation/devicetree/bindings/mfd/tps6105x_cn.txt
~~~~
* 适用于 TI TPS61050/61052 升压转换器的设备树绑定

TPS61050/TPS61052 是一款高功率“白色 LED 驱动器”。该
设备提供 LED、GPIO 和稳压器功能。
必需属性：
- compatible:       “ti,tps61050” 或 “ti,tps61052”
- reg:             指定 I2C 从地址

可选子节点：

此子节点选择芯片的工作模式
最多只能有一个可用子节点
- regulator: 存在该子节点使芯片处于稳压器模式
参见 ../regulator/regulator.yaml

- led: 存在这个子节点使芯片处于 LED 模式
可选属性：
    - function : 参见 ../leds/common.txt
    - color    : 参见 ../leds/common.txt
    - label    : 参见 ../leds/common.txt
                  （已废弃）

示例（仅 GPIO 操作）:

```yaml
i2c0 {
	tps61052@33 {
		compatible = "ti,tps61052";
		reg = <0x33>;
	};
};
```

示例（GPIO + 稳压器操作）:

```yaml
i2c0 {
	tps61052@33 {
		compatible = "ti,tps61052";
		reg = <0x33>;

		regulator {
			regulator-min-microvolt = <5000000>;
			regulator-max-microvolt = <5000000>;
			regulator-always-on;
		};
	};
};
```

示例（GPIO + LED 操作）:

```yaml
#include <dt-bindings/leds/common.h>

i2c0 {
	tps61052@33 {
		compatible = "ti,tps61052";
		reg = <0x33>;

		led {
			color = <LED_COLOR_ID_WHITE>;
		};
	};
};
```
~~~~

## Documentation/devicetree/bindings/mfd/tps6507x_cn.txt
~~~~
TPS6507x电源管理集成电路

所需属性：
- compatible（兼容性）: "ti,tps6507x"
- reg（寄存器）: I2C从设备地址
- regulators（稳压器）: 这是一个子节点列表，用于指定已定义稳压器的初始化数据。对于给定的设备，并非所有稳压器都需要存在。这些节点的定义使用在Documentation/devicetree/bindings/regulator/regulator.txt中找到的标准稳压器绑定。
  稳压器与regulator-compatible相匹配
  合法的regulator-compatible值包括：
  tps6507x: vdcdc1, vdcdc2, vdcdc3, vldo1, vldo2
- xxx-supply（输入电压供应稳压器）: 输入电压供应稳压器
如果为设备启用了稳压器，则需要这些条目
缺少这些属性可能会导致稳压器注册失败
如果某些输入电源通过电池或始终开启的电源供电，那么也需要具有这些参数以及始终开启的电源供应节点的适当句柄。

对于TPS6507x：
- vindcdc1_2-supply: VDCDC1和VDCDC2输入
- vindcdc3-supply: VDCDC3输入
- vldo1_2-supply: VLDO1和VLDO2输入

稳压器可选属性：
- defdcdc_default: 这是DCDC2和DCDC3稳压器的属性。
这段文本描述了一个电源管理单元（PMU）的配置，特别是针对德州仪器的 TPS6507X 系列芯片。下面是对这段配置文件的中文翻译：

0: 如果 DCDC2/DCDC3 的 `defdcdc` 引脚被拉低到地 (GND)。
1: 如果 DCDC2/DCDC3 的 `defdcdc` 引脚被驱动为高电平 (HIGH)。
如果未定义此属性，则默认值为 0（未启用）。
示例：

```yaml
pmu: tps6507x@48 {  // 定义 PMU 节点，并命名为 tps6507x，基地址为 0x48
    compatible = "ti,tps6507x";  // 兼容性声明，表示这是一个 TPS6507X 芯片
    reg = <0x48>;  // 设备的 I/O 基地址

    vindcdc1_2-supply = <&vbat>;  // VINDCDC1 和 VINDCDC2 电源供应来自 vbat
    vindcdc3-supply = <...>;  // VINDCDC3 电源供应信息省略
    vinldo1_2-supply = <...>;  // VINLDO1 和 VINLDO2 电源供应信息省略

    regulators {  // 定义了多个稳压器
        #address-cells = <1>;  // 地址单元的数量
        #size-cells = <0>;  // 大小单元的数量

        vdcdc1_reg: regulator@0 {  // VDCDC1 稳压器
            regulator-compatible = "VDCDC1";  // 兼容性声明
            reg = <0>;  // 稳压器的地址
            regulator-min-microvolt = <3150000>;  // 最小输出电压（微伏）
            regulator-max-microvolt = <3450000>;  // 最大输出电压（微伏）
            regulator-always-on;  // 稳压器始终开启
            regulator-boot-on;  // 开机时开启稳压器
        };
        vdcdc2_reg: regulator@1 {  // VDCDC2 稳压器
            regulator-compatible = "VDCDC2";
            reg = <1>;
            regulator-min-microvolt = <1710000>;
            regulator-max-microvolt = <3450000>;
            regulator-always-on;
            regulator-boot-on;
            defdcdc_default = <1>;  // 默认情况下将 `defdcdc` 引脚设置为高电平
        };
        vdcdc3_reg: regulator@2 {  // VDCDC3 稳压器
            regulator-compatible = "VDCDC3";
            reg = <2>;
            regulator-min-microvolt = <950000>;
            regulator-max-microvolt = <1350000>;
            regulator-always-on;
            regulator-boot-on;
            defdcdc_default = <1>;  // 默认情况下将 `defdcdc` 引脚设置为高电平
        };
        ldo1_reg: regulator@3 {  // LDO1 稳压器
            regulator-compatible = "LDO1";
            reg = <3>;
            regulator-min-microvolt = <1710000>;
            regulator-max-microvolt = <1890000>;
            regulator-always-on;
            regulator-boot-on;
        };
        ldo2_reg: regulator@4 {  // LDO2 稳压器
            regulator-compatible = "LDO2";
            reg = <4>;
            regulator-min-microvolt = <1140000>;
            regulator-max-microvolt = <1320000>;
            regulator-always-on;
            regulator-boot-on;
        };
    };

};
```

请注意，上述翻译尽可能保持了原文的结构和格式，以方便理解。
~~~~
