## Documentation/devicetree/bindings/mfd/ti,tps65086_cn.yaml
```yaml
下面是给定内容的中文翻译：

# SPDX-License-Identifier: (GPL-2.0-only OR BSD-2-Clause)
%YAML 1.2
---
$id: http://devicetree.org/schemas/mfd/ti,tps65086.yaml#
$schema: http://devicetree.org/meta-schemas/core.yaml#

title: TPS65086 电源管理集成电路 (PMIC)

maintainers:
  - Emil Renner Berthing <kernel@esmil.dk>

properties:
  compatible:
    const: ti,tps65086

  reg:
    const: 0x5e
    description: I2C 从设备地址

  interrupts:
    maxItems: 1

  interrupt-controller: true

  '#interrupt-cells':
    const: 2
    description: |
      第一个单元是中断号。第二个单元是标志，
      使用来自 ../interrupt-controller/interrupts.txt 的触发掩码进行编码

gpio-controller: true

  '#gpio-cells':
    const: 2
    description: |
      第一个单元是引脚编号，第二个单元用于指定
      标志。更多信息请参见 ../gpio/gpio.txt
regulators:
    type: object
    additionalProperties: false
    description: |
      列出子节点以指定稳压器初始化数据
子节点必须按照其硬件对应名称命名：
      buck[1-6]、ldoa[1-3]、swa1、swb[1-2] 和 vtt
每个子节点都使用标准的稳压器绑定定义，并且可以使用下面定义的可选稳压器属性
patternProperties:
      "^buck[1-6]$":
        type: object
        $ref: /schemas/regulator/regulator.yaml

        properties:
          regulator-name: true
          regulator-boot-on: true
          regulator-always-on: true
          regulator-min-microvolt: true
          regulator-max-microvolt: true
          ti,regulator-step-size-25mv:
            type: boolean
            description: |
              如果稳压器出厂设置为25mv步进电压映射，则设置此属性
ti,regulator-decay:
            type: boolean
            description: |
              如果输出需要衰减，则设置此属性；默认情况下，输出缓慢下降
additionalProperties: false

      "^(ldoa[1-3]|swa1|swb[1-2]|vtt)$":
        type: object
        $ref: /schemas/regulator/regulator.yaml

        properties:
          regulator-name: true
          regulator-boot-on: true
          regulator-always-on: true
          regulator-min-microvolt: true
          regulator-max-microvolt: true

        additionalProperties: false

additionalProperties: false

required:
  - compatible
  - reg
  - gpio-controller
  - '#gpio-cells'
  - regulators

examples:
  - |
    #include <dt-bindings/interrupt-controller/irq.h>
    i2c {
        #address-cells = <1>;
        #size-cells = <0>;

        pmic: pmic@5e {
            compatible = "ti,tps65086";
            reg = <0x5e>;
            interrupt-parent = <&gpio1>;
            interrupts = <28 IRQ_TYPE_LEVEL_LOW>;
            interrupt-controller;
            #interrupt-cells = <2>;
            gpio-controller;
            #gpio-cells = <2>;

            regulators {
                buck1 {
                    regulator-name = "vcc1";
                    regulator-min-microvolt = <1600000>;
                    regulator-max-microvolt = <1600000>;
                    regulator-boot-on;
                    ti,regulator-decay;
                    ti,regulator-step-size-25mv;
                };
            };
        };
    };
```

## Documentation/devicetree/bindings/mfd/ti,tps6594_cn.yaml
~~~~yaml
# SPDX-文件许可人: GPL-2.0-only 或 BSD-2-Clause
%YAML 1.2
---
$id: http://devicetree.org/schemas/mfd/ti,tps6594.yaml#
$schema: http://devicetree.org/meta-schemas/core.yaml#

title: TI TPS6594 电源管理集成电路

maintainers:
  - Julien Panis <jpanis@baylibre.com>

description:
  TPS6594 是一种电源管理集成电路，它提供了稳压器以及其他特性，
  如 GPIO、RTC、看门狗、ESM（错误信号监视器）以及管理设备状态的
  PFSM（预配置有限状态机）。TPS6594 是一个超级集设备，而 TPS6593 和
  LP8764 是它的衍生产品。

properties:
  compatible:
    enum:
      - ti,lp8764-q1
      - ti,tps6593-q1
      - ti,tps6594-q1
      - ti,tps65224-q1

  reg:
    description: I2C 从设备地址或 SPI 芯片选择编号
maxItems: 1

  ti,primary-pmic:
    type: boolean
    description: |
      标识 SPMI 总线上的主电源管理 IC
为了使多个 PMIC 设备同步电源状态变化，PMIC 设备中实现了一种多 PMIC 同步方案。
通过 SPMI 总线来完成这一目标：主 PMIC 是 SPMI 总线上的控制器设备，而次级 PMIC
是 SPMI 总线上的目标设备。
system-power-controller: true

  gpio-controller: true

  '#gpio-cells':
    const: 2
    description: |
      第一个单元是引脚编号，第二个单元用于指定标志
更多信息请参阅 ../gpio/gpio.txt
interrupts:
    maxItems: 1

  regulators:
    type: object
    description: 由该控制器提供的稳压器列表
patternProperties:
      "^buck([1-5]|12|34|123|1234)$":
        type: object
        $ref: /schemas/regulator/regulator.yaml#

        unevaluatedProperties: false

      "^ldo[1-4]$":
        type: object
        $ref: /schemas/regulator/regulator.yaml#

        unevaluatedProperties: false

    allOf:
      - if:
          required:
            - buck12
        then:
          properties:
            buck123: false
            buck1234: false
      - if:
          required:
            - buck123
        then:
          properties:
            buck34: false
      - if:
          required:
            - buck1234
        then:
          properties:
            buck34: false

    additionalProperties: false

patternProperties:
  "^buck([1-5]|12|34|123|1234)-supply$":
    description: 每个 buck 的输入供电句柄
"^ldo[1-4]-supply$":
    description: 每个 LDO 的输入供电句柄
这段代码是 Device Tree (设备树) 的描述，用于定义硬件组件及其配置。下面是对这段代码的中文翻译：

```yaml
# 必需字段:
- 兼容性
- 寄存器地址
- 中断

# 不允许额外属性

# 示例
- |
  #include <dt-bindings/interrupt-controller/arm-gic.h>
  i2c {  # I2C 总线
      #address-cells = <1>;  # 地址单元格数量为1
      #size-cells = <0>;  # 大小单元格数量为0

      tps6593: pmic@48 {  # PMIC 设备，I2C 地址为 0x48
          compatible = "ti,tps6593-q1";  # 兼容性声明，与 TI TPS6593-Q1 芯片兼容
          reg = <0x48>;  # 设备的寄存器地址
          ti,primary-pmic;  # TI 主电源管理 IC
          system-power-controller;  # 系统电源控制器

          gpio-controller;  # GPIO 控制器
          #gpio-cells = <2>;  # GPIO 单元格数量为2

          pinctrl-names = "default";  # 引脚控制名称
          pinctrl-0 = <&pmic_irq_pins_default>;  # 默认引脚控制配置
          interrupt-parent = <&mcu_gpio0>;  # 中断父设备
          interrupts = <0 IRQ_TYPE_EDGE_FALLING>;  # 中断请求，IRQ 类型下降沿触发

          buck123-supply = <&vcc_3v3_sys>;  # Buck123 供电来自 vcc_3v3_sys
          buck4-supply = <&vcc_3v3_sys>;  # Buck4 供电来自 vcc_3v3_sys
          buck5-supply = <&vcc_3v3_sys>;  # Buck5 供电来自 vcc_3v3_sys
          ldo1-supply = <&vcc_3v3_sys>;  # LDO1 供电来自 vcc_3v3_sys
          ldo2-supply = <&vcc_3v3_sys>;  # LDO2 供电来自 vcc_3v3_sys
          ldo3-supply = <&buck5>;  # LDO3 供电来自 Buck5
          ldo4-supply = <&vcc_3v3_sys>;  # LDO4 供电来自 vcc_3v3_sys

          regulators {  # 电压调节器
              buck123: buck123 {  # Buck123
                  regulator-name = "vcc_core";  # 名称
                  regulator-min-microvolt = <750000>;  # 最小输出电压（微伏）
                  regulator-max-microvolt = <850000>;  # 最大输出电压（微伏）
                  regulator-boot-on;  # 启动时打开
                  regulator-always-on;  # 始终保持开启状态
              };

              buck4: buck4 {  # Buck4
                  regulator-name = "vcc_1v1";  # 名称
                  regulator-min-microvolt = <1100000>;  # 最小输出电压（微伏）
                  regulator-max-microvolt = <1100000>;  # 最大输出电压（微伏）
                  regulator-boot-on;  # 启动时打开
                  regulator-always-on;  # 始终保持开启状态
              };

              buck5: buck5 {  # Buck5
                  regulator-name = "vcc_1v8_sys";  # 名称
                  regulator-min-microvolt = <1800000>;  # 最小输出电压（微伏）
                  regulator-max-microvolt = <1800000>;  # 最大输出电压（微伏）
                  regulator-boot-on;  # 启动时打开
                  regulator-always-on;  # 始终保持开启状态
              };

              ldo1: ldo1 {  # LDO1
                  regulator-name = "vddshv5_sdio";  # 名称
                  regulator-min-microvolt = <3300000>;  # 最小输出电压（微伏）
                  regulator-max-microvolt = <3300000>;  # 最大输出电压（微伏）
                  regulator-boot-on;  # 启动时打开
                  regulator-always-on;  # 始终保持开启状态
              };

              ldo2: ldo2 {  # LDO2
                  regulator-name = "vpp_1v8";  # 名称
                  regulator-min-microvolt = <1800000>;  # 最小输出电压（微伏）
                  regulator-max-microvolt = <1800000>;  # 最大输出电压（微伏）
                  regulator-boot-on;  # 启动时打开
                  regulator-always-on;  # 始终保持开启状态
              };

              ldo3: ldo3 {  # LDO3
                  regulator-name = "vcc_0v85";  # 名称
                  regulator-min-microvolt = <850000>;  # 最小输出电压（微伏）
                  regulator-max-microvolt = <850000>;  # 最大输出电压（微伏）
                  regulator-boot-on;  # 启动时打开
                  regulator-always-on;  # 始终保持开启状态
              };

              ldo4: ldo4 {  # LDO4
                  regulator-name = "vdda_1v8";  # 名称
                  regulator-min-microvolt = <1800000>;  # 最小输出电压（微伏）
                  regulator-max-microvolt = <1800000>;  # 最大输出电压（微伏）
                  regulator-boot-on;  # 启动时打开
                  regulator-always-on;  # 始终保持开启状态
              };
          };
      };
  };
```

请注意，这段翻译尽量保持了原文的结构和风格，以便更好地理解其内容。
~~~~

## Documentation/devicetree/bindings/mfd/ti,twl_cn.yaml
~~~~yaml
下面是给定 YAML 文档的中文翻译：

```yaml
# SPDX-许可证标识符: GPL-2.0
%YAML 1.2
---
$id: http://devicetree.org/schemas/mfd/ti,twl.yaml#
$schema: http://devicetree.org/meta-schemas/core.yaml#

title: 德州仪器 TWL 系列

maintainers:
  - 安德烈亚斯·肯纳德 <andreas@kemnade.info>

description: |
  TWL 系列是集成电源管理芯片。
  某些版本可能包含更多的模拟功能，例如
  USB 收发器或音频放大器。
  这些芯片通过 I2C 总线连接。
allOf:
  - if:
      properties:
        compatible:
          contains:
            const: ti,twl4030
    then:
      patternProperties:
        "^regulator-":
          properties:
            compatible:
              enum:
                - ti,twl4030-vaux1
                - ti,twl4030-vaux2
                - ti,twl4030-vaux3
                - ti,twl4030-vaux4
                - ti,twl4030-vmmc1
                - ti,twl4030-vmmc2
                - ti,twl4030-vpll1
                - ti,twl4030-vpll2
                - ti,twl4030-vsim
                - ti,twl4030-vdac
                - ti,twl4030-vintana2
                - ti,twl4030-vio
                - ti,twl4030-vdd1
                - ti,twl4030-vdd2
                - ti,twl4030-vintana1
                - ti,twl4030-vintdig
                - ti,twl4030-vusb1v5
                - ti,twl4030-vusb1v8
                - ti,twl4030-vusb3v1
            ti,retain-on-reset: false

      properties:
        madc:
          type: object
          $ref: /schemas/iio/adc/ti,twl4030-madc.yaml
          unevaluatedProperties: false

        bci:
          type: object
          $ref: /schemas/power/supply/twl4030-charger.yaml
          unevaluatedProperties: false

        pwrbutton:
          type: object
          additionalProperties: false
          properties:
            compatible:
              const: ti,twl4030-pwrbutton
            interrupts:
              items:
                - items:
                    const: 8

        watchdog:
          type: object
          additionalProperties: false
          properties:
            compatible:
              const: ti,twl4030-wdt
  - if:
      properties:
        compatible:
          contains:
            const: ti,twl6030
    then:
      patternProperties:
        "^regulator-":
          properties:
            compatible:
              enum:
                - ti,twl6030-vaux1
                - ti,twl6030-vaux2
                - ti,twl6030-vaux3
                - ti,twl6030-vmmc
                - ti,twl6030-vpp
                - ti,twl6030-vusim
                - ti,twl6030-vana
                - ti,twl6030-vcxio
                - ti,twl6030-vdac
                - ti,twl6030-vusb
                - ti,twl6030-v1v8
                - ti,twl6030-v2v1
                - ti,twl6030-vdd1
                - ti,twl6030-vdd2
                - ti,twl6030-vdd3
            regulator-initial-mode: false

      properties:
        gpadc:
          type: object
          properties:
            compatible:
              const: ti,twl6030-gpadc
  - if:
      properties:
        compatible:
          contains:
            const: ti,twl6032
    then:
      patternProperties:
        "^regulator-":
          properties:
            compatible:
              enum:
                - ti,twl6032-ldo1
                - ti,twl6032-ldo2
                - ti,twl6032-ldo3
                - ti,twl6032-ldo4
                - ti,twl6032-ldo5
                - ti,twl6032-ldo6
                - ti,twl6032-ldo7
                - ti,twl6032-ldoln
                - ti,twl6032-ldousb
                - ti,twl6032-smps3
                - ti,twl6032-smps4
                - ti,twl6032-vio
            regulator-initial-mode: false

      properties:
        gpadc:
          type: object
          properties:
            compatible:
              const: ti,twl6032-gpadc

properties:
  compatible:
    description:
      TWL4030 用于 OMAP3 基于的板载集成电源管理/音频编解码设备
      TWL6030/32 用于 OMAP4 基于的板载集成电源管理
    enum:
      - ti,twl4030
      - ti,twl6030
      - ti,twl6032

  reg:
    maxItems: 1

  interrupts:
    maxItems: 1

  interrupt-controller: true

  system-power-controller: true

  "#interrupt-cells":
    const: 1

  "#clock-cells":
    const: 1

  rtc:
    type: object
    additionalProperties: false
    properties:
      compatible:
        const: ti,twl4030-rtc
      interrupts:
        maxItems: 1

patternProperties:
  "^regulator-":
    type: object
    unevaluatedProperties: false
    $ref: /schemas/regulator/regulator.yaml
    properties:
      compatible: true
      regulator-initial-mode:
        enum:
          - 0x08 # 睡眠模式，保持标称输出电压
                 # 低功耗，低负载电流能力
          - 0x0e # 活动模式，稳压器可以提供其标称输出
                 # 电压具有全负载电流能力
      ti,retain-on-reset:
        description:
          在热重置期间不关闭供电。对于 VMMC 可能需要此设置，
          因为 TWL6030 对该信号的重置序列不符合 SD 规范
type: boolean

unevaluatedProperties: false

required:
  - compatible
  - reg
  - interrupts
  - interrupt-controller
  - "#interrupt-cells"

examples:
  - |
    i2c {
      #address-cells = <1>;
      #size-cells = <0>;

      pmic@48 {
        compatible = "ti,twl6030";
        reg = <0x48>;
        interrupts = <39>; /* IRQ_SYS_1N 级联到 GIC */
        interrupt-parent = <&gic>;
        interrupt-controller;
        #interrupt-cells = <1>;

        gpadc {
          compatible = "ti,twl6030-gpadc";
          interrupts = <6>;
          #io-channel-cells = <1>;
        };

        rtc {
          compatible = "ti,twl4030-rtc";
          interrupts = <8>;
        };

        regulator-vaux1 {
          compatible = "ti,twl6030-vaux1";
          regulator-min-microvolt = <1000000>;
          regulator-max-microvolt = <3000000>;
        };

        regulator-vmmc1 {
          compatible = "ti,twl6030-vmmc";
          ti,retain-on-reset;
        };
      };
    };

  - |
    i2c {
      #address-cells = <1>;
      #size-cells = <0>;

      pmic@48 {
        compatible = "ti,twl4030";
        reg = <0x48>;
        interrupts = <7>; /* SYS_NIRQ 级联到 INTc */
        interrupt-parent = <&intc>;
        interrupt-controller;
        #interrupt-cells = <1>;

        bci {
          compatible = "ti,twl4030-bci";
          interrupts = <9>, <2>;
          bci3v1-supply = <&vusb3v1>;
          io-channels = <&twl_madc 11>;
          io-channel-names = "vac";
        };

        twl_madc: madc {
          compatible = "ti,twl4030-madc";
          interrupts = <3>;
          #io-channel-cells = <1>;
        };

        pwrbutton {
          compatible = "ti,twl4030-pwrbutton";
          interrupts = <8>;
        };

        rtc {
          compatible = "ti,twl4030-rtc";
          interrupts = <11>;
        };

        regulator-vaux1 {
          compatible = "ti,twl4030-vaux1";
          regulator-min-microvolt = <1000000>;
          regulator-max-microvolt = <3000000>;
          regulator-initial-mode = <0xe>;
        };

        vusb3v1: regulator-vusb3v1 {
          compatible = "ti,twl4030-vusb3v1";
        };

        watchdog {
          compatible = "ti,twl4030-wdt";
        };
      };
    };
```

请注意，由于 YAML 的特殊格式和结构，翻译时保留了原始的 YAML 结构，并将必要的描述性文字翻译成了中文。
~~~~
