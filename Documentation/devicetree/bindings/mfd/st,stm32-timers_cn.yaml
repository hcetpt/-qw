## Documentation/devicetree/bindings/mfd/st,stpmic1_cn.yaml
```yaml
下面是给定 YAML 文档的中文翻译：

# SPDX-文件许可人: (GPL-2.0-only 或 BSD-2-Clause)
%YAML 1.2
---
$id: http://devicetree.org/schemas/mfd/st,stpmic1.yaml#
$schema: http://devicetree.org/meta-schemas/core.yaml#

title: 意法半导体 STPMIC1 电源管理 IC

description: 意法半导体 STPMIC1 电源管理 IC

maintainers:
  - pascal Paillet <p.paillet@foss.st.com>

properties:
  compatible:
    const: st,stpmic1

  reg:
    const: 0x33

  interrupts:
    maxItems: 1

  "#interrupt-cells":
    const: 2

  interrupt-controller: true

  onkey:
    type: object

    $ref: /schemas/input/input.yaml

    properties:
      compatible:
        const: st,stpmic1-onkey

      interrupts:
        items:
          - description: 当开机键按下时触发（onkey-falling）。PMIC 的 IT_PONKEY_F。
          - description: 当开机键释放时触发（onkey-rising）。PMIC 的 IT_PONKEY_R。

      interrupt-names:
        items:
          - const: onkey-falling
          - const: onkey-rising

      st,onkey-clear-cc-flag:
        description: 开机键能够在过流关机事件后重新上电
$ref: /schemas/types.yaml#/definitions/flag

      st,onkey-pu-inactive:
        description: 开机键的上拉功能未激活
        $ref: /schemas/types.yaml#/definitions/flag

      power-off-time-sec:
        minimum: 1
        maximum: 16

    required:
      - compatible
      - interrupts
      - interrupt-names

    additionalProperties: false

  watchdog:
    type: object

    $ref: /schemas/watchdog/watchdog.yaml

    properties:
      compatible:
        const: st,stpmic1-wdt

      timeout-sec: true

    required:
      - compatible

    additionalProperties: false

  regulators:
    type: object

    description: |
      在 STPMIC1 设备中可用的稳压器有：
        - buck1 用于 Buck BUCK1
        - buck2 用于 Buck BUCK2
        - buck3 用于 Buck BUCK3
        - buck4 用于 Buck BUCK4
        - ldo1 用于 LDO LDO1
        - ldo2 用于 LDO LDO2
        - ldo3 用于 LDO LDO3
        - ldo4 用于 LDO LDO4
        - ldo5 用于 LDO LDO5
        - ldo6 用于 LDO LDO6
        - vref_ddr 用于 LDO Vref DDR
        - boost 用于 Buck BOOST
        - pwr_sw1 用于 VBUS_OTG 开关
        - pwr_sw2 用于 SW_OUT 开关
      开关是固定电压的稳压器，仅具备启用/禁用功能
properties:
      compatible:
        const: st,stpmic1-regulators

      ldo3:
        $ref: /schemas/regulator/regulator.yaml
        type: object

        properties:
          interrupts:
            maxItems: 1

          st,mask-reset:
            description: 对于此稳压器屏蔽重置，稳压器配置在 PMIC 重置期间保持不变
$ref: /schemas/types.yaml#/definitions/flag

          regulator-name: true
          regulator-boot-on: true
          regulator-always-on: true
          regulator-min-microvolt: true
          regulator-max-microvolt: true
          regulator-allow-bypass: true
          regulator-over-current-protection: true

        additionalProperties: false

      ldo4:
        $ref: /schemas/regulator/regulator.yaml
        type: object

        properties:
          interrupts:
            maxItems: 1

          st,mask-reset:
            description: 对于此稳压器屏蔽重置，稳压器配置在 PMIC 重置期间保持不变
$ref: /schemas/types.yaml#/definitions/flag

          regulator-name: true
          regulator-boot-on: true
          regulator-always-on: true
          regulator-min-microvolt: true
          regulator-max-microvolt: true
          regulator-over-current-protection: true

        additionalProperties: false

      vref_ddr:
        $ref: /schemas/regulator/regulator.yaml
        type: object

        properties:
          interrupts:
            maxItems: 1

          st,mask-reset:
            description: 对于此稳压器屏蔽重置，稳压器配置在 PMIC 重置期间保持不变
$ref: /schemas/types.yaml#/definitions/flag

          regulator-name: true
          regulator-boot-on: true
          regulator-always-on: true

        additionalProperties: false

      boost:
        $ref: /schemas/regulator/regulator.yaml
        type: object

        properties:
          interrupts:
            maxItems: 1

          st,mask-reset:
            description: 对于此稳压器屏蔽重置，稳压器配置在 PMIC 重置期间保持不变
$ref: /schemas/types.yaml#/definitions/flag

          regulator-name: true
          regulator-boot-on: true
          regulator-always-on: true
          regulator-over-current-protection: true

        additionalProperties: false

    patternProperties:
      "^(buck[1-4]|ldo[1-6]|vref_ddr|boost|pwr_sw[1-2])-supply$":
        description: STPMIC1 电压稳压器供电

      "^ldo[1-2,5-6]$":
        $ref: /schemas/regulator/regulator.yaml
        type: object

        properties:
          interrupts:
            maxItems: 1

          st,mask-reset:
            description: 对于此稳压器屏蔽重置，稳压器配置在 PMIC 重置期间保持不变
$ref: /schemas/types.yaml#/definitions/flag

          regulator-name: true
          regulator-boot-on: true
          regulator-always-on: true
          regulator-min-microvolt: true
          regulator-max-microvolt: true
          regulator-over-current-protection: true
          regulator-enable-ramp-delay: true

        additionalProperties: false

      "^buck[1-4]$":
        $ref: /schemas/regulator/regulator.yaml
        type: object

        properties:
          interrupts:
            maxItems: 1

          st,mask-reset:
            description: 对于此稳压器屏蔽重置，稳压器配置在 PMIC 重置期间保持不变
$ref: /schemas/types.yaml#/definitions/flag

          regulator-name: true
          regulator-boot-on: true
          regulator-always-on: true
          regulator-min-microvolt: true
          regulator-max-microvolt: true
          regulator-initial-mode: true
          regulator-pull-down: true
          regulator-over-current-protection: true
          regulator-enable-ramp-delay: true

        additionalProperties: false

      "^pwr_sw[1-2]$":
        $ref: /schemas/regulator/regulator.yaml
        type: object

        properties:
          interrupts:
            maxItems: 1

          regulator-name: true
          regulator-boot-on: true
          regulator-always-on: true
          regulator-over-current-protection: true
          regulator-active-discharge: true

        additionalProperties: false

    required:
      - compatible

    additionalProperties: false

additionalProperties: false

required:
  - compatible
  - reg
  - interrupts
  - "#interrupt-cells"
  - interrupt-controller

examples:
  - |
    #include <dt-bindings/mfd/st,stpmic1.h>
    #include <dt-bindings/interrupt-controller/arm-gic.h>
    i2c {
      #address-cells = <1>;
      #size-cells = <0>;
      pmic@33 {
        compatible = "st,stpmic1";
        reg = <0x33>;
        interrupt-parent = <&gpioa>;
        interrupts = <0 2>;

        interrupt-controller;
        #interrupt-cells = <2>;

        onkey {
          compatible = "st,stpmic1-onkey";
          interrupts = <IT_PONKEY_F 0>,<IT_PONKEY_R 1>;
          interrupt-names = "onkey-falling", "onkey-rising";
          power-off-time-sec = <10>;
        };

        watchdog {
          compatible = "st,stpmic1-wdt";
        };

        regulators {
          compatible = "st,stpmic1-regulators";

          ldo6-supply = <&v3v3>;

          buck1 {
            regulator-name = "vdd_core";
            interrupts = <IT_CURLIM_BUCK1 0>;
            st,mask-reset;
            regulator-boot-on;
            regulator-min-microvolt = <700000>;
            regulator-max-microvolt = <1200000>;
          };

          buck3 {
            regulator-name = "vdd";
            regulator-min-microvolt = <3300000>;
            regulator-max-microvolt = <3300000>;
            regulator-boot-on;
            regulator-pull-down;
          };

          buck4 {
            regulator-name = "v3v3";
            interrupts = <IT_CURLIM_BUCK4 0>;
            regulator-min-microvolt = <3300000>;
            regulator-max-microvolt = <3300000>;
          };

          ldo6 {
            regulator-name = "v1v8";
            regulator-min-microvolt = <1800000>;
            regulator-max-microvolt = <1800000>;
            regulator-over-current-protection;
          };
        };
      };
    };
```
