## Documentation/devicetree/bindings/mfd/tps65910_cn.txt
~~~~
### TPS65910 电源管理集成电路

**所需属性：**
- **compatible（兼容性）:** 必须为 "ti,tps65910" 或 "ti,tps65911"。
- **reg（寄存器）:** I2C 从设备地址。
- **interrupts（中断）:** 控制器的中断输出。
- **#gpio-cells（GPIO单元数）:** 描述一个GPIO所需的单元格数量，应为2。第一个单元格是GPIO编号；第二个单元格用于指定其他选项（当前未使用）。
- **gpio-controller（GPIO控制器）:** 标记该设备为GPIO控制器。
- **#interrupt-cells（中断单元数）:** 描述一个IRQ所需的单元格数量，应为2。第一个单元格是IRQ编号；第二个单元格是标志位，这些标志位编码自 `Documentation/devicetree/bindings/interrupt-controller/interrupts.txt` 中定义的触发掩码。
- **regulators（稳压器）:** 这是一个子节点列表，用于指定所定义稳压器的初始化数据。并非所有给定设备的所有稳压器都需要存在。这些节点的定义遵循在 `Documentation/devicetree/bindings/regulator/regulator.txt` 中找到的标准稳压器绑定。稳压器通过其 `regulator-compatible` 属性进行匹配。有效的 `regulator-compatible` 值如下：
  - 对于 `tps65910`: vrtc, vio, vdd1, vdd2, vdd3, vdig1, vdig2, vpll, vdac, vaux1, vaux2, vaux33, vmmc, vbb
  - 对于 `tps65911`: vrtc, vio, vdd1, vdd2, vddctrl, ldo1, ldo2, ldo3, ldo4, ldo5, ldo6, ldo7, ldo8
- **xxx-supply（输入电压供应稳压器）:** 输入电压供应稳压器。如果启用了设备的稳压器，则需要这些条目。缺少这些属性可能会导致稳压器注册失败。如果某些输入供电通过电池或始终开启的供电，则也需要有这些参数，并且需要提供始终开启电源的适当节点句柄。
TPS65910：
- VCC1供电：VDD1 输入
- VCC2供电：VDD2 输入
- VCC3供电：VAUX33 和 VMMC 输入
- VCC4供电：VAUX1 和 VAUX2 输入
- VCC5供电：VPLL 和 VDAC 输入
- VCC6供电：VDIG1 和 VDIG2 输入
- VCC7供电：VRTC 和 VBB 输入
- VCCIO供电：VIO 输入

TPS65911：
- VCC1供电：VDD1 输入
- VCC2供电：VDD2 输入
以下是提供的内容的中文翻译：

VCC3供电：LDO6、LDO7 和 LDO8 的输入
VCC4供电：LDO5 的输入
VCC5供电：LDO3 和 LDO4 的输入
VCC6供电：LDO1 和 LDO2 的输入
VCC7供电：VRTC 的输入
VCCIO供电：VIO 的输入

可选属性：
- ti,vmbch-threshold: (对于 tps65911) 主电池充电阈值比较器。（参见 TPS65910 数据手册中的 VMBCH_VSEL）
- ti,vmbch2-threshold: (对于 tps65911) 主电池放电阈值比较器。（参见 TPS65910 数据手册中的 VMBCH_VSEL）
- ti,en-ck32k-xtal: 启用外部 32kHz 晶体振荡器（参见 TPS6591X 数据手册中的 CK32K_CTRL）
- ti,en-gpio-sleep: 为 GPIO 启用睡眠控制
  这里应该有 9 个条目，每个 GPIO 一个
- ti,system-power-controller: 指示此电源管理集成电路(PMIC) 是否在控制系统电源
- ti,sleep-enable: 启用 SLEEP 状态
- ti,sleep-keep-therm: 在睡眠状态下保持热监控开启
此段文档描述了一个电源管理单元 (PMU) 的配置，具体是针对 TI TPS65910 芯片的。下面是翻译后的中文版本：

### 睡眠状态保持特性：
- `ti,sleep-keep-ck32k`: 在睡眠状态下保持 32KHz 时钟输出开启。
- `ti,sleep-keep-hsclk`: 在睡眠状态下保持高速内部时钟开启。

### 调压器可选属性：
- `ti,regulator-ext-sleep-control`: 通过外部输入启用外部睡眠控制（0 表示未启用，1 表示 EN1，2 表示 EN2，4 表示 EN3）。如果没有定义该属性，默认值为 0（未启用）。

### 示例：

```plaintext
pmu: tps65910@d2 { // 定义一个名称为 pmu 的电源管理单元实例
    compatible = "ti,tps65910"; // 设备兼容性声明
    reg = <0xd2>; // 设备的寄存器地址
    interrupt-parent = <&intc>; // 中断父设备
    interrupts = < 0 118 0x04 >; // 中断配置

    #gpio-cells = <2>; // GPIO 地址单元数
    gpio-controller; // GPIO 控制器声明

    #interrupt-cells = <2>; // 中断地址单元数
    interrupt-controller; // 中断控制器声明

    ti,system-power-controller; // 系统电源控制器特性声明

    ti,vmbch-threshold = 0; // VMBCH 阈值设置为 0
    ti,vmbch2-threshold = 0; // VMBCH2 阈值设置为 0
    ti,en-ck32k-xtal; // 启用 32KHz 晶体时钟
    ti,en-gpio-sleep = <0 0 1 0 0 0 0 0 0>; // GPIO 睡眠控制

    vcc1-supply = <&reg_parent>; // VCC1 供电源
    vcc2-supply = <&some_reg>; // VCC2 供电源
    vcc3-supply = <...>; // VCC3 供电源
    vcc4-supply = <...>; // VCC4 供电源
    vcc5-supply = <...>; // VCC5 供电源
    vcc6-supply = <...>; // VCC6 供电源
    vcc7-supply = <...>; // VCC7 供电源
    vccio-supply = <...>; // VCCIO 供电源

    regulators { // 调压器子节点
        #address-cells = <1>; // 地址单元数
        #size-cells = <0>; // 大小单元数

        vdd1_reg: regulator@0 { // VDD1 调压器
            regulator-compatible = "vdd1"; // 兼容性声明
            reg = <0>; // 调压器地址
            regulator-min-microvolt = < 600000>; // 最小输出电压（微伏）
            regulator-max-microvolt = <1500000>; // 最大输出电压（微伏）
            regulator-always-on; // 始终开启
            regulator-boot-on; // 开机时开启
            ti,regulator-ext-sleep-control = <0>; // 外部睡眠控制未启用
        };
        vdd2_reg: regulator@1 { // VDD2 调压器
            regulator-compatible = "vdd2";
            reg = <1>;
            regulator-min-microvolt = < 600000>;
            regulator-max-microvolt = <1500000>;
            regulator-always-on;
            regulator-boot-on;
            ti,regulator-ext-sleep-control = <4>; // 通过 EN3 控制
        };
        vddctrl_reg: regulator@2 { // VDDCTRL 调压器
            regulator-compatible = "vddctrl";
            reg = <2>;
            regulator-min-microvolt = < 600000>;
            regulator-max-microvolt = <1400000>;
            regulator-always-on;
            regulator-boot-on;
            ti,regulator-ext-sleep-control = <0>; // 外部睡眠控制未启用
        };
        vio_reg: regulator@3 { // VIO 调压器
            regulator-compatible = "vio";
            reg = <3>;
            regulator-min-microvolt = <1500000>;
            regulator-max-microvolt = <1800000>;
            regulator-always-on;
            regulator-boot-on;
            ti,regulator-ext-sleep-control = <1>; // 通过 EN1 控制
        };
        ldo1_reg: regulator@4 { // LDO1 调压器
            regulator-compatible = "ldo1";
            reg = <4>;
            regulator-min-microvolt = <1000000>;
            regulator-max-microvolt = <3300000>;
            ti,regulator-ext-sleep-control = <0>; // 外部睡眠控制未启用
        };
        ldo2_reg: regulator@5 { // LDO2 调压器
            regulator-compatible = "ldo2";
            reg = <5>;
            regulator-min-microvolt = <1050000>;
            regulator-max-microvolt = <1050000>;
            ti,regulator-ext-sleep-control = <0>; // 外部睡眠控制未启用
        };
        ldo3_reg: regulator@6 { // LDO3 调压器
            regulator-compatible = "ldo3";
            reg = <6>;
            regulator-min-microvolt = <1000000>;
            regulator-max-microvolt = <3300000>;
            ti,regulator-ext-sleep-control = <0>; // 外部睡眠控制未启用
        };
        ldo4_reg: regulator@7 { // LDO4 调压器
            regulator-compatible = "ldo4";
            reg = <7>;
            regulator-min-microvolt = <1000000>;
            regulator-max-microvolt = <3300000>;
            regulator-always-on;
            ti,regulator-ext-sleep-control = <0>; // 外部睡眠控制未启用
        };
        ldo5_reg: regulator@8 { // LDO5 调压器
            regulator-compatible = "ldo5";
            reg = <8>;
            regulator-min-microvolt = <1000000>;
            regulator-max-microvolt = <3300000>;
            ti,regulator-ext-sleep-control = <0>; // 外部睡眠控制未启用
        };
        ldo6_reg: regulator@9 { // LDO6 调压器
            regulator-compatible = "ldo6";
            reg = <9>;
            regulator-min-microvolt = <1200000>;
            regulator-max-microvolt = <1200000>;
            ti,regulator-ext-sleep-control = <0>; // 外部睡眠控制未启用
        };
        ldo7_reg: regulator@10 { // LDO7 调压器
            regulator-compatible = "ldo7";
            reg = <10>;
            regulator-min-microvolt = <1200000>;
            regulator-max-microvolt = <1200000>;
            regulator-always-on;
            regulator-boot-on;
            ti,regulator-ext-sleep-control = <1>; // 通过 EN1 控制
        };
        ldo8_reg: regulator@11 { // LDO8 调压器
            regulator-compatible = "ldo8";
            reg = <11>;
            regulator-min-microvolt = <1000000>;
            regulator-max-microvolt = <3300000>;
            regulator-always-on;
            ti,regulator-ext-sleep-control = <1>; // 通过 EN1 控制
        };
    };
};
```

这段配置详细说明了 TPS65910 电源管理单元中各个调压器的参数和控制方式。
~~~~

## Documentation/devicetree/bindings/mfd/tps65912_cn.txt
~~~~
*TPS65912电源管理集成电路绑定

必需的属性：
- compatible（兼容性）：应为"ti,tps65912"
- reg（寄存器）：从机地址或芯片选择号（I2C / SPI）
- interrupts（中断）：设备连接到的中断线
- interrupt-controller（中断控制器）：标记该设备节点为一个中断控制器
- #interrupt-cells（中断单元数量）：描述一个IRQ所需的单元格数量，应为2
第一个单元格是IRQ编号
第二个单元格是标志，编码为来自../interrupt-controller/interrupts.txt中的触发掩码
- gpio-controller（GPIO控制器）：标记该设备节点为一个GPIO控制器
- #gpio-cells（GPIO单元数量）：应为两个。第一个单元格是引脚编号，
第二个单元格用于指定标志
更多信息请参阅../gpio/gpio.txt
这段英文描述了一个设备树（Device Tree）中的配置示例，主要涉及电源管理集成电路（PMIC）及其相关的电压调节器（regulators）。下面是该段落的中文翻译：

---

**调节器：** 子节点列表，用于指定调节器的初始化数据。子节点必须以其硬件对应部分命名：`dcdc[1-4]` 和 `ldo[1-10]`。每个子节点使用标准的调节器绑定定义。

**示例：**

```plaintext
pmic: tps65912@2d { // PMIC 节点名称为 tps65912@2d
    compatible = "ti,tps65912"; // 兼容性声明
    reg = <0x2d>; // 寄存器地址
    interrupt-parent = <&gpio1>; // 中断父节点
    interrupts = <28 IRQ_TYPE_LEVEL_LOW>; // 中断设置
    interrupt-controller; // 中断控制器声明
    #interrupt-cells = <2>; // 中断单元数量
    gpio-controller; // GPIO 控制器声明
    #gpio-cells = <2>; // GPIO 单元数量

    regulators { // 调节器节点
        dcdc1 { // DCDC1 调节器
            regulator-name = "vdd_core"; // 调节器名称
            regulator-min-microvolt = <912000>; // 最小输出电压 (微伏)
            regulator-max-microvolt = <1144000>; // 最大输出电压 (微伏)
            regulator-boot-on; // 开机时启用
            regulator-always-on; // 始终启用
        };

        ldo1 { // LDO1 调节器
            regulator-name = "ldo1"; // 调节器名称
            regulator-min-microvolt = <1900000>; // 最小输出电压 (微伏)
            regulator-max-microvolt = <1900000>; // 最大输出电压 (微伏)
        };
    };
};
```

---

此示例详细地展示了如何在设备树中配置一个特定型号的电源管理芯片（TPS65912），以及其内部的电压调节器。
~~~~

## Documentation/devicetree/bindings/mfd/twl4030-audio_cn.txt
~~~~
德州仪器TWL系列（twl4030）音频模块

TWL系列中的音频模块包含一个音频编解码器和一个振动驱动程序。
必需属性：
- compatible：必须为"ti,twl4030-audio"

可选属性，节点：

音频功能：
- codec { }: 如果使用音频功能，则需要存在。在该部分中可以使用以下选项：
- ti,digimic_delay: 在启用数字麦克风后所需的延迟，以减少录音样本开头的伪影（毫秒）
- ti,ramp_delay_value: 高速斜坡延迟配置，以降低爆音
- ti,hs_extmute: 使用外部静音来降低高速爆音
- ti,hs_extmute_gpio: 使用外部GPIO来控制外部静音
- ti,offset_cncl_path: 偏移消除路径选择，参阅技术参考手册获取有效值

振动功能
- ti,enable-vibra: 如果使用振动功能，则需要设置为<1>。如果缺失或为0，则禁用振动功能

示例：
``` 
&i2c1 {
    clock-frequency = <2600000>;

    twl: twl@48 {
        reg = <0x48>;
        interrupts = <7>; /* SYS_NIRQ级联到intc */
        interrupt-parent = <&intc>;

        twl_audio: audio {
            compatible = "ti,twl4030-audio";

            ti,enable-vibra = <1>;

            codec {
                ti,ramp_delay_value = <3>;
            };

        };
    };
};
```
~~~~

## Documentation/devicetree/bindings/mfd/twl4030-power_cn.txt
~~~~
德州仪器 TWL 系列（例如 twl4030）中的重置和电源管理模块

TWL 系列内部的电源管理模块提供了多种设施来控制电源资源，包括电源脚本。目前，此绑定仅支持在关机后对系统的完全关闭。
必需属性：
- compatible：必须是以下选项之一
    - "ti,twl4030-power"
    - "ti,twl4030-power-reset"
    - "ti,twl4030-power-idle"
    - "ti,twl4030-power-idle-osc-off"

至少在需要特殊配置才能使热重启生效的 3530 上推荐使用 "ti,twl4030-power-reset"。
当使用 "ti,twl4030-power-idle" 时，TWL4030 PMIC 将加载 TI 推荐的空闲模式配置。
当使用 "ti,twl4030-power-idle-osc-off" 时，将采用 TI 推荐的配置，其中外部振荡器在非空闲状态下被关闭。需要注意的是，并非所有板子都适用此配置，具体取决于外部振荡器的接线方式。
可选属性：

- ti,system-power-controller：表示 TWL4030 是系统的电源供应主控器。设置此标志后，芯片将在系统关机时发起从 ACTIVE 到 OFF 或从 SLEEP 到 OFF 的转换。
- ti,use_poweroff：这是 ti,system-power-controller 的过时名称。

示例：
```yaml
&i2c1 {
    clock-frequency = <2600000>;

    twl: twl@48 {
        reg = <0x48>;
        interrupts = <7>; /* SYS_NIRQ 级联到 intc */
        interrupt-parent = <&intc>;

        twl_power: power {
            compatible = "ti,twl4030-power";
            ti,use_poweroff;
        };
    };
};
```
在这个示例中，我们定义了一个 I2C 总线上的 TWL4030 设备，并指定了其地址、中断等信息。电源管理部分使用了兼容属性 "ti,twl4030-power" 并启用了过时的 "ti,use_poweroff" 标志。
~~~~
