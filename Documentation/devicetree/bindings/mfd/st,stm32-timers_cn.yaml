## Documentation/devicetree/bindings/mfd/st,stm32-timers_cn.yaml
```yaml
下面是给定内容的中文翻译：

# SPDX-许可证标识符: (GPL-2.0-only 或 BSD-2-Clause)
%YAML 1.2
---
$id: http://devicetree.org/schemas/mfd/st,stm32-timers.yaml#
$schema: http://devicetree.org/meta-schemas/core.yaml#

标题: 意法半导体 STM32 定时器

描述: |
  此硬件模块提供了三种类型的定时器以及脉冲宽度调制（PWM）功能：
    - 高级控制定时器由可编程预分频器驱动，具有16位自动重载计数器、断言输入特性、PWM输出和互补PWM输出通道
    - 通用定时器由可编程预分频器驱动，具有16位或32位自动重载计数器和PWM输出
    - 基本定时器由可编程预分频器驱动，具有16位自动重载计数器
维护者:
  - Fabrice Gasnier <fabrice.gasnier@foss.st.com>

属性:
  compatible:
    常量: st,stm32-timers

  reg:
    最大项数: 1

  clocks:
    最大项数: 1

  clock-names:
    项:
      - 常量: int

  resets:
    最大项数: 1

  dmas:
    最小项数: 1
    最大项数: 7

  dma-names:
    项:
      枚举: [ ch1, ch2, ch3, ch4, up, trig, com ]
    最小项数: 1
    最大项数: 7

  interrupts:
    oneOf:
      - 最大项数: 1
      - 最大项数: 4

  interrupt-names:
    oneOf:
      - 项:
          - 常量: global
      - 项:
          - 常量: brk
          - 常量: up
          - 常量: trg-com
          - 常量: cc

  "#address-cells":
    常量: 1

  "#size-cells":
    常量: 0

  access-controllers:
    最小项数: 1
    最大项数: 2

  pwm:
    类型: 对象
    additionalProperties: false

    属性:
      compatible:
        常量: st,stm32-pwm

      "#pwm-cells":
        常量: 3

      st,breakinput:
        描述:
          一个或两个<索引 级别 滤波器>来描述断言输入配置
$ref: /schemas/types.yaml#/definitions/uint32-matrix
        项:
          项:
            - 描述: |
                "索引"表示应将此配置应用于哪个断言输入（0 或 1）
              枚举: [0, 1]
            - 描述: |
                "级别"给出该配置下输入信号的活动级别（0=低电平 或 1=高电平）
              枚举: [0, 1]
            - 描述: |
                "滤波器"给出应用于该配置下的滤波值（最高为15）
              最大值: 15
        最小项数: 1
        最大项数: 2

    必需:
      - "#pwm-cells"
      - compatible

  counter:
    类型: 对象
    additionalProperties: false

    属性:
      compatible:
        常量: st,stm32-timer-counter

    必需:
      - compatible

  patternProperties:
    "^timer@[0-9]+$":
      类型: 对象
      additionalProperties: false

      属性:
        compatible:
          枚举:
            - st,stm32-timer-trigger
            - st,stm32h7-timer-trigger

        reg:
          描述: 标识触发硬件块
          项:
            最小值: 0
            最大值: 16

      必需:
        - compatible
        - reg

必需:
  - compatible
  - reg
  - clocks
  - clock-names

additionalProperties: false

示例:
  - |
    #include <dt-bindings/clock/stm32mp1-clks.h>
    timers2: timer@40000000 {
      #address-cells = <1>;
      #size-cells = <0>;
      compatible = "st,stm32-timers";
      reg = <0x40000000 0x400>;
      clocks = <&rcc TIM2_K>;
      clock-names = "int";
      dmas = <&dmamux1 18 0x400 0x1>,
             <&dmamux1 19 0x400 0x1>,
             <&dmamux1 20 0x400 0x1>,
             <&dmamux1 21 0x400 0x1>,
             <&dmamux1 22 0x400 0x1>;
      dma-names = "ch1", "ch2", "ch3", "ch4", "up";
      pwm {
        compatible = "st,stm32-pwm";
        #pwm-cells = <3>;
        st,breakinput = <0 1 5>;
      };
      timer@1 {
        compatible = "st,stm32-timer-trigger";
        reg = <1>;
      };
      counter {
        compatible = "st,stm32-timer-counter";
      };
    };

..
```

## Documentation/devicetree/bindings/mfd/st,stmfx_cn.yaml
~~~~yaml
下面是给定 YAML 文档的中文翻译：

```
# SPDX 许可标识符: (GPL-2.0-only 或 BSD-2-Clause)
%YAML 1.2
---
$id: http://devicetree.org/schemas/mfd/st,stmfx.yaml#
$schema: http://devicetree.org/meta-schemas/core.yaml#

标题: STMicroelectronics 多功能扩展器 (STMFX)

描述: ST 多功能扩展器 (STMFX) 是一个使用 I2C 与主 MCU 进行通信的从控制器。其主要特性包括 GPIO 扩展、主 MCU IDD 测量（IDD 是流经 VDD 的电流大小）以及电阻式触摸屏控制器。
维护者:
  - Amelie Delaunay <amelie.delaunay@foss.st.com>

属性:
  compatible:
    常量: st,stmfx-0300

  reg:
    枚举: [ 0x42, 0x43 ]

  interrupts:
    最大项目数: 1

  drive-open-drain: 真

  vdd-supply: 真

  pinctrl:
    类型: 对象

    属性:
      compatible:
        常量: st,stmfx-0300-pinctrl

      "#gpio-cells":
        常量: 2

      "#interrupt-cells":
        常量: 2

      gpio-controller: 真

      interrupt-controller: 真

      gpio-ranges:
        描述: 如果所有 STMFX 引脚 [24:0] 都可用（没有其他 STMFX 功能在使用中），你应该使用 gpio-ranges = <&stmfx_pinctrl 0 0 24>; 如果 agpio[3:0] 不可用（STMFX 触摸屏功能在使用中），你应该使用 gpio-ranges = <&stmfx_pinctrl 0 0 16>, <&stmfx_pinctrl 20 20 4>; 如果 agpio[7:4] 不可用（STMFX IDD 功能在使用中），你应该使用 gpio-ranges = <&stmfx_pinctrl 0 0 20>;
        最大项目数: 1

    模式属性:
      "^[a-zA-Z]*-pins$":
        类型: 对象
        其他属性: 假

        全部满足:
          - $引用: /schemas/pinctrl/pinmux-node.yaml

        属性:
          pins: 真
          bias-disable: 真
          bias-pull-up: 真
          bias-pull-pin-default: 真
          bias-pull-down: 真
          drive-open-drain: 真
          drive-push-pull: 真
          output-high: 真
          output-low: 真

    其他属性: 假

    必需:
      - compatible
      - "#gpio-cells"
      - "#interrupt-cells"
      - gpio-controller
      - interrupt-controller
      - gpio-ranges

其他属性: 假

必需:
  - compatible
  - reg
  - interrupts

示例:
  - |
    #include <dt-bindings/interrupt-controller/arm-gic.h>
    i2c {
      #address-cells = <1>;
      #size-cells = <0>;
      stmfx@42 {
        compatible = "st,stmfx-0300";
        reg = <0x42>;
        interrupts = <8 IRQ_TYPE_EDGE_RISING>;
        interrupt-parent = <&gpioi>;
        vdd-supply = <&v3v3>;

        stmfx_pinctrl: pinctrl {
          compatible = "st,stmfx-0300-pinctrl";
          #gpio-cells = <2>;
          #interrupt-cells = <2>;
          gpio-controller;
          interrupt-controller;
          gpio-ranges = <&stmfx_pinctrl 0 0 24>;

          joystick_pins: joystick-pins {
            pins = "gpio0", "gpio1", "gpio2", "gpio3", "gpio4";
            drive-push-pull;
            bias-pull-up;
          };
        };
      };
    };
..
```
~~~~

## Documentation/devicetree/bindings/mfd/st,stmpe_cn.yaml
```yaml
以下是给定 YAML 文档的中文翻译：

# SPDX-许可证标识符: (GPL-2.0-only 或 BSD-2-Clause)
%YAML 1.2
---
$id: http://devicetree.org/schemas/mfd/st,stmpe.yaml#
$schema: http://devicetree.org/meta-schemas/core.yaml#

title: STMicroelectronics 端口扩展器 (STMPE)

description: STMicroelectronics 端口扩展器 (STMPE) 是一系列慢速总线控制器，用于各种扩展外设，例如 GPIO、键盘、触摸屏、ADC、PWM 或旋转编码器。它可以包含一个或多个通过 SPI 或 I2C 连接的不同外设。
maintainers:
  - Linus Walleij <linus.walleij@linaro.org>

allOf:
  - $ref: /schemas/spi/spi-peripheral-props.yaml#

properties:
  compatible:
    enum:
      - st,stmpe601
      - st,stmpe801
      - st,stmpe811
      - st,stmpe1600
      - st,stmpe1601
      - st,stmpe2401
      - st,stmpe2403

  reg:
    maxItems: 1

  interrupts:
    maxItems: 1

  vcc-supply: true

  vio-supply: true

  reset-gpios:
    maxItems: 1

  wakeup-source: true

  st,autosleep-timeout:
    $ref: /schemas/types.yaml#/definitions/uint32
    enum: [ 4, 16, 32, 64, 128, 256, 512, 1024 ]
    description: 在进入自动睡眠以节省电力之前空闲的时间

  st,sample-time:
    $ref: /schemas/types.yaml#/definitions/uint32
    enum: [ 0, 1, 2, 3, 4, 5, 6 ]
    description: |
      每次迭代的采样时间
      0 = 36 时钟周期
      1 = 44 时钟周期
      2 = 56 时钟周期
      3 = 64 时钟周期
      4 = 80 时钟周期 - 推荐
      5 = 96 时钟周期
      6 = 124 时钟周期

  st,mod-12b:
    $ref: /schemas/types.yaml#/definitions/uint32
    enum: [ 0, 1 ]
    description: ADC 位模式 0 = 10位 ADC, 1 = 12位 ADC

  st,ref-sel:
    $ref: /schemas/types.yaml#/definitions/uint32
    enum: [ 0, 1 ]
    description: ADC 参考源 0 = 内部, 1 = 外部

  st,adc-freq:
    $ref: /schemas/types.yaml#/definitions/uint32
    enum: [ 0, 1, 2, 3 ]
    description: |
      ADC 时钟速度
      0 = 1.625 MHz
      1 = 3.25 MHz
      2, 3 = 6.5 MHz

  adc:
    type: object
    $ref: /schemas/iio/adc/st,stmpe-adc.yaml#

  gpio:
    type: object
    $ref: /schemas/gpio/st,stmpe-gpio.yaml#

  keyboard-controller:
    type: object
    $ref: /schemas/input/matrix-keymap.yaml#

    unevaluatedProperties: false

    properties:
      compatible:
        const: st,stmpe-keypad

      debounce-interval:
        description: 消抖间隔（毫秒）
        $ref: /schemas/types.yaml#/definitions/uint32

      st,no-autorepeat:
        description: 如果存在，则按键按下时不会自动重复
        $ref: /schemas/types.yaml#/definitions/flag

      st,scan-count:
        description: 更新键数据前扫描的周期数
        $ref: /schemas/types.yaml#/definitions/uint32

    required:
      - compatible
      - linux,keymap

  pwm:
    type: object
    $ref: /schemas/pwm/pwm.yaml#

    unevaluatedProperties: false

    properties:
      compatible:
        const: st,stmpe-pwm

      "#pwm-cells":
        const: 2

  touchscreen:
    type: object
    $ref: /schemas/input/touchscreen/touchscreen.yaml#

    unevaluatedProperties: false

    properties:
      compatible:
        const: st,stmpe-ts

      st,ave-ctrl:
        $ref: /schemas/types.yaml#/definitions/uint32
        enum: [ 0, 1, 2, 3 ]
        description: |
          采样平均控制
          0 = 1个样本
          1 = 2个样本
          2 = 4个样本
          3 = 8个样本

      st,touch-det-delay:
        $ref: /schemas/types.yaml#/definitions/uint32
        enum: [ 0, 1, 2, 3, 4, 5, 6, 7 ]
        description: |
          触摸检测延迟
          0 = 10 微秒
          1 = 50 微秒
          2 = 100 微秒
          3 = 500 微秒 - 推荐
          4 = 1 毫秒
          5 = 5 毫秒
          6 = 10 毫秒
          7 = 50 毫秒

      st,settling:
        $ref: /schemas/types.yaml#/definitions/uint32
        enum: [ 0, 1, 2, 3, 4, 5, 6, 7 ]
        description: |
          面板驱动器稳定时间
          0 = 10 微秒
          1 = 100 微秒
          2 = 500 微秒 - 推荐
          3 = 1 毫秒
          4 = 5 毫秒
          5 = 10 毫秒
          6 = 50 毫秒
          7 = 100 毫秒

      st,fraction-z:
        $ref: /schemas/types.yaml#/definitions/uint32
        enum: [ 0, 1, 2, 3, 4, 5, 6, 7 ]
        description: Z 值小数部分的长度，推荐值为 7
          (fraction-z ([0..7]) = 小数部分的位数)

      st,i-drive:
        $ref: /schemas/types.yaml#/definitions/uint32
        enum: [ 0, 1 ]
        description: |
          触摸屏驱动器的电流限制值
          0 = 20 毫安 (典型最大 35 毫安)
          1 = 50 毫安 (典型最大 80 毫安)

    required:
      - compatible

additionalProperties: false

required:
  - compatible
  - reg
  - interrupts

examples:
  - |
    #include <dt-bindings/gpio/gpio.h>
    #include <dt-bindings/interrupt-controller/irq.h>
    #include <dt-bindings/input/input.h>
    i2c {
      #address-cells = <1>;
      #size-cells = <0>;

      port-expander@43 {
        compatible = "st,stmpe2401";
        reg = <0x43>;
        reset-gpios = <&gpio 13 GPIO_ACTIVE_LOW>;
        interrupts = <26 IRQ_TYPE_EDGE_FALLING>;
        interrupt-parent = <&gpio>;
        vcc-supply = <&db8500_vsmps2_reg>;
        vio-supply = <&db8500_vsmps2_reg>;
        wakeup-source;
        st,autosleep-timeout = <1024>;

        gpio {
          compatible = "st,stmpe-gpio";
          gpio-controller;
          #gpio-cells = <2>;
          interrupt-controller;
          #interrupt-cells = <2>;
          st,norequest-mask = <0xf0f002>;
        };

        keyboard-controller {
          compatible = "st,stmpe-keypad";
          debounce-interval = <64>;
          st,scan-count = <8>;
          st,no-autorepeat;
          keypad,num-rows = <8>;
          keypad,num-columns = <8>;
          linux,keymap = <
              MATRIX_KEY(0x00, 0x00, KEY_1)
              MATRIX_KEY(0x00, 0x01, KEY_2)
              MATRIX_KEY(0x00, 0x02, KEY_3)
              MATRIX_KEY(0x00, 0x03, KEY_4)
              MATRIX_KEY(0x00, 0x04, KEY_5)
              MATRIX_KEY(0x00, 0x05, KEY_6)
              MATRIX_KEY(0x00, 0x06, KEY_7)
              MATRIX_KEY(0x00, 0x07, KEY_8)
              MATRIX_KEY(0x00, 0x08, KEY_9)
              MATRIX_KEY(0x00, 0x09, KEY_0)
          >;
        };

        pwm {
          compatible = "st,stmpe-pwm";
          #pwm-cells = <2>;
        };
      };

      port-expander@41 {
        compatible = "st,stmpe811";
        reg = <0x41>;
        interrupts = <10 IRQ_TYPE_LEVEL_LOW>;
        interrupt-parent = <&gpio>;
        st,adc-freq = <1>;
        st,mod-12b = <1>;
        st,ref-sel = <0>;
        st,sample-time = <4>;

        adc {
          compatible = "st,stmpe-adc";
          st,norequest-mask = <0x0f>;
          #io-channel-cells = <1>;
        };

        gpio {
          compatible = "st,stmpe-gpio";
          gpio-controller;
          #gpio-cells = <2>;
          interrupt-controller;
          #interrupt-cells = <2>;
        };

        pwm {
          compatible = "st,stmpe-pwm";
          #pwm-cells = <2>;
        };

        touchscreen {
          compatible = "st,stmpe-ts";
          st,ave-ctrl = <3>;
          st,touch-det-delay = <5>;
          st,settling = <3>;
          st,fraction-z = <7>;
          st,i-drive = <1>;
        };
      };
    };
..
```
