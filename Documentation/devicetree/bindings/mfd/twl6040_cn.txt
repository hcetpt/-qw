## Documentation/devicetree/bindings/pci/amlogic,axg-pcie_cn.yaml
~~~~yaml
下面是给定内容的中文翻译：

```yaml
# SPDX-文件许可人: (GPL-2.0-only 或 BSD-2-Clause)
%YAML 1.2
---
$id: http://devicetree.org/schemas/pci/amlogic,axg-pcie.yaml#
$schema: http://devicetree.org/meta-schemas/core.yaml#

title: Amlogic Meson AXG DWC PCIe 系统控制器

maintainers:
  - Neil Armstrong <neil.armstrong@linaro.org>

description:
  Amlogic Meson PCIe 主控制器基于 Synopsys DesignWare PCI 核心
allOf:
  - $ref: /schemas/pci/pci-host-bridge.yaml#
  - $ref: /schemas/pci/snps,dw-pcie-common.yaml#

# 我们需要在这里选择，以避免匹配所有具有 'snps,dw-pcie' 的节点
select:
  properties:
    compatible:
      enum:
        - amlogic,axg-pcie
        - amlogic,g12a-pcie
  required:
    - compatible

properties:
  compatible:
    items:
      - enum:
          - amlogic,axg-pcie
          - amlogic,g12a-pcie
      - const: snps,dw-pcie

  reg:
    items:
      - description: 外部本地总线接口寄存器
      - description: Meson 设计的配置寄存器
      - description: PCIe 配置空间

  reg-names:
    items:
      - const: elbi
      - const: cfg
      - const: config

  interrupts:
    maxItems: 1

  clocks:
    items:
      - description: PCIe GEN 100M PLL 时钟
      - description: PCIe RC 时钟门控
      - description: PCIe PHY 时钟

  clock-names:
    items:
      - const: pclk
      - const: port
      - const: general

  phys:
    maxItems: 1

  phy-names:
    const: pcie

  resets:
    items:
      - description: 端口复位
      - description: 共享 APB 复位

  reset-names:
    items:
      - const: port
      - const: apb

  num-lanes:
    const: 1

  power-domains:
    maxItems: 1

required:
  - compatible
  - reg
  - reg-names
  - interrupts
  - clocks
  - clock-names
  - "#address-cells"
  - "#size-cells"
  - "#interrupt-cells"
  - interrupt-map
  - interrupt-map-mask
  - ranges
  - bus-range
  - device_type
  - num-lanes
  - phys
  - phy-names
  - resets
  - reset-names

unevaluatedProperties: false

examples:
  - |
    #include <dt-bindings/interrupt-controller/irq.h>
    #include <dt-bindings/interrupt-controller/arm-gic.h>
    pcie: pcie@f9800000 {
        compatible = "amlogic,axg-pcie", "snps,dw-pcie";
        reg = <0xf9800000 0x400000>, <0xff646000 0x2000>, <0xf9f00000 0x100000>;
        reg-names = "elbi", "cfg", "config";
        interrupts = <GIC_SPI 177 IRQ_TYPE_EDGE_RISING>;
        clocks = <&pclk>, <&clk_port>, <&clk_phy>;
        clock-names = "pclk", "port", "general";
        resets = <&reset_pcie_port>, <&reset_pcie_apb>;
        reset-names = "port", "apb";
        phys = <&pcie_phy>;
        phy-names = "pcie";
        #interrupt-cells = <1>;
        interrupt-map-mask = <0 0 0 0>;
        interrupt-map = <0 0 0 0 &gic GIC_SPI 179 IRQ_TYPE_EDGE_RISING>;
        bus-range = <0x0 0xff>;
        #address-cells = <3>;
        #size-cells = <2>;
        device_type = "pci";
        num-lanes = <1>;
        ranges = <0x82000000 0 0 0xf9c00000 0 0x00300000>;
    };
..
```
```
~~~~

## Documentation/devicetree/bindings/pci/apple,pcie_cn.yaml
```yaml
# SPDX-许可证标识符: (GPL-2.0-only 或 BSD-2-Clause)
%YAML 1.2
---
$id: http://devicetree.org/schemas/pci/apple,pcie.yaml#
$schema: http://devicetree.org/meta-schemas/core.yaml#

标题: Apple PCIe 主控制器

维护者:
  - Mark Kettenis <kettenis@openbsd.org>

描述: |
  Apple PCIe 主控制器是一种 PCIe 主控制器，具有多个根端口，
  存在于 Apple ARM SoC 平台中，包括各种 iPhone 和 iPad 设备以及“Apple Silicon”Mac。
  控制器集成了 Synopsys DesignWare PCIe 逻辑来实现其根端口。但大多数 DesignWare
  PCIe 主桥接器上发现的 ATU 缺失。
所有根端口共享单一的 ECAM 空间，但是独立的 GPIO 被用于将这些端口上的 PCI 设备
  从复位状态中移除。因此，标准的 "reset-gpios" 和 "max-link-speed" 属性出现在
  表示对应于各个根端口的 PCI 桥接器的子节点上。
MSI 由 PCIe 控制器处理并转换为常规中断。提供了 32 个 MSI 的范围。
  这些 32 个 MSI 可以根据操作系统的需求通过编程 PCIe 控制器的端口寄存器
  分布到根端口。

属性:
  compatible:
    items:
      - 枚举:
          - apple,t8103-pcie
          - apple,t8112-pcie
          - apple,t6000-pcie
      - 常量: apple,pcie

  reg:
    minItems: 3
    maxItems: 6

  reg-names:
    minItems: 3
    items:
      - 常量: config
      - 常量: rc
      - 常量: port0
      - 常量: port1
      - 常量: port2
      - 常量: port3

  ranges:
    minItems: 2
    maxItems: 2

  interrupts:
    描述:
      每个根端口的中断标识符
minItems: 1
    maxItems: 4

  msi-parent: true

  msi-ranges:
    maxItems: 1

  iommu-map: true
  iommu-map-mask: true

  power-domains:
    maxItems: 1

必需:
  - compatible
  - reg
  - reg-names
  - bus-range
  - interrupts
  - msi-controller
  - msi-parent
  - msi-ranges

未评估属性: false

allOf:
  - $ref: /schemas/pci/pci-host-bridge.yaml#
  - $ref: /schemas/interrupt-controller/msi-controller.yaml#
  - 如果:
      属性:
        compatible:
          包含:
            常量: apple,t8103-pcie
    则:
      属性:
        reg:
          maxItems: 5
        interrupts:
          maxItems: 3

示例:
  - |
    #include <dt-bindings/interrupt-controller/apple-aic.h>

    soc {
      #address-cells = <2>;
      #size-cells = <2>;

      pcie0: pcie@690000000 {
        compatible = "apple,t8103-pcie", "apple,pcie";
        device_type = "pci";

        reg = <0x6 0x90000000 0x0 0x1000000>,
              <0x6 0x80000000 0x0 0x100000>,
              <0x6 0x81000000 0x0 0x4000>,
              <0x6 0x82000000 0x0 0x4000>,
              <0x6 0x83000000 0x0 0x4000>;
        reg-names = "config", "rc", "port0", "port1", "port2";

        interrupt-parent = <&aic>;
        interrupts = <AIC_IRQ 695 IRQ_TYPE_LEVEL_HIGH>,
                     <AIC_IRQ 698 IRQ_TYPE_LEVEL_HIGH>,
                     <AIC_IRQ 701 IRQ_TYPE_LEVEL_HIGH>;

        msi-controller;
        msi-parent = <&pcie0>;
        msi-ranges = <&aic AIC_IRQ 704 IRQ_TYPE_EDGE_RISING 32>;

        iommu-map = <0x100 &dart0 1 1>,
                    <0x200 &dart1 1 1>,
                    <0x300 &dart2 1 1>;
        iommu-map-mask = <0xff00>;

        bus-range = <0 3>;
        #address-cells = <3>;
        #size-cells = <2>;
        ranges = <0x43000000 0x6 0xa0000000 0x6 0xa0000000 0x0 0x20000000>,
                 <0x02000000 0x0 0xc0000000 0x6 0xc0000000 0x0 0x40000000>;

        power-domains = <&ps_apcie_gp>;
        pinctrl-0 = <&pcie_pins>;
        pinctrl-names = "default";

        pci@0,0 {
          device_type = "pci";
          reg = <0x0 0x0 0x0 0x0 0x0>;
          reset-gpios = <&pinctrl_ap 152 0>;

          #address-cells = <3>;
          #size-cells = <2>;
          ranges;
        };

        pci@1,0 {
          device_type = "pci";
          reg = <0x800 0x0 0x0 0x0 0x0>;
          reset-gpios = <&pinctrl_ap 153 0>;

          #address-cells = <3>;
          #size-cells = <2>;
          ranges;
        };

        pci@2,0 {
          device_type = "pci";
          reg = <0x1000 0x0 0x0 0x0 0x0>;
          reset-gpios = <&pinctrl_ap 33 0>;

          #address-cells = <3>;
          #size-cells = <2>;
          ranges;
        };
      };
    };
```

## Documentation/devicetree/bindings/pci/axis,artpec6-pcie_cn.txt
~~~~
* Axis ARTPEC-6 PCIe接口

此PCIe主机控制器基于Synopsys DesignWare PCIe IP，因此继承了在`snps,dw-pcie.yaml`中定义的所有通用属性。
必需的属性：
- `compatible`: "axis,artpec6-pcie", "snps,dw-pcie" 对于ARTPEC-6处于根复合体(RC)模式；"axis,artpec6-pcie-ep", "snps,dw-pcie" 对于ARTPEC-6处于端点(EP)模式；"axis,artpec7-pcie", "snps,dw-pcie" 对于ARTPEC-7处于RC模式；"axis,artpec7-pcie-ep", "snps,dw-pcie" 对于ARTPEC-7处于EP模式；
- `reg`: PCIe控制器（DBI）、PHY控制器以及配置地址空间的基础地址和长度
- `reg-names`: 必须包含以下条目：
    - "dbi"
    - "phy"
    - "config"
- `interrupts`: 控制器中断输出的列表。必须为`interrupt-names`属性中的每个条目包含一个条目
- `interrupt-names`: 必须包含以下条目：
    - "msi": 当接收到MSI时断言的中断
- `axis,syscon-pcie`: 指向ARTPEC-6系统控制器的phandle，用于启用和控制Synopsys IP
示例：

```yaml
pcie@f8050000 {
    compatible = "axis,artpec6-pcie", "snps,dw-pcie";
    reg = <0xf8050000 0x2000
           0xf8040000 0x1000
           0xc0000000 0x2000>;
    reg-names = "dbi", "phy", "config";
    #address-cells = <3>;
    #size-cells = <2>;
    device_type = "pci";
          /* 下游 I/O */
    ranges = <0x81000000 0 0 0xc0002000 0 0x00010000
              /* 非预取内存 */
              0x82000000 0 0xc0012000 0xc0012000 0 0x1ffee000>;
    num-lanes = <2>;
    bus-range = <0x00 0xff>;
    interrupts = <GIC_SPI 148 IRQ_TYPE_LEVEL_HIGH>;
    interrupt-names = "msi";
    #interrupt-cells = <1>;
    interrupt-map-mask = <0 0 0 0x7>;
    interrupt-map = <0 0 0 1 &intc GIC_SPI 144 IRQ_TYPE_LEVEL_HIGH>,
                    <0 0 0 2 &intc GIC_SPI 145 IRQ_TYPE_LEVEL_HIGH>,
                    <0 0 0 3 &intc GIC_SPI 146 IRQ_TYPE_LEVEL_HIGH>,
                    <0 0 0 4 &intc GIC_SPI 147 IRQ_TYPE_LEVEL_HIGH>;
    axis,syscon-pcie = <&syscon>;
};
```
以上配置描述了一个ARTPEC-6 PCIe接口的设备树片段，包括兼容性声明、寄存器配置、中断配置等。
~~~~

## Documentation/devicetree/bindings/pci/baikal,bt1-pcie_cn.yaml
```yaml
下面是给定内容的中文翻译：

# SPDX-许可证标识符: (GPL-2.0-only 或 BSD-2-Clause)
%YAML 1.2
---
$id: http://devicetree.org/schemas/pci/baikal,bt1-pcie.yaml#
$schema: http://devicetree.org/meta-schemas/core.yaml#

标题: Baikal-T1 PCIe 根端口控制器

维护者:
  - Serge Semin <fancer.lancer@gmail.com>

描述:
  集成在Baikal-T1 SoC根复合体控制器中的单端口激活控制器。它基于DWC RC PCIe v4.60a IP内核，配置为仅有一个根端口功能，并且能够在x4通道上建立高达Gen.3的速度链接。它没有内置时钟和复位控制模块，因此需要软件来正确初始化接口。有四个输入和四个输出的iATU区域，可以在PCIe总线上发送所有必需的TLP类型。
allOf:
  - $ref: /schemas/pci/snps,dw-pcie.yaml#

属性:
  compatible:
    常量: baikal,bt1-pcie

  reg:
    描述:
      DBI、DBI2以及至少4KB的输出iATU能力区域用于外围设备的配置空间访问
maxItems: 3

  reg-names:
    项目:
      - 常量: dbi
      - 常量: dbi2
      - 常量: config

  interrupts:
    描述:
      提供MSI、AER、PME、热插拔、链路带宽管理、链路均衡请求和八个读/写eDMA中断线
maxItems: 14

  interrupt-names:
    项目:
      - 常量: dma0
      - 常量: dma1
      - 常量: dma2
      - 常量: dma3
      - 常量: dma4
      - 常量: dma5
      - 常量: dma6
      - 常量: dma7
      - 常量: msi
      - 常量: aer
      - 常量: pme
      - 常量: hp
      - 常量: bw_mg
      - 常量: l_eq

  clocks:
    描述:
      DBI（连接到APB总线）、AXI总线主控器和从机接口由专用的应用时钟供电。一个通用参考时钟信号应连接到SoC相应的Ref-pad上，然后该时钟信号将在控制器核心子模块之间重新分配（如pipe、core、aux等）
maxItems: 4

  clock-names:
    项目:
      - 常量: dbi
      - 常量: mstr
      - 常量: slv
      - 常量: ref

  resets:
    描述:
      控制器的综合复位逻辑应通过软件实现，因此几乎所有可能的应用程序和核心复位信号都通过系统CCU模块暴露出来
maxItems: 9

  reset-names:
    项目:
      - 常量: mstr
      - 常量: slv
      - 常量: pwr
      - 常量: hot
      - 常量: phy
      - 常量: core
      - 常量: pipe
      - 常量: sticky
      - 常量: non-sticky

  baikal,bt1-syscon:
    $ref: /schemas/types.yaml#/definitions/phandle
    描述:
      指向Baikal-T1系统控制器DT节点的句柄。需要它来访问一些额外的PM、复位相关和LTSSM信号
num-lanes:
    最大值: 4

  max-link-speed:
    最大值: 3

必需:
  - compatible
  - reg
  - reg-names
  - interrupts
  - interrupt-names

未评估的属性: false

示例:
  - |
    #include <dt-bindings/interrupt-controller/mips-gic.h>
    #include <dt-bindings/gpio/gpio.h>

    pcie@1f052000 {
      compatible = "baikal,bt1-pcie";
      device_type = "pci";
      reg = <0x1f052000 0x1000>, <0x1f053000 0x1000>, <0x1bdbf000 0x1000>;
      reg-names = "dbi", "dbi2", "config";
      #address-cells = <3>;
      #size-cells = <2>;
      ranges = <0x81000000 0 0x00000000 0x1bdb0000 0 0x00008000>,
               <0x82000000 0 0x20000000 0x08000000 0 0x13db0000>;
      bus-range = <0x0 0xff>;

      interrupts = <GIC_SHARED 80 IRQ_TYPE_LEVEL_HIGH>,
                   <GIC_SHARED 81 IRQ_TYPE_LEVEL_HIGH>,
                   <GIC_SHARED 82 IRQ_TYPE_LEVEL_HIGH>,
                   <GIC_SHARED 83 IRQ_TYPE_LEVEL_HIGH>,
                   <GIC_SHARED 84 IRQ_TYPE_LEVEL_HIGH>,
                   <GIC_SHARED 85 IRQ_TYPE_LEVEL_HIGH>,
                   <GIC_SHARED 86 IRQ_TYPE_LEVEL_HIGH>,
                   <GIC_SHARED 87 IRQ_TYPE_LEVEL_HIGH>,
                   <GIC_SHARED 88 IRQ_TYPE_LEVEL_HIGH>,
                   <GIC_SHARED 89 IRQ_TYPE_LEVEL_HIGH>,
                   <GIC_SHARED 90 IRQ_TYPE_LEVEL_HIGH>,
                   <GIC_SHARED 91 IRQ_TYPE_LEVEL_HIGH>,
                   <GIC_SHARED 92 IRQ_TYPE_LEVEL_HIGH>,
                   <GIC_SHARED 93 IRQ_TYPE_LEVEL_HIGH>;
      interrupt-names = "dma0", "dma1", "dma2", "dma3",
                        "dma4", "dma5", "dma6", "dma7",
                        "msi", "aer", "pme", "hp", "bw_mg",
                        "l_eq";

      clocks = <&ccu_sys 1>, <&ccu_axi 6>, <&ccu_axi 7>, <&clk_pcie>;
      clock-names = "dbi", "mstr", "slv", "ref";

      resets = <&ccu_axi 6>, <&ccu_axi 7>, <&ccu_sys 7>, <&ccu_sys 10>,
               <&ccu_sys 4>, <&ccu_sys 6>, <&ccu_sys 5>, <&ccu_sys 8>,
               <&ccu_sys 9>;
      reset-names = "mstr", "slv", "pwr", "hot", "phy", "core", "pipe",
                    "sticky", "non-sticky";

      reset-gpios = <&port0 0 GPIO_ACTIVE_LOW>;

      num-lanes = <4>;
      max-link-speed = <3>;
    };
```
