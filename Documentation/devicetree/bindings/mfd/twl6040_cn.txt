## Documentation/devicetree/bindings/mfd/twl6040_cn.txt
~~~~
### Texas Instruments TWL6040 系列

TWL6040 是一款 8 通道、高质量、低功耗音频编解码器，在 OMAP4+ 平台上提供音频、振动和通用输出 (GPO) 功能。
它们通过 I²C 接口与主处理器进行命令通信，通过 McPDM 接口传输音频数据和命令。

**必需属性:**
- `compatible`: 对于 TWL6040 应为 `"ti,twl6040"`，对于 TWL6041 应为 `"ti,twl6041"`
- `reg`: 必须设置为 `0x4b` 作为 I²C 地址
- `interrupts`: TWL6040 拥有一条中断线连接到主系统芯片 (SoC)
- `gpio-controller`:
  - `#gpio-cells = <1>`: TWL6040 提供 GPO 线路
- `#clock-cells = <0>`; TWL6040 是 PDMCLK 的提供者，该时钟被 McPDM 使用
- `twl6040,audpwron-gpio`: 用于 TWL6040 的电源开启 GPIO 线路
- `vio-supply`: TWL6040 VIO 电源的调节器
- `v2v1-supply`: TWL6040 V2V1 电源的调节器

**可选属性:**
- `enable-active-high`: 在启动过程中开启 TWL6040
- `clocks`: 针对 32K 时钟和/或 MCLK 时钟提供者的句柄
- `clock-names`: 必须是 `"clk32k"` 对于 32K 时钟 和 `"mclk"` 对于 MCLK 时钟

**振动功能**
**必需属性:**
- `vddvibl-supply`: 左侧振动电机的调节器
- `vddvibr-supply`: 右侧振动电机的调节器
- `vibra { }`: 包含以下属性的振动参数配置部分：
  - `ti,vibldrv-res`: 左侧驱动电阻参数
  - `ti,vibrdrv-res`: 右侧驱动电阻参数
  - `ti,viblmotor-res`: 左侧电机电阻参数
  - `ti,vibrmotor-res`: 右侧电机电阻参数

**在 `vibra { }` 部分中的可选属性:**
- `vddvibl_uV`: 如果需要改变 `vddvibl` 默认电压
- `vddvibr_uV`: 如果需要改变 `vddvibr` 默认电压

**示例:**
```device-tree
&i2c1 {
	twl6040: twl@4b {
		compatible = "ti,twl6040";

		interrupts = <0 119 4>;
		interrupt-parent = <&gic>;
		twl6040,audpwron-gpio = <&gpio4 31 0>;

		vio-supply = <&v1v8>;
		v2v1-supply = <&v2v1>;
		enable-active-high;

		/* regulators for vibra motor */
		vddvibl-supply = <&vbat>;
		vddvibr-supply = <&vbat>;

		vibra {
			/* Vibra driver, motor resistance parameters */
			ti,vibldrv-res = <8>;
			ti,vibrdrv-res = <3>;
			ti,viblmotor-res = <10>;
			ti,vibrmotor-res = <10>;
		};
	};
};
```

**包含:** "twl6040.dtsi"
~~~~

## Documentation/devicetree/bindings/mfd/wlf,arizona_cn.yaml
~~~~yaml
```yaml
# SPDX-License-Identifier: GPL-2.0-only OR BSD-2-Clause
%YAML 1.2
---
$id: 'http://devicetree.org/schemas/mfd/wlf,arizona.yaml'
$schema: 'http://devicetree.org/meta-schemas/core.yaml'

title: Cirrus Logic/Wolfson Microelectronics Arizona 类音频系统级芯片

maintainers:
  - patches@opensource.cirrus.com

description: |
  这些设备是具备广泛的数字功能和一系列模拟输入输出的音频系统级芯片。

allOf:
  - $ref: '/schemas/spi/spi-peripheral-props.yaml'
  - $ref: '/schemas/sound/wlf,arizona.yaml'
  - $ref: '/schemas/regulator/wlf,arizona.yaml'
  - $ref: '/schemas/extcon/wlf,arizona.yaml'
  - if:
      properties:
        compatible:
          contains:
            enum:
              - cirrus,cs47l24
              - wlf,wm1831
    then:
      required:
        - DCVDD-supply
        - MICVDD-supply
    else:
      properties:
        LDOVDD-supply:
          description:
            数字电源供应，当内部供电时用于内部生成 DCVDD
  - if:
      properties:
        compatible:
          contains:
            enum:
              - wlf,wm1814
              - wlf,wm5102
              - wlf,wm5110
              - wlf,wm8280
              - wlf,wm8997
              - wlf,wm8998
    then:
      properties:
        DBVDD2-supply:
          description:
            数据总线电源供应
      required:
        - DBVDD2-supply
  - if:
      properties:
        compatible:
          contains:
            enum:
              - wlf,wm1814
              - wlf,wm5102
              - wlf,wm5110
              - wlf,wm8280
              - wlf,wm8998
    then:
      properties:
        DBVDD3-supply:
          description:
            数据总线电源供应
      required:
        - DBVDD3-supply
  - if:
      properties:
        compatible:
          contains:
            enum:
              - cirrus,cs47l24
              - wlf,wm1831
              - wlf,wm8997
    then:
      properties:
        SPKVDD-supply:
          description:
            单声道扬声器驱动电源供应
      required:
        - SPKVDD-supply
    else:
      properties:
        SPKVDDL-supply:
          description:
            左侧扬声器驱动电源供应
        SPKVDDR-supply:
          description:
            右侧扬声器驱动电源供应
      required:
        - SPKVDDL-supply
        - SPKVDDR-supply

properties:
  compatible:
    enum:
      - cirrus,cs47l24
      - wlf,wm1814
      - wlf,wm1831
      - wlf,wm5102
      - wlf,wm5110
      - wlf,wm8280
      - wlf,wm8997
      - wlf,wm8998

  reg:
    maxItems: 1

  AVDD-supply:
    description:
      模拟电源供应
  CPVDD-supply:
    description:
      充电泵电源供应
  DBVDD1-supply:
    description:
      数据总线电源供应
```
The provided text describes device tree bindings for an audio codec, specifically focusing on power supplies, GPIO controllers, interrupt controllers, and other configurations. Here's the translation into Chinese:

### DCVDD-Power Supply:
- **Description:**
  - 数字电源供应，通常内部提供，除了在cs47l24和wm1831上是必需的。

### MICVDD-Power Supply:
- **Description:**
  - 麦克风电源供应，通常内部提供，除了在cs47l24和wm1831上是必需的。

### GPIO Controller:
- **Value:** `true`

### `#gpio-cells`:
- **Description:**
  - 第一个单元格是引脚编号，第二个单元格用于指定可选参数。
- **Constant:** `2`

### `wlf,gpio-defaults`:
- **Description:**
  - GPIO配置寄存器值列表。适用于这些值的定义可以在dt-bindings/mfd/arizona.h中找到。如果未设置，则不会对这些寄存器进行配置。如果任何条目的值超出16位寄存器的范围，则将使用芯片默认值。如果存在，则必须指定恰好五个值。
- **Reference:** `/schemas/types.yaml#/definitions/uint32-array`
  - 最少项目数: `1`
  - 最大项目数: `5`

### Interrupt Controller:
- **Value:** `true`

### `#interrupt-cells`:
- **Description:**
  - 第一个单元格是IRQ编号。第二个单元格是标志，编码为触发掩码。
- **Constant:** `2`

### `interrupts`:
- **Maximum Items:** `1`

### `clocks`:
- **Description:**
  - 应引用MCLK1和MCLK2上的时钟。
- **Minimum Items:** `1`
  - 最大项目数: `2`

### `clock-names`:
- **Description:**
  - 应包含两个字符串：mclk1表示MCLK1上的时钟，建议使用高质量音频参考时钟；mclk2表示MCLK2上的时钟，建议使用始终开启的32kHz时钟。
- **One Of:**
  - 项:
    - 常量: `mclk1`
  - 项:
    - 常量: `mclk2`
  - 项:
    - 常量: `mclk1`
    - 常量: `mclk2`

### `reset-gpios`:
- **Maximum Items:** `1`

### `wlf,reset`:
- **Description:**
  - 指定控制RESET的GPIO
- **Deprecated:** `true`
- **Reference:** `/schemas/types.yaml#/definitions/phandle-array`
  - 最大项目数: `1`

### Required Properties:
- `compatible`
- `AVDD-supply`
- `CPVDD-supply`
- `DBVDD1-supply`
- `gpio-controller`
- `#gpio-cells`
- `interrupt-controller`
- `#interrupt-cells`
- `interrupts`

### Unevaluated Properties:
- `false`

### Examples:
#### Example Configuration:
```yaml
#include <dt-bindings/mfd/arizona.h>
i2c@e0004000 {
    #address-cells = <1>;
    #size-cells = <0>;
    reg = <0xe0004000 0x1000>;

    wm5102: codec@1a {
        compatible = "wlf,wm5102";
        reg = <0x1a>;

        reset-gpios = <&gpio 0>;
        wlf,ldoena = <&gpio 1>;

        AVDD-supply = <&vdd1v8>;
        DBVDD1-supply = <&vdd1v8>;
        DBVDD2-supply = <&vdd1v8>;
        DBVDD3-supply = <&vdd1v8>;
        CPVDD-supply = <&vdd1v8>;
        LDOVDD-supply = <&vdd1v8>;
        SPKVDDL-supply = <&vdd5v>;
        SPKVDDR-supply = <&vdd5v>;

        interrupts = <347>;
        interrupt-controller;
        #interrupt-cells = <2>;
        interrupt-parent = <&gic>;

        gpio-controller;
        #gpio-cells = <2>;

        #sound-dai-cells = <1>;

        wlf,gpio-defaults = <
            ARIZONA_GP_FN_TXLRCLK
            ARIZONA_GP_DEFAULT
            ARIZONA_GP_DEFAULT
            ARIZONA_GP_DEFAULT
            ARIZONA_GP_DEFAULT
        >;

        clocks = <&clks 0>, <&clks 1>;
        clock-names = "mclk1", "mclk2";

        wlf,inmode = <ARIZONA_INMODE_DIFF ARIZONA_INMODE_DMIC>;
        wlf,dmic-ref = <ARIZONA_DMIC_MICBIAS1 ARIZONA_DMIC_MICBIAS3>;

        wlf,use-jd2;
        wlf,use-jd2-nopull;
        wlf,jd-invert;

        wlf,micd-software-compare;
        wlf,micd-detect-debounce = <0>;
        wlf,micd-pol-gpio = <&codec 2 0>;
        wlf,micd-rate = <ARIZONA_MICD_TIME_8MS>;
        wlf,micd-dbtime = <4>;
        wlf,micd-timeout-ms = <100>;
        wlf,micd-force-micbias;
        wlf,micd-configs = <0 ARIZONA_DMIC_MICBIAS1 0>,
                           <0x2000 ARIZONA_DMIC_MICBIAS2 1>;

        wlf,gpsw = <ARIZONA_GPSW_OPEN>;
    };
};
```

This example shows a configuration for the `wm5102` codec with specific settings for power supplies, GPIOs, interrupts, clocks, and more.
~~~~

## Documentation/devicetree/bindings/mfd/wm831x_cn.txt
~~~~
Cirrus Logic/Wolfson Microelectronics wm831x PMICs（电源管理集成电路）

具有广泛额外特性的系统PMICs
所需属性：

- compatible（兼容性）：以下芯片特定字符串之一：
        "wlf,wm8310"
        "wlf,wm8311"
        "wlf,wm8312"
        "wlf,wm8320"
        "wlf,wm8321"
        "wlf,wm8325"
        "wlf,wm8326"
- reg（寄存器）：使用I2C连接时的I2C从机地址，使用SPI时的片选号
- gpio-controller（GPIO控制器）：指示此设备是一个GPIO控制器
- #gpio-cells（GPIO单元数）：必须是2。第一个单元是引脚编号，第二个单元用于指定可选参数（当前未使用）
- interrupts（中断）：设备的IRQ信号所连接到的中断线
- interrupt-controller（中断控制器）：wm831x设备包含中断控制器，并且可以为其他设备提供中断服务
- #interrupt-cells（中断单元数）：必须是2。第一个单元是IRQ编号，第二个单元是标志，编码为来自../interrupt-controller/interrupts.txt中的触发掩码

可选子节点：
  - phys（物理层）：包含对USB PHY的phandle（伪硬件句柄）
- regulators（稳压器）：对于由设备提供的每个稳压器包含子节点。这些稳压器根据下面列出的名称进行绑定：

    dcdc1 : DCDC1
    dcdc2 : DCDC2
    dcdc3 : DCDC3
    dcdc4 : DCDC3
    isink1 : ISINK1
    isink2 : ISINK2
    ldo1 : LDO1
    ldo2 : LDO2
    ldo3 : LDO3
    ldo4 : LDO4
    ldo5 : LDO5
    ldo7 : LDO7
    ldo11 : LDO11

    每个稳压器的详细绑定信息可以在以下位置找到：
    ../regulator/regulator.txt

示例：

```plaintext
wm8310: pmic@36 { // 设备名为wm8310，在I2C总线上地址为0x36
	compatible = "wlf,wm8310"; // 兼容wm8310芯片
	reg = <0x36>; // I2C地址为0x36

	gpio-controller; // 表明该设备为GPIO控制器
	#gpio-cells = <2>; // GPIO单元数为2

	interrupts = <347>; // 中断线为347
	interrupt-parent = <&gic>; // 中断父节点为gic

	interrupt-controller; // 表明该设备内含中断控制器
	#interrupt-cells = <2>; // 中断单元数为2

	regulators { // 稳压器子节点
		dcdc1: dcdc1 { // DCDC1稳压器
			regulator-name = "DCDC1"; // 稳压器名称
			regulator-min-microvolt = <600000>; // 最小输出电压（微伏）
			regulator-max-microvolt = <600000>; // 最大输出电压（微伏）
		};
		ldo1: ldo1 { // LDO1稳压器
			regulator-name = "LDO1"; // 稳压器名称
			regulator-min-microvolt = <1700000>; // 最小输出电压（微伏）
			regulator-max-microvolt = <1700000>; // 最大输出电压（微伏）
		};
	};
};
```
~~~~

## Documentation/devicetree/bindings/mfd/x-powers,ac100_cn.yaml
~~~~yaml
下面是给定 YAML 文档的中文翻译：

```yaml
# SPDX-许可证标识符: GPL-2.0
%YAML 1.2
---
$id: http://devicetree.org/schemas/mfd/x-powers,ac100.yaml#
$schema: http://devicetree.org/meta-schemas/core.yaml#

标题: X-Powers AC100

维护者:
  - 陈宇蔡 <wens@csie.org>

属性:
  compatible:
    常量: x-powers,ac100

  reg:
    最大项数: 1

  codec:
    类型: 对象

    属性:
      "#clock-cells":
        常量: 0

      compatible:
        常量: x-powers,ac100-codec

      interrupts:
        最大项数: 1

      clock-output-names:
        最大项数: 1
        描述: >
          由 codec 暴露的 4M_adda 时钟名称

    必需:
      - "#clock-cells"
      - compatible
      - interrupts
      - clock-output-names

    额外属性: false

  rtc:
    类型: 对象

    属性:
      "#clock-cells":
        常量: 1

      compatible:
        常量: x-powers,ac100-rtc

      interrupts:
        最大项数: 1

      clocks:
        最大项数: 1
        描述: >
           指向 codec 的 "4M_adda" 时钟的 phandle

      clock-output-names:
        最大项数: 3
        描述: >
          由 codec 暴露的 cko1, cko2 和 cko3 时钟名称

    必需:
      - "#clock-cells"
      - compatible
      - interrupts
      - clocks
      - clock-output-names

    额外属性: false

必需:
  - compatible
  - reg
  - codec
  - rtc

额外属性: false

示例:
  - |
    #include <dt-bindings/interrupt-controller/irq.h>

    rsb {
        #address-cells = <1>;
        #size-cells = <0>;

        codec@e89 {
            compatible = "x-powers,ac100";
            reg = <0xe89>;

            ac100_codec: codec {
                compatible = "x-powers,ac100-codec";
                interrupt-parent = <&r_pio>;
                interrupts = <0 9 IRQ_TYPE_LEVEL_LOW>; /* PL9 */
                #clock-cells = <0>;
                clock-output-names = "4M_adda";
            };

            ac100_rtc: rtc {
                compatible = "x-powers,ac100-rtc";
                interrupt-parent = <&nmi_intc>;
                interrupts = <0 IRQ_TYPE_LEVEL_LOW>;
                clocks = <&ac100_codec>;
                #clock-cells = <1>;
                clock-output-names = "cko1_rtc", "cko2_rtc", "cko3_rtc";
            };
        };
    };

..
```

请注意，由于 YAML 是一种数据格式，并非所有的内容都可以直接翻译为中文，比如注释、变量名等通常保持原样。上述翻译尽可能地将描述性文本转换成了中文。
~~~~
