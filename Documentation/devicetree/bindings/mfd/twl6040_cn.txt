## Documentation/devicetree/bindings/pci/brcm,iproc-pcie_cn.yaml
```yaml
以下是提供的 YAML 文档的中文翻译：

# SPDX 许可证标识符: (GPL-2.0-only 或 BSD-2-Clause)
%YAML 1.2
---
$id: http://devicetree.org/schemas/pci/brcm,iproc-pcie.yaml#
$schema: http://devicetree.org/meta-schemas/core.yaml#

标题: Broadcom iProc PCIe 控制器，带有平台总线接口

维护者:
  - Ray Jui <ray.jui@broadcom.com>
  - Scott Branden <scott.branden@broadcom.com>

allOf:
  - $ref: /schemas/pci/pci-host-bridge.yaml#

属性:
  compatible:
    items:
      - 枚举:
          # 第一代基于 PAXB 的控制器，用于包括 NSP、Cygnus、NS2 和 Pegasus 在内的 SoC
          - brcm,iproc-pcie
          # 第二代基于 PAXB 的控制器，用于 Stingray
          - brcm,iproc-pcie-paxb-v2
          # 第一代基于 PAXC 的控制器，用于 NS2
          - brcm,iproc-pcie-paxc
          # 第二代基于 PAXC 的控制器，用于 Stingray
          - brcm,iproc-pcie-paxc-v2

  reg:
    maxItems: 1
    描述: >
       PCIe 控制器 I/O 寄存器空间的基地址和长度

  ranges:
    minItems: 1
    maxItems: 2
    描述: >
      PCI 内存和 I/O 区域的范围

  phys:
    maxItems: 1

  phy-names:
    items:
      - 常量: pcie-phy

  dma-coherent: true

  brcm,pcie-ob:
    类型: 布尔
    描述: >
      某些 iProc SoC 在复位后没有由 ASIC 完成出站地址映射。在这种情况下，软件需要配置它

  brcm,pcie-ob-axi-offset:
    $ref: /schemas/types.yaml#/definitions/uint32
    描述: >
       从 AXI 地址到 iProc PCIe 核心（而非 PCIe 地址）使用的内部地址的偏移量

  msi:
    类型: 对象
    $ref: /schemas/interrupt-controller/msi-controller.yaml#
    unevaluatedProperties: false

    属性:
      compatible:
        items:
          - 常量: brcm,iproc-msi

      interrupts:
        maxItems: 4

      brcm,pcie-msi-inten:
        类型: 布尔
        描述:
          需要在一些较旧的 iProc 平台上存在，这些平台需要显式设置中断使能寄存器来启用 MSI

  msi-parent: true

依赖关系:
  brcm,pcie-ob-axi-offset: ["brcm,pcie-ob"]
  brcm,pcie-msi-inten: [msi-controller]

必需项:
  - compatible
  - reg
  - ranges

如果:
  属性:
    compatible:
      包含:
        枚举:
          - brcm,iproc-pcie
那么:
  必需项:
    - interrupt-map
    - interrupt-map-mask

unevaluatedProperties: false

示例:
  - |
    #include <dt-bindings/interrupt-controller/arm-gic.h>

    gic: interrupt-controller {
        interrupt-controller;
        #interrupt-cells = <3>;
    };

    pcie@18012000 {
        compatible = "brcm,iproc-pcie";
        reg = <0x18012000 0x1000>;

        #interrupt-cells = <1>;
        interrupt-map-mask = <0 0 0 0>;
        interrupt-map = <0 0 0 0 &gic GIC_SPI 100 IRQ_TYPE_NONE>;

        linux,pci-domain = <0>;

        bus-range = <0x00 0xff>;

        #address-cells = <3>;
        #size-cells = <2>;
        device_type = "pci";
        ranges = <0x81000000 0          0 0x28000000 0 0x00010000>,
                 <0x82000000 0 0x20000000 0x20000000 0 0x04000000>;

        phys = <&phy 0 5>;
        phy-names = "pcie-phy";

        brcm,pcie-ob;
        brcm,pcie-ob-axi-offset = <0x00000000>;

        msi-parent = <&msi0>;

        /* iProc 事件队列基础的 MSI */
        msi0: msi {
            compatible = "brcm,iproc-msi";
            msi-controller;
            interrupt-parent = <&gic>;
            interrupts = <GIC_SPI 96 IRQ_TYPE_NONE>,
                    <GIC_SPI 97 IRQ_TYPE_NONE>,
                    <GIC_SPI 98 IRQ_TYPE_NONE>,
                    <GIC_SPI 99 IRQ_TYPE_NONE>;
        };
    };
  - |
    pcie@18013000 {
        compatible = "brcm,iproc-pcie";
        reg = <0x18013000 0x1000>;

        #interrupt-cells = <1>;
        interrupt-map-mask = <0 0 0 0>;
        interrupt-map = <0 0 0 0 &gic GIC_SPI 106 IRQ_TYPE_NONE>;

        linux,pci-domain = <1>;

        bus-range = <0x00 0xff>;

        #address-cells = <3>;
        #size-cells = <2>;
        device_type = "pci";
        ranges = <0x81000000 0          0 0x48000000 0 0x00010000>,
                 <0x82000000 0 0x40000000 0x40000000 0 0x04000000>;

        phys = <&phy 1 6>;
        phy-names = "pcie-phy";
    };
```

## Documentation/devicetree/bindings/pci/cdns-pcie-ep_cn.yaml
~~~~yaml
```yaml
# SPDX-许可证标识符: (GPL-2.0-only 或 BSD-2-Clause)
%YAML 1.2
---
$id: http://devicetree.org/schemas/pci/cdns-pcie-ep.yaml#
$schema: http://devicetree.org/meta-schemas/core.yaml#

title: Cadence PCIe 设备

maintainers:
  - Tom Joseph <tjoseph@cadence.com>

allOf:
  - $ref: cdns-pcie.yaml#
  - $ref: pci-ep.yaml#

properties:
  cdns,max-outbound-regions:
    description: 最大数量的出站区域
    $ref: /schemas/types.yaml#/definitions/uint32
    minimum: 1
    maximum: 32
    default: 32

additionalProperties: true
```
~~~~

## Documentation/devicetree/bindings/pci/cdns-pcie-host_cn.yaml
```yaml
# SPDX-许可证标识符: (GPL-2.0-only 或 BSD-2-Clause)
%YAML 1.2
---
$id: http://devicetree.org/schemas/pci/cdns-pcie-host.yaml#
$schema: http://devicetree.org/meta-schemas/core.yaml#

title: Cadence PCIe 主机

maintainers:
  - Tom Joseph <tjoseph@cadence.com>

allOf:
  - $ref: /schemas/pci/pci-host-bridge.yaml#
  - $ref: cdns-pcie.yaml#

properties:
  cdns,max-outbound-regions:
    description: 最大数量的出站区域
    $ref: /schemas/types.yaml#/definitions/uint32
    minimum: 1
    maximum: 32
    default: 32
    deprecated: true

  cdns,no-bar-match-nbits:
    description:
      设置到无 BAR 匹配寄存器中，以配置在入站 (PCIe -> AXI) 地址转换期间保留的最低有效位的数量
    $ref: /schemas/types.yaml#/definitions/uint32
    minimum: 0
    maximum: 64
    default: 32
    deprecated: true

  msi-parent: true

additionalProperties: true
```

## Documentation/devicetree/bindings/pci/cdns-pcie_cn.yaml
~~~~yaml
```yaml
# SPDX-许可证标识符: (GPL-2.0-only 或 BSD-2-Clause)
%YAML 1.2
---
$id: http://devicetree.org/schemas/pci/cdns-pcie.yaml#
$schema: http://devicetree.org/meta-schemas/core.yaml#

title: Cadence PCIe 核心

maintainers:
  - Tom Joseph <tjoseph@cadence.com>

properties:
  phys:
    description:
      如果列表中有多个，则每个通道一个。如果仅列出一个 PHY，它必须管理所有通道。
    minItems: 1
    maxItems: 16

  phy-names:
    items:
      - const: pcie-phy
    # FIXME: 当多于一个时的名字

additionalProperties: true
```
~~~~

## Documentation/devicetree/bindings/pci/faraday,ftpci100_cn.yaml
```yaml
# SPDX-许可证标识符: (GPL-2.0-only 或 BSD-2-Clause)
%YAML 1.2
---
$id: http://devicetree.org/schemas/pci/faraday,ftpci100.yaml#
$schema: http://devicetree.org/meta-schemas/core.yaml#

标题: Faraday Technology FTPCI100 PCI 主桥接器

维护者:
  - Linus Walleij <linus.walleij@linaro.org>

描述: |
    这个 PCI 桥接器可以在 Cortina Systems Gemini 系统级芯片平台内部找到，并且是来自 Faraday Technology 的一个通用 IP 块。它有两种变体：普通版和双 PCI 版。普通版本将级联中断控制器嵌入到主桥接器中。双版本则将中断路由到主机芯片的中断控制器。
主控制器出现在 PCI 总线上，供应商 ID 为 0x159b（Faraday Technology），产品 ID 为 0x4321。
I/O 空间考虑:
    普通变体具有 128MiB 非预取内存空间，而“双”变体则有 64MiB。在描述范围时，请考虑这一点。
中断映射考虑：

    “双”变体会从系统中断控制器接收 INT A、B、C 和 D，并应在它的中断映射中指向控制器中的相应中断
Faraday PCI（非双变体）中断分配默认中断映射/交换的唯一文档的代码通常如下所示，在中断控制器侧而不是在互连中进行交换：

    interrupt-map-mask = <0xf800 0 0 7>;
    interrupt-map =
        <0x4800 0 0 1 &pci_intc 0>, /* 插槽 9 */
        <0x4800 0 0 2 &pci_intc 1>,
        <0x4800 0 0 3 &pci_intc 2>,
        <0x4800 0 0 4 &pci_intc 3>,
        <0x5000 0 0 1 &pci_intc 1>, /* 插槽 10 */
        <0x5000 0 0 2 &pci_intc 2>,
        <0x5000 0 0 3 &pci_intc 3>,
        <0x5000 0 0 4 &pci_intc 0>,
        <0x5800 0 0 1 &pci_intc 2>, /* 插槽 11 */
        <0x5800 0 0 2 &pci_intc 3>,
        <0x5800 0 0 3 &pci_intc 0>,
        <0x5800 0 0 4 &pci_intc 1>,
        <0x6000 0 0 1 &pci_intc 3>, /* 插槽 12 */
        <0x6000 0 0 2 &pci_intc 0>,
        <0x6000 0 0 3 &pci_intc 1>,
        <0x6000 0 0 4 &pci_intc 2>;

allOf:
  - $ref: /schemas/pci/pci-host-bridge.yaml#

属性:
  compatible:
    oneOf:
      - items:
          - const: cortina,gemini-pci
          - const: faraday,ftpci100
      - items:
          - const: cortina,gemini-pci-dual
          - const: faraday,ftpci100-dual
      - const: faraday,ftpci100
      - const: faraday,ftpci100-dual

  reg:
    maxItems: 1

  "#address-cells":
    const: 3

  "#interrupt-cells":
    const: 1

  ranges:
    minItems: 2

  dma-ranges:
    minItems: 3
    描述: |
      内存区域的三个范围。这些范围必须
      对齐到 1MB 边界，并且可以是 1MB、2MB、4MB、8MB、16MB、32MB、64MB、128MB、256MB、512MB、1GB 或 2GB 大小。内存应标记为可预取
时钟:
    items:
      - 描述: 外设时钟 (PCLK)
      - 描述: PCI 时钟 (PCICLK)
描述: |
      如果这些不存在，则假定它们
      是硬连线启用并始终开启的。PCI 时钟将是 33 或 66 MHz
时钟名称:
    items:
      - const: PCLK
      - const: PCICLK

  interrupt-controller:
    类型: 对象

必需:
  - reg
  - compatible
  - "#interrupt-cells"
  - interrupt-map-mask
  - interrupt-map
  - dma-ranges

如果:
  属性:
    compatible:
      包含:
        const: faraday,ftpci100
那么:
  必需:
    - interrupt-controller

未评估属性: false

示例:
  - |
    #include <dt-bindings/interrupt-controller/irq.h>
    pci@50000000 {
      compatible = "cortina,gemini-pci", "faraday,ftpci100";
      reg = <0x50000000 0x100>;
      device_type = "pci";
      #address-cells = <3>;
      #size-cells = <2>;
      #interrupt-cells = <1>;

      bus-range = <0x00 0xff>;
      ranges = /* 1MiB I/O 空间 0x50000000-0x500fffff */
        <0x01000000 0 0          0x50000000 0 0x00100000>,
        /* 128MiB 非预取内存 0x58000000-0x5fffffff */
        <0x02000000 0 0x58000000 0x58000000 0 0x08000000>;

      /* DMA 范围 */
      dma-ranges =
        /* 128MiB 在 0x00000000-0x07ffffff */
        <0x02000000 0 0x00000000 0x00000000 0 0x08000000>,
        /* 64MiB 在 0x00000000-0x03ffffff */
        <0x02000000 0 0x00000000 0x00000000 0 0x04000000>,
        /* 64MiB 在 0x00000000-0x03ffffff */
        <0x02000000 0 0x00000000 0x00000000 0 0x04000000>;

      interrupt-map-mask = <0xf800 0 0 7>;
      interrupt-map =
        <0x4800 0 0 1 &pci_intc 0>, /* 插槽 9 */
        <0x4800 0 0 2 &pci_intc 1>,
        <0x4800 0 0 3 &pci_intc 2>,
        <0x4800 0 0 4 &pci_intc 3>,
        <0x5000 0 0 1 &pci_intc 1>, /* 插槽 10 */
        <0x5000 0 0 2 &pci_intc 2>,
        <0x5000 0 0 3 &pci_intc 3>,
        <0x5000 0 0 4 &pci_intc 0>,
        <0x5800 0 0 1 &pci_intc 2>, /* 插槽 11 */
        <0x5800 0 0 2 &pci_intc 3>,
        <0x5800 0 0 3 &pci_intc 0>,
        <0x5800 0 0 4 &pci_intc 1>,
        <0x6000 0 0 1 &pci_intc 3>, /* 插槽 12 */
        <0x6000 0 0 2 &pci_intc 0>,
        <0x6000 0 0 3 &pci_intc 0>,
        <0x6000 0 0 4 &pci_intc 0>;
      pci_intc: interrupt-controller {
        interrupt-parent = <&intcon>;
        interrupt-controller;
        interrupts = <8 IRQ_TYPE_LEVEL_HIGH>;
        #address-cells = <0>;
        #interrupt-cells = <1>;
      };
    };
```

## Documentation/devicetree/bindings/pci/fsl,imx6q-pcie-common_cn.yaml
~~~~yaml
# SPDX-许可证标识符: (GPL-2.0-only 或 BSD-2-Clause)
%YAML 1.2
---
$id: http://devicetree.org/schemas/pci/fsl,imx6q-pcie-common.yaml#
$schema: http://devicetree.org/meta-schemas/core.yaml#

标题: Freescale i.MX6 PCIe RC/EP 控制器

维护者:
  - Lucas Stach <l.stach@pengutronix.de>
  - Richard Zhu <hongxing.zhu@nxp.com>

描述:
  Freescale i.MX PCIe 根端口和终端控制器的通用属性
属性:
  clocks:
    minItems: 3
    maxItems: 4

  clock-names:
    minItems: 3
    maxItems: 4

  num-lanes:
    const: 1

  fsl,imx7d-pcie-phy:
    $ref: /schemas/types.yaml#/definitions/phandle
    描述: 指向 fsl,imx7d-pcie-phy 节点的 phandle。对于 imx7d-pcie、imx7d-pcie-ep、imx8mq-pcie 和 imx8mq-pcie-ep 额外需要的属性
功耗域:
    minItems: 1
    items:
      - 描述: 指向 DISPLAY 域的 phandle 对于 imx6sx-pcie、imx6sx-pcie-ep，指向 PCIE_PHY 功耗域对于 imx7d-pcie、imx7d-pcie-ep、imx8mq-pcie 和 imx8mq-pcie-ep
- 描述: 指向 PCIE_PHY 功耗域的 phandle 对于 imx6sx-pcie 和 imx6sx-pcie-ep
功耗域名称:
    minItems: 1
    items:
      - const: pcie
      - const: pcie_phy

  resets:
    minItems: 2
    maxItems: 3
    描述: 由 SRC IP 块暴露的与 PCIe 相关的复位线的 phandle。对 imx7d-pcie、imx7d-pcie-ep、imx8mq-pcie 和 imx8mq-pcie-ep 额外需要
复位名称:
    minItems: 2
    maxItems: 3

  fsl,tx-deemph-gen1:
    描述: 第一代 De-emphasis 值（可选必需）
$ref: /schemas/types.yaml#/definitions/uint32
    默认值: 0

  fsl,tx-deemph-gen2-3p5db:
    描述: 第二代 (3.5db) De-emphasis 值（可选必需）
$ref: /schemas/types.yaml#/definitions/uint32
    默认值: 0

  fsl,tx-deemph-gen2-6db:
    描述: 第二代 (6db) De-emphasis 值（可选必需）
$ref: /schemas/types.yaml#/definitions/uint32
    默认值: 20

  fsl,tx-swing-full:
    描述: 第二代 TX SWING FULL 值（可选必需）
$ref: /schemas/types.yaml#/definitions/uint32
    默认值: 127

  fsl,tx-swing-low:
    描述: TX 发射幅度 swing_low 值（可选必需）
This YAML configuration describes properties and constraints for various PCIe controllers in Freescale (now NXP) SoCs (System on Chips). Here's a translation into Chinese:

```yaml
# 定义引用：最大链路速度
$ref: /schemas/types.yaml#/definitions/uint32
default: 127

fsl,max-link-speed:
  description: 指定PCIe链路能力的代数（可选）
注意IMX6 LVDS时钟输出不满足Gen2抖动要求，因此对于Gen2能力，
需要使用符合Gen2标准的时钟发生器并进行配置
$ref: /schemas/types.yaml#/definitions/uint32
enum: [1, 2, 3, 4]
default: 1

phys:
  maxItems: 1

phy-names:
  const: pcie-phy

vpcie-supply:
  description: 应指定负责PCIe端口供电的电源管理器
初始化PCIe主机时将启用电源管理器，并在初始化过程中或关闭主机时禁用它（可选）

vph-supply:
  description: 应指定负责VPH之一的三个PCIe PHY电源的电源管理器。
此电源管理器可以由1.8V和3.3V电压供应（可选）

required:
  - clocks
  - clock-names
  - num-lanes

allOf:
  - if:
      properties:
        compatible:
          contains:
            enum:
              - fsl,imx6sx-pcie
              - fsl,imx6sx-pcie-ep
    then:
      properties:
        clock-names:
          items:
            - {}
            - {}
            - const: pcie_phy
            - const: pcie_inbound_axi
        power-domains:
          minItems: 2
        power-domain-names:
          minItems: 2

  - if:
      properties:
        compatible:
          contains:
            enum:
              - fsl,imx8mq-pcie
              - fsl,imx8mq-pcie-ep
    then:
      properties:
        clock-names:
          items:
            - {}
            - {}
            - const: pcie_phy
            - const: pcie_aux

  - if:
      properties:
        compatible:
          contains:
            enum:
              - fsl,imx6q-pcie
              - fsl,imx6qp-pcie
              - fsl,imx7d-pcie
              - fsl,imx6q-pcie-ep
              - fsl,imx6qp-pcie-ep
              - fsl,imx7d-pcie-ep
    then:
      properties:
        clock-names:
          maxItems: 3
          contains:
            const: pcie_phy

  - if:
      properties:
        compatible:
          contains:
            enum:
              - fsl,imx8mm-pcie
              - fsl,imx8mp-pcie
              - fsl,imx8mm-pcie-ep
              - fsl,imx8mp-pcie-ep
    then:
      properties:
        clock-names:
          maxItems: 3
          contains:
            const: pcie_aux
  - if:
      properties:
        compatible:
          contains:
            enum:
              - fsl,imx6q-pcie
              - fsl,imx6qp-pcie
              - fsl,imx6q-pcie-ep
              - fsl,imx6qp-pcie-ep
    then:
      properties:
        power-domains: false
        power-domain-names: false

  - if:
      not:
        properties:
          compatible:
            contains:
              enum:
                - fsl,imx6sx-pcie
                - fsl,imx6q-pcie
                - fsl,imx6qp-pcie
                - fsl,imx95-pcie
                - fsl,imx6sx-pcie-ep
                - fsl,imx6q-pcie-ep
                - fsl,imx6qp-pcie-ep
    then:
      properties:
        power-domains:
          maxItems: 1
        power-domain-names: false

  - if:
      properties:
        compatible:
          contains:
            enum:
              - fsl,imx6q-pcie
              - fsl,imx6sx-pcie
              - fsl,imx6qp-pcie
              - fsl,imx7d-pcie
              - fsl,imx8mq-pcie
              - fsl,imx6q-pcie-ep
              - fsl,imx6sx-pcie-ep
              - fsl,imx6qp-pcie-ep
              - fsl,imx7d-pcie-ep
              - fsl,imx8mq-pcie-ep
    then:
      properties:
        resets:
          minItems: 3
        reset-names:
          items:
            - const: pciephy
            - const: apps
            - const: turnoff
    else:
      properties:
        resets:
          maxItems: 2
        reset-names:
          items:
            - const: apps
            - const: turnoff

additionalProperties: true
```

请注意，这段配置描述了不同SoC中PCIe控制器的各种属性和约束条件，包括兼容性、时钟名称、重置信号等。这些配置用于指导硬件初始化和驱动开发。
~~~~
