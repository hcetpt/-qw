## Documentation/devicetree/bindings/mfd/x-powers,axp152_cn.yaml
~~~~yaml
# SPDX-许可证标识符: GPL-2.0
%YAML 1.2
---
$id: http://devicetree.org/schemas/mfd/x-powers,axp152.yaml#
$schema: http://devicetree.org/meta-schemas/core.yaml#

标题: X-Powers AXP PMIC

维护者:
  - 陈宇蔡 <wens@csie.org>

allOf:
  - 如果:
      属性:
        兼容性:
          包含:
            枚举:
              - x-powers,axp152
              - x-powers,axp202
              - x-powers,axp209

    那么:
      属性:
        调压器:
          属性:
            x-powers,dcdc-freq:
              最小值: 750
              最大值: 1875
              默认: 1500

    否则:
      属性:
        调压器:
          属性:
            x-powers,dcdc-freq:
              最小值: 1800
              最大值: 4050
              默认: 3000

  - 如果:
      属性:
        兼容性:
          包含:
            枚举:
              - x-powers,axp152
              - x-powers,axp202
              - x-powers,axp209

    那么:
      属性:
        x-powers,drive-vbus-en: false

  - 如果:
      不是:
        属性:
          兼容性:
            包含:
              常量: x-powers,axp806

    那么:
      属性:
        x-powers,self-working-mode: false
        x-powers,master-mode: false

  - 如果:
      不是:
        属性:
          兼容性:
            包含:
              枚举:
                - x-powers,axp15060
                - x-powers,axp305
                - x-powers,axp313a

    那么:
      必需:
        - 中断

  - 如果:
      属性:
        兼容性:
          包含:
            枚举:
              - x-powers,axp313a
              - x-powers,axp15060
              - x-powers,axp717

    那么:
      属性:
        x-powers,dcdc-freq: false

属性:
  兼容性:
    选项之一:
      - 枚举:
          - x-powers,axp152
          - x-powers,axp192
          - x-powers,axp202
          - x-powers,axp209
          - x-powers,axp221
          - x-powers,axp223
          - x-powers,axp313a
          - x-powers,axp717
          - x-powers,axp803
          - x-powers,axp806
          - x-powers,axp809
          - x-powers,axp813
          - x-powers,axp15060
      - 项目:
          - 常量: x-powers,axp228
          - 常量: x-powers,axp221
      - 项目:
          - 常量: x-powers,axp805
          - 常量: x-powers,axp806
      - 项目:
          - 常量: x-powers,axp305
          - 常量: x-powers,axp805
          - 常量: x-powers,axp806
      - 项目:
          - 常量: x-powers,axp818
          - 常量: x-powers,axp813

  reg:
    最大项数: 1

  中断:
    最大项数: 1

  中断控制器: true

  "#中断单元":
    常量: 1

  x-powers,drive-vbus-en:
    类型: 布尔值
    描述: >
      当N_VBUSEN引脚用作输出引脚来控制一个外部调压器以驱动OTG VBus，而非作为一个指示板子是否正在驱动OTG VBus的输入引脚时，设置此项。

  x-powers,self-working-mode:
    类型: 布尔值
    描述: >
      当PMIC通过MODESET引脚连接为自工作模式时，设置此项。

  x-powers,master-mode:
    类型: 布尔值
    描述: >
      当PMIC通过MODESET引脚连接为主模式时，设置此项。

  vin1-supply:
    描述: >
      如果存在的话，DCDC1电源供应节点。

  vin2-supply:
    描述: >
      如果存在的话，DCDC2电源供应节点。

  vin3-supply:
    描述: >
      如果存在的话，DCDC3电源供应节点。

  vin4-supply:
    描述: >
      如果存在的话，DCDC4电源供应节点。

  vin5-supply:
    描述: >
      如果存在的话，DCDC5电源供应节点。

  vin6-supply:
    描述: >
      如果存在的话，DCDC6电源供应节点。

  vin7-supply:
    描述: >
      如果存在的话，DCDC7电源供应节点。
vina-supply:
    description: >
      如果存在，则为 DCDCA 电源供应节点
vinb-supply:
    description: >
      如果存在，则为 DCDCB 电源供应节点
vinc-supply:
    description: >
      如果存在，则为 DCDCC 电源供应节点
vind-supply:
    description: >
      如果存在，则为 DCDCD 电源供应节点
vine-supply:
    description: >
      如果存在，则为 DCDCE 电源供应节点
acin-supply:
    description: >
      如果存在，则为 LDO1 电源供应节点
ldo24in-supply:
    description: >
      如果存在，则为 LDO2 和 LDO4 电源供应节点
ldo3in-supply:
    description: >
      如果存在，则为 LDO3 电源供应节点
ldo5in-supply:
    description: >
      如果存在，则为 LDO5 电源供应节点
aldoin-supply:
    description: >
      如果存在，则为 ALDO* 电源供应节点
以下是提供的英文描述翻译成中文：

bldoin-supply:
    description: >
      如果存在，则为 BLDO* 电源供应节点
cldoin-supply:
    description: >
      如果存在，则为 CLDO* 电源供应节点
dldoin-supply:
    description: >
      如果存在，则为 DLDO* 电源供应节点
eldoin-supply:
    description: >
      如果存在，则为 ELDO* 电源供应节点
fldoin-supply:
    description: >
      如果存在，则为 FLDO* 电源供应节点
ips-supply:
    description: >
      如果存在，则为 LDO_IO0、LDO_IO1 和 RTC_LDO 电源供应节点
drivevbus-supply:
    description: >
      如果存在，则为 DRIVEVBUS 电源供应节点
swin-supply:
    description: >
      如果存在，则为 SW 电源供应节点
adc:
    $ref: /schemas/iio/adc/x-powers,axp209-adc.yaml#

  gpio:
    $ref: /schemas/gpio/x-powers,axp209-gpio.yaml#

  ac-power:
    $ref: /schemas/power/supply/x-powers,axp20x-ac-power-supply.yaml#

  battery-power:
    $ref: /schemas/power/supply/x-powers,axp20x-battery-power-supply.yaml#

  usb-power:
    $ref: /schemas/power/supply/x-powers,axp20x-usb-power-supply.yaml#

  regulators:
    type: object

    properties:
      x-powers,dcdc-freq:
        $ref: /schemas/types.yaml#/definitions/uint32
        description: >
          定义 DC-DC 的工作频率（单位：kHz）
patternProperties:
      "^(([a-f])?ldo[0-9]|dcdc[0-7a-e]|ldo(_|-)io(0|1)|(dc1)?sw|rtc(_|-)ldo|cpusldo|drivevbus|dc5ldo)$":
        $ref: /schemas/regulator/regulator.yaml#
        type: object
        unevaluatedProperties: false

        properties:
          regulator-ramp-delay:
            description: >
              对于 AXP209 上的 DCDC2 和 LDO3 调压器，仅 800 和 1600 是有效的值
The provided text describes device tree bindings for power management ICs (PMICs), specifically for X-Powers PMIC models AXP152 and AXP209. Below is a translation of the given text into simplified Chinese:

### `regulator-soft-start:` 
    描述: >
      仅对 LDO3 稳压器有效。

### `x-powers,dcdc-workmode:`
    $ref: /schemas/types.yaml#/definitions/uint32
    枚举: [0, 1]
    描述: >
      仅对 DCDC 稳压器有效。设置为 1 表示 PWM 模式，0 表示 AUTO (PWM/PFM) 模式。DCDC 稳压器工作在混合的 PWM/PFM 模式下，在轻负载时使用 PFM，在重负载时切换到 PWM。强制使用 PWM 模式以降低输出噪声为代价换取了轻负载下的效率。这可能适用于不受电池限制的高保真音频相关应用。

### additionalProperties: false

### required:
  - compatible
  - reg
  - "#interrupt-cells"
  - interrupt-controller

### additionalProperties: false

### 示例:

#### 示例 1:
```yaml
i2c {
    #address-cells = <1>;
    #size-cells = <0>;

    pmic@30 {
        compatible = "x-powers,axp152";
        reg = <0x30>;
        interrupts = <0>;
        interrupt-controller;
        #interrupt-cells = <1>;
    };
};
```

#### 示例 2:
```yaml
#include <dt-bindings/interrupt-controller/irq.h>

i2c {
    #address-cells = <1>;
    #size-cells = <0>;

    pmic@34 {
        compatible = "x-powers,axp209";
        reg = <0x34>;
        interrupt-parent = <&nmi_intc>;
        interrupts = <0 IRQ_TYPE_LEVEL_LOW>;
        interrupt-controller;
        #interrupt-cells = <1>;

        ac_power_supply: ac-power {
            compatible = "x-powers,axp202-ac-power-supply";
        };

        axp_adc: adc {
            compatible = "x-powers,axp209-adc";
            #io-channel-cells = <1>;
        };

        axp_gpio: gpio {
            compatible = "x-powers,axp209-gpio";
            gpio-controller;
            #gpio-cells = <2>;

            gpio0-adc-pin {
                pins = "GPIO0";
                function = "adc";
            };
        };

        battery_power_supply: battery-power {
            compatible = "x-powers,axp209-battery-power-supply";
        };

        regulators {
            /* Buck 稳压器的默认工作频率 */
            x-powers,dcdc-freq = <1500>;

            reg_dcdc2: dcdc2 {
                regulator-always-on;
                regulator-min-microvolt = <1000000>;
                regulator-max-microvolt = <1450000>;
                regulator-name = "vdd-cpu";
            };

            reg_dcdc3: dcdc3 {
                regulator-always-on;
                regulator-min-microvolt = <1000000>;
                regulator-max-microvolt = <1400000>;
                regulator-name = "vdd-int-dll";
            };

            reg_ldo1: ldo1 {
                /* LDO1 是一个固定输出稳压器 */
                regulator-always-on;
                regulator-min-microvolt = <1300000>;
                regulator-max-microvolt = <1300000>;
                regulator-name = "vdd-rtc";
            };

            reg_ldo2: ldo2 {
                regulator-always-on;
                regulator-min-microvolt = <3000000>;
                regulator-max-microvolt = <3000000>;
                regulator-name = "avcc";
            };

            reg_ldo3: ldo3 {
                regulator-name = "ldo3";
            };

            reg_ldo4: ldo4 {
                regulator-name = "ldo4";
            };

            reg_ldo5: ldo5 {
                regulator-name = "ldo5";
            };
        };

        usb_power_supply: usb-power {
            compatible = "x-powers,axp202-usb-power-supply";
        };
    };
};
```

以上是针对X-Powers PMIC型号AXP152和AXP209的设备树配置示例。
~~~~

## Documentation/devicetree/bindings/mfd/xylon,logicvc_cn.yaml
~~~~yaml
```yaml
# SPDX-许可证标识符: (GPL-2.0 或 BSD-2-Clause)
# 版权所有 2019 Bootlin
%YAML 1.2
---
$id: http://devicetree.org/schemas/mfd/xylon,logicvc.yaml#
$schema: http://devicetree.org/meta-schemas/core.yaml#

标题: Xylon LogiCVC 多功能设备

维护者:
  - Paul Kocialkowski <paul.kocialkowski@bootlin.com>

描述: |
  LogiCVC 是一个显示控制器，其中还包含了一个 GPIO 控制器。
因此，作为一个多功能设备，它作为显示和 GPIO 块的父设备被暴露出来。
属性:
  compatible:
    items:
      - 枚举:
          - xylon,logicvc-3.02.a
      - 常量: syscon
      - 常量: simple-mfd

  reg:
    最大项数: 1

  '#address-cells':
    常量: 1

  '#size-cells':
    常量: 1

选择:
  属性:
    compatible:
      包含:
        枚举:
          - xylon,logicvc-3.02.a

  必需:
    - compatible

模式属性:
  "^gpio@[0-9a-f]+$":
    $ref: /schemas/gpio/xylon,logicvc-gpio.yaml#

  "^display@[0-9a-f]+$":
    $ref: /schemas/display/xylon,logicvc-display.yaml#

必需:
  - compatible
  - reg

额外属性: false

示例:
  - |
    logicvc: logicvc@43c00000 {
      compatible = "xylon,logicvc-3.02.a", "syscon", "simple-mfd";
      reg = <0x43c00000 0x6000>;
    };
```

请注意，某些 YAML 的关键字（如 `items`、`maxItems` 等）在中文环境中可能没有直接对应的翻译。上述翻译中，这些关键字保持了原文的形式，并且对其他部分进行了翻译以适应中文环境。
~~~~

## Documentation/devicetree/bindings/mfd/zii,rave-sp_cn.txt
~~~~
### Zodiac Inflight Innovations RAVE 监控处理器

**RAVE 监控处理器**通过UART与SoC进行通信。预期其设备树节点被指定为用于通信的UART控制器节点的子节点。
#### 必需的父设备属性：

- **compatible：** 应该是以下之一：
    - `"zii,rave-sp-niu"`
    - `"zii,rave-sp-mezz"`
    - `"zii,rave-sp-esb"`
    - `"zii,rave-sp-rdu1"`
    - `"zii,rave-sp-rdu2"`

- **current-speed：** 应该设置为SP设备使用的波特率。

**RAVE SP**由以下子设备组成：

| 设备             | 描述                                 |
|------------------|--------------------------------------|
| rave-sp-wdt      | : 看门狗                             |
| rave-sp-nvmem    | : 与板载EEPROM的接口                 |
| rave-sp-backlight| : 显示屏背光                         |
| rave-sp-hwmon    | : 与板载硬件传感器的接口             |
| rave-sp-leds     | : 与板载LED的接口                     |
| rave-sp-input    | : 与板载电源按钮的接口               |

#### 使用示例：

```plaintext
rdu {
    compatible = "zii,rave-sp-rdu2";
    current-speed = <1000000>;

    watchdog {
        compatible = "zii,rave-sp-watchdog";
    };
};
```
~~~~

## Documentation/devicetree/bindings/pci/aardvark-pci_cn.txt
~~~~
Aardvark PCIe 控制器

此 PCIe 控制器用于 Marvell Armada 3700 ARM64 系统级芯片 (SoC) 上。
描述 Aardvark PCIe 控制器的设备树节点必须包含以下属性：

- compatible: 应设置为 "marvell,armada-3700-pcie"
- reg: PCIe 控制器的寄存器范围
- interrupts: PCIe 控制器的中断线
- #address-cells: 设置为 <3>
- #size-cells: 设置为 <2>
- device_type: 设置为 "pci"
- ranges: PCI 内存和 I/O 区域的范围
- #interrupt-cells: 设置为 <1>
- msi-controller: 表明 PCIe 控制器本身可以处理 MSI 中断
- msi-parent: 指向要使用的 MSI 控制器的指针
- interrupt-map-mask 和 interrupt-map: 标准 PCI 属性，定义 PCIe 接口到中断编号的映射
- bus-range: 覆盖的 PCI 总线编号
- phys: PCIe PHY 的句柄
- max-link-speed: 参见 pci.txt
- reset-gpios: 参见 pci.txt

此外，描述 Aardvark PCIe 控制器的设备树还必须包括一个子节点来描述集成在 PCIe 控制器中的传统中断控制器。该子节点必须具有以下属性：

- interrupt-controller
- #interrupt-cells: 设置为 <1>

示例：

```plaintext
pcie0: pcie@d0070000 {
    compatible = "marvell,armada-3700-pcie";
    device_type = "pci";
    reg = <0 0xd0070000 0 0x20000>;
    #address-cells = <3>;
    #size-cells = <2>;
    bus-range = <0x00 0xff>;
    interrupts = <GIC_SPI 29 IRQ_TYPE_LEVEL_HIGH>;
    #interrupt-cells = <1>;
    msi-controller;
    msi-parent = <&pcie0>;
    ranges = <0x82000000 0 0xe8000000   0 0xe8000000 0 0x1000000 /* Port 0 MEM */
              0x81000000 0 0xe9000000   0 0xe9000000 0 0x10000>; /* Port 0 IO*/
    interrupt-map-mask = <0 0 0 7>;
    interrupt-map = <0 0 0 1 &pcie_intc 0>,
                    <0 0 0 2 &pcie_intc 1>,
                    <0 0 0 3 &pcie_intc 2>,
                    <0 0 0 4 &pcie_intc 3>;
    phys = <&comphy1 0>;
    pcie_intc: interrupt-controller {
        interrupt-controller;
        #interrupt-cells = <1>;
    };
};
```
以上示例展示了如何在设备树中配置一个 Aardvark PCIe 控制器及其相关的传统中断控制器。
~~~~

## Documentation/devicetree/bindings/pci/altera-pcie-msi_cn.txt
~~~~
### Altera PCIe MSI 控制器

**必需属性：**
- `compatible`：应当包含 `"altr,msi-1.0"`，表明与Altera MSI 1.0规范兼容。
- `reg`：指定控制器的物理基地址以及内存映射区域的长度。此属性为复合属性，可以指定多个地址及其长度。
- `reg-names`：必须包括以下条目：
  - `"csr"`：CSR（配置状态寄存器）寄存器。
  - `"vector_slave"`：向量从属端口区域。
- `interrupts`：指定父中断控制器的中断源。中断标识符的具体格式取决于父中断控制器。
- `num-vectors`：向量数量，范围在1到32之间。
- `msi-controller`：指示这是一个MSI（消息信号中断）控制器节点。

**示例**

```plain
msi0: msi@0xFF200000 {
    compatible = "altr,msi-1.0";
    reg = <0xFF200000 0x00000010
        0xFF200010 0x00000080>; // 指定CSR寄存器基址为0xFF200000，长度为0x10字节；向量从属端口基址为0xFF200010，长度为0x80字节
    reg-names = "csr", "vector_slave";
    interrupt-parent = <&hps_0_arm_gic_0>; // 父中断控制器为hps_0_arm_gic_0
    interrupts = <0 42 4>; // 中断编号为42，触发类型为边沿触发
    msi-controller;
    num-vectors = <32>; // 向量数量为32
};
```

这个示例定义了一个位于物理地址0xFF200000处的MSI控制器节点，其中包含了CSR寄存器和向量从属端口的配置信息，并指定了一个父中断控制器以及相应的中断编号。
~~~~

## Documentation/devicetree/bindings/pci/altera-pcie_cn.txt
~~~~
### Altera PCIe 控制器

**所需属性：**
- `compatible`：应当包含 `"altr,pcie-root-port-1.0"` 或 `"altr,pcie-root-port-2.0"`
- `reg`：TXS 和 CRA 的物理基地址和长度的列表。对于 `"altr,pcie-root-port-2.0"`，还需额外提供 HIP 基地址和长度。
- `reg-names`：必须包括以下条目：
    - `"Txs"`：TX 从端口区域
    - `"Cra"`：控制寄存器访问区域
    - `"Hip"`：硬 IP 区域（仅 `"altr,pcie-root-port-2.0"`）
- `interrupts`：指定父中断控制器的中断源。中断指定符的格式取决于父中断控制器。
- `device_type`：必须为 `"pci"`
- `#address-cells`：设置为 `<3>`
- `#size-cells`：设置为 `<2>`
- `#interrupt-cells`：设置为 `<1>`
- `ranges`：描述根端口和标准 PCI 区域地址的转换。
- `interrupt-map-mask` 和 `interrupt-map`：定义 PCIe 接口到中断编号映射的标准 PCI 属性。

**可选属性：**
- `msi-parent`：指向作为此 PCIe 控制器 MSI 控制器的硬件实体的链接。
- `bus-range`：覆盖的 PCI 总线号。

**示例**

```yaml
pcie_0: pcie@c00000000 {
    compatible = "altr,pcie-root-port-1.0";
    reg = <0xc0000000 0x20000000>,
         <0xff220000 0x00004000>;
    reg-names = "Txs", "Cra";
    interrupt-parent = <&hps_0_arm_gic_0>;
    interrupts = <0 40 4>;
    interrupt-controller;
    #interrupt-cells = <1>;
    bus-range = <0x0 0xFF>;
    device_type = "pci";
    msi-parent = <&msi_to_gic_gen_0>;
    #address-cells = <3>;
    #size-cells = <2>;
    interrupt-map-mask = <0 0 0 7>;
    interrupt-map = <0 0 0 1 &pcie_0 1>,
                   <0 0 0 2 &pcie_0 2>,
                   <0 0 0 3 &pcie_0 3>,
                   <0 0 0 4 &pcie_0 4>;
    ranges = <0x82000000 0x00000000 0x00000000 0xc0000000 0x00000000 0x10000000
          0x82000000 0x00000000 0x10000000 0xd0000000 0x00000000 0x10000000>;
};
```
以上配置描述了一个基于 Altera 的 PCIe 根端口控制器的设备树片段。
~~~~
