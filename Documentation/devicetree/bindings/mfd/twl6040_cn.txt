## Documentation/devicetree/bindings/pci/fsl,imx6q-pcie-ep_cn.yaml
```yaml
以下是提供的 YAML 文件的中文翻译：

# SPDX 许可证标识符: (GPL-2.0-only 或 BSD-2-Clause)
%YAML 1.2
---
$id: http://devicetree.org/schemas/pci/fsl,imx6q-pcie-ep.yaml#
$schema: http://devicetree.org/meta-schemas/core.yaml#

标题: Freescale i.MX6 PCIe 终端控制器

维护者:
  - Lucas Stach <l.stach@pengutronix.de>
  - Richard Zhu <hongxing.zhu@nxp.com>

描述: |+
  此 PCIe 控制器基于 Synopsys DesignWare PCIe IP，因此继承了在 snps,dw-pcie-ep.yaml 中定义的所有通用属性。
  控制器实例为双模式，在其中可以工作于根端口模式或终端模式，但一次只能选择一种模式。

属性:
  compatible:
    枚举:
      - fsl,imx8mm-pcie-ep
      - fsl,imx8mq-pcie-ep
      - fsl,imx8mp-pcie-ep
      - fsl,imx95-pcie-ep

  clocks:
    minItems: 3
    items:
      - 描述: PCIe 桥接时钟
      - 描述: PCIe 总线时钟
      - 描述: PCIe PHY 时钟
      - 描述: imx6sx-pcie、imx6sx-pcie-ep、imx8mq-pcie 和 imx8mq-pcie-ep 所需的附加时钟条目

  clock-names:
    minItems: 3
    maxItems: 4

  interrupts:
    items:
      - 描述: 内置 eDMA 中断器

  interrupt-names:
    items:
      - 常量: dma

必需:
  - compatible
  - reg
  - reg-names
  - interrupts
  - interrupt-names

allOf:
  - $ref: /schemas/pci/snps,dw-pcie-ep.yaml#
  - $ref: /schemas/pci/fsl,imx6q-pcie-common.yaml#
  - 如果:
      属性:
        compatible:
          枚举:
            - fsl,imx8mm-pcie-ep
            - fsl,imx8mq-pcie-ep
            - fsl,imx8mp-pcie-ep
    那么:
      属性:
        reg:
          minItems: 2
          maxItems: 2
        reg-names:
          items:
            - 常量: dbi
            - 常量: addr_space

  - 如果:
      属性:
        compatible:
          枚举:
            - fsl,imx95-pcie-ep
    那么:
      属性:
        reg:
          minItems: 6
          maxItems: 6
        reg-names:
          items:
            - 常量: dbi
            - 常量: atu
            - 常量: dbi2
            - 常量: app
            - 常量: dma
            - 常量: addr_space

  - 如果:
      属性:
        compatible:
          枚举:
            - fsl,imx8mq-pcie-ep
            - fsl,imx95-pcie-ep
    那么:
      属性:
        clocks:
          minItems: 4
        clock-names:
          items:
            - 常量: pcie
            - 常量: pcie_bus
            - 常量: pcie_phy
            - 常量: pcie_aux
    否则:
      属性:
        clocks:
          maxItems: 3
        clock-names:
          items:
            - 常量: pcie
            - 常量: pcie_bus
            - 常量: pcie_aux

unevaluatedProperties: false

示例:
  - |
    #include <dt-bindings/clock/imx8mp-clock.h>
    #include <dt-bindings/power/imx8mp-power.h>
    #include <dt-bindings/reset/imx8mp-reset.h>
    #include <dt-bindings/interrupt-controller/arm-gic.h>

    pcie_ep: pcie-ep@33800000 {
      compatible = "fsl,imx8mp-pcie-ep";
      reg = <0x33800000 0x000400000>, <0x18000000 0x08000000>;
      reg-names = "dbi", "addr_space";
      clocks = <&clk IMX8MP_CLK_HSIO_ROOT>,
               <&clk IMX8MP_CLK_HSIO_AXI>,
               <&clk IMX8MP_CLK_PCIE_ROOT>;
      clock-names = "pcie", "pcie_bus", "pcie_aux";
      assigned-clocks = <&clk IMX8MP_CLK_PCIE_AUX>;
      assigned-clock-rates = <10000000>;
      assigned-clock-parents = <&clk IMX8MP_SYS_PLL2_50M>;
      num-lanes = <1>;
      interrupts = <GIC_SPI 127 IRQ_TYPE_LEVEL_HIGH>; /* eDMA */
      interrupt-names = "dma";
      fsl,max-link-speed = <3>;
      power-domains = <&hsio_blk_ctrl IMX8MP_HSIOBLK_PD_PCIE>;
      resets = <&src IMX8MP_RESET_PCIE_CTRL_APPS_EN>,
               <&src IMX8MP_RESET_PCIE_CTRL_APPS_TURNOFF>;
      reset-names = "apps", "turnoff";
      phys = <&pcie_phy>;
      phy-names = "pcie-phy";
      num-ib-windows = <4>;
      num-ob-windows = <4>;
    };
```

## Documentation/devicetree/bindings/pci/fsl,imx6q-pcie_cn.yaml
```yaml
# SPDX-License-Identifier: (GPL-2.0-only OR BSD-2-Clause)
%YAML 1.2
---
$id: http://devicetree.org/schemas/pci/fsl,imx6q-pcie.yaml#
$schema: http://devicetree.org/meta-schemas/core.yaml#

title: Freescale i.MX6 PCIe 主控制器

maintainers:
  - Lucas Stach <l.stach@pengutronix.de>
  - Richard Zhu <hongxing.zhu@nxp.com>

description: |+
  此 PCIe 主控制器基于 Synopsys DesignWare PCIe IP，
  因此继承了在 snps,dw-pcie.yaml 中定义的所有通用属性。
  控制器实例是双模式的，它们可以工作在根端口模式或终端模式，
  但一次只能使用其中一种模式。
  有关终端模式设备树绑定的详细信息，请参见 fsl,imx6q-pcie-ep.yaml。

properties:
  compatible:
    enum:
      - fsl,imx6q-pcie
      - fsl,imx6sx-pcie
      - fsl,imx6qp-pcie
      - fsl,imx7d-pcie
      - fsl,imx8mq-pcie
      - fsl,imx8mm-pcie
      - fsl,imx8mp-pcie
      - fsl,imx95-pcie

  clocks:
    minItems: 3
    items:
      - description: PCIe 桥接时钟
      - description: PCIe 总线时钟
      - description: PCIe PHY 时钟
      - description: 对于 imx6sx-pcie、imx6sx-pcie-ep、imx8mq-pcie 和 imx8mq-pcie-ep 需要的额外时钟条目
clock-names:
    minItems: 3
    maxItems: 4

  interrupts:
    items:
      - description: 内置的 MSI 控制器
interrupt-names:
    items:
      - const: msi

  reset-gpio:
    description: 应指定用于控制 PCI 总线设备复位信号的 GPIO。它不识别极性，并默认为低电平有效复位序列（L=复位状态，H=运行状态）（可选）
reset-gpio-active-high:
    description: 如果存在，则使用在 "reset-gpio" 属性中指定的 GPIO 的复位序列将被反转（H=复位状态，L=运行状态）（可选）
这段文本定义了一个设备树节点的配置模板，用于描述Freescale i.MX 系列处理器中的PCIe控制器。下面是翻译成中文的内容：

类型: 布尔值

必须包含:
  - 兼容性（compatible）
  - 地址范围（reg）
  - 地址范围名称（reg-names）
  - 地址单元数（#address-cells）
  - 大小单元数（#size-cells）
  - 设备类型（device_type）
  - 总线范围（bus-range）
  - 范围映射（ranges）
  - 中断（interrupts）
  - 中断名称（interrupt-names）
  - 中断单元数（#interrupt-cells）
  - 中断映射掩码（interrupt-map-mask）
  - 中断映射（interrupt-map）

所有选项中都应包括:
  - 引用文件：`/schemas/pci/snps,dw-pcie.yaml`
  - 引用文件：`/schemas/pci/fsl,imx6q-pcie-common.yaml`

对于特定兼容性的条件:
  - 如果兼容性是 `fsl,imx6q-pcie`, `fsl,imx6sx-pcie`, `fsl,imx6qp-pcie`, `fsl,imx7d-pcie`, `fsl,imx8mq-pcie`, `fsl,imx8mm-pcie`, 或 `fsl,imx8mp-pcie`:
    - 地址范围（reg）最多可以有2项
    - 地址范围名称（reg-names）为 "dbi" 和 "config"

  - 如果兼容性是 `fsl,imx95-pcie`:
    - 地址范围（reg）至少要有4项且最多可以有4项
    - 地址范围名称（reg-names）为 "dbi", "config", "atu", 和 "app"

  - 如果兼容性是 `fsl,imx6sx-pcie`:
    - 时钟（clocks）至少要有4项
    - 时钟名称（clock-names）为 "pcie", "pcie_bus", "pcie_phy", 和 "pcie_inbound_axi"

  - 如果兼容性是 `fsl,imx8mq-pcie` 或 `fsl,imx95-pcie`:
    - 时钟（clocks）至少要有4项
    - 时钟名称（clock-names）为 "pcie", "pcie_bus", "pcie_phy", 和 "pcie_aux"

  - 如果兼容性是 `fsl,imx6q-pcie`, `fsl,imx6qp-pcie`, 或 `fsl,imx7d-pcie`:
    - 时钟（clocks）最多可以有3项
    - 时钟名称（clock-names）为 "pcie", "pcie_bus", 和 "pcie_phy"

  - 如果兼容性是 `fsl,imx8mm-pcie` 或 `fsl,imx8mp-pcie`:
    - 时钟（clocks）最多可以有3项
    - 时钟名称（clock-names）为 "pcie", "pcie_bus", 和 "pcie_aux"

不允许未评估的属性。

示例:
  - |
    包含 <dt-bindings/clock/imx6qdl-clock.h>
    包含 <dt-bindings/interrupt-controller/arm-gic.h>

    pcie: pcie@1ffc000 {
        兼容性 = "fsl,imx6q-pcie";
        地址范围 = <0x01ffc000 0x04000>,
                  <0x01f00000 0x80000>;
        地址范围名称 = "dbi", "config";
        地址单元数 = <3>;
        大小单元数 = <2>;
        设备类型 = "pci";
        总线范围 = <0x00 0xff>;
        范围映射 = <0x81000000 0 0          0x01f80000 0 0x00010000>,
                   <0x82000000 0 0x01000000 0x01000000 0 0x00f00000>;
        车道数量 = <1>;
        中断 = <GIC_SPI 120 IRQ_TYPE_LEVEL_HIGH>;
        中断名称 = "msi";
        中断单元数 = <1>;
        中断映射掩码 = <0 0 0 0x7>;
        中断映射 = <0 0 0 1 &gpc GIC_SPI 123 IRQ_TYPE_LEVEL_HIGH>,
                   <0 0 0 2 &gpc GIC_SPI 122 IRQ_TYPE_LEVEL_HIGH>,
                   <0 0 0 3 &gpc GIC_SPI 121 IRQ_TYPE_LEVEL_HIGH>,
                   <0 0 0 4 &gpc GIC_SPI 120 IRQ_TYPE_LEVEL_HIGH>;
        时钟 = <&clks IMX6QDL_CLK_PCIE_AXI>,
               <&clks IMX6QDL_CLK_LVDS1_GATE>,
               <&clks IMX6QDL_CLK_PCIE_REF_125M>;
        时钟名称 = "pcie", "pcie_bus", "pcie_phy";
    };
..
```

## Documentation/devicetree/bindings/pci/fsl,layerscape-pcie-ep_cn.yaml
```yaml
下面是给定内容的中文翻译：

# SPDX-License-Identifier: (GPL-2.0-only OR BSD-2-Clause)
%YAML 1.2
---
$id: http://devicetree.org/schemas/pci/fsl,layerscape-pcie-ep.yaml#
$schema: http://devicetree.org/meta-schemas/core.yaml#

title: Freescale Layerscape PCIe 终端控制器

maintainers:
  - Frank Li <Frank.Li@nxp.com>

description:
  此 PCIe 终端控制器基于 Synopsys DesignWare PCIe IP。
  该控制器从重置配置词（RCW）获取时钟，该配置词用于描述芯片重置时的 PLL 设置。
  根据可用的参考手册，在 Freescale PCIe 控制器寄存器集中没有特定的“版本”寄存器，
  这使得无法确定底层 DesignWare PCIe 控制器的版本信息。

properties:
  compatible:
    enum:
      - fsl,ls2088a-pcie-ep
      - fsl,ls1088a-pcie-ep
      - fsl,ls1046a-pcie-ep
      - fsl,ls1028a-pcie-ep
      - fsl,lx2160ar2-pcie-ep

  reg:
    maxItems: 2

  reg-names:
    items:
      - const: regs
      - const: addr_space

  fsl,pcie-scfg:
    $ref: /schemas/types.yaml#/definitions/phandle
    description: 指向 SCFG 设备节点的 phandle。第二个条目是从 '0' 开始的物理 PCIe 控制器索引。这用于获取 SCFG PEXN 寄存器。
big-endian:
    $ref: /schemas/types.yaml#/definitions/flag
    description: 如果 PEX_LUT 和 PF 寄存器块采用大端格式，请指定此属性
dma-coherent: true

  interrupts:
    minItems: 1
    maxItems: 2

  interrupt-names:
    minItems: 1
    maxItems: 2

required:
  - compatible
  - reg
  - reg-names

allOf:
  - if:
      properties:
        compatible:
          enum:
            - fsl,ls1028a-pcie-ep
            - fsl,ls1046a-pcie-ep
            - fsl,ls1088a-pcie-ep
    then:
      properties:
        interrupt-names:
          items:
            - const: pme

unevaluatedProperties: false

examples:
  - |
    #include <dt-bindings/interrupt-controller/arm-gic.h>

    soc {
      #address-cells = <2>;
      #size-cells = <2>;

      pcie_ep1: pcie-ep@3400000 {
        compatible = "fsl,ls1028a-pcie-ep";
        reg = <0x00 0x03400000 0x0 0x00100000
              0x80 0x00000000 0x8 0x00000000>;
        reg-names = "regs", "addr_space";
        interrupts = <GIC_SPI 108 IRQ_TYPE_LEVEL_HIGH>; /* PME 中断 */
        interrupt-names = "pme";
        num-ib-windows = <6>;
        num-ob-windows = <8>;
        status = "disabled";
      };
    };
..
```
