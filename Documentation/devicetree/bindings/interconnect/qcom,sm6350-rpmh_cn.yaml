## Documentation/devicetree/bindings/interconnect/qcom,sm6350-rpmh_cn.yaml
~~~~yaml
```yaml
# SPDX-License-Identifier: (GPL-2.0 OR BSD-2-Clause)
%YAML 1.2
---
$id: 'http://devicetree.org/schemas/interconnect/qcom,sm6350-rpmh.yaml#'
$schema: 'http://devicetree.org/meta-schemas/core.yaml#'

title: 高通 SM6350 RPMh 网络芯片间互连

maintainers:
  - Luca Weiss <luca.weiss@fairphone.com>

description:
  高通 SM6350 上基于RPMh的互连提供者
allOf:
  - $ref: 'qcom,rpmh-common.yaml#'

properties:
  compatible:
    enum:
      - qcom,sm6350-aggre1-noc
      - qcom,sm6350-aggre2-noc
      - qcom,sm6350-config-noc
      - qcom,sm6350-dc-noc
      - qcom,sm6350-gem-noc
      - qcom,sm6350-mmss-noc
      - qcom,sm6350-npu-noc
      - qcom,sm6350-system-noc

  reg:
    maxItems: 1

  '#interconnect-cells': true

patternProperties:
  '^interconnect-[a-z0-9\-]+$':
    type: object
    description:
      互连提供者没有独立的质量保证寄存器空间，而是共享父级的空间
$ref: 'qcom,rpmh-common.yaml#'

    properties:
      compatible:
        enum:
          - qcom,sm6350-clk-virt
          - qcom,sm6350-compute-noc

      '#interconnect-cells': true

    required:
      - compatible

    unevaluatedProperties: false

required:
  - compatible
  - reg

unevaluatedProperties: false

examples:
  - |
    config_noc: interconnect@1500000 {
        compatible = "qcom,sm6350-config-noc";
        reg = <0x01500000 0x28000>;
        #interconnect-cells = <2>;
        qcom,bcm-voters = <&apps_bcm_voter>;
    };

    system_noc: interconnect@1620000 {
        compatible = "qcom,sm6350-system-noc";
        reg = <0x01620000 0x17080>;
        #interconnect-cells = <2>;
        qcom,bcm-voters = <&apps_bcm_voter>;

        clk_virt: interconnect-clk-virt {
            compatible = "qcom,sm6350-clk-virt";
            #interconnect-cells = <2>;
            qcom,bcm-voters = <&apps_bcm_voter>;
        };
    };
```

请注意，这个 YAML 文件是设备树规范的一部分，用于定义高通 SM6350 芯片中的网络芯片间互连配置。其中的英文描述和属性名称未被翻译，因为它们通常保持原样以保持一致性。
~~~~

## Documentation/devicetree/bindings/interconnect/qcom,sm7150-rpmh_cn.yaml
~~~~yaml
下面是给定 YAML 文档的中文翻译：

```yaml
# SPDX-文件许可标识符: (GPL-2.0-only 或 BSD-2-Clause)
%YAML 1.2
---
$id: http://devicetree.org/schemas/interconnect/qcom,sm7150-rpmh.yaml#
$schema: http://devicetree.org/meta-schemas/core.yaml#

title: Qualcomm SM7150 上的 RPMh 网络-on-芯片互连

maintainers:
  - Danila Tikhonov <danila@jiaxyga.com>

description: |
  RPMh 互连提供者通过 RPMh 硬件加速器即总线时钟管理器（BCM）支持系统带宽需求。
参见:: include/dt-bindings/interconnect/qcom,sm7150-rpmh.h

allOf:
  - $ref: qcom,rpmh-common.yaml#

properties:
  compatible:
    enum:
      - qcom,sm7150-aggre1-noc
      - qcom,sm7150-aggre2-noc
      - qcom,sm7150-compute-noc
      - qcom,sm7150-config-noc
      - qcom,sm7150-dc-noc
      - qcom,sm7150-gem-noc
      - qcom,sm7150-mc-virt
      - qcom,sm7150-mmss-noc
      - qcom,sm7150-system-noc

  reg:
    maxItems: 1

# 子节点属性
patternProperties:
  '^interconnect-[0-9]+$':
    type: object
    description:
      互连提供者没有单独的 QoS 寄存器空间，而是共享父级的空间
allOf:
      - $ref: qcom,rpmh-common.yaml#

    properties:
      compatible:
        enum:
          - qcom,sm7150-camnoc-virt

    required:
      - compatible

    unevaluatedProperties: false

required:
  - compatible
  - reg

unevaluatedProperties: false

examples:
  - |
    mc_virt: interconnect@1380000 {
        compatible = "qcom,sm7150-mc-virt";
        reg = <0x01380000 0x40000>;
        #interconnect-cells = <2>;
        qcom,bcm-voters = <&apps_bcm_voter>;
    };

    system_noc: interconnect@1620000 {
        compatible = "qcom,sm7150-system-noc";
        reg = <0x01620000 0x40000>;
        #interconnect-cells = <2>;
        qcom,bcm-voters = <&apps_bcm_voter>;

        camnoc_virt: interconnect-0 {
            compatible = "qcom,sm7150-camnoc-virt";
            #interconnect-cells = <2>;
            qcom,bcm-voters = <&apps_bcm_voter>;
        };
    };
```

请注意，由于 YAML 是一种数据格式，并非所有的内容都可以直接翻译为中文，例如变量、函数和路径等需要保持原样。因此，在翻译过程中，我尽量保留了这些元素的英文形式。
~~~~

## Documentation/devicetree/bindings/interconnect/qcom,sm8550-rpmh_cn.yaml
~~~~yaml
```yaml
# SPDX-许可证标识符: (GPL-2.0 或 BSD-2-Clause)
%YAML 1.2
---
$id: http://devicetree.org/schemas/interconnect/qcom,sm8550-rpmh.yaml#
$schema: http://devicetree.org/meta-schemas/core.yaml#

title: 高通 SM8550 上的 RPMh 网络芯片互连

maintainers:
  - Abel Vesa <abel.vesa@linaro.org>
  - Neil Armstrong <neil.armstrong@linaro.org>

description: |
  RPMh 互连提供者通过 RPMh 硬件加速器（称为总线时钟管理器 (BCM)）支持系统带宽需求。提供者能够通过与每个执行环境相关的资源状态协调器 (RSC) 与 BCM 进行通信。
  提供者节点必须指向至少一个与其 RSC 相关的 RPMh 设备子节点，且每个提供者可以映射到多个 RPMh 资源。
更多信息参见: include/dt-bindings/interconnect/qcom,sm8550-rpmh.h

properties:
  compatible:
    enum:
      - qcom,sm8550-aggre1-noc
      - qcom,sm8550-aggre2-noc
      - qcom,sm8550-clk-virt
      - qcom,sm8550-cnoc-main
      - qcom,sm8550-config-noc
      - qcom,sm8550-gem-noc
      - qcom,sm8550-lpass-ag-noc
      - qcom,sm8550-lpass-lpiaon-noc
      - qcom,sm8550-lpass-lpicx-noc
      - qcom,sm8550-mc-virt
      - qcom,sm8550-mmss-noc
      - qcom,sm8550-nsp-noc
      - qcom,sm8550-pcie-anoc
      - qcom,sm8550-system-noc

  reg:
    maxItems: 1

  clocks:
    minItems: 1
    maxItems: 2

allOf:
  - $ref: qcom,rpmh-common.yaml#
  - if:
      properties:
        compatible:
          contains:
            enum:
              - qcom,sm8550-clk-virt
              - qcom,sm8550-mc-virt
    then:
      properties:
        reg: false
    else:
      required:
        - reg

  - if:
      properties:
        compatible:
          contains:
            enum:
              - qcom,sm8550-pcie-anoc
    then:
      properties:
        clocks:
          items:
            - description: aggre-NOC PCIe AXI 时钟
            - description: cfg-NOC PCIe a-NOC AHB 时钟

  - if:
      properties:
        compatible:
          contains:
            enum:
              - qcom,sm8550-aggre1-noc
    then:
      properties:
        clocks:
          items:
            - description: aggre UFS PHY AXI 时钟
            - description: aggre USB3 PRIM AXI 时钟

  - if:
      properties:
        compatible:
          contains:
            enum:
              - qcom,sm8550-aggre2-noc
    then:
      properties:
        clocks:
          items:
            - description: RPMH CC IPA 时钟

  - if:
      properties:
        compatible:
          contains:
            enum:
              - qcom,sm8550-aggre1-noc
              - qcom,sm8550-aggre2-noc
              - qcom,sm8550-pcie-anoc
    then:
      required:
        - clocks
    else:
      properties:
        clocks: false

required:
  - compatible

unevaluatedProperties: false

examples:
  - |
    #include <dt-bindings/clock/qcom,sm8550-gcc.h>

    clk_virt: interconnect-0 {
      compatible = "qcom,sm8550-clk-virt";
      #interconnect-cells = <2>;
      qcom,bcm-voters = <&apps_bcm_voter>;
    };

    aggre1_noc: interconnect@16e0000 {
      compatible = "qcom,sm8550-aggre1-noc";
      reg = <0x016e0000 0x14400>;
      #interconnect-cells = <2>;
      clocks = <&gcc GCC_AGGRE_UFS_PHY_AXI_CLK>,
               <&gcc GCC_AGGRE_USB3_PRIM_AXI_CLK>;
      qcom,bcm-voters = <&apps_bcm_voter>;
    };
```
```
~~~~

## Documentation/devicetree/bindings/interconnect/qcom,sm8650-rpmh_cn.yaml
~~~~yaml
```yaml
# SPDX-许可证标识符: (GPL-2.0 或 BSD-2-Clause)
%YAML 1.2
---
$id: http://devicetree.org/schemas/interconnect/qcom,sm8650-rpmh.yaml#
$schema: http://devicetree.org/meta-schemas/core.yaml#

title: 高通 SM8650 上的 RPMh 网络芯片互连

maintainers:
  - Abel Vesa <abel.vesa@linaro.org>
  - Neil Armstrong <neil.armstrong@linaro.org>

description: |
  RPMh 互连提供者通过 RPMh 硬件加速器（称为总线时钟管理器 (BCM)）支持系统带宽需求。提供者能够通过与每个执行环境相关的资源状态协调器 (RSC) 与 BCM 进行通信。提供者节点必须指向至少一个与其 RSC 相关的 RPMh 设备子节点，且每个提供者可以映射到多个 RPMh 资源。
更多信息参见: include/dt-bindings/interconnect/qcom,sm8650-rpmh.h

properties:
  compatible:
    enum:
      - qcom,sm8650-aggre1-noc
      - qcom,sm8650-aggre2-noc
      - qcom,sm8650-clk-virt
      - qcom,sm8650-cnoc-main
      - qcom,sm8650-config-noc
      - qcom,sm8650-gem-noc
      - qcom,sm8650-lpass-ag-noc
      - qcom,sm8650-lpass-lpiaon-noc
      - qcom,sm8650-lpass-lpicx-noc
      - qcom,sm8650-mc-virt
      - qcom,sm8650-mmss-noc
      - qcom,sm8650-nsp-noc
      - qcom,sm8650-pcie-anoc
      - qcom,sm8650-system-noc

  reg:
    maxItems: 1

  clocks:
    minItems: 1
    maxItems: 2

required:
  - compatible

allOf:
  - $ref: qcom,rpmh-common.yaml#
  - if:
      properties:
        compatible:
          contains:
            enum:
              - qcom,sm8650-clk-virt
              - qcom,sm8650-mc-virt
    then:
      properties:
        reg: false
    else:
      required:
        - reg

  - if:
      properties:
        compatible:
          contains:
            enum:
              - qcom,sm8650-pcie-anoc
    then:
      properties:
        clocks:
          items:
            - description: aggre-NOC PCIe AXI 时钟
            - description: cfg-NOC PCIe a-NOC AHB 时钟

  - if:
      properties:
        compatible:
          contains:
            enum:
              - qcom,sm8650-aggre1-noc
    then:
      properties:
        clocks:
          items:
            - description: aggre UFS PHY AXI 时钟
            - description: aggre USB3 PRIM AXI 时钟

  - if:
      properties:
        compatible:
          contains:
            enum:
              - qcom,sm8650-aggre2-noc
    then:
      properties:
        clocks:
          items:
            - description: RPMH CC IPA 时钟

  - if:
      properties:
        compatible:
          contains:
            enum:
              - qcom,sm8650-aggre1-noc
              - qcom,sm8650-aggre2-noc
              - qcom,sm8650-pcie-anoc
    then:
      required:
        - clocks
    else:
      properties:
        clocks: false

unevaluatedProperties: false

examples:
  - |
    clk_virt: interconnect-0 {
      compatible = "qcom,sm8650-clk-virt";
      #interconnect-cells = <2>;
      qcom,bcm-voters = <&apps_bcm_voter>;
    };

    aggre1_noc: interconnect@16e0000 {
      compatible = "qcom,sm8650-aggre1-noc";
      reg = <0x016e0000 0x14400>;
      #interconnect-cells = <2>;
      clocks = <&gcc_phy_axi_clk>, <&gcc_prim_axi_clk>;
      qcom,bcm-voters = <&apps_bcm_voter>;
    };
```
```
~~~~

## Documentation/devicetree/bindings/interconnect/qcom,x1e80100-rpmh_cn.yaml
~~~~yaml
```yaml
# SPDX-许可证标识符: (GPL-2.0 或 BSD-2-Clause)
%YAML 1.2
---
$id: http://devicetree.org/schemas/interconnect/qcom,x1e80100-rpmh.yaml#
$schema: http://devicetree.org/meta-schemas/core.yaml#

title: Qualcomm RPMh 网络芯片互连在 X1E80100 上

maintainers:
  - Rajendra Nayak <quic_rjendra@quicinc.com>
  - Abel Vesa <abel.vesa@linaro.org>

description: |
  RPMh 互连提供者通过 RPMh 硬件加速器（称为总线时钟管理器 (BCM)）支持系统带宽需求。
  提供者能够通过与每个执行环境相关的资源状态协调器 (RSC) 与 BCM 进行通信。
  提供者节点必须指向至少一个与其 RSC 相关的 RPMh 设备子节点，且每个提供者可以映射到多个 RPMh 资源。
更多信息见:: include/dt-bindings/interconnect/qcom,x1e80100-rpmh.h

properties:
  compatible:
    enum:
      - qcom,x1e80100-aggre1-noc
      - qcom,x1e80100-aggre2-noc
      - qcom,x1e80100-clk-virt
      - qcom,x1e80100-cnoc-cfg
      - qcom,x1e80100-cnoc-main
      - qcom,x1e80100-gem-noc
      - qcom,x1e80100-lpass-ag-noc
      - qcom,x1e80100-lpass-lpiaon-noc
      - qcom,x1e80100-lpass-lpicx-noc
      - qcom,x1e80100-mc-virt
      - qcom,x1e80100-mmss-noc
      - qcom,x1e80100-nsp-noc
      - qcom,x1e80100-pcie-center-anoc
      - qcom,x1e80100-pcie-north-anoc
      - qcom,x1e80100-pcie-south-anoc
      - qcom,x1e80100-system-noc
      - qcom,x1e80100-usb-center-anoc
      - qcom,x1e80100-usb-north-anoc
      - qcom,x1e80100-usb-south-anoc

  reg:
    maxItems: 1

required:
  - compatible

allOf:
  - $ref: qcom,rpmh-common.yaml#
  - if:
      properties:
        compatible:
          contains:
            enum:
              - qcom,x1e80100-clk-virt
              - qcom,x1e80100-mc-virt
    then:
      properties:
        reg: false
    else:
      required:
        - reg

unevaluatedProperties: false

examples:
  - |
    clk_virt: interconnect-0 {
      compatible = "qcom,x1e80100-clk-virt";
      #interconnect-cells = <2>;
      qcom,bcm-voters = <&apps_bcm_voter>;
    };

    aggre1_noc: interconnect@16e0000 {
      compatible = "qcom,x1e80100-aggre1-noc";
      reg = <0x016e0000 0x14400>;
      #interconnect-cells = <2>;
      qcom,bcm-voters = <&apps_bcm_voter>;
    };
```
```
~~~~
