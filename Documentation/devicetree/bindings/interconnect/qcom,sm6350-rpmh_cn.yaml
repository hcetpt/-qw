## Documentation/devicetree/bindings/leds/backlight/lp855x-backlight_cn.yaml
~~~~yaml
# SPDX-许可证标识符: (GPL-2.0 或 BSD-2-Clause)
%YAML 1.2
---
$id: http://devicetree.org/schemas/leds/backlight/lp855x-backlight.yaml#
$schema: http://devicetree.org/meta-schemas/core.yaml#

title: 德州仪器 LP855X 背光控制器

maintainers:
  - Artur Weber <aweber.kernel@gmail.com>

properties:
  compatible:
    enum:
      - ti,lp8550
      - ti,lp8551
      - ti,lp8552
      - ti,lp8553
      - ti,lp8555
      - ti,lp8556
      - ti,lp8557

  reg:
    maxItems: 1

  dev-ctrl:
    $ref: /schemas/types.yaml#/definitions/uint8
    description:
      设备控制寄存器的值。这是一个特定于设备的值。
bl-name:
    $ref: /schemas/types.yaml#/definitions/string
    description: 背光设备名称
init-brt:
    $ref: /schemas/types.yaml#/definitions/uint8
    description: 初始背光亮度值
power-supply:
    description: 控制3V电源轨的稳压器
enable-supply:
    description: 控制EN/VDDIO输入的稳压器
pwms:
    maxItems: 1
    description: |
      用于控制背光的PWM通道；设置此属性将启用基于PWM的背光控制模式
pwm-names: true

  pwm-period:
    $ref: /schemas/types.yaml#/definitions/uint32
    description:
      PWM周期值。已弃用；请在pwms属性中设置周期值
deprecated: true

patternProperties:
  "^rom-[0-9a-f]{2}h$":
    type: object
    description: 包含配置寄存器值的节点
additionalProperties: false
    properties:
      rom-addr:
        $ref: /schemas/types.yaml#/definitions/uint8
        description: 要更新的ROM区域的寄存器地址
rom-val:
        $ref: /schemas/types.yaml#/definitions/uint8
        description: 写入ROM寄存器的值
下面是给定的Device Tree Blob (DTB) 配置片段的中文翻译，这些配置用于定义I2C总线上的背光控制器。

```plaintext
# 必需字段：
- compatible（兼容性）
- reg（寄存器地址）
- dev-ctrl（设备控制）

# 不允许未评估的属性
unevaluatedProperties: false

# 示例
examples:
  - |
    i2c {  # I2C 总线
        #address-cells = <1>;  # 地址单元数量为 1
        #size-cells = <0>;  # 大小单元数量为 0

        backlight@2c {  # 背光控制器，地址为 0x2c
            compatible = "ti,lp8555";  # 兼容 ti,lp8555 芯片
            reg = <0x2c>;  # 寄存器地址为 0x2c

            dev-ctrl = /bits/ 8 <0x00>;  # 设备控制，8位宽度，值为 0x00

            pwms = <&pwm 0 10000>;  # PWM 控制信息
            pwm-names = "lp8555";  # PWM 名称

            /* 4V 过压保护，启用第 0 组输出 LED */
            rom-14h {  # ROM 地址为 0x14
              rom-addr = /bits/ 8 <0x14>;  # ROM 地址，8位宽度，值为 0x14
              rom-val = /bits/ 8 <0xcf>;  # ROM 值，8位宽度，值为 0xcf
            };

            /* 重平滑处理，24ms 的斜坡时间步长 */
            rom-15h {  # ROM 地址为 0x15
              rom-addr = /bits/ 8 <0x15>;  # ROM 地址，8位宽度，值为 0x15
              rom-val = /bits/ 8 <0xc7>;  # ROM 值，8位宽度，值为 0xc7
            };

            /* 启用第 1 组输出 LED */
            rom-19h {  # ROM 地址为 0x19
              rom-addr = /bits/ 8 <0x19>;  # ROM 地址，8位宽度，值为 0x19
              rom-val = /bits/ 8 <0x0f>;  # ROM 值，8位宽度，值为 0x0f
            };
        };
    };
  - |
    i2c {  # I2C 总线
        #address-cells = <1>;  # 地址单元数量为 1
        #size-cells = <0>;  # 大小单元数量为 0

        backlight@2c {  # 背光控制器，地址为 0x2c
            compatible = "ti,lp8556";  # 兼容 ti,lp8556 芯片
            reg = <0x2c>;  # 寄存器地址为 0x2c

            bl-name = "lcd-bl";  # 背光名称
            dev-ctrl = /bits/ 8 <0x85>;  # 设备控制，8位宽度，值为 0x85
            init-brt = /bits/ 8 <0x10>;  # 初始亮度，8位宽度，值为 0x10
        };
      };
  - |
    i2c {  # I2C 总线
        #address-cells = <1>;  # 地址单元数量为 1
        #size-cells = <0>;  # 大小单元数量为 0

        backlight@2c {  # 背光控制器，地址为 0x2c
            compatible = "ti,lp8557";  # 兼容 ti,lp8557 芯片
            reg = <0x2c>;  # 寄存器地址为 0x2c
            enable-supply = <&backlight_vddio>;  # 启用电源供应
            power-supply = <&backlight_vdd>;  # 电源供应

            dev-ctrl = /bits/ 8 <0x41>;  # 设备控制，8位宽度，值为 0x41
            init-brt = /bits/ 8 <0x0a>;  # 初始亮度，8位宽度，值为 0x0a

            /* 4V 过压保护，启用 LED 输出串 */
            rom-14h {  # ROM 地址为 0x14
              rom-addr = /bits/ 8 <0x14>;  # ROM 地址，8位宽度，值为 0x14
              rom-val = /bits/ 8 <0xcf>;  # ROM 值，8位宽度，值为 0xcf
            };
        };
    };
```

以上是 Device Tree Blob (DTB) 中关于背光控制器配置的示例，其中定义了不同的芯片型号以及它们的初始化参数。```
~~~~

## Documentation/devicetree/bindings/leds/backlight/mediatek,mt6370-backlight_cn.yaml
```yaml
# SPDX-文件许可人: (GPL-2.0-only 或 BSD-2-Clause)
%YAML 1.2
---
$id: http://devicetree.org/schemas/leds/backlight/mediatek,mt6370-backlight.yaml#
$schema: http://devicetree.org/meta-schemas/core.yaml#

title: MediaTek MT6370 背光

maintainers:
  - ChiaEn Wu <chiaen_wu@richtek.com>

description: |
  本模块是 MT6370 多功能设备的一部分。
MT6370 背光 WLED 驱动支持高达 29V 的输出电压，用于 4 通道串联的 8 个 WLED。每个通道支持最高 30mA 的电流能力，并具有 2048 个电流步进（11 位，仅适用于 MT6370/MT6371）或 16384 个电流步进（14 位，仅适用于 MT6372），可在指数或线性映射曲线中使用。
allOf:
  - $ref: common.yaml#

properties:
  compatible:
    enum:
      - mediatek,mt6370-backlight
      - mediatek,mt6372-backlight

  default-brightness:
    minimum: 0

  max-brightness:
    minimum: 0

  enable-gpios:
    description: 外部背光“启用”引脚
    maxItems: 1

  mediatek,bled-pwm-enable:
    description: |
      启用外部 PWM 输入以调节背光亮度
    type: boolean

  mediatek,bled-pwm-hys-enable:
    description: |
      启用背光输入迟滞以用于 PWM 模式
    type: boolean

  mediatek,bled-pwm-hys-input-th-steps:
    $ref: /schemas/types.yaml#/definitions/uint8
    enum: [1, 4, 16, 64]
    description: |
      选择背光 PWM 分辨率的上、下限阈值。如果我们选择 64，则 PWM 分辨率的变化需要超过 64 步。
mediatek,bled-ovp-shutdown:
    description: |
      当达到过压保护 (OVP) 级别时启用背光关闭
    type: boolean

  mediatek,bled-ovp-microvolt:
    enum: [17000000, 21000000, 25000000, 29000000]
    description: |
      背光过压保护 (OVP) 级别选择
mediatek,bled-ocp-shutdown:
    description: |
      当达到过流保护 (OCP) 级别时启用背光关闭
    type: boolean

  mediatek,bled-ocp-microamp:
    enum: [900000, 1200000, 1500000, 1800000]
    description: |
      背光过流保护 (OCP) 级别选择
mediatek,bled-exponential-mode-enable:
    description: |
      启用背光亮度的指数模式。如果未启用此属性，默认情况下将使用线性模式。
    type: boolean

  mediatek,bled-channel-use:
    $ref: /schemas/types.yaml#/definitions/uint8
    description: |
      使用的背光 LED 通道
每位映射到：
        - 0: CH4
        - 1: CH3
        - 2: CH2
        - 3: CH1
    minimum: 1
    maximum: 15

if:
  properties:
    compatible:
      contains:
        const: mediatek,mt6372-backlight

then:
  properties:
    default-brightness:
      maximum: 16384

    max-brightness:
      maximum: 16384

else:
  properties:
    default-brightness:
      maximum: 2048

    max-brightness:
      maximum: 2048

required:
  - compatible
  - mediatek,bled-channel-use

additionalProperties: false
```

## Documentation/devicetree/bindings/leds/backlight/mps,mp3309c_cn.yaml
~~~~yaml
```yaml
# SPDX-许可证标识符: (GPL-2.0 或 BSD-2-Clause)
%YAML 1.2
---
$id: http://devicetree.org/schemas/leds/backlight/mps,mp3309c.yaml#
$schema: http://devicetree.org/meta-schemas/core.yaml#

title: MPS MP3309C 背光

maintainers:
  - Flavio Suligoi <f.suligoi@asem.it>

description: |
  Monolithic Power (MPS) MP3309C 是一款 WLED 升压转换器，具有可编程的开关频率以优化效率。
它支持两种不同的调光模式：

  - 模拟模式，默认模式（32级调光），通过 I2C 命令控制
  - PWM 控制模式（可选）

  数据手册可在以下网址获取：
  https://www.monolithicpower.com/en/mp3309c.html

allOf:
  - $ref: common.yaml#

properties:
  compatible:
    const: mps,mp3309c

  reg:
    maxItems: 1

  pwms:
    description: 如果存在，则背光在 PWM 模式下被控制
maxItems: 1

  enable-gpios:
    description: 用于在 "analog-i2c" 调光模式下启用背光的 GPIO
maxItems: 1

  mps,overvoltage-protection-microvolt:
    description: 过电压保护（13.5V、24V 或 35.5V）
enum: [ 13500000, 24000000, 35500000 ]
    default: 35500000

  mps,no-sync-mode:
    description: 禁用同步整流模式
    type: boolean

required:
  - compatible
  - reg

unevaluatedProperties: false

examples:
  - |
    i2c {
        #address-cells = <1>;
        #size-cells = <0>;

        /* 使用 PWM 控制的背光 */
        backlight_pwm: backlight@17 {
            compatible = "mps,mp3309c";
            reg = <0x17>;
            pwms = <&pwm1 0 3333333 0>; /* 300 Hz --> (1/f) * 1*10^9 */
            brightness-levels = <0 4 8 16 32 64 128 255>;
            default-brightness = <6>;
            mps,overvoltage-protection-microvolt = <24000000>;
        };
    };
```

此 YAML 文件定义了针对 Monolithic Power Systems (MPS) MP3309C 背光设备的 Device Tree 兼容性规范。MP3309C 是一种 WLED 升压转换器，可通过 I2C 或 PWM 控制来调节亮度。文档还包含了配置示例。
~~~~

## Documentation/devicetree/bindings/leds/backlight/pwm-backlight_cn.yaml
~~~~yaml
```yaml
# SPDX-文件许可标识符: GPL-2.0-only
%YAML 1.2
---
$id: http://devicetree.org/schemas/leds/backlight/pwm-backlight.yaml#
$schema: http://devicetree.org/meta-schemas/core.yaml#

title: pwm-backlight

maintainers:
  - Lee Jones <lee@kernel.org>
  - Daniel Thompson <daniel.thompson@linaro.org>
  - Jingoo Han <jingoohan1@gmail.com>

allOf:
  - $ref: common.yaml#

properties:
  compatible:
    const: pwm-backlight

  pwms:
    maxItems: 1

  pwm-names: true

  power-supply:
    description: 供电电压的稳压器

  enable-gpios:
    description:
      包含一个GPIO指定，用于启用和禁用背光
    maxItems: 1

  post-pwm-on-delay-ms:
    description:
      在设置初始（非零）PWM与使用GPIO启用背光之间的延迟（毫秒）
      
  pwm-off-delay-ms:
    description:
      在使用GPIO禁用背光与将PWM值设为0之间的延迟（毫秒）

  num-interpolated-steps:
    description:
      亮度级别表中每个值之间插值步骤的数量。这样可以在不需在亮度级别数组中列出所有可能值的情况下使用高分辨率的PWM占空比
    $ref: /schemas/types.yaml#/definitions/uint32

dependencies:
  default-brightness-level: [brightness-levels]
  num-interpolated-steps: [brightness-levels]

required:
  - compatible
  - pwms

unevaluatedProperties: false

examples:
  - |
    backlight {
        compatible = "pwm-backlight";
        pwms = <&pwm 0 5000000>;

        brightness-levels = <0 4 8 16 32 64 128 255>;
        default-brightness-level = <6>;

        power-supply = <&vdd_bl_reg>;
        enable-gpios = <&gpio 58 0>;
        post-pwm-on-delay-ms = <10>;
        pwm-off-delay-ms = <10>;
    };

  - |
    // 使用num-interpolation-steps的示例：
    backlight {
        compatible = "pwm-backlight";
        pwms = <&pwm 0 5000000>;

        brightness-levels = <0 2048 4096 8192 16384 65535>;
        num-interpolated-steps = <2048>;
        default-brightness-level = <4096>;

        power-supply = <&vdd_bl_reg>;
        enable-gpios = <&gpio 58 0>;
    };
```
请注意，某些字段如 `description` 和注释已根据上下文进行了翻译。如果需要更详细的翻译或者调整，请告诉我。
~~~~

## Documentation/devicetree/bindings/leds/backlight/qcom-wled_cn.yaml
~~~~yaml
# SPDX-许可证标识符: (GPL-2.0 或 BSD-2-Clause)
%YAML 1.2
---
$id: http://devicetree.org/schemas/leds/backlight/qcom-wled.yaml#
$schema: http://devicetree.org/meta-schemas/core.yaml#

标题: Qualcomm Technologies, Inc. 的 WLED 驱动程序

维护者:
  - Bjorn Andersson <andersson@kernel.org>
  - Kiran Gunda <quic_kgunda@quicinc.com>

描述: |
  WLED（白色发光二极管）驱动程序用于控制作为 Qualcomm Technologies, Inc. 参考平台上电源管理 IC (PMIC) 一部分的显示背光。该 PMIC 通过 SPMI 总线与主机处理器相连。
属性:
  compatible:
    枚举:
      - qcom,pm8941-wled
      - qcom,pmi8950-wled
      - qcom,pmi8994-wled
      - qcom,pmi8998-wled
      - qcom,pm660l-wled
      - qcom,pm6150l-wled
      - qcom,pm8150l-wled

  reg:
    minItems: 1
    maxItems: 2

  default-brightness:
    描述: |
      启动时的亮度值
    label: true

  max-brightness:
    描述: |
      最大亮度级别

  qcom,cs-out:
    描述: |
      启用电流阱输出
    此属性仅在 WLED3 中支持
    类型: 布尔值

  qcom,cabc:
    描述: |
      启用内容自适应背光控制
    类型: 布尔值

  qcom,ext-gen:
    描述: |
      使用外部生成的调制信号进行调光
    此属性仅在 WLED3 中支持
    类型: 布尔值

  qcom,current-limit:
    描述: |
      mA；每串电流限制
    此属性仅在 WLED3 中支持
这段文本定义了一系列与特定硬件配置相关的属性，主要针对Qualcomm（QCOM）的WLED设备。下面是这些属性的中文翻译：

```yaml
# uint32 类型引用
$ref: /schemas/types.yaml#/definitions/uint32
    # 默认值
    default: 20
    # 最小值
    minimum: 0
    # 最大值
    maximum: 25

# qcom,current-limit-microamp 属性
qcom,current-limit-microamp:
    # 描述：每串的微安 (uA) 电流限制
    description: |
      uA; 每串的电流限制
    # 默认值
    default: 25
    # 最小值
    minimum: 0
    # 最大值
    maximum: 30000
    # 必须为该数的倍数
    multipleOf: 25

# qcom,current-boost-limit 属性
qcom,current-boost-limit:
    # 描述：毫安 (mA) 提升电流限制
    description: |
      mA; 提升电流限制
    # 类型引用
    $ref: /schemas/types.yaml#/definitions/uint32

# qcom,switching-freq 属性
qcom,switching-freq:
    # 描述：千赫兹 (kHz) 开关频率
    description: |
      kHz; 开关频率
    # 类型引用
    $ref: /schemas/types.yaml#/definitions/uint32
    # 枚举值
    enum: [ 600, 640, 685, 738, 800, 872, 960, 1066, 1200, 1371, 1600, 1920,
            2400, 3200, 4800, 9600 ]

# qcom,ovp 属性
qcom,ovp:
    # 描述：伏特 (V) 过压保护限值；此属性仅支持 WLED3
    description: |
      V; 过电压保护限值。此属性仅适用于 WLED3。
    # 类型引用
    $ref: /schemas/types.yaml#/definitions/uint32
    # 枚举值
    enum: [ 27, 29, 32, 35 ]
    # 默认值
    default: 29

# qcom,ovp-millivolt 属性
qcom,ovp-millivolt:
    # 描述：过压保护限值；此属性仅适用于 WLED4
    description: |
      过电压保护限值。此属性仅适用于 WLED4。
    # 类型引用
    $ref: /schemas/types.yaml#/definitions/uint32
    # 枚举值
    enum: [ 18100, 19600, 29600, 31100 ]
    # 默认值
    default: 29600

# qcom,num-strings 属性
qcom,num-strings:
    # 描述：连接的 LED 串的数量
    description: |
      连接的 LED 串的数量
    # 类型引用
    $ref: /schemas/types.yaml#/definitions/uint32

# qcom,enabled-strings 属性
qcom,enabled-strings:
    # 描述：启用的 LED 串数组，编号从 0 到 3。每串 LED 都单独运行。指定设备使用的 LED 串列表。可以使用任意组合的 LED 串。
    description: |
      数组中的 WLED 串编号从 0 到 3。每个 LED 串都单独运行。指定设备使用的 LED 串列表。可以使用任意组合的 LED 串。
    # 类型引用
    $ref: /schemas/types.yaml#/definitions/uint32-array
    # 最小项数
    minItems: 1
    # 最大项数
    maxItems: 4

# qcom,external-pfet 属性
qcom,external-pfet:
    # 描述：指定是否使用外部 PFET 控制以实现短路保护。此属性仅适用于 WLED4。
    description: |
      指定是否使用外部 PFET 控制以实现短路保护。此属性仅适用于 WLED4。
    # 类型：布尔值
    type: boolean

# qcom,auto-string-detection 属性
qcom,auto-string-detection:
    # 描述：启用 WLED 串配置的自动检测
    description: |
      启用 WLED 串配置的自动检测
```

请注意，上述翻译已尽量保持原文格式和结构，以便于理解各属性的具体含义。
此特性不支持WLED3类型：布尔

中断：
    最少项目：1
    项目：
      - 描述：过电压保护中断
      - 描述：短路中断
中断名称：
    最少项目：1
    项目：
      - 常量：ovp
      - 常量：short

`qcom,modulator-sel`：
    描述： |
      选择用于亮度调制的调制器
允许的值为：
           0 - 调制器 A
           1 - 调制器 B
      此属性仅适用于WLED5外设
$ref: /schemas/types.yaml#/definitions/uint32
    枚举：[ 0, 1 ]
    默认：0

`qcom,cabc-sel`：
    描述： |
      选择用于亮度调制的CABC引脚信号
允许的值为：
           0 - 禁用CABC
           1 - CABC 1
           2 - CABC 2
           3 - 使用外部信号（例如LPG）进行调光
      此属性仅适用于WLED5外设
$ref: /schemas/types.yaml#/definitions/uint32
    枚举：[ 0, 1, 2, 3 ]

全部满足以下条件之一：
  - 如果：
      属性：
        兼容性：
          包含：
            常量：qcom,pm8941-wled

    那么：
      属性：
        reg：
          最大项目：1

        `qcom,current-boost-limit`：
          枚举：[ 105, 385, 525, 805, 980, 1260, 1400, 1680 ]
          默认：805

        `qcom,switching-freq`：
          默认：1600

        `qcom,num-strings`：
          枚举：[ 1, 2, 3 ]

        中断：
          最大项目：1

        中断名称：
          最大项目：1

    否则：
      属性：
        reg：
          最少项目：2

        `qcom,current-boost-limit`：
          枚举：[ 105, 280, 450, 620, 970, 1150, 1300, 1500 ]
          默认：970

        `qcom,switching-freq`：
          默认：800

        `qcom,num-strings`：
          枚举：[ 1, 2, 3, 4 ]

        中断：
          最少项目：2

        中断名称：
          最少项目：2
  - 如果：
      属性：
        兼容性：
          包含：
            枚举：
              - qcom,pm8150l-wled

    那么：
      属性：
        default-brightness：
          最小值：0
          最大值：32767

        max-brightness：
          最小值：0
          最大值：32767

    否则：
      属性：
        default-brightness：
          最小值：0
          最大值：4095

        max-brightness：
          最小值：0
          最大值：4095

必需：
  - 兼容性
  - reg
  - 标签

不允许额外属性

示例：
  - |
    backlight@d800 {
        兼容性 = "qcom,pm8941-wled";
        reg = <0xd800 0x100>;
        标签 = "backlight";

        qcom,cs-out;
        qcom,current-limit = <20>;
        qcom,current-boost-limit = <805>;
        qcom,switching-freq = <1600>;
        qcom,ovp = <29>;
        qcom,num-strings = <2>;
        qcom,enabled-strings = <0 1>;
    };
~~~~
