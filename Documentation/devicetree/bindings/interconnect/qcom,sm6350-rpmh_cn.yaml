## Documentation/devicetree/bindings/interconnect/samsung,exynos-bus_cn.yaml
~~~~yaml
# SPDX-许可证标识符: GPL-2.0
%YAML 1.2
---
$id: http://devicetree.org/schemas/interconnect/samsung,exynos-bus.yaml#
$schema: http://devicetree.org/meta-schemas/core.yaml#

标题: Samsung Exynos 系统级芯片总线和互连

维护者:
  - Chanwoo Choi <cw00.choi@samsung.com>
  - Krzysztof Kozlowski <krzk@kernel.org>

描述: |
  Samsung Exynos 系统级芯片有许多用于数据传输的总线，这些总线连接DRAM与系统级芯片中的子模块。大多数Exynos系统级芯片共享通用的总线架构。通常，每个Exynos系统级芯片的总线包括一个源时钟和一条电源线，可以在运行时改变总线的时钟频率。为了监控每个总线在运行时的使用情况，驱动程序使用PPMU（平台性能监控单元），它可以测量子模块的当前负载。
  Exynos系统级芯片包含许多具有各自AXI总线的子模块。每个AXI总线拥有自己的源时钟，但并非每条总线都有唯一的电源线。电源线可能被一个或多个子模块共享。因此，我们可以根据每个子模块的角色将设备分为两种类型：父总线设备和被动总线设备。

  基本上，父总线设备和被动总线设备共享相同的电源线。父总线设备可以更改共享电源线的电压，而其余的总线设备（被动总线设备）则依赖于父总线设备的决策。如果三个模块共享VDD_xxx电源线，则只有一个模块应该作为父设备，而其他模块应作为被动设备依赖于该父设备。
VDD_xxx |--- A模块 (父设备)
      |--- B模块 (被动设备)
      |--- C模块 (被动设备)

  Exynos系统级芯片之间的电源线与子模块的组成略有不同，因为每个Exynos系统级芯片有不同的子模块。因此，这种差异应在设备树文件中而不是在每个设备驱动程序中指定。最终，这个驱动程序能够支持所有Exynos系统级芯片的总线频率。
根据Exynos系统级芯片的不同，子模块与电源线之间详细的关联关系如下：
   - 对于Exynos3250，有两个电源线如下所示：
     VDD_MIF |--- DMC (动态内存控制器)

     VDD_INT |--- LEFTBUS (父设备)
       |--- PERIL
       |--- MFC
       |--- G3D
       |--- RIGHTBUS
       |--- PERIR
       |--- FSYS
       |--- LCD0
       |--- PERIR
       |--- ISP
       |--- CAM

     - MIF总线的频率/电压表
       -----------------------
       |Lv| Freq   | Voltage |
       -----------------------
       |L1| 50000  |800000   |
       |L2| 100000 |800000   |
       |L3| 134000 |800000   |
       |L4| 200000 |825000   |
       |L5| 400000 |875000   |
       -----------------------

     - INT总线的频率/电压表
       ----------------------------------------------------------
       |Block|LEFTBUS|RIGHTBUS|MCUISP |ISP    |PERIL  ||VDD_INT |
       | 名称|       |LCD0    |       |       |       ||        |
       |     |       |FSYS    |       |       |       ||        |
       |     |       |MFC     |       |       |       ||        |
       ----------------------------------------------------------
       |模式 |*父设备|被动设备 |被动设备|被动设备|被动设备||        |
       ----------------------------------------------------------
       |Lv   |Frequency                               ||Voltage |
       ----------------------------------------------------------
       |L1   |50000  |50000   |50000  |50000  |50000  ||900000  |
       |L2   |80000  |80000   |80000  |80000  |80000  ||900000  |
       |L3   |100000 |100000  |100000 |100000 |100000 ||1000000 |
       |L4   |134000 |134000  |200000 |200000 |       ||1000000 |
       |L5   |200000 |200000  |400000 |300000 |       ||1000000 |
       ----------------------------------------------------------

   - 对于Exynos4210，有一个电源线如下所示：
     VDD_INT |--- DMC (父设备，动态内存控制器)
       |--- LEFTBUS
       |--- PERIL
       |--- MFC(L)
       |--- G3D
       |--- TV
       |--- LCD0
       |--- RIGHTBUS
       |--- PERIR
       |--- MFC(R)
       |--- CAM
       |--- FSYS
       |--- GPS
       |--- LCD0
       |--- LCD1

   - 对于Exynos4x12，有两个电源线如下所示：
     VDD_MIF |--- DMC (动态内存控制器)

     VDD_INT |--- LEFTBUS (父设备)
       |--- PERIL
       |--- MFC(L)
       |--- G3D
       |--- TV
       |--- IMAGE
       |--- RIGHTBUS
       |--- PERIR
       |--- MFC(R)
       |--- CAM
       |--- FSYS
       |--- GPS
       |--- LCD0
       |--- ISP

   - 对于Exynos5422，有两个电源线如下所示：
     VDD_MIF |--- DREX 0 (父设备，DRAM Express 控制器)
             |--- DREX 1

     VDD_INT |--- NoC_Core (父设备)
       |--- G2D
       |--- G3D
       |--- DISP1
       |--- NoC_WCORE
       |--- GSCL
       |--- MSCL
       |--- ISP
       |--- MFC
       |--- GEN
       |--- PERIS
       |--- PERIC
       |--- FSYS
       |--- FSYS2

   - 对于Exynos5433，有一个VDD_INT电源线如下所示：
     VDD_INT |--- G2D (父设备)
       |--- MSCL
       |--- GSCL
       |--- JPEG
       |--- MFC
       |--- HEVC
       |--- BUS0
       |--- BUS1
       |--- BUS2
       |--- PERIS (固定时钟速率)
       |--- PERIC (固定时钟速率)
       |--- FSYS  (固定时钟速率)

属性:
  compatible:
    枚举:
      - samsung,exynos-bus

  clocks:
    最大项数: 1

  clock-names:
    项:
      - 常量: bus

  devfreq:
    $引用: /schemas/types.yaml#/definitions/phandle
    描述:
      父总线设备。仅对被动总线设备有效且必需
devfreq-events:
    $引用: /schemas/types.yaml#/definitions/phandle-array
    最小项数: 1
    最大项数: 4
    描述:
      用于监控总线当前利用率的Devfreq事件设备。仅对父总线设备有效且必需
exynos,saturation-ratio:
    $引用: /schemas/types.yaml#/definitions/uint32
    描述:
      百分比值，用于校准性能计数与总周期计数。仅对父总线设备有效
'#interconnect-cells':
    常量: 0

  interconnects:
    最小项数: 1
    最大项数: 2

  operating-points-v2: true
  opp-table:
    类型: 对象

  samsung,data-clock-ratio:
    $引用: /schemas/types.yaml#/definitions/uint32
    默认: 8
    描述:
      数据吞吐量（B/s）与最小数据时钟频率（Hz）之比
vdd-supply:
    描述:
      主总线电源轨。仅对父总线设备有效且必需
The provided text describes device tree bindings for configuring system components, specifically focusing on buses and their power management. Below is the translation of the given examples into Chinese:

### 示例

#### 示例 1
```yaml
# 包含时钟绑定
#include <dt-bindings/clock/exynos3250.h>

bus-dmc {  # DMC 总线
    compatible = "samsung,exynos-bus";  # 兼容性
    clocks = <&cmu_dmc CLK_DIV_DMC>;  # 时钟源
    clock-names = "bus";  # 时钟名称
    operating-points-v2 = <&bus_dmc_opp_table>;  # 运行点表
    devfreq-events = <&ppmu_dmc0_3>, <&ppmu_dmc1_3>;  # 动态频率调整事件
    vdd-supply = <&buck1_reg>;  # 供电

    bus_dmc_opp_table: opp-table {  # 运行点表
        compatible = "operating-points-v2";  # 兼容性

        opp-50000000 {  # 运行点 50MHz
            opp-hz = /bits/ 64 <50000000>;  # 频率
            opp-microvolt = <800000>;  # 电压
        };
        opp-100000000 {  # 运行点 100MHz
            opp-hz = /bits/ 64 <100000000>;  # 频率
            opp-microvolt = <800000>;  # 电压
        };
        opp-134000000 {  # 运行点 134MHz
            opp-hz = /bits/ 64 <134000000>;  # 频率
            opp-microvolt = <800000>;  # 电压
        };
        opp-200000000 {  # 运行点 200MHz
            opp-hz = /bits/ 64 <200000000>;  # 频率
            opp-microvolt = <825000>;  # 电压
        };
        opp-400000000 {  # 运行点 400MHz
            opp-hz = /bits/ 64 <400000000>;  # 频率
            opp-microvolt = <875000>;  # 电压
        };
    };
};

ppmu_dmc0: ppmu@106a0000 {  # PPMU 控制器
    compatible = "samsung,exynos-ppmu";  # 兼容性
    reg = <0x106a0000 0x2000>;  # 寄存器地址
    events {  # 事件
        ppmu_dmc0_3: ppmu-event3-dmc0 {  # 事件 3
            event-name = "ppmu-event3-dmc0";  # 事件名称
        };
    };
};

bus_leftbus {  # 左侧总线
    compatible = "samsung,exynos-bus";  # 兼容性
    clocks = <&cmu CLK_DIV_GDL>;  # 时钟源
    clock-names = "bus";  # 时钟名称
    operating-points-v2 = <&bus_leftbus_opp_table>;  # 运行点表
    devfreq-events = <&ppmu_leftbus_3>, <&ppmu_rightbus_3>;  # 动态频率调整事件
    vdd-supply = <&buck3_reg>;  # 供电
};

bus-rightbus {  # 右侧总线
    compatible = "samsung,exynos-bus";  # 兼容性
    clocks = <&cmu CLK_DIV_GDR>;  # 时钟源
    clock-names = "bus";  # 时钟名称
    operating-points-v2 = <&bus_leftbus_opp_table>;  # 运行点表
    devfreq = <&bus_leftbus>;  # 动态频率调整配置
};
```

#### 示例 2
```yaml
dmc: bus-dmc {  # DMC 总线
    compatible = "samsung,exynos-bus";  # 兼容性
    clocks = <&clock CLK_DIV_DMC>;  # 时钟源
    clock-names = "bus";  # 时钟名称
    operating-points-v2 = <&bus_dmc_opp_table>;  # 运行点表
    samsung,data-clock-ratio = <4>;  # 数据时钟比率
    #interconnect-cells = <0>;  # 互联单元描述
    devfreq-events = <&ppmu_dmc0_3>, <&ppmu_dmc1_3>;  # 动态频率调整事件
    vdd-supply = <&buck1_reg>;  # 供电
};

leftbus: bus-leftbus {  # 左侧总线
    compatible = "samsung,exynos-bus";  # 兼容性
    clocks = <&clock CLK_DIV_GDL>;  # 时钟源
    clock-names = "bus";  # 时钟名称
    operating-points-v2 = <&bus_leftbus_opp_table>;  # 运行点表
    interconnects = <&dmc>;  # 互联
    #interconnect-cells = <0>;  # 互联单元描述
    devfreq-events = <&ppmu_leftbus_3>, <&ppmu_rightbus_3>;  # 动态频率调整事件
    vdd-supply = <&buck3_reg>;  # 供电
};

display: bus-display {  # 显示总线
    compatible = "samsung,exynos-bus";  # 兼容性
    clocks = <&clock CLK_DIV_ACLK_266>;  # 时钟源
    clock-names = "bus";  # 时钟名称
    operating-points-v2 = <&bus_display_opp_table>;  # 运行点表
    interconnects = <&leftbus &dmc>;  # 互联
    #interconnect-cells = <0>;  # 互联单元描述
    devfreq = <&leftbus>;  # 动态频率调整配置
};
```
These examples demonstrate how to configure different buses and their associated power management settings within the device tree for an Exynos-based system.
~~~~

## Documentation/devicetree/bindings/leds/allwinner,sun50i-a100-ledc_cn.yaml
```yaml
# SPDX-许可证标识符: GPL-2.0-only 或 BSD-2-Clause
%YAML 1.2
---
$id: http://devicetree.org/schemas/leds/allwinner,sun50i-a100-ledc.yaml#
$schema: http://devicetree.org/meta-schemas/core.yaml#

标题: Allwinner A100 LED 控制器

维护者:
  - Samuel Holland <samuel@sholland.org>

描述:
  在 Allwinner sunxi 系统级芯片(SoC)中找到的 LED 控制器使用单线串行接口来驱动最多 1024 个 RGB LED。
属性:
  compatible:
    oneOf:
      - const: allwinner,sun50i-a100-ledc
      - items:
          - enum:
              - allwinner,sun20i-d1-ledc
              - allwinner,sun50i-r329-ledc
          - const: allwinner,sun50i-a100-ledc

  reg:
    maxItems: 1

  "#address-cells":
    const: 1

  "#size-cells":
    const: 0

  interrupts:
    maxItems: 1

  clocks:
    items:
      - description: 总线时钟
      - description: 模块时钟

  clock-names:
    items:
      - const: bus
      - const: mod

  resets:
    maxItems: 1

  dmas:
    maxItems: 1
    description: 发送 DMA 通道

  dma-names:
    const: tx

  allwinner,pixel-format:
    description: 像素格式（子像素传输顺序），默认为 "grb"
    enum:
      - bgr
      - brg
      - gbr
      - grb
      - rbg
      - rgb

  allwinner,t0h-ns:
    default: 336
    description: 发送 "0" 位时高脉冲的长度

  allwinner,t0l-ns:
    default: 840
    description: 发送 "0" 位时低脉冲的长度

  allwinner,t1h-ns:
    default: 882
    description: 发送 "1" 位时高脉冲的长度

  allwinner,t1l-ns:
    default: 294
    description: 发送 "1" 位时低脉冲的长度

  allwinner,treset-ns:
    default: 300000
    description: 传输帧之间的最小延迟

模式匹配属性:
  "^multi-led@[0-9a-f]+$":
    type: object
    $ref: leds-class-multicolor.yaml#
    unevaluatedProperties: false
    properties:
      reg:
        minimum: 0
        maximum: 1023
        description: LED 在序列中的索引（必须是连续的）

    required:
      - reg

必需:
  - compatible
  - reg
  - interrupts
  - clocks
  - clock-names
  - resets

additionalProperties: false

示例:
  - |
    #include <dt-bindings/interrupt-controller/irq.h>
    #include <dt-bindings/leds/common.h>

    ledc: led-controller@2008000 {
      compatible = "allwinner,sun20i-d1-ledc",
                   "allwinner,sun50i-a100-ledc";
      reg = <0x2008000 0x400>;
      interrupts = <36 IRQ_TYPE_LEVEL_HIGH>;
      clocks = <&ccu 12>, <&ccu 34>;
      clock-names = "bus", "mod";
      resets = <&ccu 12>;
      dmas = <&dma 42>;
      dma-names = "tx";
      #address-cells = <1>;
      #size-cells = <0>;

      multi-led@0 {
        reg = <0x0>;
        color = <LED_COLOR_ID_RGB>;
        function = LED_FUNCTION_INDICATOR;
      };
    };

..
```

## Documentation/devicetree/bindings/leds/ams,as3645a_cn.txt
~~~~
Analog devices AS3645A 设备树绑定

AS3645A 闪光 LED 控制器可以驱动两个 LED，一个大电流的闪光 LED 和一个指示 LED。大电流的闪光 LED 也可以用作手电筒模式。
下面标记为 [a, b] 的范围是指从 a 到 b 的闭区间，即包括 a 和 b 在内。

请同时参阅同一目录下的 common.txt 文件。

必需属性
==========

compatible : 必须是 "ams,as3645a"
reg       : 设备的 I2C 地址。通常为 0x30
#address-cells : 1
#size-cells    : 0

闪光子节点（0）的必需属性
=================================

reg: 0
flash-timeout-us: 闪光超时时间，单位为微秒。该值必须在 [100000, 850000] 范围内，并且可被 50000 整除
flash-max-microamp: 最大闪光电流，单位为微安。必须在 [200000, 500000] 范围内，并且可被 20000 整除
led-max-microamp: 最大手电筒（辅助）电流，单位为微安。该值必须在 [20000, 160000] 范围内，并且可被 20000 整除
ams,input-max-microamp: 最大闪光控制器输入电流。该值必须在 [1250000, 2000000] 范围内，并且可被 50000 整除

闪光子节点的可选属性
======================

function : 请参阅 Documentation/devicetree/bindings/leds/common.txt
下面是给定内容的中文翻译：

颜色 : 参见文档/设备树/绑定/LEDs/common.txt
标签 : 参见文档/设备树/绑定/LEDs/common.txt（已废弃）
指示器子节点所需的属性（1）
===================================================
reg: 1
led-max-microamp: 最大指示电流。允许的值为
		  2500、5000、7500 和 10000
指示器子节点的可选属性
===============================================
功能 : 参见文档/设备树/绑定/LEDs/common.txt
颜色 : 参见文档/设备树/绑定/LEDs/common.txt
标签 : 参见文档/设备树/绑定/LEDs/common.txt（已废弃）
示例
=====

``` 
#include <dt-bindings/leds/common.h>

as3645a@30 {
	#address-cells = <1>;
	#size-cells = <0>;
	reg = <0x30>;
	compatible = "ams,as3645a";
	led@0 {
		reg = <0x0>;
		flash-timeout-us = <150000>;
		flash-max-microamp = <320000>;
		led-max-microamp = <60000>;
		ams,input-max-microamp = <1750000>;
		function = LED_FUNCTION_FLASH;
	};
	led@1 {
		reg = <0x1>;
		led-max-microamp = <10000>;
		function = LED_FUNCTION_INDICATOR;
	};
};
```

这里主要描述了在设备树中定义LED控制器（例如 as3645a）时，对于指示器子节点所要求和可选的属性。其中“reg”表示该指示器的寄存器地址，“led-max-microamp”定义了最大允许通过的电流（以微安为单位），而“function”则指定了LED的功能类型。此外，还提到了“color”和“label”的属性，但它们已被标记为废弃。
~~~~
