## Documentation/devicetree/bindings/leds/backlight/richtek,rt4831-backlight_cn.yaml
~~~~yaml
```yaml
# SPDX-License-Identifier: (GPL-2.0-only OR BSD-2-Clause)
%YAML 1.2
---
$id: http://devicetree.org/schemas/leds/backlight/richtek,rt4831-backlight.yaml#
$schema: http://devicetree.org/meta-schemas/core.yaml#

title: Richtek RT4831 背光

maintainers:
  - ChiYuan Huang <cy_huang@richtek.com>

description: |
  RT4831 是一款多功能设备，可以为 LCD 显示屏和 LCD 背光供电。
  对于 LCD 背光，它可以提供四个通道的 WLED 驱动能力，
  每个通道的驱动电流最高可达 30mA。

  数据手册可在以下网址获取：
  https://www.richtek.com/assets/product_file/RT4831A/DS4831A-05.pdf

allOf:
  - $ref: common.yaml#

properties:
  compatible:
    const: richtek,rt4831-backlight

  default-brightness:
    minimum: 0
    maximum: 2048

  max-brightness:
    minimum: 0
    maximum: 2048

  richtek,pwm-enable:
    description: |
      指定背光调光是跟随 PWM 占空比还是通过软件控制
    type: boolean

  richtek,bled-ovp-sel:
    description: |
      背光过压保护级别选择，目前支持 17V/21V/25V/29V
    $ref: /schemas/types.yaml#/definitions/uint8
    default: 1
    minimum: 0
    maximum: 3

  richtek,bled-ocp-microamp:
    description: |
      背光过流保护级别
    enum: [900000, 1200000, 1500000, 1800000]

  richtek,channel-use:
    description: |
      使用的背光 LED 通道
      位 0/1/2/3 用于指示 LED 通道 1/2/3/4 是否启用
    $ref: /schemas/types.yaml#/definitions/uint8
    minimum: 1
    maximum: 15

required:
  - compatible
  - richtek,channel-use

additionalProperties: false
```

以上是 YAML 文件的中文翻译。注意，由于 YAML 的格式要求，这里的翻译保持了原有的 YAML 结构和语法，并尽可能地进行了中文描述。
~~~~

## Documentation/devicetree/bindings/leds/backlight/sky81452-backlight_cn.txt
~~~~
SKY81452背光绑定

必需属性：
- compatible		：必须为"skyworks,sky81452-backlight"

可选属性：
- name			：背光设备的名称。默认值为'lcd-backlight'
- gpios			：用于EN引脚的GPIO
请参阅Documentation/devicetree/bindings/gpio/gpio.txt
- led-sources		：从0到5的已启用通道列表
请参阅Documentation/devicetree/bindings/leds/common.txt
- skyworks,ignore-pwm	：忽略两个PWM输入
- skyworks,dpwm-mode	：启用DPWM调光模式，否则使用模拟调光
- skyworks,phase-shift	：启用相移模式
- skyworks,short-detection-threshold-volt	：应为4、5、6或7伏之一
- skyworks,current-limit-mA	：应为2300mA或2750mA

示例：

```
backlight {
	compatible = "skyworks,sky81452-backlight";
	name = "pwm-backlight";
	led-sources = <0 1 2 5>;
	skyworks,ignore-pwm;
	skyworks,phase-shift;
	skyworks,current-limit-mA = <2300>;
};
```
~~~~
