## Documentation/devicetree/bindings/soc/socionext/socionext,uniphier-sysctrl_cn.yaml
```yaml
# SPDX-许可证标识符: (GPL-2.0-only 或 BSD-2-Clause)
%YAML 1.2
---
$id: http://devicetree.org/schemas/soc/socionext/socionext,uniphier-sysctrl.yaml#
$schema: http://devicetree.org/meta-schemas/core.yaml#

标题: Socionext UniPhier 系统控制器

维护者:
  - Kunihiko Hayashi <hayashi.kunihiko@socionext.com>

描述: |+
  在 Socionext UniPhier 系统级芯片 (SoC) 上实现的系统控制器具有多种功能，如时钟控制、复位控制、内部看门狗定时器、热管理等。
属性:
  compatible:
    项目:
      - 枚举:
          - socionext,uniphier-ld4-sysctrl
          - socionext,uniphier-pro4-sysctrl
          - socionext,uniphier-pro5-sysctrl
          - socionext,uniphier-pxs2-sysctrl
          - socionext,uniphier-sld8-sysctrl
          - socionext,uniphier-ld11-sysctrl
          - socionext,uniphier-ld20-sysctrl
          - socionext,uniphier-pxs3-sysctrl
          - socionext,uniphier-nx1-sysctrl
      - 常量: simple-mfd
      - 常量: syscon

  reg:
    最大项数: 1

  clock-controller:
    $ref: /schemas/clock/socionext,uniphier-clock.yaml#

  reset-controller:
    $ref: /schemas/reset/socionext,uniphier-reset.yaml#

  watchdog:
    $ref: /schemas/watchdog/socionext,uniphier-wdt.yaml#

  thermal-sensor:
    $ref: /schemas/thermal/socionext,uniphier-thermal.yaml#

allOf:
  - 如果:
      属性:
        compatible:
          包含:
            常量: socionext,uniphier-ld4-sysctrl
    那么:
      属性:
        watchdog: false

  - 如果:
      属性:
        compatible:
          包含:
            枚举:
              - socionext,uniphier-ld4-sysctrl
              - socionext,uniphier-pro4-sysctrl
              - socionext,uniphier-sld8-sysctrl
              - socionext,uniphier-ld11-sysctrl
    那么:
      属性:
        thermal-sensor: false

additionalProperties: false

必需:
  - compatible
  - reg

示例:
  - |
    #include <dt-bindings/interrupt-controller/arm-gic.h>
    syscon@61840000 {
        compatible = "socionext,uniphier-ld20-sysctrl",
                     "simple-mfd", "syscon";
        reg = <0x61840000 0x4000>;

        clock-controller {
            compatible = "socionext,uniphier-ld20-clock";
            #clock-cells = <1>;
        };

        reset-controller {
            compatible = "socionext,uniphier-ld20-reset";
            #reset-cells = <1>;
        };

        watchdog {
            compatible = "socionext,uniphier-wdt";
        };

        thermal-sensor {
            compatible = "socionext,uniphier-ld20-thermal";
            interrupts = <GIC_SPI 3 IRQ_TYPE_LEVEL_HIGH>;
            #thermal-sensor-cells = <0>;
        };
    };
```

## Documentation/devicetree/bindings/soc/sti/st,sti-syscon_cn.yaml
```yaml
# SPDX-许可证标识符: (GPL-2.0-only 或 BSD-2-Clause)
%YAML 1.2
---
$id: http://devicetree.org/schemas/soc/sti/st,sti-syscon.yaml#
$schema: http://devicetree.org/meta-schemas/core.yaml#

标题: STMicroelectronics STi 平台 sysconfig

维护者:
  - Patrice Chotard <patrice.chotard@foss.st.com>

描述: |
  对于在 STi
  平台设备树中使用的各种 sysconfig 节点的绑定，这些节点指向其他节点所使用的常见配置寄存器。

属性:
  compatible:
    items:
      - enum:
          - st,stih407-core-syscfg
          - st,stih407-flash-syscfg
          - st,stih407-front-syscfg
          - st,stih407-lpm-syscfg
          - st,stih407-rear-syscfg
          - st,stih407-sbc-reg-syscfg
          - st,stih407-sbc-syscfg
      - const: syscon

  reg:
    maxItems: 1

  sti-sasg-codec:
    描述: STi 内置音频编解码器
    类型: object
    additionalProperties: true

    属性:
      compatible:
        const: st,stih407-sas-codec

必需:
  - compatible
  - reg

additionalProperties: false

示例:
  - |
    syscfg_sbc: syscon@9620000 {
        compatible = "st,stih407-sbc-syscfg", "syscon";
        reg = <0x9620000 0x1000>;
    };

..
```

## Documentation/devicetree/bindings/soc/tegra/nvidia,nvec_cn.yaml
```yaml
# SPDX-许可证标识符: (GPL-2.0-only 或 BSD-2-Clause)
%YAML 1.2
---
$id: http://devicetree.org/schemas/soc/tegra/nvidia,nvec.yaml#
$schema: http://devicetree.org/meta-schemas/core.yaml#

title: 符合NVIDIA规范的嵌入式控制器

maintainers:
  - Thierry Reding <thierry.reding@gmail.com>
  - Jon Hunter <jonathanh@nvidia.com>

properties:
  compatible:
    const: nvidia,nvec

  reg:
    maxItems: 1

  interrupts:
    maxItems: 1

  clocks:
    minItems: 1
    items:
      - description: 分频时钟
      - description: 快速时钟

  clock-names:
    minItems: 1
    items:
      - const: div-clk
      - const: fast-clk

  resets:
    items:
      - description: 模块复位

  reset-names:
    items:
      - const: i2c

  clock-frequency: true

  request-gpios:
    description: 用于EC请求的GPIO的phandle

  slave-addr:
    $ref: /schemas/types.yaml#/definitions/uint32
    description: 从控制器的I2C地址

additionalProperties: false

required:
  - compatible
  - reg
  - interrupts
  - clocks
  - clock-names
  - resets
  - reset-names
  - clock-frequency
  - request-gpios
  - slave-addr

examples:
  - |
    #include <dt-bindings/clock/tegra20-car.h>
    #include <dt-bindings/gpio/tegra-gpio.h>
    #include <dt-bindings/interrupt-controller/arm-gic.h>

    i2c@7000c500 {
        compatible = "nvidia,nvec";
        reg = <0x7000c500 0x100>;
        interrupts = <GIC_SPI 92 IRQ_TYPE_LEVEL_HIGH>;
        clock-frequency = <80000>;
        request-gpios = <&gpio TEGRA_GPIO(V, 2) GPIO_ACTIVE_HIGH>;
        slave-addr = <138>;
        clocks = <&tegra_car TEGRA20_CLK_I2C3>,
                 <&tegra_car TEGRA20_CLK_PLL_P_OUT3>;
        clock-names = "div-clk", "fast-clk";
        resets = <&tegra_car 67>;
        reset-names = "i2c";
    };
```

## Documentation/devicetree/bindings/soc/tegra/nvidia,tegra20-ahb_cn.yaml
~~~~yaml
```yaml
# SPDX-许可证标识符: (GPL-2.0-only 或 BSD-2-Clause)
%YAML 1.2
---
$id: http://devicetree.org/schemas/soc/tegra/nvidia,tegra20-ahb.yaml#
$schema: http://devicetree.org/meta-schemas/core.yaml#

维护者:
  - Thierry Reding <thierry.reding@gmail.com>
  - Jon Hunter <jonathanh@nvidia.com>

标题: NVIDIA Tegra AHB

属性:
  compatible:
    oneOf:
      - 枚举:
          - nvidia,tegra20-ahb
          - nvidia,tegra30-ahb
      - items:
          - 枚举:
              - nvidia,tegra114-ahb
              - nvidia,tegra124-ahb
              - nvidia,tegra210-ahb
          - 常量: nvidia,tegra30-ahb

  reg:
    maxItems: 1

additionalProperties: false

必需:
  - compatible
  - reg

示例:
  - |
    ahb@6000c004 {
        compatible = "nvidia,tegra20-ahb";
        reg = <0x6000c004 0x10c>; /* AHB 仲裁 + Gizmo 控制器 */
    };
```

这个文档定义了一个用于描述 NVIDIA Tegra 系列处理器中的 AHB (Advanced High-performance Bus) 配置的 Device Tree schema。它包含了兼容性声明、寄存器地址范围等信息，并给出了一个具体的示例。
~~~~

## Documentation/devicetree/bindings/soc/tegra/nvidia,tegra20-flowctrl_cn.yaml
~~~~yaml
```yaml
# SPDX-许可证标识符: (GPL-2.0-only 或 BSD-2-Clause)
%YAML 1.2
---
$id: http://devicetree.org/schemas/soc/tegra/nvidia,tegra20-flowctrl.yaml#
$schema: http://devicetree.org/meta-schemas/core.yaml#

title: NVIDIA Tegra 流控制器

maintainers:
  - Thierry Reding <thierry.reding@gmail.com>
  - Jon Hunter <jonathanh@nvidia.com>

properties:
  compatible:
    oneOf:
      - enum:
          - nvidia,tegra20-flowctrl
          - nvidia,tegra30-flowctrl
          - nvidia,tegra114-flowctrl
          - nvidia,tegra124-flowctrl
          - nvidia,tegra210-flowctrl

      - items:
          - const: nvidia,tegra132-flowctrl
          - const: nvidia,tegra124-flowctrl

  reg:
    maxItems: 1

required:
  - compatible
  - reg

additionalProperties: false

examples:
  - |
    flow-controller@60007000 {
        compatible = "nvidia,tegra20-flowctrl";
        reg = <0x60007000 0x1000>;
    };
```

这段 YAML 文档定义了 NVIDIA Tegra 流控制器的设备树规范。它包含了兼容性声明、寄存器地址范围等信息，并给出了一个示例。
~~~~
