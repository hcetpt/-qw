## Documentation/devicetree/bindings/soc/socionext/socionext,uniphier-ahci-glue_cn.yaml
~~~~yaml
```yaml
# SPDX-许可证标识符: (GPL-2.0-only 或 BSD-2-Clause)
%YAML 1.2
---
$id: http://devicetree.org/schemas/soc/socionext/socionext,uniphier-ahci-glue.yaml#
$schema: http://devicetree.org/meta-schemas/core.yaml#

标题: Socionext UniPhier SoC AHCI 粘合层

维护者:
  - Kunihiko Hayashi <hayashi.kunihiko@socionext.com>

描述: |+
  在 Socionext UniPhier SoCs 上实现的 AHCI 粘合层是一种旁路逻辑，用于处理 AHCI 组件内部 AHCI 主控制器的信号。

属性:
  compatible:
    items:
      - 枚举:
          - socionext,uniphier-pro4-ahci-glue
          - socionext,uniphier-pxs2-ahci-glue
          - socionext,uniphier-pxs3-ahci-glue
      - 常量: simple-mfd

  reg:
    maxItems: 1

  "#address-cells":
    常量: 1

  "#size-cells":
    常量: 1

  ranges: 真

模式属性:
  "^reset-controller@[0-9a-f]+$":
    $ref: /schemas/reset/socionext,uniphier-glue-reset.yaml#

  "phy@[0-9a-f]+$":
    $ref: /schemas/phy/socionext,uniphier-ahci-phy.yaml#

必需:
  - compatible
  - reg

附加属性: 错误

示例:
  - |
    sata-controller@65700000 {
        compatible = "socionext,uniphier-pxs3-ahci-glue", "simple-mfd";
        reg = <0x65b00000 0x400>;
        #address-cells = <1>;
        #size-cells = <1>;
        ranges = <0 0x65700000 0x100>;

        reset-controller@0 {
            compatible = "socionext,uniphier-pxs3-ahci-reset";
            reg = <0x0 0x4>;
            clock-names = "link";
            clocks = <&sys_clk 28>;
            reset-names = "link";
            resets = <&sys_rst 28>;
            #reset-cells = <1>;
        };

        phy@10 {
            compatible = "socionext,uniphier-pxs3-ahci-phy";
            reg = <0x10 0x10>;
            clock-names = "link", "phy";
            clocks = <&sys_clk 28>, <&sys_clk 30>;
            reset-names = "link", "phy";
            resets = <&sys_rst 28>, <&sys_rst 30>;
            #phy-cells = <0>;
        };
    };
```

请注意，部分 YAML 关键字（如 `true`）以及特殊符号（如 `#`, `@`）在中文环境下可能没有对应的翻译。因此，在技术文档中这些通常保持原样。
~~~~

## Documentation/devicetree/bindings/soc/socionext/socionext,uniphier-dwc3-glue_cn.yaml
```yaml
# SPDX-许可证标识符: (GPL-2.0-only 或 BSD-2-Clause)
%YAML 1.2
---
$id: http://devicetree.org/schemas/soc/socionext/socionext,uniphier-dwc3-glue.yaml#
$schema: http://devicetree.org/meta-schemas/core.yaml#

标题: Socionext UniPhier SoC 的 DWC3 USB3.0 黏合层

维护者:
  - Kunihiko Hayashi <hayashi.kunihiko@socionext.com>

描述: |+
  实现在 Socionext UniPhier SoC 上的 DWC3 USB3.0 黏合层是一种
  辅助逻辑，用于处理向 DWC3 主控制器内部的 USB3.0 组件发送的信号。

属性:
  compatible:
    items:
      - 枚举:
          - socionext,uniphier-pro4-dwc3-glue
          - socionext,uniphier-pro5-dwc3-glue
          - socionext,uniphier-pxs2-dwc3-glue
          - socionext,uniphier-ld20-dwc3-glue
          - socionext,uniphier-pxs3-dwc3-glue
          - socionext,uniphier-nx1-dwc3-glue
      - 常量: simple-mfd

  reg:
    最大项数: 1

  "#address-cells":
    常量: 1

  "#size-cells":
    常量: 1

  ranges: 真

模式属性:
  "^reset-controller@[0-9a-f]+$":
    $ref: /schemas/reset/socionext,uniphier-glue-reset.yaml#

  "^regulator@[0-9a-f]+$":
    $ref: /schemas/regulator/socionext,uniphier-regulator.yaml#

  "^phy@[0-9a-f]+$":
    oneOf:
      - $ref: /schemas/phy/socionext,uniphier-usb3hs-phy.yaml#
      - $ref: /schemas/phy/socionext,uniphier-usb3ss-phy.yaml#

必需:
  - compatible
  - reg

额外属性: 假

示例:
  - |
    usb@65b00000 {
        compatible = "socionext,uniphier-ld20-dwc3-glue", "simple-mfd";
        reg = <0x65b00000 0x400>;
        #address-cells = <1>;
        #size-cells = <1>;
        ranges = <0 0x65b00000 0x400>;

        reset-controller@0 {
            compatible = "socionext,uniphier-ld20-usb3-reset";
            reg = <0x0 0x4>;
            #reset-cells = <1>;
            clock-names = "link";
            clocks = <&sys_clk 14>;
            reset-names = "link";
            resets = <&sys_rst 14>;
        };

        regulator@100 {
            compatible = "socionext,uniphier-ld20-usb3-regulator";
            reg = <0x100 0x10>;
            clock-names = "link";
            clocks = <&sys_clk 14>;
            reset-names = "link";
            resets = <&sys_rst 14>;
        };

        phy@200 {
            compatible = "socionext,uniphier-ld20-usb3-hsphy";
            reg = <0x200 0x10>;
            #phy-cells = <0>;
            clock-names = "link", "phy";
            clocks = <&sys_clk 14>, <&sys_clk 16>;
            reset-names = "link", "phy";
            resets = <&sys_rst 14>, <&sys_rst 16>;
        };

        phy@300 {
            compatible = "socionext,uniphier-ld20-usb3-ssphy";
            reg = <0x300 0x10>;
            #phy-cells = <0>;
            clock-names = "link", "phy";
            clocks = <&sys_clk 14>, <&sys_clk 18>;
            reset-names = "link", "phy";
            resets = <&sys_rst 14>, <&sys_rst 18>;
        };
    };
```

## Documentation/devicetree/bindings/soc/socionext/socionext,uniphier-mioctrl_cn.yaml
```yaml
# SPDX-文件许可人: (GPL-2.0-only 或 BSD-2-Clause)
%YAML 1.2
---
$id: http://devicetree.org/schemas/soc/socionext/socionext,uniphier-mioctrl.yaml#
$schema: http://devicetree.org/meta-schemas/core.yaml#

title: Socionext UniPhier 媒体 I/O 模块 (MIO) 控制器

maintainers:
  - Kunihiko Hayashi <hayashi.kunihiko@socionext.com>

description: |+
  实现在 Socionext UniPhier 系统芯片上的媒体 I/O 模块是一个流类型外设的集成组件，包括 USB2.0、SD/eMMC 和 MIO-DMAC。
  媒体 I/O 模块具有用于控制这些组件的通用逻辑。
  最近的系统芯片具有专门用于 SD 功能的 SD 接口逻辑，作为媒体 I/O 模块的一个子集。请参见 socionext,uniphier-sdctrl.yaml。
properties:
  compatible:
    items:
      - enum:
          - socionext,uniphier-ld4-mioctrl
          - socionext,uniphier-pro4-mioctrl
          - socionext,uniphier-sld8-mioctrl
          - socionext,uniphier-ld11-mioctrl
      - const: simple-mfd
      - const: syscon

  reg:
    maxItems: 1

  clock-controller:
    $ref: /schemas/clock/socionext,uniphier-clock.yaml#

  reset-controller:
    $ref: /schemas/reset/socionext,uniphier-reset.yaml#

required:
  - compatible
  - reg

additionalProperties: false

examples:
  - |
    syscon@5b3e0000 {
        compatible = "socionext,uniphier-ld11-mioctrl",
                     "simple-mfd", "syscon";
        reg = <0x5b3e0000 0x800>;

        clock-controller {
            compatible = "socionext,uniphier-ld11-mio-clock";
            #clock-cells = <1>;
        };

        reset-controller {
            compatible = "socionext,uniphier-ld11-mio-reset";
            #reset-cells = <1>;
            resets = <&sys_rst 7>;
        };
    };
```

## Documentation/devicetree/bindings/soc/socionext/socionext,uniphier-perictrl_cn.yaml
```yaml
# SPDX-文件许可人: (GPL-2.0-only 或 BSD-2-Clause)
%YAML 1.2
---
$id: http://devicetree.org/schemas/soc/socionext/socionext,uniphier-perictrl.yaml#
$schema: http://devicetree.org/meta-schemas/core.yaml#

title: Socionext UniPhier 周边设备块控制器

maintainers:
  - Kunihiko Hayashi <hayashi.kunihiko@socionext.com>

description: |+
  在 Socionext UniPhier 系统级芯片上实现的周边设备块是一个集成的组件，包括 UART、I2C/FI2C 和 SCSSI。
  周边设备块控制器是一种用于控制这些组件特性的逻辑。

属性:
  compatible:
    items:
      - enum:
          - socionext,uniphier-ld4-perictrl
          - socionext,uniphier-pro4-perictrl
          - socionext,uniphier-pro5-perictrl
          - socionext,uniphier-pxs2-perictrl
          - socionext,uniphier-sld8-perictrl
          - socionext,uniphier-ld11-perictrl
          - socionext,uniphier-ld20-perictrl
          - socionext,uniphier-pxs3-perictrl
          - socionext,uniphier-nx1-perictrl
      - const: simple-mfd
      - const: syscon

  reg:
    maxItems: 1

  clock-controller:
    $ref: /schemas/clock/socionext,uniphier-clock.yaml#

  reset-controller:
    $ref: /schemas/reset/socionext,uniphier-reset.yaml#

required:
  - compatible
  - reg

additionalProperties: false

示例:
  - |
    syscon@59820000 {
        compatible = "socionext,uniphier-ld20-perictrl",
                     "simple-mfd", "syscon";
        reg = <0x59820000 0x200>;

        clock-controller {
            compatible = "socionext,uniphier-ld20-peri-clock";
            #clock-cells = <1>;
        };

        reset-controller {
            compatible = "socionext,uniphier-ld20-peri-reset";
            #reset-cells = <1>;
        };
    };
```

## Documentation/devicetree/bindings/soc/socionext/socionext,uniphier-sdctrl_cn.yaml
```yaml
# SPDX-文件许可人: (GPL-2.0-only 或 BSD-2-Clause)
%YAML 1.2
---
$id: http://devicetree.org/schemas/soc/socionext/socionext,uniphier-sdctrl.yaml#
$schema: http://devicetree.org/meta-schemas/core.yaml#

title: Socionext UniPhier SD 接口逻辑

maintainers:
  - Kunihiko Hayashi <hayashi.kunihiko@socionext.com>

description: |+
  Socionext UniPhier 系统芯片上的 SD 接口逻辑位于 SDHC 外部，具有时钟控制、复位控制、模式切换等与 SD 相关的功能。

properties:
  compatible:
    items:
      - enum:
          - socionext,uniphier-pro5-sdctrl
          - socionext,uniphier-pxs2-sdctrl
          - socionext,uniphier-ld11-sdctrl
          - socionext,uniphier-ld20-sdctrl
          - socionext,uniphier-pxs3-sdctrl
          - socionext,uniphier-nx1-sdctrl
      - const: simple-mfd
      - const: syscon

  reg:
    maxItems: 1

  clock-controller:
    $ref: /schemas/clock/socionext,uniphier-clock.yaml#

  reset-controller:
    $ref: /schemas/reset/socionext,uniphier-reset.yaml#

required:
  - compatible
  - reg

additionalProperties: false

examples:
  - |
    syscon@59810000 {
        compatible = "socionext,uniphier-ld20-sdctrl",
                     "simple-mfd", "syscon";
        reg = <0x59810000 0x400>;

        clock-controller {
            compatible = "socionext,uniphier-ld20-sd-clock";
            #clock-cells = <1>;
        };

        reset-controller {
            compatible = "socionext,uniphier-ld20-sd-reset";
            #reset-cells = <1>;
        };
    };
```

## Documentation/devicetree/bindings/soc/socionext/socionext,uniphier-soc-glue-debug_cn.yaml
~~~~yaml
```yaml
# SPDX-许可证标识符: (GPL-2.0-only 或 BSD-2-Clause)
%YAML 1.2
---
$id: http://devicetree.org/schemas/soc/socionext/socionext,uniphier-soc-glue-debug.yaml#
$schema: http://devicetree.org/meta-schemas/core.yaml#

标题: Socionext UniPhier SoC-glue 逻辑调试部分

维护者:
  - Kunihiko Hayashi <hayashi.kunihiko@socionext.com>

描述: |+
  在 Socionext UniPhier SoCs 上实现的 SoC-glue 逻辑调试部分是
  一组用于处理系统组件外部信号以供调试和监控使用的各种功能寄存器。

属性:
  compatible:
    items:
      - 枚举:
          - socionext,uniphier-ld4-soc-glue-debug
          - socionext,uniphier-pro4-soc-glue-debug
          - socionext,uniphier-pro5-soc-glue-debug
          - socionext,uniphier-pxs2-soc-glue-debug
          - socionext,uniphier-sld8-soc-glue-debug
          - socionext,uniphier-ld11-soc-glue-debug
          - socionext,uniphier-ld20-soc-glue-debug
          - socionext,uniphier-pxs3-soc-glue-debug
          - socionext,uniphier-nx1-soc-glue-debug
      - 常量: simple-mfd
      - 常量: syscon

  reg:
    maxItems: 1

  "#address-cells":
    常量: 1

  "#size-cells":
    常量: 1

  ranges: 真

模式属性:
  "^efuse@[0-9a-f]+$":
    $ref: /schemas/nvmem/socionext,uniphier-efuse.yaml#

必需:
  - compatible
  - reg

附加属性: 错误

示例:
  - |
    syscon@5f900000 {
        compatible = "socionext,uniphier-pxs2-soc-glue-debug",
                     "simple-mfd", "syscon";
        reg = <0x5f900000 0x2000>;
        #address-cells = <1>;
        #size-cells = <1>;
        ranges = <0 0x5f900000 0x2000>;

        efuse@100 {
            compatible = "socionext,uniphier-efuse";
            reg = <0x100 0x28>;
        };
    };
```

请注意，某些术语（如“枚举”、“常量”、“模式属性”等）在翻译中保持了英文原词，这是因为这些术语在计算机编程和配置文件中通常使用英文表示。
~~~~

## Documentation/devicetree/bindings/soc/socionext/socionext,uniphier-soc-glue_cn.yaml
```yaml
# SPDX-许可证标识符: (GPL-2.0-only 或 BSD-2-Clause)
%YAML 1.2
---
$id: http://devicetree.org/schemas/soc/socionext/socionext,uniphier-soc-glue.yaml#
$schema: http://devicetree.org/meta-schemas/core.yaml#

title: Socionext UniPhier SoC-粘合逻辑

maintainers:
  - Kunihiko Hayashi <hayashi.kunihiko@socionext.com>

description: |+
  在 Socionext UniPhier SoCs 上实现的 SoC-粘合逻辑是一系列处理系统组件外部信号的杂项功能寄存器的集合。

properties:
  compatible:
    items:
      - enum:
          - socionext,uniphier-ld4-soc-glue
          - socionext,uniphier-pro4-soc-glue
          - socionext,uniphier-pro5-soc-glue
          - socionext,uniphier-pxs2-soc-glue
          - socionext,uniphier-sld8-soc-glue
          - socionext,uniphier-ld11-soc-glue
          - socionext,uniphier-ld20-soc-glue
          - socionext,uniphier-pxs3-soc-glue
          - socionext,uniphier-nx1-soc-glue
      - const: simple-mfd
      - const: syscon

  reg:
    maxItems: 1

  pinctrl:
    $ref: /schemas/pinctrl/socionext,uniphier-pinctrl.yaml#

  usb-hub:
    $ref: /schemas/phy/socionext,uniphier-usb2-phy.yaml#

  clock-controller:
    $ref: /schemas/clock/socionext,uniphier-clock.yaml#

allOf:
  - if:
      not:
        properties:
          compatible:
            contains:
              enum:
                - socionext,uniphier-pro4-soc-glue
                - socionext,uniphier-ld11-soc-glue
    then:
      properties:
        usb-hub: false

  - if:
      not:
        properties:
          compatible:
            contains:
              const: socionext,uniphier-pro4-soc-glue
    then:
      properties:
        clock-controller: false

required:
  - compatible
  - reg

additionalProperties: false

examples:
  - |
    syscon@5f800000 {
        compatible = "socionext,uniphier-pro4-soc-glue",
                     "simple-mfd", "syscon";
        reg = <0x5f800000 0x2000>;

        pinctrl {
            compatible = "socionext,uniphier-pro4-pinctrl";
        };

        usb-hub {
            compatible = "socionext,uniphier-pro4-usb2-phy";
            #address-cells = <1>;
            #size-cells = <0>;

            phy@0 {
                reg = <0>;
                #phy-cells = <0>;
            };

            phy@1 {
                reg = <1>;
                #phy-cells = <0>;
            };

            phy@2 {
                reg = <2>;
                #phy-cells = <0>;
            };

            phy@3 {
                reg = <3>;
                #phy-cells = <0>;
            };
        };

        clock-controller {
            compatible = "socionext,uniphier-pro4-sg-clock";
            #clock-cells = <1>;
        };
    };
```
