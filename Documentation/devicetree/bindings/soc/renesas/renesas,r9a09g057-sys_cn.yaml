## Documentation/devicetree/bindings/soc/renesas/renesas,r9a09g057-sys_cn.yaml
```yaml
# SPDX-许可证标识符: (GPL-2.0-only 或 BSD-2-Clause)
%YAML 1.2
---
$id: http://devicetree.org/schemas/soc/renesas/renesas,r9a09g057-sys.yaml#
$schema: http://devicetree.org/meta-schemas/core.yaml#

title: Renesas RZ/V2H(P) 系统控制器 (SYS)

maintainers:
  - Geert Uytterhoeven <geert+renesas@glider.be>

description: |
  RZ/V2H(P) SYS (系统控制器) 控制 LSI 的整体配置，并支持以下功能：
  - 信任区域控制
  - 扩展特定主控器对超过 4GB 地址空间的访问
  - GBETH 配置
  - 控制 SRAM/PCIe/CM33/CA55/CR8/xSPI/ADC/TSU 的设置和状态
  - LSI 版本
  - WDT 停止控制
  - 通用寄存器

properties:
  compatible:
    const: renesas,r9a09g057-sys

  reg:
    maxItems: 1

  clocks:
    maxItems: 1

  resets:
    maxItems: 1

required:
  - compatible
  - reg
  - clocks
  - resets

additionalProperties: false

examples:
  - |
    sys: system-controller@10430000 {
        compatible = "renesas,r9a09g057-sys";
        reg = <0x10430000 0x10000>;
        clocks = <&cpg 1>;
        resets = <&cpg 1>;
    };
```

## Documentation/devicetree/bindings/soc/renesas/renesas,rzg2l-sysc_cn.yaml
```yaml
# SPDX-许可证标识符: (GPL-2.0-only 或 BSD-2-Clause)
%YAML 1.2
---
$id: http://devicetree.org/schemas/soc/renesas/renesas,rzg2l-sysc.yaml#
$schema: http://devicetree.org/meta-schemas/core.yaml#

标题: Renesas RZ/{G2L,V2L} 系统控制器 (SYSC)

维护者:
  - Geert Uytterhoeven <geert+renesas@glider.be>

描述:
  RZ/{G2L,V2L}-类系统控制器 (SYSC) 执行 LSI 的系统控制，并支持以下功能：
  - 外部终端状态捕获功能
  - 34 位地址空间访问功能
  - 低功耗控制
  - WDT 停止控制

属性:
  compatible:
    枚举:
      - renesas,r9a07g043-sysc # RZ/G2UL 和 RZ/Five
      - renesas,r9a07g044-sysc # RZ/G2{L,LC}
      - renesas,r9a07g054-sysc # RZ/V2L
      - renesas,r9a08g045-sysc # RZ/G3S

  reg:
    最大项数: 1

  interrupts:
    项:
      - 描述: CA55/CM33 睡眠/软件待机模式请求中断
      - 描述: CA55 软件待机模式释放请求中断
      - 描述: CM33 软件待机模式释放请求中断
      - 描述: CA55 ACE 异步桥接主/从接口拒绝请求中断

  interrupt-names:
    项:
      - 常量: lpm_int
      - 常量: ca55stbydone_int
      - 常量: cm33stbyr_int
      - 常量: ca55_deny

必需:
  - compatible
  - reg

附加属性: false

示例:
  - |
    #include <dt-bindings/interrupt-controller/arm-gic.h>

    sysc: system-controller@11020000 {
            compatible = "renesas,r9a07g044-sysc";
            reg = <0x11020000 0x10000>;
            interrupts = <GIC_SPI 42 IRQ_TYPE_LEVEL_HIGH>,
                         <GIC_SPI 43 IRQ_TYPE_LEVEL_HIGH>,
                         <GIC_SPI 44 IRQ_TYPE_LEVEL_HIGH>,
                         <GIC_SPI 45 IRQ_TYPE_LEVEL_HIGH>;
            interrupt-names = "lpm_int", "ca55stbydone_int", "cm33stbyr_int",
                              "ca55_deny";
    };
```

## Documentation/devicetree/bindings/soc/renesas/renesas,rzv2m-pwc_cn.yaml
```yaml
# SPDX-文件许可人: (GPL-2.0-only 或 BSD-2-Clause)
%YAML 1.2
---
$id: http://devicetree.org/schemas/soc/renesas/renesas,rzv2m-pwc.yaml#
$schema: http://devicetree.org/meta-schemas/core.yaml#

title: Renesas RZ/V2M 外部电源序列控制器 (PWC)

description: |+
  在 RZ/V2M 系列芯片中发现的 PWC IP 具有以下功能：
    - 生成外部电源供应的开关序列
    - 为 LPDDR4 内核电源 (LPVDD) 生成开关信号
    - 处理键输入信号
    - 通用输出引脚

maintainers:
  - Fabrizio Castro <fabrizio.castro.jz@renesas.com>

properties:
  compatible:
    items:
      - enum:
          - renesas,r9a09g011-pwc # RZ/V2M
          - renesas,r9a09g055-pwc # RZ/V2MA
      - const: renesas,rzv2m-pwc

  reg:
    maxItems: 1

  gpio-controller: true

  '#gpio-cells':
    const: 2

  renesas,rzv2m-pwc-power:
    description: PWC 用于控制系统的电源供应
    type: boolean

required:
  - compatible
  - reg
  - gpio-controller
  - '#gpio-cells'

additionalProperties: false

examples:
  - |
    pwc: pwc@a3700000 {
      compatible = "renesas,r9a09g011-pwc", "renesas,rzv2m-pwc";
      reg = <0xa3700000 0x800>;
      gpio-controller;
      #gpio-cells = <2>;
      renesas,rzv2m-pwc-power;
    };
```

## Documentation/devicetree/bindings/soc/renesas/renesas-soc_cn.yaml
~~~~yaml
```yaml
# SPDX-许可证标识符: GPL-2.0-only OR BSD-2-Clause
%YAML 1.2
---
$id: http://devicetree.org/schemas/soc/renesas/renesas-soc.yaml#
$schema: http://devicetree.org/meta-schemas/core.yaml#

标题: Renesas SoC 兼容性命名规范

维护者:
  - Geert Uytterhoeven <geert+renesas@glider.be>
  - Niklas Söderlund <niklas.soderlund@ragnatech.se>

描述: |
  对于新添加的 SoC 块/组件兼容性的指导原则。
当在新的绑定中添加新的兼容性时，请使用以下格式：
    renesas,SoC-IP

例如：
   renesas,r8a77965-csi2

当向现有绑定中添加新的兼容性时，即使与上述规则冲突也要使用现有绑定中的格式。
选择:
  属性:
    compatible:
      包含:
        正则表达式: "^renesas,.+-.+$"
  必需:
    - compatible

属性:
  compatible:
    最少项数: 1
    最多项数: 4
    项:
      anyOf:
        # 对于 SoC 组件兼容性的首选命名风格
        - 正则表达式: "^renesas,(emev2|r(7s|8a|9a)[a-z0-9]+|rcar|rmobile|rz[a-z0-9]*|sh(7[a-z0-9]+)?|mobile)-[a-z0-9-]+$"
        - 正则表达式: "^renesas,(condor|falcon|gr-peach|gray-hawk|salvator|sk-rz|smar(c(2)?)?|spider|white-hawk)(.*)?$"

        # 遗留的兼容性
        #
        # 不允许添加新的兼容性
- 正则表达式: "^renesas,(can|cpg|dmac|du|(g)?ether(avb)?|gpio|hscif|(r)?i[i2]c|imr|intc|ipmmu|irqc|jpu|mmcif|msiof|mtu2|pci(e)?|pfc|pwm|[rq]spi|rcar_sound|sata|scif[ab]*|sdhi|thermal|tmu|tpu|usb(2|hs)?|vin|xhci)-[a-z0-9-]+$"
        - 正则表达式: "^renesas,(d|s)?bsc(3)?-(r8a73a4|r8a7740|sh73a0)$"
        - 正则表达式: "^renesas,em-(gio|sti|uart)$"
        - 正则表达式: "^renesas,fsi2-(r8a7740|sh73a0)$"
        - 正则表达式: "^renesas,hspi-r8a777[89]$"
        - 正则表达式: "^renesas,sysc-(r8a73a4|r8a7740|rmobile|sh73a0)$"
        - 枚举:
            - renesas,imr-lx4
            - renesas,mtu2-r7s72100

        # 非 SoC 组件兼容性
        #
        # 与任何 SoC 组件无关但带有 Renesas 厂商前缀的兼容性是允许的。允许添加新的兼容性。
- 枚举:
            - renesas,smp-sram

        # 不拒绝不符合选择模式的兼容性
        #
        # 某些 SoC 组件除了列出 Renesas 兼容性之外还列出了与 Renesas 无关的兼容性。此模式的选择适用于所有至少包含一个 Renesas 兼容性的兼容性，并尝试验证该兼容性数组中的所有值，允许所有不符合模式选择模式的项。例如，
        #
        #   compatible = "renesas,r9a07g044-mali", "arm,mali-bifrost";
        - 正则表达式: "^(?!renesas,.+-.+).+$"

附加属性: true
```
请注意，某些 YAML 特定的语法（如正则表达式的表示）在直接翻译时可能需要调整以符合 YAML 的标准写法。
~~~~

## Documentation/devicetree/bindings/soc/samsung/exynos-pmu_cn.yaml
```yaml
# SPDX-License-Identifier: GPL-2.0
%YAML 1.2
---
$id: http://devicetree.org/schemas/soc/samsung/exynos-pmu.yaml#
$schema: http://devicetree.org/meta-schemas/core.yaml#

title: 三星 Exynos 系列系统芯片的电源管理单元 (PMU)

maintainers:
  - Krzysztof Kozlowski <krzk@kernel.org>

# 自定义选择器以避免匹配所有带有 'syscon' 的节点
select:
  properties:
    compatible:
      contains:
        enum:
          - google,gs101-pmu
          - samsung,exynos3250-pmu
          - samsung,exynos4210-pmu
          - samsung,exynos4212-pmu
          - samsung,exynos4412-pmu
          - samsung,exynos5250-pmu
          - samsung,exynos5260-pmu
          - samsung,exynos5410-pmu
          - samsung,exynos5420-pmu
          - samsung,exynos5433-pmu
          - samsung,exynos7-pmu
          - samsung,exynos850-pmu
          - samsung-s5pv210-pmu
  required:
    - compatible

properties:
  compatible:
    oneOf:
      - items:
          - enum:
              - google,gs101-pmu
              - samsung,exynos3250-pmu
              - samsung,exynos4210-pmu
              - samsung,exynos4212-pmu
              - samsung,exynos4412-pmu
              - samsung,exynos5250-pmu
              - samsung,exynos5260-pmu
              - samsung,exynos5410-pmu
              - samsung,exynos5420-pmu
              - samsung,exynos5433-pmu
              - samsung,exynos7-pmu
              - samsung,exynos850-pmu
              - samsung-s5pv210-pmu
          - const: syscon
      - items:
          - enum:
              - samsung,exynos7885-pmu
              - samsung,exynosautov9-pmu
              - samsung,exynosautov920-pmu
              - tesla,fsd-pmu
          - const: samsung,exynos7-pmu
          - const: syscon
      - items:
          - enum:
              - samsung,exynos3250-pmu
              - samsung,exynos4210-pmu
              - samsung,exynos4212-pmu
              - samsung,exynos4412-pmu
              - samsung,exynos5250-pmu
              - samsung,exynos5420-pmu
              - samsung,exynos5433-pmu
          - const: simple-mfd
          - const: syscon

  reg:
    maxItems: 1

  '#clock-cells':
    const: 1

  clock-names:
    description:
      为特定 CLKOUT 复用器输入列出时钟名称
    minItems: 1
    maxItems: 32
    items:
      pattern: '^clkout([0-9]|[12][0-9]|3[0-1])$'

  clocks:
    minItems: 1
    maxItems: 32

  dp-phy:
    $ref: /schemas/phy/samsung,dp-video-phy.yaml
    unevaluatedProperties: false

  interrupt-controller:
    description:
      某些 PMU 可以充当中断控制器（主要用于唤醒挂起的 PMU）
'#interrupt-cells':
    description:
      必须与父中断控制器的值相同
    const: 3

  mipi-phy:
    $ref: /schemas/phy/samsung,mipi-video-phy.yaml
    unevaluatedProperties: false

  reboot-mode:
    $ref: /schemas/power/reset/syscon-reboot-mode.yaml
    type: object
    description:
      用于改变下次启动时引导加载程序行为的重启模式

  syscon-poweroff:
    $ref: /schemas/power/reset/syscon-poweroff.yaml#
    type: object
    description:
      关机方法对应的节点

  syscon-reboot:
    $ref: /schemas/power/reset/syscon-reboot.yaml#
    type: object
    description:
      重启方法对应的节点

required:
  - compatible
  - reg

additionalProperties: false

allOf:
  - if:
      properties:
        compatible:
          contains:
            enum:
              - samsung,exynos3250-pmu
              - samsung,exynos4210-pmu
              - samsung,exynos4212-pmu
              - samsung,exynos4412-pmu
              - samsung,exynos5250-pmu
              - samsung,exynos5410-pmu
              - samsung,exynos5420-pmu
              - samsung,exynos5433-pmu
    then:
      required:
        - '#clock-cells'
        - clock-names
        - clocks

  - if:
      properties:
        compatible:
          contains:
            enum:
              - samsung,exynos3250-pmu
              - samsung,exynos4210-pmu
              - samsung,exynos4212-pmu
              - samsung,exynos4412-pmu
              - samsung,exynos5250-pmu
              - samsung,exynos5420-pmu
              - samsung,exynos5433-pmu
    then:
      properties:
        mipi-phy: true
    else:
      properties:
        mipi-phy: false

  - if:
      properties:
        compatible:
          contains:
            enum:
              - samsung,exynos5250-pmu
              - samsung,exynos5420-pmu
              - samsung,exynos5433-pmu
    then:
      properties:
        dp-phy: true
    else:
      properties:
        dp-phy: false

examples:
  - |
    #include <dt-bindings/clock/exynos5250.h>

    pmu_system_controller: system-controller@10040000 {
        compatible = "samsung,exynos5250-pmu", "syscon";
        reg = <0x10040000 0x5000>;
        interrupt-controller;
        #interrupt-cells = <3>;
        interrupt-parent = <&gic>;
        #clock-cells = <1>;
        clock-names = "clkout16";
        clocks = <&clock CLK_FIN_PLL>;

        dp-phy {
            compatible = "samsung,exynos5250-dp-video-phy";
            #phy-cells = <0>;
        };

        mipi-phy {
            compatible = "samsung,s5pv210-mipi-video-phy";
            #phy-cells = <1>;
        };
    };
```

## Documentation/devicetree/bindings/soc/samsung/exynos-usi_cn.yaml
```yaml
# SPDX-许可证标识符: (GPL-2.0-only 或 BSD-2-Clause)
%YAML 1.2
---
$id: http://devicetree.org/schemas/soc/samsung/exynos-usi.yaml#
$schema: http://devicetree.org/meta-schemas/core.yaml#

title: 三星的 Exynos USI (通用串行接口)

maintainers:
  - Sam Protsenko <semen.protsenko@linaro.org>
  - Krzysztof Kozlowski <krzk@kernel.org>

description: |
  USI IP 核心提供了可选的串行协议（UART、SPI 或高速 I2C）
  USI 几乎在每种协议中都共享所有内部电路，因此一次只能选择一种
  协议。USI 被建模为一个节点，包含零个或多个子节点，每个子节点代表一个串行子设备。模式设置决定了将使用哪种特定功能。
properties:
  $nodename:
    pattern: "^usi@[0-9a-f]+$"

  compatible:
    oneOf:
      - items:
          - enum:
              - google,gs101-usi
              - samsung,exynosautov9-usi
              - samsung,exynosautov920-usi
          - const: samsung,exynos850-usi
      - enum:
          - samsung,exynos850-usi

  reg: true

  clocks: true

  clock-names: true

  ranges: true

  "#address-cells":
    const: 1

  "#size-cells":
    const: 1

  samsung,sysreg:
    $ref: /schemas/types.yaml#/definitions/phandle-array
    items:
      - items:
          - description: System Register syscon 节点的 phandle
          - description: 此 USI 控制器的 SW_CONF 寄存器偏移量
    description:
      应该是 phandle/偏移量对。System Register syscon 节点的 phandle
      （此 USI 控制器所在的相同域）和此 USI 控制器的 SW_CONF 寄存器偏移量
samsung,mode:
    $ref: /schemas/types.yaml#/definitions/uint32
    description:
      选择 USI 功能（要使用的串行协议）。参考
      <include/dt-bindings/soc/samsung,exynos-usi.h> 获取有效的 USI 模式值
samsung,clkreq-on:
    type: boolean
    description:
      如果底层协议要求时钟持续提供且不进行自动门控，则启用此属性。如 SoC 手册建议，在 SPI/I2C 从机、UART 接收以及 I2C 多主机模式下应设置此属性。通常，如果 USI 模式设置为 "UART" 则需要此属性。
      此属性是可选的
patternProperties:
  "^i2c@[0-9a-f]+$":
    $ref: /schemas/i2c/i2c-exynos5.yaml
    description: 描述底层 I2C 的子节点

  "^serial@[0-9a-f]+$":
    $ref: /schemas/serial/samsung_uart.yaml
    description: 描述底层 UART/串行的子节点

  "^spi@[0-9a-f]+$":
    $ref: /schemas/spi/samsung,spi.yaml
    description: 描述底层 SPI 的子节点

required:
  - compatible
  - ranges
  - "#address-cells"
  - "#size-cells"
  - samsung,sysreg
  - samsung,mode

if:
  properties:
    compatible:
      contains:
        enum:
          - samsung,exynos850-usi

then:
  properties:
    reg:
      maxItems: 1

    clocks:
      items:
        - description: 总线 (APB) 时钟
        - description: UART/SPI/I2C 协议的操作时钟

    clock-names:
      items:
        - const: pclk
        - const: ipclk

  required:
    - reg
    - clocks
    - clock-names

else:
  properties:
    reg: false
    clocks: false
    clock-names: false
    samsung,clkreq-on: false

additionalProperties: false

examples:
  - |
    #include <dt-bindings/interrupt-controller/arm-gic.h>
    #include <dt-bindings/soc/samsung,exynos-usi.h>

    usi0: usi@138200c0 {
        compatible = "samsung,exynos850-usi";
        reg = <0x138200c0 0x20>;
        samsung,sysreg = <&sysreg_peri 0x1010>;
        samsung,mode = <USI_V2_UART>;
        samsung,clkreq-on; /* 对于 UART 模式是必需的 */
        #address-cells = <1>;
        #size-cells = <1>;
        ranges;
        clocks = <&cmu_peri 32>, <&cmu_peri 31>;
        clock-names = "pclk", "ipclk";

        serial_0: serial@13820000 {
            compatible = "samsung,exynos850-uart";
            reg = <0x13820000 0xc0>;
            interrupts = <GIC_SPI 227 IRQ_TYPE_LEVEL_HIGH>;
            clocks = <&cmu_peri 32>, <&cmu_peri 31>;
            clock-names = "uart", "clk_uart_baud0";
            status = "disabled";
        };

        hsi2c_0: i2c@13820000 {
            compatible = "samsung,exynos850-hsi2c", "samsung,exynosautov9-hsi2c";
            reg = <0x13820000 0xc0>;
            interrupts = <GIC_SPI 227 IRQ_TYPE_LEVEL_HIGH>;
            #address-cells = <1>;
            #size-cells = <0>;
            clocks = <&cmu_peri 31>, <&cmu_peri 32>;
            clock-names = "hsi2c", "hsi2c_pclk";
            status = "disabled";
        };
    };
```

## Documentation/devicetree/bindings/soc/socionext/socionext,uniphier-adamv_cn.yaml
```yaml
# SPDX-许可证标识符: (GPL-2.0-only 或 BSD-2-Clause)
%YAML 1.2
---
$id: http://devicetree.org/schemas/soc/socionext/socionext,uniphier-adamv.yaml#
$schema: http://devicetree.org/meta-schemas/core.yaml#

title: Socionext UniPhier ADAMV 模块

maintainers:
  - Kunihiko Hayashi <hayashi.kunihiko@socionext.com>

description: |+
  Socionext UniPhier 系统芯片上实现的 ADAMV 模块是一个模拟信号放大器，它是外部视频和音频 I/O 系统的一部分。
  此模块仅定义用于控制音频 I/O 复位。

properties:
  compatible:
    items:
      - enum:
          - socionext,uniphier-ld11-adamv
          - socionext,uniphier-ld20-adamv
      - const: simple-mfd
      - const: syscon

  reg:
    maxItems: 1

  reset-controller:
    $ref: /schemas/reset/socionext,uniphier-reset.yaml#

required:
  - compatible
  - reg

additionalProperties: false

examples:
  - |
    syscon@57920000 {
        compatible = "socionext,uniphier-ld20-adamv",
                     "simple-mfd", "syscon";
        reg = <0x57920000 0x1000>;

        reset-controller {
            compatible = "socionext,uniphier-ld20-adamv-reset";
            #reset-cells = <1>;
        };
    };
```
