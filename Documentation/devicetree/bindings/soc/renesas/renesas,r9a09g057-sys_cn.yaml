## Documentation/devicetree/bindings/soc/tegra/nvidia,tegra20-pmc_cn.yaml
```yaml
# SPDX-许可证标识符: (GPL-2.0-only 或 BSD-2-Clause)
%YAML 1.2
---
$id: http://devicetree.org/schemas/soc/tegra/nvidia,tegra20-pmc.yaml#
$schema: http://devicetree.org/meta-schemas/core.yaml#

title: Tegra 功率管理控制器 (PMC)

maintainers:
  - Thierry Reding <thierry.reding@gmail.com>
  - Jonathan Hunter <jonathanh@nvidia.com>

properties:
  compatible:
    enum:
      - nvidia,tegra20-pmc
      - nvidia,tegra30-pmc
      - nvidia,tegra114-pmc
      - nvidia,tegra124-pmc
      - nvidia,tegra210-pmc

  reg:
    maxItems: 1

  clock-names:
    items:
      # 与Tegra时钟同名的时钟
      - const: pclk
      # 32 KHz时钟输入
      - const: clk32k_in

  clocks:
    maxItems: 2

  '#clock-cells':
    const: 1
    description: |
      Tegra PMC具有clk_out_1、clk_out_2和clk_out_3。PMC还具有blink控制，可将32KHz时钟输出到Tegra blink pad
使用PMC时钟的消费者应通过在其"clocks" phandle单元中指定所需的时钟ID来指定所期望的时钟。请参阅include/dt-bindings/soc/tegra-pmc.h以获取Tegra PMC时钟ID列表。
'#interrupt-cells':
    const: 2
    description: 指定编码中断源所需的单元数量
interrupt-controller: true

  nvidia,invert-interrupt:
    $ref: /schemas/types.yaml#/definitions/flag
    description: 反转PMU中断信号。PMU是一个外部功率管理单元，其中断输出信号被馈送到PMC。此信号可以选择性地反转，然后馈送到ARM GIC。PMC不参与该中断信号的检测或处理，仅参与其反转。
nvidia,core-power-req-active-high:
    $ref: /schemas/types.yaml#/definitions/flag
    description: 核心电源请求有效高电平

  nvidia,sys-clock-req-active-high:
    $ref: /schemas/types.yaml#/definitions/flag
    description: 系统时钟请求有效高电平

  nvidia,combined-power-req:
    $ref: /schemas/types.yaml#/definitions/flag
    description: 组合CPU和核心的电源请求

  nvidia,cpu-pwr-good-en:
    $ref: /schemas/types.yaml#/definitions/flag
    description: 外部PMIC到PMC的CPU电源良好信号已启用

  nvidia,suspend-mode:
    $ref: /schemas/types.yaml#/definitions/uint32
    description: 平台应使用的挂起模式
    oneOf:
      - description: LP0, 关闭CPU+核心电压且DRAM处于自刷新状态
        const: 0
      - description: LP1, 关闭CPU电压且DRAM处于自刷新状态
        const: 1
      - description: LP2, 关闭CPU电压
        const: 2

  nvidia,cpu-pwr-good-time:
    $ref: /schemas/types.yaml#/definitions/uint32
    description: CPU电源良好时间（微秒）

  nvidia,cpu-pwr-off-time:
    $ref: /schemas/types.yaml#/definitions/uint32
    description: CPU电源关闭时间（微秒）

  nvidia,core-pwr-good-time:
    $ref: /schemas/types.yaml#/definitions/uint32-array
    description: 核心电源良好时间（微秒）
    items:
      - description: 振荡器稳定时间
      - description: 电源稳定时间

  nvidia,core-pwr-off-time:
    $ref: /schemas/types.yaml#/definitions/uint32
    description: 核心电源关闭时间（微秒）

  nvidia,lp0-vec:
    $ref: /schemas/types.yaml#/definitions/uint32-array
    description: |
      LP0向量的起始地址和长度。LP0向量包含由AVP在从LP0状态恢复时执行的热启动代码
AVP（音频-视频处理器）是一个ARM7处理器，并且始终是芯片上电或从深度睡眠恢复时的第一个启动处理器。当系统从深度睡眠模式恢复时，热启动代码将恢复一些PLL、时钟，然后启动CPU0以恢复系统。
items:
      - description: LP0向量的起始地址
      - description: LP0向量的长度

  core-supply:
    description: 连接到SoC核心电源轨的电压调节器的phandle

  core-domain:
    type: object
    description: Tegra SoC的绝大多数硬件块属于一个核心电源域，该域有一个专用的电压轨为这些块供电
additionalProperties: false
    properties:
      operating-points-v2:
        description: 应包含level、voltages和opp-supported-hw属性。supported-hw是一个位字段，指示SoC速度计或进程ID掩码
"#power-domain-cells":
        const: 0

    required:
      - operating-points-v2
      - "#power-domain-cells"

  i2c-thermtrip:
    type: object
    description: 在Tegra30、Tegra114和Tegra124上，如果存在i2c-thermtrip子节点，则将启用硬件触发的热重置
additionalProperties: false
    properties:
      nvidia,i2c-controller-id:
        $ref: /schemas/types.yaml#/definitions/uint32
        description: 发送关机命令给PMU的I2C控制器ID
### Translation

#### Valid values are described in section 9.2.148 "APBDEV_PMC_SCRATCH53_0" of the Tegra K1 Technical Reference Manual
- **nvidia,bus-addr:**
  - $ref: /schemas/types.yaml#/definitions/uint32
  - description: I2C总线上PMU的总线地址

- **nvidia,reg-addr:**
  - $ref: /schemas/types.yaml#/definitions/uint32
  - description: 发出关机命令时PMU I2C寄存器地址

- **nvidia,reg-data:**
  - $ref: /schemas/types.yaml#/definitions/uint32
  - description: 写入PMU以发出关机命令的数据

- **nvidia,pinmux-id:**
  - $ref: /schemas/types.yaml#/definitions/uint32
  - description: 发出关机命令时硬件所使用的Pinmux。默认值为0。有效值在Tegra4技术参考手册第12.5.2节“Pinmux支持”中描述。

#### 必需项:
- **nvidia,i2c-controller-id**
- **nvidia,bus-addr**
- **nvidia,reg-addr**
- **nvidia,reg-data**

### Powergates
- **类型**: 对象
- **additionalProperties**: false
- **description**: 
  - 本节点包含一个电源域节点层级结构，应与Tegra SoC上的电源门控相匹配。每个电源门控节点代表Tegra SoC上可以由Tegra PMC进行电源门控的一个电源域。属于电源域的硬件块应该包含属性"power-domains"，该属性是一个指向相应电源门控节点的句柄。
  - 电源门控节点的名称应为以下之一。需要注意，并非所有电源门控都适用于所有Tegra设备，下列表格显示了哪些电源门控适用于哪些设备。请参阅Tegra TRM获取有关每个电源门控块内使用的电源门控节点的更多信息。
  
| 名称 | 描述 | 适用设备 |
| --- | --- | --- |
| 3d | 3D图形 | Tegra20/114/124/210 |
| 3d0 | 3D图形0 | Tegra30 |
| 3d1 | 3D图形1 | Tegra30 |
| aud | 音频 | Tegra210 |
| dfd | 调试 | Tegra210 |
| dis | 显示A | Tegra114/124/210 |
| disb | 显示B | Tegra114/124/210 |
| heg | 2D图形 | Tegra30/114/124/210 |
| iram | 内部RAM | Tegra124/210 |
| mpe | MPEG编码 | 所有 |
| nvdec | NVIDIA视频解码引擎 | Tegra210 |
| nvjpg | NVIDIA JPEG引擎 | Tegra210 |
| pcie | PCIE | Tegra20/30/124/210 |
| sata | SATA | Tegra30/124/210 |
| sor | 显示接口 | Tegra124/210 |
| ve2 | 视频编码引擎2 | Tegra210 |
| venc | 视频编码引擎 | 所有 |
| vdec | 视频解码引擎 | Tegra20/30/114/124 |
| vic | 视频图像合成器 | Tegra124/210 |
| xusba | USB分区A | Tegra114/124/210 |
| xusbb | USB分区B | Tegra114/124/210 |
| xusbc | USB分区C | Tegra114/124/210 |

- **patternProperties**:
  - "^[a-z0-9]+$":
    - 类型: 对象
    - additionalProperties: false
    - 属性:
      - clocks:
        - minItems: 1
        - maxItems: 10
      - resets:
        - minItems: 1
        - maxItems: 8
      - power-domains:
        - maxItems: 1
      - '#power-domain-cells':
        - const: 0
        - description: 必须为0

#### 必需项:
- **clocks**
- **resets**
- **'#power-domain-cells'**

### Pinmux
- **类型**: 对象
- **additionalProperties**:
  - 类型: 对象
  - description: 
    - 这是一个端口配置节点。在Tegra SoC上，端口是一组被一起配置的引脚。引脚分组是硬件的固定属性。PMC可用于设置端口电源状态和信号电压。端口可以处于活动或电源关闭模式。对于信号电压配置的支持因端口而异。软件可控信号电压切换可用的引脚支持3.3V和1.8V信号电压。
垫配置状态节点位于pmc节点下，并通过pinctrl客户端属性进行引用。更多信息，请参阅：

          文档/devicetree/bindings/pinctrl/pinctrl-bindings.txt

        在pin配置节点中，应使用垫名称作为pins属性的值。
以下垫存在于Tegra124和Tegra132上：

          audio, bb, cam, comp, csia, csb, cse, dsi, dsib, dsic, dsid, hdmi,
          hsic, hv, lvds, mipi-bias, nand, pex-bias, pex-clk1, pex-clk2,
          pex-cntrl, sdmmc1, sdmmc3, sdmmc4, sys_ddc, uart, usb0, usb1, usb2,
          usb_bias

        以下垫存在于Tegra210上：

          audio, audio-hv, cam, csia, csib, csic, csid, csie, csif, dbg,
          debug-nonao, dmic, dp, dsi, dsib, dsic, dsid, emmc, emmc2, gpio,
          hdmi, hsic, lvds, mipi-bias, pex-bias, pex-clk1, pex-clk2, pex-cntrl,
          sdmmc1, sdmmc3, spi, spi-hv, uart, usb0, usb1, usb2, usb3, usb-bias
additionalProperties: false
properties:
        pins:
          $ref: /schemas/types.yaml#/definitions/string-array
          描述: 必须包含要配置的垫名称
low-power-enable:
          $ref: /schemas/types.yaml#/definitions/flag
          描述: 配置垫进入电源关闭模式
low-power-disable:
          $ref: /schemas/types.yaml#/definitions/flag
          描述: 配置垫进入活动模式
power-source:
          $ref: /schemas/types.yaml#/definitions/uint32
          描述: |
            必须包含TEGRA_IO_PAD_VOLTAGE_1V8或
            TEGRA_IO_PAD_VOLTAGE_3V3以选择信号电压。这些值在以下文件中定义：

              include/dt-bindings/pinctrl/pinctrl-tegra-io-pad.h

            所有Tegra124和Tegra132垫都可配置电源状态。Tegra124和Tegra132的任何垫都不支持信号电压切换。除了pex-cntrl以外的所有列出的Tegra210垫都支持电源状态配置。以下Tegra210垫支持信号电压切换：

              audio, audio-hv, cam, dbg, dmic, gpio, pex-cntrl, sdmmc1, sdmmc3,
              spi, spi-hv, uart

      required:
        - pins

required:
  - compatible
  - reg
  - clock-names
  - clocks
  - '#clock-cells'

allOf:
  - if:
      properties:
        compatible:
          contains:
            const: nvidia,tegra124-pmc
    then:
      properties:
        pinmux:
          additionalProperties:
            type: object
            properties:
              pins:
                items:
                  enum: [ audio, bb, cam, comp, csia, csb, cse, dsi, dsib,
                          dsic, dsid, hdmi, hsic, hv, lvds, mipi-bias, nand,
                          pex-bias, pex-clk1, pex-clk2, pex-cntrl, sdmmc1,
                          sdmmc3, sdmmc4, sys_ddc, uart, usb0, usb1, usb2,
                          usb_bias ]

  - if:
      properties:
        compatible:
          contains:
            const: nvidia,tegra210-pmc
    then:
      properties:
        pinmux:
          additionalProperties:
            type: object
            properties:
              pins:
                items:
                  enum: [ audio, audio-hv, cam, csia, csib, csic, csid, csie,
                          csif, dbg, debug-nonao, dmic, dp, dsi, dsib, dsic,
                          dsid, emmc, emmc2, gpio, hdmi, hsic, lvds, mipi-bias,
                          pex-bias, pex-clk1, pex-clk2, pex-cntrl, sdmmc1,
                          sdmmc3, spi, spi-hv, uart, usb0, usb1, usb2, usb3,
                          usb-bias ]

additionalProperties: false

dependencies:
  nvidia,suspend-mode: ["nvidia,core-pwr-off-time", "nvidia,cpu-pwr-off-time"]
  nvidia,core-pwr-off-time: ["nvidia,core-pwr-good-time"]
  nvidia,cpu-pwr-off-time: ["nvidia,cpu-pwr-good-time"]

例子:
  - |
    #include <dt-bindings/clock/tegra210-car.h>
    #include <dt-bindings/pinctrl/pinctrl-tegra-io-pad.h>
    #include <dt-bindings/soc/tegra-pmc.h>

    pmc@7000e400 {
        compatible = "nvidia,tegra210-pmc";
        reg = <0x7000e400 0x400>;
        core-supply = <&regulator>;
        clocks = <&tegra_car TEGRA210_CLK_PCLK>, <&clk32k_in>;
        clock-names = "pclk", "clk32k_in";
        #clock-cells = <1>;

        nvidia,invert-interrupt;
        nvidia,suspend-mode = <0>;
        nvidia,cpu-pwr-good-time = <0>;
        nvidia,cpu-pwr-off-time = <0>;
        nvidia,core-pwr-good-time = <4587 3876>;
        nvidia,core-pwr-off-time = <39065>;
        nvidia,core-power-req-active-high;
        nvidia,sys-clock-req-active-high;

        pd_core: core-domain {
            operating-points-v2 = <&core_opp_table>;
            #power-domain-cells = <0>;
        };

        powergates {
            pd_audio: aud {
                clocks = <&tegra_car TEGRA210_CLK_APE>,
                         <&tegra_car TEGRA210_CLK_APB2APE>;
                resets = <&tegra_car 198>;
                power-domains = <&pd_core>;
                #power-domain-cells = <0>;
            };

            pd_xusbss: xusba {
                clocks = <&tegra_car TEGRA210_CLK_XUSB_SS>;
                resets = <&tegra_car TEGRA210_CLK_XUSB_SS>;
                power-domains = <&pd_core>;
                #power-domain-cells = <0>;
            };
        };
    };
```

## Documentation/devicetree/bindings/soc/ti/k3-ringacc_cn.yaml
```yaml
### 许可证标识符：(GPL-2.0-only 或 BSD-2-Clause)
### 版权所有：2020 Texas Instruments Incorporated - http://www.ti.com/

**YAML 1.2**
---
$id$: http://devicetree.org/schemas/soc/ti/k3-ringacc.yaml#
$schema$: http://devicetree.org/meta-schemas/core.yaml#

**标题**：Texas Instruments K3 NavigatorSS 环形加速器

**维护者**：
  - Santosh Shilimkar <ssantosh@kernel.org>
  - Grygorii Strashko <grygorii.strashko@ti.com>

**描述**：  
  环形加速器（RA）是一台将对固定地址的读/写访问转换为对内存中环形数据结构相应读/写访问的机器。RA消除了每个需要访问环元素的DMA控制器必须了解当前环状态（基地址、当前偏移量）的需求。DMA控制器执行对特定地址范围的读或写访问（这映射到RA上的源接口），而RA将交易中的地址替换为一个新的地址，该地址对应于环的头部或尾部元素（对于读取是头部，对于写入是尾部）。  
  环形加速器是一个硬件模块，负责加速数据包队列的管理。K3系统级芯片可以拥有一个以上的RA实例。

**全部遵循**：
  - $ref: /schemas/arm/keystone/ti,k3-sci-common.yaml#

**属性**：
  compatible:
    items:
      - 常值: ti,am654-navss-ringacc

  reg:
    minItems: 4
    items:
      - 描述: 实时寄存器区域
      - 描述: FIFO寄存器区域
      - 描述: 代理gcfg寄存器区域
      - 描述: 代理目标寄存器区域
      - 描述: 配置寄存器区域

  reg-names:
    minItems: 4
    items:
      - 常值: rt
      - 常值: fifos
      - 常值: proxy_gcfg
      - 常值: proxy_target
      - 常值: cfg

  msi-parent: true

  ti,num-rings:
    $ref: /schemas/types.yaml#/definitions/uint32
    描述: RA支持的环数

  ti,sci-rm-range-gp-rings:
    $ref: /schemas/types.yaml#/definitions/uint32
    描述: TI-SCI RM子类型用于通用环范围

**必需**：
  - compatible
  - reg
  - reg-names
  - msi-parent
  - ti,num-rings
  - ti,sci-rm-range-gp-rings
  - ti,sci
  - ti,sci-dev-id

**未评估属性**：false

**示例**：
  - |
    bus {
        #address-cells = <2>;
        #size-cells = <2>;

        ringacc: ringacc@3c000000 {
            compatible = "ti,am654-navss-ringacc";
            reg = <0x0 0x3c000000 0x0 0x400000>,
                  <0x0 0x38000000 0x0 0x400000>,
                  <0x0 0x31120000 0x0 0x100>,
                  <0x0 0x33000000 0x0 0x40000>,
                  <0x0 0x31080000 0x0 0x40000>;
            reg-names = "rt", "fifos", "proxy_gcfg", "proxy_target", "cfg";
            ti,num-rings = <818>;
            ti,sci-rm-range-gp-rings = <0x2>; /* 通用环范围 */
            ti,sci = <&dmsc>;
            ti,sci-dev-id = <187>;
            msi-parent = <&inta_main_udmass>;
        };
    };
```

## Documentation/devicetree/bindings/soc/ti/keystone-navigator-dma_cn.txt
~~~~
### Keystone Navigator DMA 控制器

本文件解释了 Keystone 设备上数据包 DMA 的设备树绑定。Keystone Navigator DMA 驱动程序为 QMSS（队列管理子系统）设置 DMA 通道和流，QMSS 触发客户端间实际的数据传输使用目标队列。每个客户端模块，如 NETCP（网络协处理器）、SRIO（串行快速 I/O）、CRYPTO 引擎等，都有自己的 DMA 硬件实例。QMSS 也有一个内部的数据包 DMA 模块，作为零复制基础设施 DMA 使用。

#### Navigator DMA 云布局：
```
------------------
| Navigator DMAs |
------------------
    |
    |-> DMA 实例 #0
    |
    |-> DMA 实例 #1

    |
    |-> DMA 实例 #n
```

#### Navigator DMA 属性：

**必需属性：**
- `compatible`：应为 "ti,keystone-navigator-dma"
- `clocks`：指向 DMA 实例时钟的 phandle。时钟句柄的数量可以与 DMA 实例数量相同。顺序应保持与 DMA 实例一致。
- `ti,navigator-cloud-address`：应包含多核 Navigator 云的基本地址，地址的数量取决于 SoC 集成配置。Navigator 云全局地址需要被编程到 DMA 中，并且 DMA 将其用作到达队列管理器的物理地址。需要注意的是，尽管这些地址指向队列管理器，但它们仅从 DMA 的角度来看是相关的。QMSS 可能不会选择使用它们，因为它有一个不同的地址空间视图来访问所有组件。

#### DMA 实例属性：

**必需属性：**
- `reg`：应包含以下 DMA 寄存器区域的位置和长度。寄存器区域应按以下顺序指定：
  - 全局控制寄存器区域（global）
  - 发送 DMA 通道配置寄存器区域（txchan）
  - 接收 DMA 通道配置寄存器区域（rxchan）
  - 发送 DMA 通道调度器配置寄存器区域（txsched）
### DMA 流配置寄存器区域 (rxflow)
可选属性:
- `reg-names`: 寄存器区域的名称。
- `ti,enable-all`: 启用所有DMA通道，而不是客户端仅打开它们需要的具体通道。此属性对于用户空间快速路径案例有用，在这种情况下，Linux驱动程序会启用用户空间堆栈使用的通道。
- `ti,loop-back`: 用于将Tx流接口回环到Rx流接口。用于基础设施传输。
- `ti,rx-retry-timeout`: 缓冲区饥饿前等待的DMA周期数。

#### 示例：

```plaintext
knav_dmas: knav_dmas@0 { // DMA 设备节点
    compatible = "ti,keystone-navigator-dma"; // 兼容性字符串
    clocks = <&papllclk>, <&clkxge>; // 钟频率引用
    #address-cells = <1>; // 地址单元的数量
    #size-cells = <1>; // 大小单元的数量
    ranges; // 地址映射范围
    ti,navigator-cloud-address = <0x23a80000 0x23a90000
                                 0x23aa0000 0x23ab0000>; // 导航器云地址

    dma_gbe: dma_gbe@0 { // GBE DMA 控制器实例
        reg = <0x2004000 0x100>,
             <0x2004400 0x120>,
             <0x2004800 0x300>,
             <0x2004c00 0x120>,
             <0x2005000 0x400>; // 寄存器基地址和大小
        reg-names = "global", "txchan", "rxchan",
                    "txsched", "rxflow"; // 寄存器区域名称
    };

    dma_xgbe: dma_xgbe@0 { // XGBE DMA 控制器实例
        reg = <0x2fa1000 0x100>,
             <0x2fa1400 0x200>,
             <0x2fa1800 0x200>,
             <0x2fa1c00 0x200>,
             <0x2fa2000 0x400>; // 寄存器基地址和大小
        reg-names = "global", "txchan", "rxchan",
                    "txsched", "rxflow"; // 寄存器区域名称
    };
};
```

### Navigator DMA 客户端
必需属性:
- `ti,navigator-dmas`: 一个或多个DMA指定符列表，每个指定符包括：
   - 指向DMA实例节点的phandle
   - 作为phandle参数的DMA通道编号
- `ti,navigator-dma-names`: 包含在`ti,navigator-dmas`属性中每个DMA指定符对应的DMA通道名称。

#### 示例：

```plaintext
netcp: netcp@2090000 { // 网络控制器节点
    .
    ti,navigator-dmas = <&dma_gbe 22>,
                         <&dma_gbe 23>,
                         <&dma_gbe 8>; // DMA指定符列表
    ti,navigator-dma-names = "netrx0", "netrx1", "nettx"; // DMA通道名称
    .
};
```
~~~~
