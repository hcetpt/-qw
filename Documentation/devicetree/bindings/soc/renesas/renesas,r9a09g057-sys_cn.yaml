## Documentation/devicetree/bindings/soc/ti/sci-pm-domain_cn.yaml
```yaml
# SPDX-许可证标识符: (GPL-2.0-only 或 BSD-2-Clause)
%YAML 1.2
---
$id: http://devicetree.org/schemas/soc/ti/sci-pm-domain.yaml#
$schema: http://devicetree.org/meta-schemas/core.yaml#

标题: TI-SCI 通用电源域

维护者:
  - Nishanth Menon <nm@ti.com>

allOf:
  - $ref: /schemas/power/power-domain.yaml#

描述: |
  某些 TI 系统芯片 (SoC) 包含一个系统控制器（例如，在 Keystone 66AK2G SoC 上的电源管理微控制器 (PMMC)），这些控制器负责控制 SoC 上存在的各种硬件模块的状态。主机处理器运行操作系统与系统控制器之间的通信通过称为 TI 系统控制接口 (TI-SCI 协议) 的协议进行。
此电源域节点代表由 TI-SCI 控制器管理的全局电源域。由于它依赖于 TI SCI 协议与 TI-SCI 控制器通信，因此必须是 TI-SCI 控制器节点的子节点。

属性:
  compatible:
    常量: ti,sci-pm-domain

  "#power-domain-cells":
    枚举: [1, 2]
    描述:
      这两个单元表示 TI-SCI 控制器定义的值。
第一个单元应包含设备 ID。
如果单元值为 2，则第二个单元应该是以下之一：
      TI_SCI_PD_EXCLUSIVE - 允许设备被独家控制
      或
      TI_SCI_PD_SHARED - 允许设备被多个主机共享
请参考 dt-bindings/soc/ti,sci_pm_domain.h 获取定义。
请参阅 https://software-dl.ti.com/tisci/esd/latest/index.html 获取不同设备使用的协议文档中的值。
additionalProperties: false

示例:
  - |
    k2g_pds: power-controller {
        compatible = "ti,sci-pm-domain";
        #power-domain-cells = <1>;
    };

  - |
    k3_pds: power-controller {
        compatible = "ti,sci-pm-domain";
        #power-domain-cells = <2>;
    };
```

## Documentation/devicetree/bindings/soc/ti/ti,am654-serdes-ctrl_cn.yaml
~~~~yaml
```yaml
# SPDX-许可证标识符: GPL-2.0-only 或 BSD-2-Clause
%YAML 1.2
---
$id: http://devicetree.org/schemas/soc/ti/ti,am654-serdes-ctrl.yaml#
$schema: http://devicetree.org/meta-schemas/core.yaml#

title: Texas Instruments AM654 Serdes 控制 Syscon

maintainers:
  - Nishanth Menon <nm@ti.com>

properties:
  compatible:
    items:
      - const: ti,am654-serdes-ctrl
      - const: syscon

  reg:
    maxItems: 1

  mux-controller:
    $ref: /schemas/mux/reg-mux.yaml#

required:
  - compatible
  - reg
  - mux-controller

additionalProperties: false

examples:
  - |
    clock@4080 {
        compatible = "ti,am654-serdes-ctrl", "syscon";
        reg = <0x4080 0x4>;

        mux-controller {
            compatible = "mmio-mux";
            #mux-control-cells = <1>;
            mux-reg-masks = <0x0 0x3>; /* 车道选择 */
        };
    };
```

此文档定义了Texas Instruments AM654 Serdes控制Syscon的Device Tree规范。它包括对兼容性的要求、寄存器的使用以及多路复用控制器的配置。示例部分展示了一个具体的设备树片段，用于说明如何配置AM654 Serdes控制Syscon。
~~~~
