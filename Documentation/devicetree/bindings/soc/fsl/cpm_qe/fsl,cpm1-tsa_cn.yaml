## Documentation/devicetree/bindings/soc/fsl/cpm_qe/fsl,cpm1-tsa_cn.yaml
```yaml
# SPDX-许可证标识符: (GPL-2.0-only 或 BSD-2-Clause)
%YAML 1.2
---
$id: http://devicetree.org/schemas/soc/fsl/cpm_qe/fsl,cpm1-tsa.yaml#
$schema: http://devicetree.org/meta-schemas/core.yaml#

标题: PowerQUICC CPM 时间槽分配器 (TSA) 控制器

维护者:
  - Herve Codina <herve.codina@bootlin.com>

描述:
  TSA 是可在某些 PowerQUICC 系统级芯片上找到的时间槽分配器。
它的目的是将一些时分复用 (TDM) 时间槽路由到其他内部串行控制器。
属性:
  compatible:
    items:
      - 枚举:
          - fsl,mpc885-tsa
          - fsl,mpc866-tsa
      - 常量: fsl,cpm1-tsa

  reg:
    items:
      - 描述: SI (串行接口) 寄存器基址
      - 描述: SI RAM 基址

  reg-names:
    items:
      - 常量: si_regs
      - 常量: si_ram

  '#address-cells':
    常量: 1

  '#size-cells':
    常量: 0

模式属性:
  '^tdm@[0-1]$':
    描述:
      该控制器管理的 TDM
    类型: 对象

    不允许额外属性。

    属性:
      reg:
        最小值: 0
        最大值: 1
        描述:
          该 TDM 的编号，0 表示 TDMa，1 表示 TDMb

      fsl,common-rxtx-pins:
        $ref: /schemas/types.yaml#/definitions/flag
        描述:
          硬件可以使用四个专用引脚用于 Tx 时钟、Tx 同步、Rx 时钟和 Rx 同步，
          或仅使用两个引脚用于 Tx/Rx 时钟和 Tx/Rx 同步。
          如果没有 'fsl,common-rxtx-pins' 属性，则使用四个引脚。
          如果有 'fsl,common-rxtx-pins' 属性，则使用两个引脚。
      clocks:
        minItems: 2
        items:
          - 描述: 连接到 L1RSYNC 引脚的外部时钟
          - 描述: 连接到 L1RCLK 引脚的外部时钟
          - 描述: 连接到 L1TSYNC 引脚的外部时钟
          - 描述: 连接到 L1TCLK 引脚的外部时钟

      clock-names:
        minItems: 2
        items:
          - 常量: l1rsync
          - 常量: l1rclk
          - 常量: l1tsync
          - 常量: l1tclk

      fsl,rx-frame-sync-delay-bits:
        枚举: [0, 1, 2, 3]
        默认: 0
        描述: |
          接收帧同步延迟比特数
          指示 Rx 同步与 Rx 帧的第一个比特之间的延迟。0 表示无比特延迟。1、2 或 3 表示 1、2 或 3 比特延迟。
      fsl,tx-frame-sync-delay-bits:
        枚举: [0, 1, 2, 3]
        默认: 0
        描述: |
          发送帧同步延迟比特数
          指示 Tx 同步与 Tx 帧的第一个比特之间的延迟。0 表示无比特延迟。1、2 或 3 表示 1、2 或 3 比特延迟。
      fsl,clock-falling-edge:
        $ref: /schemas/types.yaml#/definitions/flag
        描述:
          数据在时钟下降沿发送（并在上升沿接收）。如果未指定 'clock-falling-edge'，
          则数据在上升沿发送（并在下降沿接收）。
Here's the translation into Chinese:

`fsl`, `fsync-rising-edge`:
        $ref: /schemas/types.yaml#/definitions/flag
        description:
          帧同步脉冲使用通道时钟的上升沿进行采样。如果不存在`fsync-rising-edge`，则脉冲使用下降沿进行采样。

`fsl`, `double-speed-clock`:
        $ref: /schemas/types.yaml#/definitions/flag
        description:
          通道时钟是数据速率的两倍。

`patternProperties`:
      '^fsl,[rt]x-ts-routes$':
        $ref: /schemas/types.yaml#/definitions/uint32-matrix
        description: |
          一个元组列表，指示Tx或Rx时隙的路由
items:
          items:
            - description:
                时隙的数量
              minimum: 1
              maximum: 64
            - description: |
                源（Tx）或目的地（Rx）串行接口
                （dt-bindings/soc/cpm1-fsl,tsa.h定义了这些值）
                 - 0: 无目的地
                 - 1: SCC2
                 - 2: SCC3
                 - 3: SCC4
                 - 4: SMC1
                 - 5: SMC2
              enum: [0, 1, 2, 3, 4, 5]
        minItems: 1
        maxItems: 64

`allOf`:
      # 如果存在`fsl,common-rxtx-pins`，只需要2个时钟
# 否则，必须存在4个时钟
- if:
          required:
            - fsl,common-rxtx-pins
        then:
          properties:
            clocks:
              maxItems: 2
            clock-names:
              maxItems: 2
        else:
          properties:
            clocks:
              minItems: 4
            clock-names:
              minItems: 4

`required`:
      - reg
      - clocks
      - clock-names

`required`:
  - compatible
  - reg
  - reg-names
  - '#address-cells'
  - '#size-cells'

additionalProperties: false

例子:
  - |
    #include <dt-bindings/soc/cpm1-fsl,tsa.h>

    tsa@ae0 {
        compatible = "fsl,mpc885-tsa", "fsl,cpm1-tsa";
        reg = <0xae0 0x10>,
              <0xc00 0x200>;
        reg-names = "si_regs", "si_ram";

        #address-cells = <1>;
        #size-cells = <0>;

        tdm@0 {
            /* TDMa */
            reg = <0>;

            clocks = <&clk_l1rsynca>, <&clk_l1rclka>;
            clock-names = "l1rsync", "l1rclk";

            fsl,common-rxtx-pins;
            fsl,fsync-rising-edge;

            fsl,tx-ts-routes = <2 0>,             /* TS 0..1 */
                           <24 FSL_CPM_TSA_SCC4>, /* TS 2..25 */
                           <1 0>,                 /* TS 26 */
                           <5 FSL_CPM_TSA_SCC3>;  /* TS 27..31 */

            fsl,rx-ts-routes = <2 0>,             /* TS 0..1 */
                           <24 FSL_CPM_TSA_SCC4>, /* 2..25 */
                           <1 0>,                 /* TS 26 */
                           <5 FSL_CPM_TSA_SCC3>;  /* TS 27..31 */
        };
    };
```

## Documentation/devicetree/bindings/soc/fsl/cpm_qe/fsl,qe-firmware_cn.yaml
```yaml
# SPDX-许可证标识符: (GPL-2.0-only 或 BSD-2-Clause)
%YAML 1.2
---
$id: http://devicetree.org/schemas/soc/fsl/cpm_qe/fsl,qe-firmware.yaml#
$schema: http://devicetree.org/meta-schemas/core.yaml#

title: Freescale QUICC Engine 模块固件节点

maintainers:
  - Frank Li <Frank.Li@nxp.com>

description: |
  此节点定义了一个嵌入在设备树中的固件二进制文件，其目的是为了将固件从引导加载程序传递给内核，或从虚拟机监控器传递给客户机。
  固件节点本身包含了固件的二进制内容、兼容性属性以及任何特定于固件的属性。该节点应放置在需要它的 QE 节点内部。这样做消除了对 fsl,firmware-phandle 属性的需求。其他需要相同固件的 QE 节点应该定义一个 fsl,firmware-phandle 属性，指向第一个 QE 节点内的固件节点。
  fsl,firmware 属性可以在 DTS 中指定（可能使用 incbin），或者由引导加载程序在启动时插入。
properties:
  compatible:
    enum:
      - fsl,qe-firmware

  fsl,firmware:
    $ref: /schemas/types.yaml#/definitions/uint8-array
    description:
      这是一个标准属性。此属性包含固件二进制“块”。
required:
  - compatible
  - fsl,firmware

additionalProperties: false

examples:
  - |
    qe-firmware {
        compatible = "fsl,qe-firmware";
        fsl,firmware = <0x70 0xcd 0x00 0x00 0x01 0x46 0x45>;
    };
```

## Documentation/devicetree/bindings/soc/fsl/cpm_qe/fsl,qe-ic_cn.yaml
```yaml
# SPDX-许可证标识符: (GPL-2.0-only 或 BSD-2-Clause)
%YAML 1.2
---
$id: http://devicetree.org/schemas/soc/fsl/cpm_qe/fsl,qe-ic.yaml#
$schema: http://devicetree.org/meta-schemas/core.yaml#

title: Freescale QUICC Engine 模块中断控制器 (IC)

maintainers:
  - Frank Li <Frank.Li@nxp.com>

properties:
  compatible:
    const: fsl,qe-ic

  reg:
    maxItems: 1

  interrupts:
    items:
      - description: QE 中断
      - description: QE 关键
      - description: QE 错误
    minItems: 1

  interrupt-controller: true

  "#interrupt-cells":
    const: 1

required:
  - compatible
  - reg
  - interrupt-controller
  - "#interrupt-cells"

additionalProperties: false

examples:
  - |
    interrupt-controller@80 {
        compatible = "fsl,qe-ic";
        reg = <0x80 0x80>;
        #interrupt-cells = <1>;
        interrupt-controller;
        interrupts = <95 2 0 0  94 2 0 0>;
    };
```

## Documentation/devicetree/bindings/soc/fsl/cpm_qe/fsl,qe-muram_cn.yaml
```yaml
# SPDX-许可证标识符: (GPL-2.0-only 或 BSD-2-Clause)
%YAML 1.2
---
$id: http://devicetree.org/schemas/soc/fsl/cpm_qe/fsl,qe-muram.yaml#
$schema: http://devicetree.org/meta-schemas/core.yaml#

title: Freescale QUICC Engine 多用户RAM (MURAM)

maintainers:
  - Frank Li <Frank.Li@nxp.com>

description: 多用户RAM (MURAM)

properties:
  compatible:
    items:
      - const: fsl,qe-muram
      - const: fsl,cpm-muram

  ranges:
    maxItems: 1

  "#address-cells":
    const: 1

  "#size-cells":
    const: 1

  mode:
    $ref: /schemas/types.yaml#/definitions/string
    enum: [host, slave]


patternProperties:
  '^data\-only@[a-f0-9]+$':
    type: object
    properties:
      compatible:
        items:
          - const: fsl,qe-muram-data
          - const: fsl,cpm-muram-data

      reg:
        maxItems: 1

    required:
      - compatible
      - reg

    additionalProperties: false

required:
  - compatible
  - ranges

additionalProperties: false

examples:
  - |
    muram@10000 {
        compatible = "fsl,qe-muram", "fsl,cpm-muram";
        ranges = <0 0x00010000 0x0000c000>;
        #address-cells = <1>;
        #size-cells = <1>;

        data-only@0{
            compatible = "fsl,qe-muram-data",
                         "fsl,cpm-muram-data";
            reg = <0 0xc000>;
        };
     };
```

## Documentation/devicetree/bindings/soc/fsl/cpm_qe/fsl,qe-si_cn.yaml
```yaml
# SPDX-许可证标识符: (GPL-2.0-only 或 BSD-2-Clause)
%YAML 1.2
---
$id: http://devicetree.org/schemas/soc/fsl/cpm_qe/fsl,qe-si.yaml#
$schema: http://devicetree.org/meta-schemas/core.yaml#

title: Freescale QUICC Engine 模块串行接口块 (SI)

maintainers:
  - Frank Li <Frank.Li@nxp.com>

description:
  SI 管理八条 TDM 线路到 QE 块串行驱动器、MCC 和 UCC 的路由，用于接收和传输。

properties:
  compatible:
    oneOf:
      - items:
          - enum:
              - fsl,ls1043-qe-si
          - const: fsl,t1040-qe-si
      - enum:
          - fsl,t1040-qe-si

  reg:
    maxItems: 1

required:
  - compatible
  - reg

additionalProperties: false

examples:
  - |
    si@700 {
        compatible = "fsl,t1040-qe-si";
        reg = <0x700 0x80>;
    };
```

## Documentation/devicetree/bindings/soc/fsl/cpm_qe/fsl,qe-siram_cn.yaml
```yaml
# SPDX-许可证标识符: (GPL-2.0-only 或 BSD-2-Clause)
%YAML 1.2
---
$id: http://devicetree.org/schemas/soc/fsl/cpm_qe/fsl,qe-siram.yaml#
$schema: http://devicetree.org/meta-schemas/core.yaml#

title: Freescale QUICC Engine 模块串行接口块RAM (SIRAM)

维护者:
  - Frank Li <Frank.Li@nxp.com>

描述:
  用于存储串行接口的路由条目

属性:
  compatible:
    oneOf:
      - items:
          - enum:
              - fsl,ls1043-qe-siram
          - const: fsl,t1040-qe-siram
      - const: fsl,t1040-qe-siram

  reg:
    maxItems: 1

必需:
  - compatible
  - reg

附加属性: false

示例:
  - |
    siram@1000 {
        compatible = "fsl,t1040-qe-siram";
        reg = <0x1000 0x800>;
    };
```

## Documentation/devicetree/bindings/soc/fsl/cpm_qe/fsl,qe_cn.yaml
```yaml
# SPDX-许可证标识符: (GPL-2.0-only 或 BSD-2-Clause)
%YAML 1.2
---
$id: http://devicetree.org/schemas/soc/fsl/cpm_qe/fsl,qe.yaml#
$schema: http://devicetree.org/meta-schemas/core.yaml#

标题: Freescale QUICC Engine 模块 (QE)

维护者:
  - Frank Li <Frank.Li@nxp.com>

描述: |
  这表示安装在 PowerQUICC II Pro 上的 QE 模块。
注意: 这是一个临时绑定；文档后面部分中应根据 CPM 绑定进行更新。
基本上，它是一个设备总线，可以或多或少作为一个完整的实体来运行（例如 UCC、USB 等）。所有这些都应该作为“根”qe 节点的同级节点存在，并使用那里的通用属性。
以下描述适用于 MPC8360 的 QE，
未来将扩展更多的节点和属性。
属性:
  compatible:
    items:
      - const: fsl,qe
      - const: simple-bus

  reg:
    maxItems: 1

  ranges:
    maxItems: 1

  model:
    $ref: /schemas/types.yaml#/definitions/string
    enum: [QE, CPM, CPM2]

  bus-frequency:
    $ref: /schemas/types.yaml#/definitions/uint32
    描述: QUICC Engine 的时钟频率
  fsl,qe-num-riscs:
    $ref: /schemas/types.yaml#/definitions/uint32
    描述: 定义 QE 拥有的 RISC 引擎数量
  fsl,qe-snums:
    $ref: /schemas/types.yaml#/definitions/uint8-array
    maxItems: 28
    描述:
      定义虚拟线程的串行号 (SNUM) 值数组
  fsl,firmware-phandle:
    $ref: /schemas/types.yaml#/definitions/phandle
    描述: |
      如果没有 fsl,qe-firmware 子节点，则为必需。

      指向一个固件节点（参见下面的“QE 固件节点”）
      包含应为此 QE 加载的固件
对于固件节点的 compatible 属性应该声明为,
      "fsl,qe-firmware"
  brg-frequency:
    $ref: /schemas/types.yaml#/definitions/uint32
    描述:
      波特率生成器内部时钟源频率（以赫兹为单位）
这段文本定义了一个设备树片段，描述了特定硬件配置。以下是翻译后的中文版本：

`fsl,qe-num-snums`:
    `$ref`: `/schemas/types.yaml#/definitions/uint32`
    `deprecated`: `true`
    `description`: |
      定义QE可以为线程使用多少个序列号（SNUM）。建议使用`fsl,qe-snums`来不仅指定SNUM的数量，还指定它们的值。

`patternProperties`:
  `'^muram@[a-f0-9]+$'`:
    `$ref`: `fsl,qe-muram.yaml`

  `'^interrupt-controller@[a-f0-9]+$'`:
    `$ref`: `fsl,qe-ic.yaml`

  `'^si@[a-f0-9]+$'`:
    `$ref`: `fsl,qe-si.yaml`

  `'^siram@[a-f0-9]+$'`:
    `$ref`: `fsl,qe-siram.yaml`

`required`:
  - `compatible`
  - `reg`
  - `bus-frequency`

`allOf`:
  - `$ref`: `/schemas/simple-bus.yaml#`

`unevaluatedProperties`: `false`

`examples`:
  - |
    `qe-bus@e0100000` {
        `compatible` = `"fsl,qe"`, `"simple-bus"`;
        `reg` = `<0xe0100000 0x480>`;
        `ranges` = `<0 0xe0100000 0x00100000>`;
        `#address-cells` = `<1>`;
        `#size-cells` = `<1>`;
        `brg-frequency` = `<0>`;
        `bus-frequency` = `<0x179a7b00>`;
        `fsl,qe-snums` = `/bits/ 8` `<
            0x04 0x05 0x0c 0x0d 0x14 0x15 0x1c 0x1d
            0x24 0x25 0x2c 0x2d 0x34 0x35 0x88 0x89
            0x98 0x99 0xa8 0xa9 0xb8 0xb9 0xc8 0xc9
            0xd8 0xd9 0xe8 0xe9>`;

        `interrupt-controller@80` {
            `compatible` = `"fsl,qe-ic"`;
            `reg` = `<0x80 0x80>`;
            `#interrupt-cells` = `<1>`;
            `interrupt-controller`;
            `interrupts` = `<95 2 0 0  94 2 0 0>`;
        };

        `si@700` {
            `compatible` = `"fsl,t1040-qe-si"`;
            `reg` = `<0x700 0x80>`;
        };

        `siram@1000` {
          `compatible` = `"fsl,t1040-qe-siram"`;
          `reg` = `<0x1000 0x800>`;
        };

        `muram@10000` {
            `compatible` = `"fsl,qe-muram"`, `"fsl,cpm-muram"`;
            `ranges` = `<0 0x00010000 0x0000c000>`;
            `#address-cells` = `<1>`;
            `#size-cells` = `<1>`;

              `data-only@0` {
                  `compatible` = `"fsl,qe-muram-data"`,
                              `"fsl,cpm-muram-data"`;
                  `reg` = `<0 0xc000>`;
              };
        };
    };

请注意，这里的翻译保持了原有的格式和语法结构，并尽量贴近原文的表述方式。
```

## Documentation/devicetree/bindings/soc/fsl/cpm_qe/gpio_cn.txt
~~~~
每个GPIO控制器节点都必须定义`#gpio-cells`属性，这些信息将用于转换GPIO指定符。

在CPM1设备上，所有端口使用略有不同的寄存器布局。
端口A、C和D是16位端口，而端口B和E是32位端口。
在CPM2设备上，所有端口都是32位端口，并且使用通用的寄存器布局。

必需的属性：
- `compatible`：可以是"fsl,cpm1-pario-bank-a"、"fsl,cpm1-pario-bank-b"、"fsl,cpm1-pario-bank-c"、"fsl,cpm1-pario-bank-d"、"fsl,cpm1-pario-bank-e"或"fsl,cpm2-pario-bank"
- `#gpio-cells`：应当为两个。第一个单元是针脚编号，第二个单元用于指定可选参数（当前未使用）
- `gpio-controller`：标记端口为GPIO控制器

可选属性：
- `fsl,cpm1-gpio-irq-mask`：对于具有中断能力的端口（如CPM1上的端口C），此属性指明哪些端口与中断相关联（端口按PCINT寄存器中的相同顺序列出）
- `interrupts`：此属性提供具有中断功能的每个GPIO的中断列表，如`fsl,cpm1-gpio-irq-mask`属性所描述。中断的数量应等于掩码属性中“1”的数量。列表中的第一个中断对应掩码中最显著的位。

下面是四个定义为GPIO控制器节点的SOC GPIO端口组的例子：

```text
CPM1_PIO_A: gpio-controller@950 {
	#gpio-cells = <2>;
	compatible = "fsl,cpm1-pario-bank-a";
	reg = <0x950 0x10>;
	gpio-controller;
};

CPM1_PIO_B: gpio-controller@ab8 {
	#gpio-cells = <2>;
	compatible = "fsl,cpm1-pario-bank-b";
	reg = <0xab8 0x10>;
	gpio-controller;
};

CPM1_PIO_C: gpio-controller@960 {
	#gpio-cells = <2>;
	compatible = "fsl,cpm1-pario-bank-c";
	reg = <0x960 0x10>;
	fsl,cpm1-gpio-irq-mask = <0x0fff>;
	interrupts = <1 2 6 9 10 11 14 15 23 24 26 31>;
	interrupt-parent = <&CPM_PIC>;
	gpio-controller;
};

CPM1_PIO_E: gpio-controller@ac8 {
	#gpio-cells = <2>;
	compatible = "fsl,cpm1-pario-bank-e";
	reg = <0xac8 0x18>;
	gpio-controller;
};
```
~~~~
