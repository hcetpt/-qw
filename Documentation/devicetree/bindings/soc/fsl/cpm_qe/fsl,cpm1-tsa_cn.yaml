## Documentation/devicetree/bindings/soc/fsl/fsl,qman-portal_cn.yaml
```yaml
下面是给定 YAML 文档的中文翻译：

# SPDX-License-Identifier: (GPL-2.0-only OR BSD-2-Clause)
%YAML 1.2
---
$id: http://devicetree.org/schemas/soc/fsl/fsl,qman-portal.yaml#
$schema: http://devicetree.org/meta-schemas/core.yaml#

title: QorIQ DPAA 队列管理器端口

maintainers:
  - Frank Li <Frank.Li@nxp.com>

description:
  端口是与 QMan 的内存映射接口，允许在处理器内核、加速器和网络接口上运行的软件以低延迟、无锁的方式与 QMan 进行交互。

properties:
  compatible:
    oneOf:
      - const: fsl,qman-portal
      - items:
          - enum:
              - fsl,ls1043-qman-portal
              - fsl,ls1046-qman-portal
              - fsl,qman-portal-1.2.0
          - const: fsl,qman-portal

  reg:
    items:
      - description: 端口的缓存启用区域
      - description: 端口的缓存抑制区域

  interrupts:
    maxItems: 1

  fsl,liodn:
    $ref: /schemas/types.yaml#/definitions/uint32-array
    description: 参见 pamu.txt。两个 LIODN。数据队列重排序寄存器 LIODN (DLIODN) 和帧 LIODN (FLIODN)

  fsl,iommu-parent:
    $ref: /schemas/types.yaml#/definitions/phandle
    description: 参见 pamu.txt

  fsl,qman-channel-id:
    $ref: /schemas/types.yaml#/definitions/uint32
    description: qman 通道 ID

  cell-index:
    $ref: /schemas/types.yaml#/definitions/uint32
    description:
      通道的硬件索引。这也可以通过将通道的任一工作队列 ID 除以 8 来确定。

      除了这些属性外，qman 端口还应具有子节点来表示与此软件端口连接的硬件设备/端口。

required:
  - compatible
  - reg
  - interrupts

additionalProperties: false

patternProperties:
  '^(fman0|fman1|pme|crypto)+$':
    type: object
    properties:
      fsl,liodn:
        description: 参见 pamu.txt，PAMU 属性用于静态 LIODN 分配

      fsl,iommu-parent:
        description: 参见 pamu.txt，PAMU 属性用于动态 LIODN 分配

      dev-handle:
        $ref: /schemas/types.yaml#/definitions/phandle
        description:
          此端口所连接到的具体硬件设备的 phandle
additionalProperties: false

examples:
  - |
    #include <dt-bindings/interrupt-controller/irq.h>

    qman-portal@0 {
        compatible = "fsl,qman-portal-1.2.0", "fsl,qman-portal";
        reg = <0 0x4000>, <0x100000 0x1000>;
        interrupts = <104 IRQ_TYPE_EDGE_FALLING 0 0>;
        fsl,liodn = <1 2>;
        fsl,qman-channel-id = <0>;

        fman0 {
            fsl,liodn = <0x21>;
            dev-handle = <&fman0>;
        };

        fman1 {
            fsl,liodn = <0xa1>;
            dev-handle = <&fman1>;
        };

        crypto {
            fsl,liodn = <0x41 0x66>;
            dev-handle = <&crypto>;
        };
    };
```

## Documentation/devicetree/bindings/soc/fsl/fsl,qman_cn.yaml
```yaml
# SPDX-许可证标识符: (GPL-2.0-only 或 BSD-2-Clause)
%YAML 1.2
---
$id: http://devicetree.org/schemas/soc/fsl/fsl,qman.yaml#
$schema: http://devicetree.org/meta-schemas/core.yaml#

标题: QorIQ DPAA 队列管理器

维护者:
  - Frank Li <Frank.Li@nxp.com>

描述:
  队列管理器是数据路径加速架构（DPAA）的一部分。QMan 支持将帧队列化并进行 QoS 调度至 CPU、网络接口以及 DPAA 逻辑模块，并保持流内数据包的顺序。除了提供基于流级别的队列外，还负责诸如 RED/WRED、拥塞通知和尾部丢弃等拥塞管理功能。此绑定涵盖了 CCSR 空间编程模型。

属性:
  compatible:
    oneOf:
      - const: fsl,qman
      - items:
          - enum:
              - fsl,ls1043a-qman
              - fsl,ls1046a-qman
          - const: fsl,qman
  reg:
    items:
      - 描述: |
          在 CCSR 地址空间内的寄存器区域

          QMan 的版本信息位于 QMAN_IP_REV_1/2 寄存器中，这些寄存器位于偏移地址 0xbf8 和 0xbfc 处

  interrupts:
    items:
      - 描述: 错误中断

  fsl,qman-portals:
    $ref: /schemas/types.yaml#/definitions/phandle
    描述: 参见 fsl,qman-port.yaml

  fsl,liodn:
    $ref: /schemas/types.yaml#/definitions/uint32-array
    描述:
      参见 pamu.txt，PAMU 属性用于静态 LIODN 分配

  fsl,iommu-parent:
    $ref: /schemas/types.yaml#/definitions/phandle
    描述:
      参见 pamu.txt，PAMU 属性用于动态 LIODN 分配

  clocks:
    maxItems: 1
    描述:
      输入时钟参考。其频率为平台时钟的一半

  memory-region:
    maxItems: 2
    描述:
      引用 QMan 私有内存节点的句柄列表（如下所述）。qman-fqd 节点必须首先出现，然后是 qman-pfdr 节点。
仅在通过直接连接端口 (DCP) 连接到 QMan 实例的 ARM 设备上使用
      DCP 必须链接到相应的 QMan 实例
fsl,qman:
    $ref: /schemas/types.yaml#/definitions/uint32-array
    描述:
      列表包含指向 QMan 实例的句柄和 DCP 索引对，该实例通过 DCP 与该设备相连

必需项:
  - compatible
  - reg
  - interrupts

附加属性: false

示例:
  - |
    #include <dt-bindings/interrupt-controller/irq.h>

    qman: qman@318000 {
        compatible = "fsl,qman";
        reg = <0x318000 0x1000>;
        interrupts = <16 IRQ_TYPE_EDGE_FALLING 1 3>;
        fsl,liodn = <0x16>;
        fsl,qman-portals = <&qportals>;
        memory-region = <&qman_fqd &qman_pfdr>;
        clocks = <&platform_pll 1>;
    };
```

## Documentation/devicetree/bindings/soc/fsl/guts_cn.txt
~~~~
* 全局实用功能模块

全局实用功能模块控制电源管理、I/O设备启用、上电复位配置监控、通用I/O信号配置、多路复用信号的备用功能选择以及时钟控制。
必需属性：

- compatible：应定义适用于全局实用功能的兼容设备类型
可能的兼容类型：
    "fsl,qoriq-device-config-1.0"
    "fsl,qoriq-device-config-2.0"
    "fsl,<芯片>-device-config"
    "fsl,<芯片>-guts"
- reg：该设备寄存器集的偏移量和长度
推荐属性：

- fsl,has-rstcr：指示全局实用功能寄存器集包含一个功能性的“复位控制寄存器”（即设置此寄存器中的HRESET_REQ位时，板卡将被复位）
- fsl,liodn-bits：指示对于具有PAMU设备的系统级芯片(SoC)，LIODN寄存器中定义的位数
- little-endian：指示全局实用功能模块采用小端格式。默认情况下为大端格式
示例：
```
global-utilities@e0000 {	/* 全局实用功能模块 */
	compatible = "fsl,mpc8548-guts";
	reg = <e0000 1000>;
	fsl,has-rstcr;
};
```

```
guts: global-utilities@e0000 {
	compatible = "fsl,qoriq-device-config-1.0";
	reg = <0xe0000 0xe00>;
	fsl,has-rstcr;
	#sleep-cells = <1>;
	fsl,liodn-bits = <12>;
};
```
~~~~
