## Documentation/devicetree/bindings/soc/fsl/cpm_qe/network_cn.txt
~~~~
* 网络

当前定义的兼容设备：
- fsl,cpm1-scc-enet
- fsl,cpm2-scc-enet
- fsl,cpm1-fec-enet
- fsl,cpm2-fcc-enet（第三个资源是GFEMR）
- fsl,qe-enet

示例：

```yaml
ethernet@11300 {
	compatible = "fsl,mpc8272-fcc-enet",
			     "fsl,cpm2-fcc-enet";
		reg = <11300 20 8400 100 11390 1>;
		local-mac-address = [ 00 00 00 00 00 00 ];
		interrupts = <20 8>;
		interrupt-parent = <&PIC>;
		phy-handle = <&PHY0>;
		fsl,cpm-command = <12000300>;
};
```

* MDIO

当前定义的兼容设备：
fsl,pq1-fec-mdio（reg与FEC设备的第一个资源相同）
fsl,cpm2-mdio-bitbang（reg为端口C寄存器）

fsl,cpm2-mdio-bitbang的属性：
fsl,mdio-pin : 控制MDIO数据的端口C引脚
fsl,mdc-pin : 控制MDIO时钟的端口C引脚

示例：

```yaml
mdio@10d40 {
	compatible = "fsl,mpc8272ads-mdio-bitbang",
			     "fsl,mpc8272-mdio-bitbang",
			     "fsl,cpm2-mdio-bitbang";
		reg = <10d40 14>;
		#address-cells = <1>;
		#size-cells = <0>;
		fsl,mdio-pin = <12>;
		fsl,mdc-pin = <13>;
};
```

* HDLC

当前定义的兼容设备：
- fsl,ucc-hdlc

fsl,ucc-hdlc的属性：
- rx-clock-name
- tx-clock-name
	用途：必需
	值类型：<字符串>
	定义：内部时钟源必须为"brg1"-"brg16"，
		  外部时钟源必须为"clk1"-"clk24"
- fsl,tdm-interface
	用途：可选
	值类型：<空>
	定义：指定HDLC基于TDM接口

以下属性依赖于fsl,tdm-interface：
- fsl,rx-sync-clock
	用途：必需
	值类型：<字符串>
	定义：必须是"none"，"rsync_pin"，"brg9-11"或"brg13-15"
- fsl,tx-sync-clock
	用途：必需
	值类型：<字符串>
	定义：必须是"none"，"tsync_pin"，"brg9-11"或"brg13-15"
- fsl,tdm-framer-type
	用途：对于TDM接口是必需的
	值类型：<字符串>
	定义："e1" 或 "t1"。目前使用e1和t1，其他帧格式不支持
- fsl,tdm-id
	用途：对于TDM接口是必需的
	值类型：<u32>
	定义：TDM ID的编号
- fsl,tx-timeslot-mask
- fsl,rx-timeslot-mask
	用途：对于TDM接口是必需的
	值类型：<u32>
	定义：TDM操作的时间槽掩码。指示用于发送和接收的时间槽
- fsl,siram-entry-id
	用途：对于TDM接口是必需的
	值类型：<u32>
	定义：必须是0,2,4...64。TDM条目的编号
- fsl,tdm-internal-loopback
	用途：对于TDM接口是可选的
	值类型：<空>
	定义：在TDM层进行内部环回
- fsl,hmask
	用途：可选
	值类型：<u16>
	定义：HDLC地址识别。设置为零以禁用包地址过滤：
		    fsl,hmask = /bits/ 16 <0x0000>;

TDM接口示例：

```yaml
ucc@2000 {
	compatible = "fsl,ucc-hdlc";
	rx-clock-name = "clk8";
	tx-clock-name = "clk9";
	fsl,rx-sync-clock = "rsync_pin";
	fsl,tx-sync-clock = "tsync_pin";
	fsl,tx-timeslot-mask = <0xfffffffe>;
	fsl,rx-timeslot-mask = <0xfffffffe>;
	fsl,tdm-framer-type = "e1";
	fsl,tdm-id = <0>;
	fsl,siram-entry-id = <0>;
	fsl,tdm-interface;
};
```

无TDM接口的HDLC示例：

```yaml
ucc@2000 {
	compatible = "fsl,ucc-hdlc";
	rx-clock-name = "brg1";
	tx-clock-name = "brg1";
};
```
~~~~

## Documentation/devicetree/bindings/soc/fsl/cpm_qe/qe/par_io_cn.txt
~~~~
* 并行 I/O 端口

此节点为具有 QE 支持的 CPU 配置并行 I/O 端口。
该节点应位于树中的 "soc" 节点内。对于每个使用并行 I/O 端口的设备，都应该创建一个子节点。
有关更多信息，请参阅下面的引脚配置节点定义。
所需属性：
- device_type ： 应为 "par_io"
- reg ： 寄存器集的偏移及其长度
- num-ports ： 并行 I/O 端口的数量

示例：
```
par_io@1400 {
	reg = <1400 100>;
	#address-cells = <1>;
	#size-cells = <0>;
	device_type = "par_io";
	num-ports = <7>;
	ucc_pin@1 {
		.....
};
```

请注意，“par_io”节点已过时，不应在新的设备树中使用。相反，每个并行 I/O 银行应通过其自己的 gpio-controller 节点来表示：

所需属性：
- #gpio-cells ： 应为 "2"
- compatible ： 应为 "fsl,<chip>-qe-pario-bank", "fsl,mpc8323-qe-pario-bank"
- reg ： 寄存器集的偏移及其长度
- gpio-controller ： 识别 gpio 控制器的节点
示例：

`qe_pio_a`：gpio-controller@1400 {
	#gpio-cells = <2>;
	compatible = "fsl,mpc8360-qe-pario-bank",
	"fsl,mpc8323-qe-pario-bank";
	reg = <0x1400 0x18>;
	gpio-controller;
};

`qe_pio_e`：gpio-controller@1460 {
	#gpio-cells = <2>;
	compatible = "fsl,mpc8360-qe-pario-bank",
			     "fsl,mpc8323-qe-pario-bank";
	reg = <0x1460 0x18>;
	gpio-controller;
};

这里描述了两个 GPIO 控制器设备，分别是 `qe_pio_a` 和 `qe_pio_e`。每个控制器都定义了以下属性：
- `#gpio-cells = <2>`：表示 GPIO 引脚配置单元的数量为2。
- `compatible`：指定了与该控制器兼容的设备类型。
- `reg`：定义了设备的寄存器地址范围。
- `gpio-controller`：标记此设备为 GPIO 控制器。
~~~~

## Documentation/devicetree/bindings/soc/fsl/cpm_qe/qe/ucc_cn.txt
~~~~
* UCC（统一通信控制器）

必需属性：
- device_type : 应为 "network"、"hldc"、"uart"、"transparent"、
  "bisync"、"atm" 或 "serial"
- compatible : 可以是 "ucc_geth" 或 "fsl_atm" 等等
- cell-index : UCC 编号（1-8），对应 UM 中的 UCCx
- reg : 设备寄存器集的偏移量和长度
- interrupts : `<a b>` 其中 a 是中断编号，b 是一个表示中断的感觉和电平信息编码的字段。
  这应该根据您拥有的中断控制器类型，在第 2) 部分中的信息进行编码
- pio-handle : 并行 I/O 端口配置的 phandle
- port-number : 对于 UART 驱动程序，使用的端口号，范围在 0 到 3 之间。
  通常对应于 /dev/ttyQE 设备，例如 `<0>` 表示 /dev/ttyQE0。
  端口号加到设备的小号上。与 CPM UART 驱动程序不同，QE UART 驱动程序需要 port-number
- soft-uart : 对于 UART 驱动程序，如果指定，则意味着 QE UART 设备驱动程序应使用 "Soft-UART" 模式，
  这对于某些具有故障 UART 硬件的 SOC 是必需的。Soft-UART 通过微码上传提供
- rx-clock-name: UCC 接收时钟源
  "none": 关闭时钟源
  "brg1" 至 "brg16": 时钟源分别为 BRG1 至 BRG16
  "clk1" 至 "clk24": 时钟源分别为 CLK1 至 CLK24
- tx-clock-name: UCC 发送时钟源
  "none": 关闭时钟源
  "brg1" 至 "brg16": 时钟源分别为 BRG1 至 BRG16
  "clk1" 至 "clk24": 时钟源分别为 CLK1 至 CLK24

以下两个属性已废弃。rx-clock 已被 rx-clock-name 替换，tx-clock 已被 tx-clock-name 替换。
目前使用已弃用属性的驱动程序应继续这样做，以便支持旧版设备树，但它们应该首先更新以检查新属性。

- `rx-clock`：表示UCC接收时钟源。
  - 0x00：时钟源被禁用；
  - 0x1~0x10：时钟源分别为BRG1~BRG16；
  - 0x11~0x28：时钟源分别为QE_CLK1~QE_CLK24；

- `tx-clock`：表示UCC发送时钟源。
  - 0x00：时钟源被禁用；
  - 0x1~0x10：时钟源分别为BRG1~BRG16；
  - 0x11~0x28：时钟源分别为QE_CLK1~QE_CLK24；

网络设备类型所需的属性：
- `mac-address`：表示以太网地址的字节列表。
- `phy-handle`：与该控制器相连的PHY的phandle。

推荐使用的属性：
- `phy-connection-type`：一个字符串，命名控制器/PHY接口类型，例如，“mii”（默认）、“rmii”、“gmii”、“rgmii”、“rgmii-id”（内部延迟）、“rgmii-txid”（仅TX有延迟）、“rgmii-rxid”（仅RX有延迟）、“tbi”或“rtbi”。

示例：

```plaintext
ucc@2000 {
    device_type = "network";
    compatible = "ucc_geth";
    cell-index = <1>;
    reg = <2000 200>;
    interrupts = <a0 0>;
    interrupt-parent = <700>;
    mac-address = [ 00 04 9f 00 23 23 ];
    rx-clock = "none";  // 假设"none"表示0x00，即时钟源被禁用
    tx-clock = "clk9";  // 假设"clk9"表示某个具体的时钟源
    phy-handle = <212000>;
    phy-connection-type = "gmii";
    pio-handle = <140001>;
};
```

请注意，对于`rx-clock`和`tx-clock`的值，在示例中假设了文本形式的表示方法，而实际的数值应该根据上下文来确定。例如，“none”可能代表0x00（时钟源被禁用），而“clk9”则需要根据具体的实现细节来解释。
~~~~

## Documentation/devicetree/bindings/soc/fsl/cpm_qe/qe/usb_cn.txt
~~~~
Freescale QUICC Engine USB 控制器

必需属性：
- `compatible`：应为 "fsl,<chip>-qe-usb", "fsl,mpc8323-qe-usb"
- `reg`：前两个单元应包含USB寄存器的位置和长度，接下来的两个单元应包含PRAM的位置和长度
- `interrupts`：应包含USB中断
- `fsl,fullspeed-clock`：指定全速USB时钟源:
  - "none": 时钟源被禁用
  - "brg1" 至 "brg16": 时钟源分别是BRG1至BRG16
  - "clk1" 至 "clk24": 时钟源分别是CLK1至CLK24
- `fsl,lowspeed-clock`：指定低速USB时钟源:
  - "none": 时钟源被禁用
  - "brg1" 至 "brg16": 时钟源分别是BRG1至BRG16
  - "clk1" 至 "clk24": 时钟源分别是CLK1至CLK24
- `hub-power-budget`：根集线器的USB电源预算，单位是mA
- `gpios`：应按以下顺序指定GPIOs: USBOE, USBTP, USBTN, USBRP, USBRN, SPEED（可选）, 和 POWER（可选）

示例：

```yaml
usb@6c0 {
    compatible = "fsl,mpc8360-qe-usb", "fsl,mpc8323-qe-usb";
    reg = <0x6c0 0x40 0x8b00 0x100>;
    interrupts = <11>;
    interrupt-parent = <&qeic>;
    fsl,fullspeed-clock = "clk21";
    gpios = <&qe_pio_b  2 0 /* USBOE */
             &qe_pio_b  3 0 /* USBTP */
             &qe_pio_b  8 0 /* USBTN */
             &qe_pio_b  9 0 /* USBRP */
             &qe_pio_b 11 0 /* USBRN */
             &qe_pio_e 20 0 /* SPEED */
             &qe_pio_e 21 0 /* POWER */>;
};
```
请注意，这个配置文件示例用于定义一个特定的USB控制器硬件设备，并且这些配置项需要根据实际硬件进行调整。
~~~~

## Documentation/devicetree/bindings/soc/fsl/cpm_qe/serial_cn.txt
~~~~
### 串口（Serial）

当前定义的兼容设备：
- fsl,cpm1-smc-uart
- fsl,cpm2-smc-uart
- fsl,cpm1-scc-uart
- fsl,cpm2-scc-uart
- fsl,qe-uart

连接到GPIO控制器的调制解调器控制线在`gpios`属性中列出，具体描述参见`booting-without-of.txt`文档中的IX.1节，顺序如下：

CTS, RTS, DCD, DSR, DTR, 和 RI
`gpios`属性是可选的，在不使用控制线时可以省略。
#### 示例：

```txt
serial@11a00 {
    device_type = "串口";
    compatible = "fsl,mpc8272-scc-uart",
                 "fsl,cpm2-scc-uart";
    reg = <11a00 20 8000 100>;
    interrupts = <28 8>;
    interrupt-parent = <&PIC>;
    fsl,cpm-brg = <1>;
    fsl,cpm-command = <00800000>;
    gpios = <&gpio_c 15 0
             &gpio_d 29 0>;
};
```
### 注释说明：
- `serial@11a00`：表示串口设备位于地址0x11a00处。
- `device_type = "串口";`：指定设备类型为串口。
- `compatible`：声明了该设备与特定型号的兼容性。
- `reg`：指定了设备的内存区域或寄存器范围。
- `interrupts` 和 `interrupt-parent`：指定了中断信息及其父中断控制器。
- `fsl,cpm-brg` 和 `fsl,cpm-command`：这些是特定于Freescale平台的配置项。
- `gpios`：列出了与GPIO控制器关联的控制线。
~~~~

## Documentation/devicetree/bindings/soc/fsl/cpm_qe/uqe_serial_cn.txt
~~~~
所需属性：
compatible：必须是 "fsl,<chip>-ucc-uart"。对于 t1040，必须是
"fsl,t1040-ucc-uart"
port-number：UCC-UART 的端口号
tx/rx-clock-name：内部时钟源应为 "brg1"-"brg16"，
		   外部时钟源应为 "clk1"-"clk28"
示例：

``` 
ucc_serial: ucc@2200 {
	compatible = "fsl,t1040-ucc-uart";
	port-number = <0>;
	rx-clock-name = "brg2";
	tx-clock-name = "brg2";
};
```
~~~~

## Documentation/devicetree/bindings/soc/fsl/fsl,bman-portal_cn.yaml
```yaml
# SPDX-许可证标识符: (GPL-2.0-only 或 BSD-2-Clause)
%YAML 1.2
---
$id: http://devicetree.org/schemas/soc/fsl/fsl,bman-portal.yaml#
$schema: http://devicetree.org/meta-schemas/core.yaml#

标题: QorIQ DPAA 队列管理器端口

维护者:
  - Frank Li <Frank.Li@nxp.com>

描述:
  QorIQ DPAA 缓冲管理器端口

  端口是到 BMan 的内存映射接口，允许在处理器核心、加速器和网络接口上运行的软件与 BMan 进行低延迟、无锁的交互。

属性:
  compatible:
    oneOf:
      - const: fsl,bman-portal
      - items:
          - enum:
              - fsl,bman-portal-1.0.0
              - fsl,ls1043a-bmap-portal
              - fsl,ls1046a-bmap-portal
          - const: fsl,bman-portal
  reg:
    items:
      - description: 端口的启用缓存区域
      - description: 端口的禁用缓存区域

  interrupts:
    maxItems: 1

必需:
  - compatible
  - reg
  - interrupts

附加属性: false

示例:
  - |
    #include <dt-bindings/interrupt-controller/irq.h>

    bman-portal@0 {
        compatible = "fsl,bman-portal-1.0.0", "fsl,bman-portal";
        reg = <0x0 0x4000>, <0x100000 0x1000>;
        interrupts = <105 IRQ_TYPE_EDGE_FALLING 0 0>;
    };
```

## Documentation/devicetree/bindings/soc/fsl/fsl,bman_cn.yaml
```yaml
# SPDX-许可证标识符: (GPL-2.0-only 或 BSD-2-Clause)
%YAML 1.2
---
$id: http://devicetree.org/schemas/soc/fsl/fsl,bman.yaml#
$schema: http://devicetree.org/meta-schemas/core.yaml#

标题: QorIQ DPAA 缓冲区管理器

维护者:
  - Frank Li <Frank.Li@nxp.com>

描述:
  缓冲区管理器是数据路径加速架构（DPAA）的一部分。
  BMan 支持硬件分配和释放属于池的缓冲区，这些池最初由软件创建，并具有可配置的耗尽阈值。
  此绑定涵盖了 CCSR 空间编程模型。

属性:
  compatible:
    oneOf:
      - const: fsl,bman
      - items:
          - enum:
              - fsl,ls1043a-bman
              - fsl,ls1046a-bman
          - const: fsl,bman

  reg:
    items:
      - 描述: |
          在 CCSR 地址空间内的寄存器区域

          BMan 的版本信息位于 BMAN_IP_REV_1/2 寄存器中，这些寄存器位于偏移量 0xbf8 和 0xbfc 处

  interrupts:
    items:
      - 描述: 错误中断

  memory-region:
    minItems: 1
    maxItems: 2
    描述:
      引用 BMan 私有内存节点的 phandle 列表（如下所述）。bman-fqd 节点必须在 bman-pfdr 节点之前。仅用于 ARM

      通过直接连接端口（DCP）连接到 BMan 实例的设备必须链接到相应的 BMan 实例

  fsl,bman-portals:
    $ref: /schemas/types.yaml#/definitions/phandle
    描述: 引用 fsl,bman-port.yaml

  fsl,liodn:
    $ref: /schemas/types.yaml#/definitions/uint32-array
    描述:
      参见 pamu.txt，PAMU 属性用于静态 LIODN 分配

  fsl,iommu-parent:
    $ref: /schemas/types.yaml#/definitions/phandle
    描述:
      参见 pamu.txt，PAMU 属性用于动态 LIODN 分配

必需:
  - compatible
  - reg
  - interrupts

额外属性: false

示例:
  - |
    #include <dt-bindings/interrupt-controller/irq.h>

    bman@31a000 {
        compatible = "fsl,bman";
        reg = <0x31a000 0x1000>;
        interrupts = <16 IRQ_TYPE_EDGE_FALLING 1 2>;
        fsl,liodn = <0x17>;
        fsl,bman-portals = <&bportals>;
        memory-region = <&bman_fbpr>;
    };
```

## Documentation/devicetree/bindings/soc/fsl/fsl,layerscape-dcfg_cn.yaml
```yaml
# SPDX-许可证标识符: (GPL-2.0-only 或 BSD-2-Clause)
%YAML 1.2
---
$id: http://devicetree.org/schemas/soc/fsl/fsl,layerscape-dcfg.yaml#
$schema: http://devicetree.org/meta-schemas/core.yaml#

title: Freescale Layerscape 设备配置单元

maintainers:
  - Shawn Guo <shawnguo@kernel.org>

description: |
  DCFG 是设备配置单元，它为设备提供通用的配置和状态。例如设置次级核心启动地址和释放次级核心从等待状态启动。

properties:
  compatible:
    oneOf:
      - items:
          - enum:
              - fsl,ls1012a-dcfg
              - fsl,ls1021a-dcfg
              - fsl,ls1043a-dcfg
              - fsl,ls1046a-dcfg
              - fsl,ls1088a-dcfg
              - fsl,ls2080a-dcfg
              - fsl,lx2160a-dcfg
          - const: syscon

      - items:
          - enum:
              - fsl,ls1028a-dcfg
          - const: syscon
          - const: simple-mfd

  reg:
    maxItems: 1

  little-endian: true
  big-endian: true

  '#address-cells':
    const: 1

  '#size-cells':
    const: 1

  ranges: true

patternProperties:
  "^clock-controller@[0-9a-f]+$":
    $ref: /schemas/clock/fsl,flexspi-clock.yaml#

required:
  - compatible
  - reg

additionalProperties: false

examples:
  - |
    syscon@1ee0000 {
        compatible = "fsl,ls1021a-dcfg", "syscon";
        reg = <0x1ee0000 0x10000>;
    };
```

## Documentation/devicetree/bindings/soc/fsl/fsl,layerscape-scfg_cn.yaml
```yaml
# SPDX-许可证标识符: (GPL-2.0-only 或 BSD-2-Clause)
%YAML 1.2
---
$id: http://devicetree.org/schemas/soc/fsl/fsl,layerscape-scfg.yaml#
$schema: http://devicetree.org/meta-schemas/core.yaml#

title: Freescale Layerscape 补充配置单元

maintainers:
  - Shawn Guo <shawnguo@kernel.org>

description: |
  SCFG 是补充配置单元，它为芯片提供了特定于 SoC 的配置和状态寄存器。例如获取 PEX 端口的状态。
properties:
  compatible:
    items:
      - enum:
          - fsl,ls1012a-scfg
          - fsl,ls1021a-scfg
          - fsl,ls1028a-scfg
          - fsl,ls1043a-scfg
          - fsl,ls1046a-scfg
      - const: syscon

  reg:
    maxItems: 1

  little-endian: true
  big-endian: true

  '#address-cells':
    const: 1

  '#size-cells':
    const: 1

  ranges: true

patternProperties:
  "^interrupt-controller@[a-f0-9]+$":
    $ref: /schemas/interrupt-controller/fsl,ls-extirq.yaml#

required:
  - compatible
  - reg

additionalProperties: false

examples:
  - |
    syscon@1570000 {
        compatible = "fsl,ls1021a-scfg", "syscon";
        reg = <0x1570000 0x10000>;
    };
```

## Documentation/devicetree/bindings/soc/fsl/fsl,ls1028a-reset_cn.yaml
~~~~yaml
```yaml
# SPDX-许可证标识符: (GPL-2.0-only 或 BSD-2-Clause)
%YAML 1.2
---
$id: 'http://devicetree.org/schemas//soc/fsl/fsl,ls1028a-reset.yaml#'
$schema: 'http://devicetree.org/meta-schemas/core.yaml#'

title: Freescale Layerscape 重置寄存器模块

maintainers:
  - Frank Li

description:
  重置模块包括芯片重置、服务处理器控制和重置控制字 (RCW) 状态
properties:
  $nodename:
    pattern: '^syscon@[0-9a-f]+$'

  compatible:
    items:
      - enum:
          - fsl,ls1028a-reset
      - const: syscon
      - const: simple-mfd

  reg:
    maxItems: 1

  little-endian: true

  reboot:
    $ref: '/schemas/power/reset/syscon-reboot.yaml#'
    unevaluatedProperties: false

required:
  - compatible
  - reg
  - reboot

additionalProperties: false

examples:
  - |
    syscon@1e60000 {
        compatible = "fsl,ls1028a-reset", "syscon", "simple-mfd";
        reg = <0x1e60000 0x10000>;
        little-endian;

        reboot {
            compatible = "syscon-reboot";
            offset = <0>;
            mask = <0x02>;
        };
    };
```

此文档定义了一个用于Freescale Layerscape系列处理器中重置寄存器模块的Device Tree片段。它描述了如何配置该模块，包括必要的兼容性声明、寄存器地址范围以及如何实现重置功能。
~~~~

## Documentation/devicetree/bindings/soc/fsl/fsl,qman-fqd_cn.yaml
```yaml
# SPDX-许可证标识符: (GPL-2.0-only 或 BSD-2-Clause)
%YAML 1.2
---
$id: http://devicetree.org/schemas/soc/fsl/fsl,qman-fqd.yaml#
$schema: http://devicetree.org/meta-schemas/core.yaml#

标题: QMan 私有内存节点

维护者:
  - Frank Li <Frank.Li@nxp.com>

描述: |
  QMan 需要两段连续的物理内存范围，用于 QMan 帧队列描述符 (FQD) 和打包帧描述符记录 (PFDR) 的支持存储。
  这部分内存作为节点在 `/reserved-memory` 节点下保留/分配。
  BMan 需要一段连续的物理内存范围，用于 BMan 空闲缓冲区代理记录 (FBPR) 的支持存储。
  这部分内存也作为节点在 `/reserved-memory` 节点下保留/分配。
  QMan FQD 内存节点必须命名为 "qman-fqd"。
  QMan PFDR 内存节点必须命名为 "qman-pfdr"。
  BMan FBPR 内存节点必须命名为 "bman-fbpr"。

  下面这些约束与 FQD 和 PFDR 的私有内存相关：
    - 大小必须为 2^(大小 + 1)，其中大小 = 11..29。即 4 KiB 到 1 GiB。
    - 对齐必须是内存大小的倍数。

  FQD 和 PFDR 的大小必须根据通过重置配置字 (RCW) 配置的硬件特性以及针对特定板卡的相关特性来选择（例如，引出的 MAC 数量、离线/主机命令 FMan 端口的数量等）。
  在设备树中配置的大小必须反映硬件能力，而不是特定应用的具体需求。

  关于保留内存区域的更多详细信息，请参阅 dtschema 项目中的 `reserved-memory/reserved-memory.yaml`

属性:
  $nodename:
    模式: '^(qman-fqd|qman-pfdr|bman-fbpr)+$'

  compatible:
    枚举:
      - fsl,qman-fqd
      - fsl,qman-pfdr
      - fsl,bman-fbpr

必需:
  - compatible

allOf:
  - $ref: reserved-memory.yaml

未评估属性: false

示例:
  - |
    reserved-memory {
        #address-cells = <2>;
        #size-cells = <2>;

        qman-fqd {
            compatible = "shared-dma-pool";
            size = <0 0x400000>;
            alignment = <0 0x400000>;
            no-map;
        };
    };
```
