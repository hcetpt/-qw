## Documentation/devicetree/bindings/soc/loongson/loongson,ls2k-pmc_cn.yaml
~~~~yaml
此文档定义了龙芯2号（Loongson-2）处理器中电源管理控制器的设备树规范。

# 设备树元数据
```yaml
# SPDX 许可证标识符: (GPL-2.0 或 BSD-2-Clause)
%YAML 1.2
---
$id: http://devicetree.org/schemas/soc/loongson/loongson,ls2k-pmc.yaml#
$schema: http://devicetree.org/meta-schemas/core.yaml#

title: 龙芯2号电源管理控制器

maintainers:
  - 朱银波 <zhuyinbo@loongson.cn>

properties:
  compatible:
    oneOf:
      - items:
          - const: loongson,ls2k0500-pmc
          - const: syscon
      - items:
          - enum:
              - loongson,ls2k1000-pmc
              - loongson,ls2k2000-pmc
          - const: loongson,ls2k0500-pmc
          - const: syscon

  reg:
    maxItems: 1

  interrupts:
    maxItems: 1

  loongson,suspend-address:
    $ref: /schemas/types.yaml#/definitions/uint64
    description:
      "loongson,suspend-address" 表示从内核跳转到的一个深度休眠状态（挂起到RAM）的固件入口地址。该值依赖于特定平台的固件代码。此外，电源管理器需要根据这个地址来指示当前SoC是否支持挂起到RAM功能。

  syscon-poweroff:
    $ref: /schemas/power/reset/syscon-poweroff.yaml#
    type: object
    description:
      关机方法的节点

  syscon-reboot:
    $ref: /schemas/power/reset/syscon-reboot.yaml#
    type: object
    description:
      重启方法的节点

required:
  - compatible
  - reg
  - interrupts

additionalProperties: false

examples:
  - |
    #include <dt-bindings/interrupt-controller/irq.h>

    power-management@1fe27000 {
        compatible = "loongson,ls2k1000-pmc", "loongson,ls2k0500-pmc", "syscon";
        reg = <0x1fe27000 0x58>;
        interrupt-parent = <&liointc1>;
        interrupts = <11 IRQ_TYPE_LEVEL_LOW>;
        loongson,suspend-address = <0x0 0x1c000500>;

        syscon-reboot {
            compatible = "syscon-reboot";
            offset = <0x30>;
            mask = <0x1>;
        };

        syscon-poweroff {
            compatible = "syscon-poweroff";
            regmap = <&pmc>;
            offset = <0x14>;
            mask = <0x3c00>;
            value = <0x3c00>;
        };
    };
```

### 翻译说明
- `compatible` 属性定义了与电源管理控制器兼容的不同型号。
- `reg` 属性指定了控制器的基地址和范围。
- `interrupts` 属性指定了中断信息。
- `loongson,suspend-address` 属性用于配置进入深度休眠状态时的固件入口地址。
- `syscon-poweroff` 和 `syscon-reboot` 分别定义了关机和重启的方法。

以上内容定义了一个电源管理控制器的设备树规范，并给出了一个具体的示例。
~~~~

## Documentation/devicetree/bindings/soc/mediatek/devapc_cn.yaml
~~~~yaml
```yaml
# SPDX-文件许可标识: (GPL-2.0 或 BSD-2-Clause)
# # 版权所有 2020 MediaTek Inc
%YAML 1.2
---
$id: 'http://devicetree.org/schemas/soc/mediatek/devapc.yaml#'
$schema: 'http://devicetree.org/meta-schemas/core.yaml#'

title: MediaTek 设备访问权限控制驱动程序

description: |
  MediaTek 总线结构提供了 TrustZone 安全支持和数据保护，以防止从设备被未预期的主设备访问。
  安全违规会被记录并发送给处理器进行进一步分析和对策。
maintainers:
  - Neal Liu <neal.liu@mediatek.com>

properties:
  compatible:
    enum:
      - mediatek,mt6779-devapc
      - mediatek,mt8186-devapc

  reg:
    description: devapc 寄存器组的基本地址
    maxItems: 1

  interrupts:
    description: 单个中断指定符
    maxItems: 1

  clocks:
    description: 包含模块时钟源及时钟名称
    maxItems: 1

  clock-names:
    description: 在 clocks 属性中列出的时钟名称
    maxItems: 1

required:
  - compatible
  - reg
  - interrupts
  - clocks
  - clock-names

additionalProperties: false

examples:
  - |
    #include <dt-bindings/interrupt-controller/arm-gic.h>
    #include <dt-bindings/clock/mt6779-clk.h>

    devapc: devapc@10207000 {
      compatible = "mediatek,mt6779-devapc";
      reg = <0x10207000 0x1000>;
      interrupts = <GIC_SPI 168 IRQ_TYPE_LEVEL_LOW>;
      clocks = <&infracfg_ao CLK_INFRA_DEVICE_APC>;
      clock-names = "devapc-infra-clock";
    };
```
请注意，这里的中文翻译尽量保持了原文的格式和风格。
~~~~

## Documentation/devicetree/bindings/soc/mediatek/mediatek,ccorr_cn.yaml
~~~~yaml
```yaml
# SPDX-许可证标识符: (GPL-2.0-only 或 BSD-2-Clause)
%YAML 1.2
---
$id: http://devicetree.org/schemas/soc/mediatek/mediatek,ccorr.yaml#
$schema: http://devicetree.org/meta-schemas/core.yaml#

标题: MediaTek 颜色校正

维护者:
  - Matthias Brugger <matthias.bgg@gmail.com>
  - Moudy Ho <moudy.ho@mediatek.com>

描述: |
  使用 3x3 矩阵的 MediaTek 颜色校正
属性:
  compatible:
    项目:
      - 枚举:
          - mediatek,mt8183-mdp3-ccorr

  reg:
    最大项目数: 1

  mediatek,gce-client-reg:
    $ref: /schemas/types.yaml#/definitions/phandle-array
    项目:
      项目:
        - 描述: GCE 的 phandle
        - 描述: GCE 子系统 ID
        - 描述: 寄存器偏移量
        - 描述: 寄存器大小
    描述: 客户端驱动程序的寄存器可以通过 GCE 配置，通过此属性定义的 4 个参数。每个 GCE 子系统 ID 映射到在头文件 include/dt-bindings/gce/<chip>-gce.h 中定义的一个客户端。
mediatek,gce-events:
    描述:
      映射到特定硬件事件信号给 GCE 的事件 ID。事件 ID 在每个芯片的 GCE 头文件 include/dt-bindings/gce/<chip>-gce.h 中定义
$ref: /schemas/types.yaml#/definitions/uint32-array

  clocks:
    最小项目数: 1

必需:
  - compatible
  - reg
  - mediatek,gce-client-reg
  - mediatek,gce-events
  - clocks

额外属性: false

示例:
  - |
    #include <dt-bindings/clock/mt8183-clk.h>
    #include <dt-bindings/gce/mt8183-gce.h>

    mdp3_ccorr: mdp3-ccorr@1401c000 {
      compatible = "mediatek,mt8183-mdp3-ccorr";
      reg = <0x1401c000 0x1000>;
      mediatek,gce-client-reg = <&gce SUBSYS_1401XXXX 0xc000 0x1000>;
      mediatek,gce-events = <CMDQ_EVENT_MDP_CCORR_SOF>,
                            <CMDQ_EVENT_MDP_CCORR_EOF>;
      clocks = <&mmsys CLK_MM_MDP_CCORR>;
    };
```
请注意，某些英文术语（如“属性”、“必需”等）在翻译时保持不变，因为它们是 YAML 结构的一部分，而非具体的中文术语。
~~~~

## Documentation/devicetree/bindings/soc/mediatek/mediatek,mutex_cn.yaml
```yaml
# SPDX-License-Identifier: (GPL-2.0-only OR BSD-2-Clause)
%YAML 1.2
---
$id: http://devicetree.org/schemas/soc/mediatek/mediatek,mutex.yaml#
$schema: http://devicetree.org/meta-schemas/core.yaml#

标题: 联发科互斥锁

维护者:
  - 春光 胡 <chunkuang.hu@kernel.org>
  - 菲利普·扎贝尔 <p.zabel@pengutronix.de>

描述: |
  联发科互斥锁，即MUTEX，用于向显示数据路径或MDP数据路径上的每个子模块发送触发信号，这些信号称为帧开始(SOF)/帧结束(EOF)。
  在某些SoC中（例如mt2701），MUTEX可能是一个硬件互斥锁，用于保护影子寄存器。
  MUTEX设备节点必须是中央MMSYS_CONFIG节点的同级节点。
  关于MMSYS_CONFIG绑定的详细说明，请参阅Documentation/devicetree/bindings/arm/mediatek/mediatek,mmsys.yaml。

属性:
  compatible:
    枚举:
      - mediatek,mt2701-disp-mutex
      - mediatek,mt2712-disp-mutex
      - mediatek,mt6795-disp-mutex
      - mediatek,mt8167-disp-mutex
      - mediatek,mt8173-disp-mutex
      - mediatek,mt8183-disp-mutex
      - mediatek,mt8186-disp-mutex
      - mediatek,mt8186-mdp3-mutex
      - mediatek,mt8188-disp-mutex
      - mediatek,mt8188-vpp-mutex
      - mediatek,mt8192-disp-mutex
      - mediatek,mt8195-disp-mutex
      - mediatek,mt8195-vpp-mutex
      - mediatek,mt8365-disp-mutex

  reg:
    最大项数: 1

  interrupts:
    最大项数: 1

  power-domains:
    描述: 根据由phandle指定的电源控制器绑定定义的phandle和PM域指定符。详细信息请参阅Documentation/devicetree/bindings/power/power-domain.yaml。

时钟:
    项目:
      - 描述: MUTEX时钟

  mediatek,gce-events:
    描述:
      与特定硬件事件信号映射到GCE的事件ID。事件ID在各芯片的GCE头文件include/dt-bindings/gce/<chip>-gce.h中定义。
$ref: /schemas/types.yaml#/definitions/uint32-array

  mediatek,gce-client-reg:
    $ref: /schemas/types.yaml#/definitions/phandle-array
    项目:
      项目:
        - 描述: GCE的phandle
        - 描述: GCE子系统ID
        - 描述: 寄存器偏移量
        - 描述: 寄存器大小
    描述: 客户端驱动程序的寄存器可以通过GCE配置，该配置使用此属性中定义的4个参数。每个GCE子系统ID映射到头文件include/dt-bindings/gce/<chip>-gce.h中定义的一个客户端。

allOf:
  - 如果:
      属性:
        compatible:
          包含:
            枚举:
              - mediatek,mt2701-disp-mutex
              - mediatek,mt2712-disp-mutex
              - mediatek,mt6795-disp-mutex
              - mediatek,mt8173-disp-mutex
              - mediatek,mt8186-disp-mutex
              - mediatek,mt8186-mdp3-mutex
              - mediatek,mt8192-disp-mutex
              - mediatek,mt8195-disp-mutex
    那么:
      必需:
        - clocks


必需:
  - compatible
  - reg
  - interrupts
  - power-domains

额外属性: false

示例:
  - |
    #include <dt-bindings/interrupt-controller/arm-gic.h>
    #include <dt-bindings/clock/mt8173-clk.h>
    #include <dt-bindings/power/mt8173-power.h>
    #include <dt-bindings/gce/mt8173-gce.h>

    soc {
        #address-cells = <2>;
        #size-cells = <2>;

        mutex: mutex@14020000 {
            compatible = "mediatek,mt8173-disp-mutex";
            reg = <0 0x14020000 0 0x1000>;
            interrupts = <GIC_SPI 169 IRQ_TYPE_LEVEL_LOW>;
            power-domains = <&spm MT8173_POWER_DOMAIN_MM>;
            clocks = <&mmsys CLK_MM_MUTEX_32K>;
            mediatek,gce-events = <CMDQ_EVENT_MUTEX0_STREAM_EOF>,
                                  <CMDQ_EVENT_MUTEX1_STREAM_EOF>;
        };
    };
```

## Documentation/devicetree/bindings/soc/mediatek/mediatek,pwrap_cn.yaml
```yaml
# SPDX-许可证标识符: (GPL-2.0-only 或 BSD-2-Clause)
%YAML 1.2
---
$id: http://devicetree.org/schemas/soc/mediatek/mediatek,pwrap.yaml#
$schema: http://devicetree.org/meta-schemas/core.yaml#

标题: Mediatek 电源管理集成电路 (PMIC) 包装器

维护者:
  - Flora Fu <flora.fu@mediatek.com>
  - Alexandre Mergnat <amergnat@baylibre.com>

描述:
  在 MediaTek 系统级芯片 (SoC) 中，电源管理集成电路 (PMIC) 通过 SPI 接口连接。SPI 主接口对 CPU 并非直接可见，而是仅通过 SoC 内的 PMIC 包装器可见。SoC 和 PMIC 之间的通信可选地进行加密。此外，还可以使用非标准的双 I/O SPI 模式以提高速度。

  在 MT8135 上，某些 SoC 内部外设的引脚可以位于 PMIC 上。这些引脚的信号通过 pwrap 桥接器在 SPI 总线上路由。在下面的绑定说明中，桥接所需的属性标有“IP 配对”。对于不支持 IP 配对的 SoC，这些是可选的。

属性:
  compatible:
    oneOf:
      - items:
          - 枚举:
              - mediatek,mt2701-pwrap
              - mediatek,mt6765-pwrap
              - mediatek,mt6779-pwrap
              - mediatek,mt6795-pwrap
              - mediatek,mt6797-pwrap
              - mediatek,mt6873-pwrap
              - mediatek,mt7622-pwrap
              - mediatek,mt8135-pwrap
              - mediatek,mt8173-pwrap
              - mediatek,mt8183-pwrap
              - mediatek,mt8186-pwrap
              - mediatek,mt8195-pwrap
              - mediatek,mt8365-pwrap
              - mediatek,mt8516-pwrap
      - items:
          - 枚举:
              - mediatek,mt8186-pwrap
              - mediatek,mt8195-pwrap
          - 常量: syscon
      - items:
          - 枚举:
              - mediatek,mt8188-pwrap
          - 常量: mediatek,mt8195-pwrap
          - 常量: syscon

  reg:
    minItems: 1
    items:
      - 描述: PMIC 包装器寄存器
      - 描述: IP 配对寄存器

  reg-names:
    minItems: 1
    items:
      - 常量: pwrap
      - 常量: pwrap-bridge

  interrupts:
    maxItems: 1

  clocks:
    minItems: 2
    items:
      - 描述: SPI 总线时钟
      - 描述: 主模块时钟
      - 描述: 系统模块时钟
      - 描述: 定时器模块时钟

  clock-names:
    minItems: 2
    items:
      - 常量: spi
      - 常量: wrap
      - 常量: sys
      - 常量: tmr

  resets:
    minItems: 1
    items:
      - 描述: PMIC 包装器复位
      - 描述: IP 配对复位

  reset-names:
    minItems: 1
    items:
      - 常量: pwrap
      - 常量: pwrap-bridge

  pmic:
    类型: 对象

必需:
  - compatible
  - reg
  - reg-names
  - interrupts
  - clocks
  - clock-names

依赖必需:
  resets: [reset-names]

allOf:
  - 如果:
      属性:
        compatible:
          包含:
            常量: mediatek,mt8365-pwrap
    则:
      属性:
        clocks:
          minItems: 4

        clock-names:
          minItems: 4

其他属性: false

示例:
  - |
    #include <dt-bindings/interrupt-controller/irq.h>
    #include <dt-bindings/interrupt-controller/arm-gic.h>
    #include <dt-bindings/reset/mt8135-resets.h>

    soc {
        #address-cells = <2>;
        #size-cells = <2>;
        pwrap@1000f000 {
            compatible = "mediatek,mt8135-pwrap";
            reg = <0 0x1000f000 0 0x1000>,
                  <0 0x11017000 0 0x1000>;
            reg-names = "pwrap", "pwrap-bridge";
            interrupts = <GIC_SPI 128 IRQ_TYPE_LEVEL_HIGH>;
            clocks = <&clk26m>, <&clk26m>;
            clock-names = "spi", "wrap";
            resets = <&infracfg MT8135_INFRA_PMIC_WRAP_RST>,
                     <&pericfg MT8135_PERI_PWRAP_BRIDGE_SW_RST>;
            reset-names = "pwrap", "pwrap-bridge";
        };
    };
```

## Documentation/devicetree/bindings/soc/mediatek/mediatek,wdma_cn.yaml
```yaml
# SPDX-许可证标识符: (GPL-2.0-only 或 BSD-2-Clause)
%YAML 1.2
---
$id: http://devicetree.org/schemas/soc/mediatek/mediatek,wdma.yaml#
$schema: http://devicetree.org/meta-schemas/core.yaml#

标题: MediaTek 写直接内存访问

维护者:
  - Matthias Brugger <matthias.bgg@gmail.com>
  - Moudy Ho <moudy.ho@mediatek.com>

描述: |
  MediaTek 写直接内存访问(WDMA)组件用于将数据写入 DMA。

属性:
  compatible:
    项目:
      - 枚举:
          - mediatek,mt8183-mdp3-wdma

  reg:
    最大项数: 1

  mediatek,gce-client-reg:
    $ref: /schemas/types.yaml#/definitions/phandle-array
    项目:
      项目:
        - 描述: GCE 的 phandle
        - 描述: GCE 子系统 ID
        - 描述: 寄存器偏移量
        - 描述: 寄存器大小
    描述: 客户端驱动程序的寄存器可以通过 GCE 和此属性中定义的 4 个参数进行配置。每个 GCE 子系统 ID 都映射到头文件 include/dt-bindings/gce/<chip>-gce.h 中定义的一个客户端。
  mediatek,gce-events:
    描述:
      映射到特定硬件事件信号到 GCE 的事件 ID。事件 ID 在各芯片的 GCE 头文件 include/dt-bindings/gce/<chip>-gce.h 中定义。
    $ref: /schemas/types.yaml#/definitions/uint32-array

  power-domains:
    最大项数: 1

  clocks:
    最少项数: 1

  iommus:
    最大项数: 1

必需:
  - compatible
  - reg
  - mediatek,gce-client-reg
  - mediatek,gce-events
  - power-domains
  - clocks
  - iommus

额外属性: false

示例:
  - |
    #include <dt-bindings/clock/mt8183-clk.h>
    #include <dt-bindings/gce/mt8183-gce.h>
    #include <dt-bindings/power/mt8183-power.h>
    #include <dt-bindings/memory/mt8183-larb-port.h>

    mdp3_wdma: mdp3-wdma@14006000 {
      compatible = "mediatek,mt8183-mdp3-wdma";
      reg = <0x14006000 0x1000>;
      mediatek,gce-client-reg = <&gce SUBSYS_1400XXXX 0x6000 0x1000>;
      mediatek,gce-events = <CMDQ_EVENT_MDP_WDMA0_SOF>,
                            <CMDQ_EVENT_MDP_WDMA0_EOF>;
      power-domains = <&spm MT8183_POWER_DOMAIN_DISP>;
      clocks = <&mmsys CLK_MM_MDP_WDMA0>;
      iommus = <&iommu>;
    };
```

## Documentation/devicetree/bindings/soc/mediatek/mtk-svs_cn.yaml
```yaml
# SPDX-许可证标识符: (GPL-2.0-only 或 BSD-2-Clause)
%YAML 1.2
---
$id: http://devicetree.org/schemas/soc/mediatek/mtk-svs.yaml#
$schema: http://devicetree.org/meta-schemas/core.yaml#

标题: MediaTek 智能电压调节 (SVS)

维护者:
  - Roger Lu <roger.lu@mediatek.com>
  - Matthias Brugger <matthias.bgg@gmail.com>
  - Kevin Hilman <khilman@kernel.org>

描述: |+
  SVS 引擎是一块硬件，它包含多个控制器（银行），用于根据芯片工艺角、温度和其他因素计算适合不同电源域（CPU/GPU/CCI）的电压。然后，DVFS 驱动程序可以将 SVS 控制器的电压应用于 PMIC/降压转换器。

属性:
  compatible:
    枚举:
      - mediatek,mt8183-svs
      - mediatek,mt8186-svs
      - mediatek,mt8188-svs
      - mediatek,mt8192-svs
      - mediatek,mt8195-svs

  reg:
    最大项数: 1
    描述: MTK SVS 控制器的地址范围
中断:
    最大项数: 1

  clocks:
    最大项数: 1
    描述: MTK SVS 控制器工作的主时钟
clock-names:
    常量: main

  nvmem-cells:
    最少项数: 1
    描述:
      由非易失性内存设备提供的校准数据的 phandle
项:
      - 描述: SVS 控制器的 SVS efuse
      - 描述: SVS 控制器的热 efuse

  nvmem-cell-names:
    项:
      - 常量: svs-calibration-data
      - 常量: t-calibration-data

  resets:
    最大项数: 1

  reset-names:
    项:
      - 常量: svs_rst

必需:
  - compatible
  - reg
  - interrupts
  - clocks
  - clock-names
  - nvmem-cells
  - nvmem-cell-names

附加属性: false

示例:
  - |
    #include <dt-bindings/clock/mt8183-clk.h>
    #include <dt-bindings/interrupt-controller/arm-gic.h>
    #include <dt-bindings/interrupt-controller/irq.h>

    soc {
        #address-cells = <2>;
        #size-cells = <2>;

        svs@1100b000 {
            compatible = "mediatek,mt8183-svs";
            reg = <0 0x1100b000 0 0x1000>;
            interrupts = <GIC_SPI 127 IRQ_TYPE_LEVEL_LOW>;
            clocks = <&infracfg CLK_INFRA_THERM>;
            clock-names = "main";
            nvmem-cells = <&svs_calibration>, <&thermal_calibration>;
            nvmem-cell-names = "svs-calibration-data", "t-calibration-data";
        };
    };
```
