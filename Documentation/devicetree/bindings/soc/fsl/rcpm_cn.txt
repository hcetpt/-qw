## Documentation/devicetree/bindings/soc/mediatek/scpsys_cn.txt
~~~~
### MediaTek SCPSYS

系统控制处理器系统（SCPSYS）在系统中负责多个与电源管理相关的任务。这些任务包括温度测量、动态电压频率缩放（DVFS）、中断过滤及低级睡眠控制。SCPSYS 内的系统电源管理器（SPM）用于 MTCMOS 电源域的控制。

该驱动程序实现了在 `power/power-domain.yaml` 中描述的一般电源域绑定。它提供了以下定义的电源域：

- `include/dt-bindings/power/mt8173-power.h`
- `include/dt-bindings/power/mt6797-power.h`
- `include/dt-bindings/power/mt6765-power.h`
- `include/dt-bindings/power/mt2701-power.h`
- `include/dt-bindings/power/mt2712-power.h`
- `include/dt-bindings/power/mt7622-power.h`

**必需属性：**
- `compatible`: 应为以下之一：
    - `"mediatek,mt2701-scpsys"`
    - `"mediatek,mt2712-scpsys"`
    - `"mediatek,mt6765-scpsys"`
    - `"mediatek,mt6797-scpsys"`
    - `"mediatek,mt7622-scpsys"`
    - `"mediatek,mt7623-scpsys"`，适用于 MT7623 SoC
    - `"mediatek,mt7623a-scpsys"`，适用于 MT7623A SoC
    - `"mediatek,mt7629-scpsys"`，适用于 MT7629 SoC
    - `"mediatek,mt8173-scpsys"`
- `#power-domain-cells`: 必须为 1
- `reg`: SCPSYS 单元的地址范围
- `infracfg`: 必须包含指向 infracfg 控制器的 phandle
- `clock`, `clock-names`: 根据通用时钟绑定定义的时钟。这些是在启用某些电源域之前硬件需要启用的时钟。
    - 对于 MT2701 或 MT7623: `"mm"`, `"mfg"`, `"ethif"`
    - 对于 MT2712: `"mm"`, `"mfg"`, `"venc"`, `"jpgdec"`, `"audio"`, `"vdec"`
    - 对于 MT6765: MUX: `"mm"`, `"mfg"`；CG: `"mm-0"`, `"mm-1"`, `"mm-2"`, `"mm-3"`, `"isp-0"`, `"isp-1"`, `"cam-0"`, `"cam-1"`, `"cam-2"`, `"cam-3"`, `"cam-4"`
    - 对于 MT6797: `"mm"`, `"mfg"`, `"vdec"`
    - 对于 MT7622 或 MT7629: `"hif_sel"`
    - 对于 MT7623A: `"ethif"`
    - 对于 MT8173: `"mm"`, `"mfg"`, `"venc"`, `"venc_lt"`

**可选属性：**
- `vdec-supply`: vdec 电源域的电源供应
- `venc-supply`: venc 电源域的电源供应
- `isp-supply`: isp 电源域的电源供应
- `mm-supply`: mm 电源域的电源供应
- `venc_lt-supply`: venc_lt 电源域的电源供应
- `audio-supply`: 音频电源域的电源供应
- `usb-supply`: USB 电源域的电源供应
- `mfg_async-supply`: mfg_async 电源域的电源供应
- `mfg_2d-supply`: mfg_2d 电源域的电源供应
- `mfg-supply`: mfg 电源域的电源供应

**示例：**

```yaml
scpsys: scpsys@10006000 {
	#power-domain-cells = <1>;
	compatible = "mediatek,mt8173-scpsys";
	reg = <0 0x10006000 0 0x1000>;
	infracfg = <&infracfg>;
	clocks = <&clk26m>,
			<&topckgen CLK_TOP_MM_SEL>;
			<&topckgen CLK_TOP_VENC_SEL>,
			<&topckgen CLK_TOP_VENC_LT_SEL>;
	clock-names = "mfg", "mm", "venc", "venc_lt";
};
```

**示例消费者：**

```yaml
afe: mt8173-afe-pcm@11220000 {
	compatible = "mediatek,mt8173-afe-pcm";
	power-domains = <&scpsys MT8173_POWER_DOMAIN_AUDIO>;
};
```
~~~~

## Documentation/devicetree/bindings/soc/microchip/atmel,at91rm9200-tcb_cn.yaml
~~~~yaml
下面是给定 YAML 文档的中文翻译：

```yaml
# SPDX-许可证标识符: (GPL-2.0 或 BSD-2-Clause)
%YAML 1.2
---
$id: http://devicetree.org/schemas/soc/microchip/atmel,at91rm9200-tcb.yaml#
$schema: http://devicetree.org/meta-schemas/core.yaml#

标题: Atmel 定时器计数器模块

维护者:
  - Alexandre Belloni <alexandre.belloni@bootlin.com>

描述: |
  Microchip（原Atmel）系统级芯片(SoC)包含一种名为定时器计数器模块(Timer Counter Block, TCB)的定时器。每个定时器有三个通道，每个通道有两个计数器。
属性:
  compatible:
    项目:
      - 枚举:
          - atmel,at91rm9200-tcb
          - atmel,at91sam9x5-tcb
          - atmel,sama5d2-tcb
      - 常量: simple-mfd
      - 常量: syscon

  reg:
    最大项数: 1

  interrupts:
    描述:
      中断列表。如果可用，则每个TCB通道一个中断，或者整个TC块一个中断
    最小项数: 1
    最大项数: 3

  clock-names:
    描述:
      时钟名称列表。始终包括t0_clk和slow clk。如果每个通道有一个时钟，则还包括t1_clk和t2_clk
最小项数: 2
    最大项数: 4

  clocks:
    最小项数: 2
    最大项数: 4

  '#address-cells':
    常量: 1

  '#size-cells':
    常量: 0

模式属性:
  "^timer@[0-2]$":
    描述: 作为定时器或计数器使用的定时器模块通道
类型: 对象
    其他属性: false
    属性:
      compatible:
        项目:
          - 枚举:
              - atmel,tcb-timer
              - atmel,tcb-pwm
              - microchip,tcb-capture
      reg:
        描述:
          此特定定时器要使用的通道列表。在Microchip TCB捕获模式下，通道注册为计数器设备；对于qdec模式，需要TCB0的通道<0>和<1>
最小项数: 1
        最大项数: 3
    必需:
      - compatible
      - reg

  "^pwm@[0-2]$":
    描述: 用作脉宽调制(PWM)的定时器模块通道
$ref: /schemas/pwm/pwm.yaml#
    类型: 对象
    属性:
      compatible:
        常量: atmel,tcb-pwm
      reg:
        描述:
          用于此PWM的TCB通道
枚举: [ 0, 1, 2 ]

      "#pwm-cells":
        描述:
          本绑定支持的唯一第三个单元标志是PWM_POLARITY_INVERTED
常量: 3

    必需:
      - compatible
      - reg
      - "#pwm-cells"

    其他属性: false


所有:
  - 如果:
      属性:
        compatible:
          包含:
            常量: atmel,sama5d2-tcb
    然后:
      属性:
        clocks:
          最小项数: 3
          最大项数: 3
        clock-names:
          项目:
            - 常量: t0_clk
            - 常量: gclk
            - 常量: slow_clk
    否则:
      属性:
        clocks:
          最小项数: 2
          最大项数: 4
        clock-names:
          一:
            - 项目:
                - 常量: t0_clk
                - 常量: slow_clk
          二:
            - 项目:
                - 常量: t0_clk
                - 常量: t1_clk
                - 常量: t2_clk
                - 常量: slow_clk

必需:
  - compatible
  - reg
  - interrupts
  - clocks
  - clock-names
  - '#address-cells'
  - '#size-cells'

其他属性: false

示例:
  - |
    /* 每个TC块一个中断: */
        tcb0: timer@fff7c000 {
                compatible = "atmel,at91rm9200-tcb", "simple-mfd", "syscon";
                #address-cells = <1>;
                #size-cells = <0>;
                reg = <0xfff7c000 0x100>;
                interrupts = <18 4>;
                clocks = <&tcb0_clk>, <&clk32k>;
                clock-names = "t0_clk", "slow_clk";

                timer@0 {
                        compatible = "atmel,tcb-timer";
                        reg = <0>, <1>;
                };

                timer@2 {
                        compatible = "atmel,tcb-timer";
                        reg = <2>;
                };
        };

    /* 每个TC块中的TC通道一个中断: */
        tcb1: timer@fffdc000 {
                compatible = "atmel,at91rm9200-tcb", "simple-mfd", "syscon";
                #address-cells = <1>;
                #size-cells = <0>;
                reg = <0xfffdc000 0x100>;
                interrupts = <26 4>, <27 4>, <28 4>;
                clocks = <&tcb1_clk>, <&clk32k>;
                clock-names = "t0_clk", "slow_clk";

                timer@0 {
                        compatible = "atmel,tcb-timer";
                        reg = <0>;
                };

                timer@1 {
                        compatible = "atmel,tcb-timer";
                        reg = <1>;
                };

                pwm@2 {
                        compatible = "atmel,tcb-pwm";
                        reg = <2>;
                        #pwm-cells = <3>;
                };
         };
    /* TCB0 捕获与QDEC: */
        timer@f800c000 {
                compatible = "atmel,at91rm9200-tcb", "simple-mfd", "syscon";
                #address-cells = <1>;
                #size-cells = <0>;
                reg = <0xfff7c000 0x100>;
                interrupts = <18 4>;
                clocks = <&tcb0_clk>, <&clk32k>;
                clock-names = "t0_clk", "slow_clk";

                timer@0 {
                        compatible = "microchip,tcb-capture";
                        reg = <0>, <1>;
                };

                timer@2 {
                        compatible = "atmel,tcb-timer";
                        reg = <2>;
                };
        };
```

请注意，某些 YAML 关键字如 `allOf` 和 `patternProperties` 无法直接翻译，因为它们是 YAML 语法的一部分。
~~~~
