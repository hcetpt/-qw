## Documentation/devicetree/bindings/soc/imx/fsl,imx8mp-media-blk-ctrl_cn.yaml
```yaml
# SPDX-许可证标识符: (GPL-2.0-only 或 BSD-2-Clause)
%YAML 1.2
---
$id: http://devicetree.org/schemas/soc/imx/fsl,imx8mp-media-blk-ctrl.yaml#
$schema: http://devicetree.org/meta-schemas/core.yaml#

标题: NXP i.MX8MP 媒体块控制

维护者:
  - Paul Elder <paul.elder@ideasonboard.com>

描述:
  i.MX8MP 媒体块控制 (MEDIA BLK_CTRL) 是一个顶级外设，
  提供对 NoC 的访问并确保 MEDIAMIX 域内外设的正确供电序列。

属性:
  compatible:
    items:
      - const: fsl,imx8mp-media-blk-ctrl
      - const: syscon

  reg:
    maxItems: 1

  '#address-cells':
    const: 1

  '#size-cells':
    const: 1

  '#power-domain-cells':
    const: 1

  power-domains:
    maxItems: 10

  power-domain-names:
    items:
      - const: bus
      - const: mipi-dsi1
      - const: mipi-csi1
      - const: lcdif1
      - const: isi
      - const: mipi-csi2
      - const: lcdif2
      - const: isp
      - const: dwe
      - const: mipi-dsi2

  clocks:
    items:
      - description: APB 时钟
      - description: AXI 时钟
      - description: 第一个 CSI2 接收器的像素时钟 (aclk)
      - description: 第二个 CSI2 接收器的像素时钟 (aclk)
      - description: 第一个 LCDIF 的像素时钟 (pix_clk)
      - description: 第二个 LCDIF 的像素时钟 (pix_clk)
      - description: ISP 的核心时钟 (clk)
      - description: 由 DSI 使用的 MIPI-PHY 参考时钟

  clock-names:
    items:
      - const: apb
      - const: axi
      - const: cam1
      - const: cam2
      - const: disp1
      - const: disp2
      - const: isp
      - const: phy

  interconnects:
    maxItems: 8

  interconnect-names:
    items:
      - const: lcdif-rd
      - const: lcdif-wr
      - const: isi0
      - const: isi1
      - const: isi2
      - const: isp0
      - const: isp1
      - const: dwe

  bridge@5c:
    类型: object
    $ref: /schemas/display/bridge/fsl,ldb.yaml#
    unevaluatedProperties: false

必需:
  - compatible
  - reg
  - '#address-cells'
  - '#size-cells'
  - '#power-domain-cells'
  - power-domains
  - power-domain-names
  - clocks
  - clock-names

额外属性: false

示例:
  - |
    #include <dt-bindings/clock/imx8mp-clock.h>
    #include <dt-bindings/power/imx8mp-power.h>

    blk-ctrl@32ec0000 {
        compatible = "fsl,imx8mp-media-blk-ctrl", "syscon";
        reg = <0x32ec0000 0x138>;
        power-domains = <&mediamix_pd>, <&mipi_phy1_pd>, <&mipi_phy1_pd>,
                        <&mediamix_pd>, <&mediamix_pd>, <&mipi_phy2_pd>,
                        <&mediamix_pd>, <&ispdwp_pd>, <&ispdwp_pd>,
                        <&mipi_phy2_pd>;
        power-domain-names = "bus", "mipi-dsi1", "mipi-csi1", "lcdif1", "isi",
                             "mipi-csi2", "lcdif2", "isp", "dwe", "mipi-dsi2";
        clocks = <&clk IMX8MP_CLK_MEDIA_APB_ROOT>,
                 <&clk IMX8MP_CLK_MEDIA_AXI_ROOT>,
                 <&clk IMX8MP_CLK_MEDIA_CAM1_PIX_ROOT>,
                 <&clk IMX8MP_CLK_MEDIA_CAM2_PIX_ROOT>,
                 <&clk IMX8MP_CLK_MEDIA_DISP1_PIX_ROOT>,
                 <&clk IMX8MP_CLK_MEDIA_DISP2_PIX_ROOT>,
                 <&clk IMX8MP_CLK_MEDIA_ISP_ROOT>,
                 <&clk IMX8MP_CLK_MEDIA_MIPI_PHY1_REF_ROOT>;
        clock-names = "apb", "axi", "cam1", "cam2", "disp1", "disp2",
                      "isp", "phy";
        #power-domain-cells = <1>;
        #address-cells = <1>;
        #size-cells = <1>;

        bridge@5c {
            compatible = "fsl,imx8mp-ldb";
            reg = <0x5c 0x4>, <0x128 0x4>;
            reg-names = "ldb", "lvds";
            clocks = <&clk IMX8MP_CLK_MEDIA_LDB>;
            clock-names = "ldb";

            ports {
                #address-cells = <1>;
                #size-cells = <0>;

                port@0 {
                    reg = <0>;

                    ldb_from_lcdif2: endpoint {
                        remote-endpoint = <&lcdif2_to_ldb>;
                    };
                };

                port@1 {
                    reg = <1>;

                    ldb_lvds_ch0: endpoint {
                        remote-endpoint = <&ldb_to_lvdsx4panel>;
                    };
                };

                port@2 {
                    reg = <2>;

                    ldb_lvds_ch1: endpoint {
                    };
                };
            };
        };
    };
```

## Documentation/devicetree/bindings/soc/imx/fsl,imx8mq-vpu-blk-ctrl_cn.yaml
```yaml
# SPDX-文件许可人: (GPL-2.0-only 或 BSD-2-Clause)
%YAML 1.2
---
$id: http://devicetree.org/schemas/soc/imx/fsl,imx8mq-vpu-blk-ctrl.yaml#
$schema: http://devicetree.org/meta-schemas/core.yaml#

title: NXP i.MX8MQ VPU blk-ctrl

maintainers:
  - Lucas Stach <l.stach@pengutronix.de>

description:
  i.MX8MQ VPU blk-ctrl 是一个顶层外设，它提供对 NoC 的访问，并确保位于 SoC 的 VPU 域中的 VPU 外设的正确供电序列。

properties:
  compatible:
    items:
      - const: fsl,imx8mq-vpu-blk-ctrl

  reg:
    maxItems: 1

  '#power-domain-cells':
    const: 1

  power-domains:
    minItems: 3
    maxItems: 3

  power-domain-names:
    items:
      - const: bus
      - const: g1
      - const: g2

  clocks:
    minItems: 2
    maxItems: 2

  clock-names:
    items:
      - const: g1
      - const: g2

required:
  - compatible
  - reg
  - power-domains
  - power-domain-names
  - clocks
  - clock-names

additionalProperties: false

examples:
  - |
    #include <dt-bindings/clock/imx8mq-clock.h>
    #include <dt-bindings/power/imx8mq-power.h>

    blk-ctrl@38320000 {
      compatible = "fsl,imx8mq-vpu-blk-ctrl";
      reg = <0x38320000 0x100>;
      power-domains = <&pgc_vpu>, <&pgc_vpu>, <&pgc_vpu>;
      power-domain-names = "bus", "g1", "g2";
      clocks = <&clk IMX8MQ_CLK_VPU_G1_ROOT>,
               <&clk IMX8MQ_CLK_VPU_G2_ROOT>;
      clock-names = "g1", "g2";
      #power-domain-cells = <1>;
    };
```

## Documentation/devicetree/bindings/soc/imx/fsl,imx93-media-blk-ctrl_cn.yaml
~~~~yaml
下面是给定 YAML 文档的中文翻译：

```yaml
# SPDX-文件许可标识符: (GPL-2.0-only 或 BSD-2-Clause)
%YAML 1.2
---
$id: http://devicetree.org/schemas/soc/imx/fsl,imx93-media-blk-ctrl.yaml#
$schema: http://devicetree.org/meta-schemas/core.yaml#

标题: NXP i.MX93 Media blk-ctrl

维护者:
  - 潘鹏 <peng.fan@nxp.com>

描述:
  i.MX93 MEDIAMIX 域包含被称为 MEDIAMIX 块控制（MEDIAMIX BLK_CTRL）的控制和状态寄存器。这些寄存器包括时钟、复位以及 MEDIAMIX 域内外设的其他顶层控制。

属性:
  compatible:
    items:
      - 常量: fsl,imx93-media-blk-ctrl
      - 常量: syscon

  reg:
    maxItems: 1

  '#power-domain-cells':
    常量: 1

  power-domains:
    maxItems: 1

  clocks:
    maxItems: 10

  clock-names:
    items:
      - 常量: apb
      - 常量: axi
      - 常量: nic
      - 常量: disp
      - 常量: cam
      - 常量: pxp
      - 常量: lcdif
      - 常量: isi
      - 常量: csi
      - 常量: dsi

必需:
  - compatible
  - reg
  - power-domains
  - clocks
  - clock-names

additionalProperties: false

示例:
  - |
    #include <dt-bindings/clock/imx93-clock.h>
    #include <dt-bindings/power/fsl,imx93-power.h>

    system-controller@4ac10000 {
      compatible = "fsl,imx93-media-blk-ctrl", "syscon";
      reg = <0x4ac10000 0x10000>;
      power-domains = <&mediamix>;
      clocks = <&clk IMX93_CLK_MEDIA_APB>,
               <&clk IMX93_CLK_MEDIA_AXI>,
               <&clk IMX93_CLK_NIC_MEDIA_GATE>,
               <&clk IMX93_CLK_MEDIA_DISP_PIX>,
               <&clk IMX93_CLK_CAM_PIX>,
               <&clk IMX93_CLK_PXP_GATE>,
               <&clk IMX93_CLK_LCDIF_GATE>,
               <&clk IMX93_CLK_ISI_GATE>,
               <&clk IMX93_CLK_MIPI_CSI_GATE>,
               <&clk IMX93_CLK_MIPI_DSI_GATE>;
      clock-names = "apb", "axi", "nic", "disp", "cam",
                    "pxp", "lcdif", "isi", "csi", "dsi";
      #power-domain-cells = <1>;
    };
```

请注意，代码中的注释和关键字保持了英文原貌，以确保与实际代码的一致性。
~~~~

## Documentation/devicetree/bindings/soc/imx/fsl,imx93-src_cn.yaml
~~~~yaml
下面是给定 YAML 文档的中文翻译：

```yaml
# SPDX-许可证标识符: (GPL-2.0-only 或 BSD-2-Clause)
%YAML 1.2
---
$id: http://devicetree.org/schemas/soc/imx/fsl,imx93-src.yaml#
$schema: http://devicetree.org/meta-schemas/core.yaml#

标题: NXP i.MX93 系统复位控制器

维护者:
  - 樊鹏 <peng.fan@nxp.com>

描述: |
  系统复位控制器（SRC）负责生成所有系统复位信号和启动参数锁存。
  其主要功能如下：
  - 处理来自其他模块的所有全局系统复位源，并生成全局系统复位
  - 负责 MIX（切片）及其内存的低功耗控制的电源门控

属性:
  compatible:
    items:
      - const: fsl,imx93-src
      - const: syscon

  reg:
    maxItems: 1

  ranges: true

  '#address-cells':
    const: 1

  '#size-cells':
    const: 1

模式属性:
  "power-domain@[0-9a-f]+$":
    类型: 对象
    additionalProperties: false

    属性:
      compatible:
        items:
          - const: fsl,imx93-src-slice

      '#power-domain-cells':
        const: 0

      reg:
        items:
          - 描述: MIX 切片寄存器区域
          - 描述: MEM 切片寄存器区域

      clocks:
        描述: |
          一组时钟句柄，在域电源上电序列期间需要启用这些时钟，
          以确保复位信号传播到此电源域内的设备
        minItems: 1
        maxItems: 5

    必需:
      - compatible
      - '#power-domain-cells'
      - reg

必需:
  - compatible
  - reg
  - ranges
  - '#address-cells'
  - '#size-cells'

additionalProperties: false

示例:
  - |
    #include <dt-bindings/clock/imx93-clock.h>

    system-controller@44460000 {
        compatible = "fsl,imx93-src", "syscon";
        reg = <0x44460000 0x10000>;
        #address-cells = <1>;
        #size-cells = <1>;
        ranges;

        mediamix: power-domain@0 {
            compatible = "fsl,imx93-src-slice";
            reg = <0x44462400 0x400>, <0x44465800 0x400>;
            #power-domain-cells = <0>;
            clocks = <&clk IMX93_CLK_MEDIA_AXI>,
                     <&clk IMX93_CLK_MEDIA_APB>;
        };
    };
```

请注意，某些术语（如 `phandle`、`clocks` 等）保持英文原样，因为它们在技术文档中通常使用英语术语。
~~~~

## Documentation/devicetree/bindings/soc/imx/imx8m-soc_cn.yaml
~~~~yaml
```yaml
# SPDX-License-Identifier: (GPL-2.0 OR BSD-2-Clause)
%YAML 1.2
---
$id: 'http://devicetree.org/schemas/soc/imx/imx8m-soc.yaml#'
$schema: 'http://devicetree.org/meta-schemas/core.yaml#'

title: NXP i.MX8M 系列 SoC

maintainers:
  - Alice Guo <alice.guo@nxp.com>

description: |
  NXP i.MX8M 系列 SoC 包含了从其中可以获取 SoC 唯一标识符的熔丝条目。
select:
  properties:
    compatible:
      contains:
        enum:
          - fsl,imx8mm
          - fsl,imx8mn
          - fsl,imx8mp
          - fsl,imx8mq
  required:
    - compatible

patternProperties:
  '^soc@[0-9a-f]+$':
    type: object
    properties:
      compatible:
        items:
          - enum:
              - fsl,imx8mm-soc
              - fsl,imx8mn-soc
              - fsl,imx8mp-soc
              - fsl,imx8mq-soc
          - const: simple-bus

      '#address-cells':
        const: 1

      '#size-cells':
        const: 1

      ranges: true

      dma-ranges: true

      nvmem-cells:
        maxItems: 1
        description: 指向由 nvmem 节点提供的 SoC 唯一标识符的句柄。

      nvmem-cell-names:
        const: soc_unique_id

    required:
      - compatible
      - nvmem-cells
      - nvmem-cell-names

    additionalProperties:
      type: object

additionalProperties: true

examples:
  - |
    / {
        model = "FSL i.MX8MM EVK 板";
        compatible = "fsl,imx8mm-evk", "fsl,imx8mm";
        #address-cells = <2>;
        #size-cells = <2>;

        soc@0 {
            compatible = "fsl,imx8mm-soc", "simple-bus";
            #address-cells = <1>;
            #size-cells = <1>;
            ranges = <0x0 0x0 0x0 0x3e000000>;
            nvmem-cells = <&imx8mm_uid>;
            nvmem-cell-names = "soc_unique_id";
        };
    };
```

请注意，某些关键词和字段名由于约定或语法要求并未进行翻译。例如，`$schema`、`$id`、`patternProperties`等关键字保持原样未变。同时，注释中的代码示例也保留了原始格式，以确保其正确性。
~~~~

## Documentation/devicetree/bindings/soc/intel/intel,hps-copy-engine_cn.yaml
~~~~yaml
```yaml
# SPDX-许可证标识符: (GPL-2.0 或 BSD-2-Clause)
# 版权所有 (C) 2022, Intel Corporation
%YAML 1.2
---
$id: http://devicetree.org/schemas/soc/intel/intel,hps-copy-engine.yaml#
$schema: http://devicetree.org/meta-schemas/core.yaml#

标题: Intel HPS 复制引擎

维护者:
  - Matthew Gerlach <matthew.gerlach@linux.intel.com>

描述: |
  Intel 硬件处理器系统 (HPS) 复制引擎是一个用于将可启动映像从主机内存复制到 HPS DDR 的 IP 模块。此外，还有一个寄存器，HPS 可以使用它来指示所复制映像的启动状态以及向主机提供存活状态指示。
属性:
  compatible:
    常量: intel,hps-copy-engine

  '#dma-cells':
    常量: 1

  reg:
    最大项数: 1

必需:
  - compatible
  - reg

附加属性: false

示例:
  - |
    bus@80000000 {
        compatible = "simple-bus";
        reg = <0x80000000 0x60000000>,
              <0xf9000000 0x00100000>;
        reg-names = "axi_h2f", "axi_h2f_lw";
        #address-cells = <2>;
        #size-cells = <1>;
        ranges = <0x00000000 0x00000000 0xf9000000 0x00001000>;

        dma-controller@0 {
            compatible = "intel,hps-copy-engine";
            reg = <0x00000000 0x00000000 0x00001000>;
            #dma-cells = <1>;
        };
    };
```
请注意，代码中的注释和文本已尽可能地进行了准确的翻译。
~~~~

## Documentation/devicetree/bindings/soc/intel/intel,lgm-syscon_cn.yaml
~~~~yaml
```yaml
# SPDX-许可证标识符: GPL-2.0-only 或 BSD-2-Clause
%YAML 1.2
---
$id: http://devicetree.org/schemas/soc/intel/intel,lgm-syscon.yaml#
$schema: http://devicetree.org/meta-schemas/core.yaml#

title: Intel Lightning Mountain (LGM) Syscon

maintainers:
  - 雷传华 <lchuanhua@maxlinear.com>
  - Rahul Tanwar <rtanwar@maxlinear.com>

properties:
  compatible:
    items:
      - const: intel,lgm-syscon
      - const: syscon

  reg:
    maxItems: 1

  ranges: true

  "#address-cells":
    const: 1

  "#size-cells":
    const: 1

patternProperties:
  "^emmc-phy@[0-9a-f]+$":
    $ref: /schemas/phy/intel,lgm-emmc-phy.yaml#

required:
  - compatible
  - reg
  - "#address-cells"
  - "#size-cells"

additionalProperties: false

examples:
  - |
    chiptop@e0200000 {
        compatible = "intel,lgm-syscon", "syscon";
        reg = <0xe0200000 0x100>;
        ranges = <0x0 0xe0200000 0x100>;
        #address-cells = <1>;
        #size-cells = <1>;

        emmc-phy@a8 {
            compatible = "intel,lgm-emmc-phy";
            reg = <0x00a8 0x10>;
            clocks = <&emmc>;
            #phy-cells = <0>;
        };
    };
```

此翻译将给定的 YAML 文档转换为中文，同时保持其结构和内容不变。请注意，某些专业术语和技术词汇在中文环境中可能没有标准翻译，因此这里使用了直接的音译或意译来尽可能准确地表达原意。
~~~~

## Documentation/devicetree/bindings/soc/litex/litex,soc-controller_cn.yaml
```yaml
# SPDX-许可证标识符: GPL-2.0-only 或 BSD-2-Clause
# 版权所有 2020 Antmicro <www.antmicro.com>
%YAML 1.2
---
$id: http://devicetree.org/schemas/soc/litex/litex,soc-controller.yaml#
$schema: http://devicetree.org/meta-schemas/core.yaml#

标题: LiteX SoC 控制器驱动程序

描述: |
  这是为 LiteX SoC 构建器设计的 SoC 控制器驱动程序。
它的目的是验证 LiteX CSR（控制与状态寄存器）访问操作，
并为其他驱动程序提供读写 CSRs 的功能以及检查这些访问器是否准备好使用。
维护者:
  - Karol Gugala <kgugala@antmicro.com>
  - Mateusz Holenko <mholenko@antmicro.com>

属性:
  compatible:
    常量: litex,soc-controller

  reg:
    最大项数: 1

必需:
  - compatible
  - reg

额外属性: false

示例:
  - |
    soc_ctrl0: soc-controller@f0000000 {
        compatible = "litex,soc-controller";
        reg = <0xf0000000 0xc>;
    };
```
