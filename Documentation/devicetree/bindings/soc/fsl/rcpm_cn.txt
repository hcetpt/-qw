## Documentation/devicetree/bindings/soc/fsl/rcpm_cn.txt
~~~~
运行控制和电源管理
--------------------
RCPM（Run Control and Power Management）执行与设备运行控制和电源管理相关的所有设备级任务。
所需属性：
  - `reg`：RCPM模块寄存器集的偏移量和长度
- `#fsl,rcpm-wakeup-cells` ：`fsl,rcpm-wakeup` 属性中 IPPDEXPCR 寄存器单元的数量
- `compatible`：必须包含特定于芯片的 RCPM 模块兼容字符串，并且（如果适用）可以包含特定于机箱版本的 RCPM 兼容字符串。特定于芯片的字符串形式为 `"fsl,<chip>-rcpm"`，例如：
    * `"fsl,p2041-rcpm"`
    * `"fsl,p5020-rcpm"`
    * `"fsl,t4240-rcpm"`

    特定于机箱版本的字符串形式为 `"fsl,qoriq-rcpm-<version>"`，例如：
    * `"fsl,qoriq-rcpm-1.0"`：适用于 1.0 版本机箱的 RCPM
    * `"fsl,qoriq-rcpm-2.0"`：适用于 2.0 版本机箱的 RCPM
    * `"fsl,qoriq-rcpm-2.1"`：适用于 2.1 版本机箱的 RCPM
    * `"fsl,qoriq-rcpm-2.1+"`：适用于 2.1+ 版本机箱的 RCPM

    所有提到的“1.0”和“2.0”均指芯片遵循的 QorIQ 机箱版本。
    | 机箱版本 | 示例芯片 |
    |:--------:|:--------:|
    |    1.0   | p4080, p5020, p5040, p2041, p3041 |
    |    2.0   | t4240, b4860, b4420 |
    |    2.1   | t1040 |
    |   2.1+   | ls1021a, ls1012a, ls1043a, ls1046a |

可选属性：
 - `little-endian`：指定 RCPM 寄存器块采用小端格式。若未指定，则默认为大端格式。

示例：
T4240 的 RCPM 节点配置如下：
```device_tree
rcpm: global-utilities@e2000 {
    compatible = "fsl,t4240-rcpm", "fsl,qoriq-rcpm-2.0";
    reg = <0xe2000 0x1000>;
    #fsl,rcpm-wakeup-cells = <2>;
};
```

* Freescale RCPM 唤醒源设备树绑定
------------------------------------
如果设备可以作为唤醒源使用，则应在设备节点中添加必需的 `fsl,rcpm-wakeup` 属性。
- `fsl,rcpm-wakeup`：由指向 RCPM 节点的句柄和 IPPDEXPCR 寄存器单元组成。IPPDEXPCR 寄存器单元的数量在 RCPM 节点中的 `#fsl,rcpm-wakeup-cells` 中定义。第一个寄存器单元是应设置在 IPPDEXPCR0 中的位掩码，第二个寄存器单元用于 IPPDEXPCR1，依此类推。
注：IPPDEXPCR（IP 功耗降低异常控制寄存器）提供了一种机制，可以在 STANDBY 和 MEM 状态下保持某些区块处于唤醒状态，以便将它们用作唤醒源。

示例：
```device_tree
lpuart0: serial@2950000 {
    compatible = "fsl,ls1021a-lpuart";
    reg = <0x0 0x2950000 0x0 0x1000>;
    interrupts = <GIC_SPI 80 IRQ_TYPE_LEVEL_HIGH>;
    clocks = <&sysclk>;
    clock-names = "ipg";
    fsl,rcpm-wakeup = <&rcpm 0x0 0x40000000>;
};
```
~~~~

## Documentation/devicetree/bindings/soc/hisilicon/hisilicon,hi3660-usb3-otg-bc_cn.yaml
~~~~yaml
```yaml
# SPDX-许可证标识符: GPL-2.0 或 BSD-2-Clause
%YAML 1.2
---
$id: http://devicetree.org/schemas/soc/hisilicon/hisilicon,hi3660-usb3-otg-bc.yaml#
$schema: http://devicetree.org/meta-schemas/core.yaml#

title: Hisilicon Kirin 960 USB OTG 电池充电 Syscon

maintainers:
  - Mauro Carvalho Chehab <mchehab+huawei@kernel.org>

properties:
  compatible:
    items:
      - const: hisilicon,hi3660-usb3-otg-bc
      - const: syscon
      - const: simple-mfd

  reg:
    maxItems: 1

  usb-phy:
    $ref: /schemas/phy/hisilicon,hi3660-usb3.yaml
    description: USB 物理层节点

required:
  - compatible
  - reg
  - usb-phy

additionalProperties: false

examples:
  - |
    syscon@ff200000 {
        compatible = "hisilicon,hi3660-usb3-otg-bc", "syscon", "simple-mfd";
        reg = <0xff200000 0x1000>;

        usb-phy {
            compatible = "hisilicon,hi3660-usb-phy";
            #phy-cells = <0>;
            hisilicon,pericrg-syscon = <&crg_ctrl>;
            hisilicon,pctrl-syscon = <&pctrl>;
            hisilicon,eye-diagram-param = <0x22466e4>;
        };
    };
```

注释：
- `SPDX-许可证标识符`: 指定了源代码文件的许可证信息。
- `title`: 描述了该设备树片段的目标硬件。
- `maintainers`: 列出了负责维护此设备树片段的人员。
- `compatible`: 定义了设备兼容性，通常包含多个字符串以表示不同级别的兼容性。
- `reg`: 用于指定设备的内存地址范围。
- `usb-phy`: 描述了USB物理层配置。
- `examples`: 提供了一个使用该设备树片段的具体示例。
~~~~

## Documentation/devicetree/bindings/soc/imx/fsl,aips-bus_cn.yaml
~~~~yaml
```yaml
# SPDX-License-Identifier: (GPL-2.0 OR BSD-2-Clause)
%YAML 1.2
---
$id: 'http://devicetree.org/schemas/soc/imx/fsl,aips-bus.yaml'
$schema: 'http://devicetree.org/meta-schemas/core.yaml'

title: i.MX AHB 到 IP 桥接器

maintainers:
  - Peng Fan <peng.fan@nxp.com>

description: |
  这个特定的外设设计为 AHB 总线与较低带宽的 IP 从属 (IPS) 总线之间桥接器。

select:
  properties:
    compatible:
      contains:
        const: fsl,aips-bus
  required:
    - compatible

properties:
  compatible:
    items:
      - const: fsl,aips-bus
      - const: simple-bus

  reg:
    maxItems: 1

required:
  - compatible
  - reg

additionalProperties: true

examples:
  - |
    bus@30000000 {
      compatible = "fsl,aips-bus", "simple-bus";
      reg = <0x30000000 0x400000>;
      #address-cells = <1>;
      #size-cells = <1>;
      ranges;
    };
```

此文档定义了 i.MX AHB 到 IP 桥接器在 Device Tree 中的表示方式，该桥接器用于连接 AHB 总线和低带宽的 IP Slave (IPS) 总线。文档遵循 YAML 1.2 格式，并使用 Device Tree 元模式进行描述。
~~~~

## Documentation/devicetree/bindings/soc/imx/fsl,imx8mm-disp-blk-ctrl_cn.yaml
```yaml
# SPDX-License-Identifier: (GPL-2.0-only OR BSD-2-Clause)
%YAML 1.2
---
$id: http://devicetree.org/schemas/soc/imx/fsl,imx8mm-disp-blk-ctrl.yaml#
$schema: http://devicetree.org/meta-schemas/core.yaml#

标题: NXP i.MX8MM DISP blk-ctrl

维护者:
  - Lucas Stach <l.stach@pengutronix.de>

描述:
  i.MX8MM DISP blk-ctrl 是一个顶级外设，提供对 NoC 的访问，并确保位于 SoC 的 DISP 域中的显示和 MIPI CSI 外设的正确电源排序。

属性:
  compatible:
    项目:
      - 常量: fsl,imx8mm-disp-blk-ctrl
      - 常量: syscon

  reg:
    最大项目数: 1

  '#power-domain-cells':
    常量: 1

  power-domains:
    最小项目数: 5
    最大项目数: 5

  power-domain-names:
    项目:
      - 常量: bus
      - 常量: csi-bridge
      - 常量: lcdif
      - 常量: mipi-dsi
      - 常量: mipi-csi

  clocks:
    最小项目数: 10
    最大项目数: 10

  clock-names:
    项目:
      - 常量: csi-bridge-axi
      - 常量: csi-bridge-apb
      - 常量: csi-bridge-core
      - 常量: lcdif-axi
      - 常量: lcdif-apb
      - 常量: lcdif-pix
      - 常量: dsi-pclk
      - 常量: dsi-ref
      - 常量: csi-aclk
      - 常量: csi-pclk

必需:
  - compatible
  - reg
  - power-domains
  - power-domain-names
  - clocks
  - clock-names

额外属性: false

示例:
  - |
    #include <dt-bindings/clock/imx8mm-clock.h>
    #include <dt-bindings/power/imx8mm-power.h>

    blk-ctrl@32e28000 {
      compatible = "fsl,imx8mm-disp-blk-ctrl", "syscon";
      reg = <0x32e28000 0x100>;
      power-domains = <&pgc_dispmix>, <&pgc_dispmix>, <&pgc_dispmix>,
                      <&pgc_mipi>, <&pgc_mipi>;
      power-domain-names = "bus", "csi-bridge", "lcdif",
                           "mipi-dsi", "mipi-csi";
      clocks = <&clk IMX8MM_CLK_DISP_AXI_ROOT>,
               <&clk IMX8MM_CLK_DISP_APB_ROOT>,
               <&clk IMX8MM_CLK_CSI1_ROOT>,
               <&clk IMX8MM_CLK_DISP_AXI_ROOT>,
               <&clk IMX8MM_CLK_DISP_APB_ROOT>,
               <&clk IMX8MM_CLK_DISP_ROOT>,
               <&clk IMX8MM_CLK_DSI_CORE>,
               <&clk IMX8MM_CLK_DSI_PHY_REF>,
               <&clk IMX8MM_CLK_CSI1_CORE>,
               <&clk IMX8MM_CLK_CSI1_PHY_REF>;
       clock-names = "csi-bridge-axi", "csi-bridge-apb", "csi-bridge-core",
                     "lcdif-axi", "lcdif-apb", "lcdif-pix", "dsi-pclk",
                     "dsi-ref", "csi-aclk", "csi-pclk";
       #power-domain-cells = <1>;
    };
```

## Documentation/devicetree/bindings/soc/imx/fsl,imx8mm-vpu-blk-ctrl_cn.yaml
```yaml
下面是给定 YAML 文档的中文翻译：

# SPDX-许可证标识符: (GPL-2.0-only 或 BSD-2-Clause)
%YAML 1.2
---
$id: http://devicetree.org/schemas/soc/imx/fsl,imx8mm-vpu-blk-ctrl.yaml#
$schema: http://devicetree.org/meta-schemas/core.yaml#

标题: NXP i.MX8MM VPU blk-ctrl

维护者:
  - Lucas Stach <l.stach@pengutronix.de>

描述:
  i.MX8MM VPU blk-ctrl 是一个顶层外设，提供对 NoC 的访问，并确保位于 SoC VPU 域中的 VPU 外设得到正确的电源排序。

属性:
  compatible:
    items:
      - const: fsl,imx8mm-vpu-blk-ctrl
      - const: syscon

  reg:
    maxItems: 1

  '#power-domain-cells':
    const: 1

  power-domains:
    maxItems: 4

  power-domain-names:
    maxItems: 4

  clocks:
    maxItems: 3

  clock-names:
    maxItems: 3

  interconnects:
    maxItems: 3

  interconnect-names:
    maxItems: 3

必需:
  - compatible
  - reg
  - power-domains
  - power-domain-names
  - clocks
  - clock-names

allOf:
  - if:
      properties:
        compatible:
          contains:
            const: fsl,imx8mm-vpu-blk-ctrl
    then:
      properties:
        power-domains:
          items:
            - description: 总线电源域
            - description: G1 解码器电源域
            - description: G2 解码器电源域
            - description: H1 编码器电源域

        power-domain-names:
          items:
            - const: bus
            - const: g1
            - const: g2
            - const: h1

        clocks:
          items:
            - description: G1 解码器时钟
            - description: G2 解码器时钟
            - description: H1 编码器时钟

        clock-names:
          items:
            - const: g1
            - const: g2
            - const: h1

        interconnects:
          items:
            - description: G1 解码器互连
            - description: G2 解码器互连
            - description: H1 编码器电源域

        interconnect-names:
          items:
            - const: g1
            - const: g2
            - const: h1

  - if:
      properties:
        compatible:
          contains:
            const: fsl,imx8mp-vpu-blk-ctrl
    then:
      properties:
        power-domains:
          items:
            - description: 总线电源域
            - description: G1 解码器电源域
            - description: G2 解码器电源域
            - description: VC8000E 编码器电源域

        power-domain-names:
          items:
            - const: bus
            - const: g1
            - const: g2
            - const: vc8000e

        clocks:
          items:
            - description: G1 解码器时钟
            - description: G2 解码器时钟
            - description: VC8000E 编码器时钟

        clock-names:
          items:
            - const: g1
            - const: g2
            - const: vc8000e

        interconnects:
          items:
            - description: G1 解码器互连
            - description: G2 解码器互连
            - description: VC8000E 编码器互连

        interconnect-names:
          items:
            - const: g1
            - const: g2
            - const: vc8000e

additionalProperties: false

示例:
  - |
    #include <dt-bindings/clock/imx8mm-clock.h>
    #include <dt-bindings/power/imx8mm-power.h>

    blk-ctrl@38330000 {
      compatible = "fsl,imx8mm-vpu-blk-ctrl", "syscon";
      reg = <0x38330000 0x100>;
      power-domains = <&pgc_vpumix>, <&pgc_vpu_g1>,
                      <&pgc_vpu_g2>, <&pgc_vpu_h1>;
      power-domain-names = "bus", "g1", "g2", "h1";
      clocks = <&clk IMX8MM_CLK_VPU_G1_ROOT>,
               <&clk IMX8MM_CLK_VPU_G2_ROOT>,
               <&clk IMX8MM_CLK_VPU_H1_ROOT>;
      clock-names = "g1", "g2", "h1";
      #power-domain-cells = <1>;
    };
```

## Documentation/devicetree/bindings/soc/imx/fsl,imx8mp-hdmi-blk-ctrl_cn.yaml
```yaml
# SPDX-License-Identifier: (GPL-2.0-only OR BSD-2-Clause)
%YAML 1.2
---
$id: http://devicetree.org/schemas/soc/imx/fsl,imx8mp-hdmi-blk-ctrl.yaml#
$schema: http://devicetree.org/meta-schemas/core.yaml#

title: NXP i.MX8MP HDMI blk-ctrl

maintainers:
  - Lucas Stach <l.stach@pengutronix.de>

description:
  i.MX8MP HDMI blk-ctrl 是一个顶层外设，提供对 NoC 的访问，并确保位于 SoC HDMI 域中的显示管道外设的正确电源排序。

属性:
  compatible:
    items:
      - const: fsl,imx8mp-hdmi-blk-ctrl
      - const: syscon

  reg:
    maxItems: 1

  '#power-domain-cells':
    const: 1

  power-domains:
    minItems: 10
    maxItems: 10

  power-domain-names:
    items:
      - const: bus
      - const: irqsteer
      - const: lcdif
      - const: pai
      - const: pvi
      - const: trng
      - const: hdmi-tx
      - const: hdmi-tx-phy
      - const: hdcp
      - const: hrv

  clocks:
    minItems: 5
    maxItems: 5

  clock-names:
    items:
      - const: apb
      - const: axi
      - const: ref_266m
      - const: ref_24m
      - const: fdcc

  interconnects:
    maxItems: 3

  interconnect-names:
    items:
      - const: hrv
      - const: lcdif-hdmi
      - const: hdcp

必需项:
  - compatible
  - reg
  - power-domains
  - power-domain-names
  - clocks
  - clock-names

其他属性: false

示例:
  - |
    #include <dt-bindings/clock/imx8mp-clock.h>
    #include <dt-bindings/power/imx8mp-power.h>

    blk-ctrl@32fc0000 {
        compatible = "fsl,imx8mp-hdmi-blk-ctrl", "syscon";
        reg = <0x32fc0000 0x23c>;
        clocks = <&clk IMX8MP_CLK_HDMI_APB>,
                 <&clk IMX8MP_CLK_HDMI_ROOT>,
                 <&clk IMX8MP_CLK_HDMI_REF_266M>,
                 <&clk IMX8MP_CLK_HDMI_24M>,
                 <&clk IMX8MP_CLK_HDMI_FDCC_TST>;
        clock-names = "apb", "axi", "ref_266m", "ref_24m", "fdcc";
        power-domains = <&pgc_hdmimix>, <&pgc_hdmimix>, <&pgc_hdmimix>,
                        <&pgc_hdmimix>, <&pgc_hdmimix>, <&pgc_hdmimix>,
                        <&pgc_hdmimix>, <&pgc_hdmi_phy>,
                        <&pgc_hdmimix>, <&pgc_hdmimix>;
        power-domain-names = "bus", "irqsteer", "lcdif", "pai", "pvi", "trng",
                             "hdmi-tx", "hdmi-tx-phy",
                             "hdcp", "hrv";
        #power-domain-cells = <1>;
    };
```

## Documentation/devicetree/bindings/soc/imx/fsl,imx8mp-hsio-blk-ctrl_cn.yaml
```yaml
# SPDX-许可证标识符: (GPL-2.0-only 或 BSD-2-Clause)
%YAML 1.2
---
$id: http://devicetree.org/schemas/soc/imx/fsl,imx8mp-hsio-blk-ctrl.yaml#
$schema: http://devicetree.org/meta-schemas/core.yaml#

标题: NXP i.MX8MP HSIO blk-ctrl

维护者:
  - Lucas Stach <l.stach@pengutronix.de>

描述:
  i.MX8MP HSIO blk-ctrl 是一个顶层外设，提供对 NoC 的访问，并确保位于 SoC 的 HSIO 域中的高速 I/O（USB 和 PCIe）外设的正确电源排序。

属性:
  compatible:
    项目:
      - 常量: fsl,imx8mp-hsio-blk-ctrl
      - 常量: syscon

  reg:
    最大项数: 1

  '#power-domain-cells':
    常量: 1

  power-domains:
    最小项数: 6
    最大项数: 6

  power-domain-names:
    项目:
      - 常量: bus
      - 常量: usb
      - 常量: usb-phy1
      - 常量: usb-phy2
      - 常量: pcie
      - 常量: pcie-phy

  '#clock-cells':
    常量: 0

  clocks:
    最小项数: 2
    最大项数: 2

  clock-names:
    项目:
      - 常量: usb
      - 常量: pcie

  interconnects:
    最大项数: 4

  interconnect-names:
    项目:
      - 常量: noc-pcie
      - 常量: usb1
      - 常量: usb2
      - 常量: pcie

必需:
  - compatible
  - reg
  - power-domains
  - power-domain-names
  - clocks
  - clock-names

额外属性: false

示例:
  - |
    #include <dt-bindings/clock/imx8mp-clock.h>
    #include <dt-bindings/power/imx8mp-power.h>

    blk-ctrl@32f10000 {
        compatible = "fsl,imx8mp-hsio-blk-ctrl", "syscon";
        reg = <0x32f10000 0x24>;
        clocks = <&clk IMX8MP_CLK_USB_ROOT>,
                 <&clk IMX8MP_CLK_PCIE_ROOT>;
        clock-names = "usb", "pcie";
        power-domains = <&pgc_hsiomix>, <&pgc_hsiomix>,
                        <&pgc_usb1_phy>, <&pgc_usb2_phy>,
                        <&pgc_hsiomix>, <&pgc_pcie_phy>;
        power-domain-names = "bus", "usb", "usb-phy1",
                             "usb-phy2", "pcie", "pcie-phy";
        #power-domain-cells = <1>;
        #clock-cells = <0>;
    };
```
