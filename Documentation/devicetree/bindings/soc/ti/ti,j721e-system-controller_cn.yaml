## Documentation/devicetree/bindings/thermal/imx8mm-thermal_cn.yaml
```yaml
# SPDX-许可证标识符: GPL-2.0
%YAML 1.2
---
$id: http://devicetree.org/schemas/thermal/imx8mm-thermal.yaml#
$schema: http://devicetree.org/meta-schemas/core.yaml#

标题: NXP i.MX8M Mini 温度传感器

维护者:
  - Shawn Guo <shawnguo@kernel.org>
  - Sascha Hauer <s.hauer@pengutronix.de>
  - Fabio Estevam <festevam@gmail.com>

描述: |
  i.MX8MM 具有 TMU IP 来允许温度测量，目前有两个不同的主要版本的 IP 被单个驱动程序支持。
  这些 IP 版本分别称为 v1 和 v2，v1 是为 i.MX8MM 设计的，它仅有一个传感器；而 v2 是为 i.MX8MP 设计的，它有两个传感器。
$ref: thermal-sensor.yaml#

属性:
  compatible:
    oneOf:
      - 枚举:
          - fsl,imx8mm-tmu
          - fsl,imx8mp-tmu
      - items:
          - 常量: fsl,imx8mn-tmu
          - 常量: fsl,imx8mm-tmu

  reg:
    maxItems: 1

  clocks:
    maxItems: 1

  nvmem-cells:
    maxItems: 1
    描述: 指向由 ocotp 提供的校准数据的句柄

  nvmem-cell-names:
    常量: calib

  "#thermal-sensor-cells":
    描述: |
      需要的单元格数量来唯一标识温度传感器，对于只有一个传感器的情况为 0，对于多个传感器的情况为 1
    枚举:
      - 0
      - 1

必需:
  - compatible
  - reg
  - clocks

未评估属性: false

示例:
  - |
    #include <dt-bindings/clock/imx8mm-clock.h>

    thermal-sensor@30260000 {
         compatible = "fsl,imx8mm-tmu";
         reg = <0x30260000 0x10000>;
         clocks = <&clk IMX8MM_CLK_TMU_ROOT>;
         #thermal-sensor-cells = <0>;
    };
```

## Documentation/devicetree/bindings/thermal/kirkwood-thermal_cn.txt
~~~~
*Kirkwood 温度监控*

本版本适用于 Kirkwood 88F8262 与 88F6283 系统级芯片 (SoC)。其他 Kirkwood 芯片并未内置温度传感器。
所需属性：
- compatible: "marvell,kirkwood-thermal"
- reg: 温度寄存器的地址范围

示例：

``` 
	thermal@10078 {
		compatible = "marvell,kirkwood-thermal";
		reg = <0x10078 0x4>;
	};
```
这段配置表示在地址 0x10078 处有一个长度为 0x4（即 4 字节）的温度寄存器区域，它与 "marvell,kirkwood-thermal" 兼容。
~~~~

## Documentation/devicetree/bindings/thermal/loongson,ls2k-thermal_cn.yaml
~~~~yaml
```yaml
# SPDX-许可证标识符: (GPL-2.0-only 或 BSD-2-Clause)
%YAML 1.2
---
$id: http://devicetree.org/schemas/thermal/loongson,ls2k-thermal.yaml#
$schema: http://devicetree.org/meta-schemas/core.yaml#

title: 龙芯2系列SoC上的温度传感器

维护者:
  - 张洪臣 <zhanghongchen@loongson.cn>
  - 朱银波 <zhuyinbo@loongson.cn>

allOf:
  - $ref: /schemas/thermal/thermal-sensor.yaml#

properties:
  compatible:
    oneOf:
      - enum:
          - loongson,ls2k1000-thermal
          - loongson,ls2k2000-thermal
      - items:
          - enum:
              - loongson,ls2k0500-thermal
          - const: loongson,ls2k1000-thermal

  reg:
    minItems: 1
    maxItems: 2

  interrupts:
    maxItems: 1

  '#thermal-sensor-cells':
    const: 1

required:
  - compatible
  - reg
  - interrupts

if:
  properties:
    compatible:
      contains:
        enum:
          - loongson,ls2k2000-thermal

then:
  properties:
    reg:
      minItems: 2
      maxItems: 2

else:
  properties:
    reg:
      maxItems: 1

unevaluatedProperties: false

examples:
  - |
    #include <dt-bindings/interrupt-controller/irq.h>
    thermal: thermal-sensor@1fe01500 {
        compatible = "loongson,ls2k1000-thermal";
        reg = <0x1fe01500 0x30>;
        interrupt-parent = <&liointc0>;
        interrupts = <7 IRQ_TYPE_LEVEL_LOW>;
        #thermal-sensor-cells = <1>;
    };
```
```
~~~~

## Documentation/devicetree/bindings/thermal/max77620_thermal_cn.txt
~~~~
Maxim Semiconductor 的 MAX77620 电源管理 IC 的热驱动程序。MAX77620 支持在其芯片温度超过 120°C 和 140°C 时触发报警中断。这些阈值温度是不可配置的。该设备除了指示温度是否高于或低于阈值水平外，不提供实际的芯片温度。

**必需属性：**
-------------------
`#thermal-sensor-cells`: 更多详细信息，请参考
            `<devicetree/bindings/thermal/thermal-sensor.yaml>`
            值必须为 0

更多信息请参阅通用热设备树绑定文档
`<devicetree/bindings/thermal/thermal*.yaml>`

关于 MAX77620 的多功能设备（mfd）设备树绑定文档，请参考
`<devicetree/bindings/mfd/max77620.txt>`

**示例：**
--------

```yaml
#include <dt-bindings/mfd/max77620.h>
#include <dt-bindings/thermal/thermal.h>

...

i2c@7000d000 {
    spmic: max77620@3c {
        compatible = "maxim,max77620";
        ::::
        #thermal-sensor-cells = <0>;
        :::
    };
};

cool_dev: cool-dev {
    compatible = "cooling-dev";
    #cooling-cells = <2>;
};

thermal-zones {
    PMIC-Die {
        polling-delay = <0>;
        polling-delay-passive = <0>;
        thermal-sensors = <&spmic>;

        trips {
            pmic_die_warn_temp_thresh: hot-die {
                temperature = <120000>; // 单位为微度 (μ°C)
                type = "hot";
                hysteresis = <0>;
            };

            pmic_die_cirt_temp_thresh: critical-die {
                temperature = <140000>; // 单位为微度 (μ°C)
                type = "critical";
                hysteresis = <0>;
            };
        };

        cooling-maps {
            map0 {
                trip = <&pmic_die_warn_temp_thresh>;
                cooling-device = <&cool_dev THERMAL_NO_LIMIT
                                  THERMAL_NO_LIMIT>;
                contribution = <100>;
            };
        };
    };
};
```

在这个示例中，我们定义了一个 MAX77620 芯片，它通过 I2C 总线连接，并指定了热传感器单元的数量为 0。接着定义了一个冷却设备，并且在一个名为 `thermal-zones` 的节点中定义了热区域。该热区域定义了两个阈值事件：当温度达到 120°C 时发出警告（类型为“hot”），当温度达到 140°C 时发出严重警告（类型为“critical”）。此外，还定义了一个冷却映射，当温度超过警告阈值时，启用冷却设备进行降温。
~~~~
