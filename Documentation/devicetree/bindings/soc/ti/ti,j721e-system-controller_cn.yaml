## Documentation/devicetree/bindings/thermal/brcm,bcm2835-thermal_cn.yaml
~~~~yaml
```yaml
# SPDX-许可证标识符: (GPL-2.0-only 或 BSD-2-Clause)
%YAML 1.2
---
$id: http://devicetree.org/schemas/thermal/brcm,bcm2835-thermal.yaml#
$schema: http://devicetree.org/meta-schemas/core.yaml#

title: Broadcom BCM2835 温度传感器

maintainers:
  - Stefan Wahren <stefan.wahren@i2se.com>

allOf:
  - $ref: thermal-sensor.yaml#

properties:
  compatible:
    enum:
      - brcm,bcm2835-thermal
      - brcm,bcm2836-thermal
      - brcm,bcm2837-thermal

  reg:
    maxItems: 1

  clocks:
    maxItems: 1

  "#thermal-sensor-cells":
    const: 0

unevaluatedProperties: false

required:
  - compatible
  - reg
  - clocks

examples:
  - |
    #include <dt-bindings/clock/bcm2835.h>

    thermal@7e212000 {
      compatible = "brcm,bcm2835-thermal";
      reg = <0x7e212000 0x8>;
      clocks = <&clocks BCM2835_CLOCK_TSENS>;
      #thermal-sensor-cells = <0>;
    };
```

这段 YAML 文件描述了 Broadcom BCM2835 系列温度传感器的设备树配置文件。它定义了与该传感器相关的兼容性、寄存器地址、时钟配置等属性，并提供了一个示例来展示如何在设备树中使用这些配置。
~~~~

## Documentation/devicetree/bindings/thermal/brcm,ns-thermal_cn.yaml
```yaml
# SPDX-许可证标识符: GPL-2.0-only 或 BSD-2-Clause
%YAML 1.2
---
$id: http://devicetree.org/schemas/thermal/brcm,ns-thermal.yaml#
$schema: http://devicetree.org/meta-schemas/core.yaml#

title: Broadcom Northstar 温度监控

maintainers:
  - Rafał Miłecki <rafal@milecki.pl>

description:
  北极星DMU（设备管理单元）中的一部分温度传感器
allOf:
  - $ref: thermal-sensor.yaml#

properties:
  compatible:
    const: brcm,ns-thermal

  reg:
    description: PVTMON 寄存器范围
    maxItems: 1

  "#thermal-sensor-cells":
    const: 0

unevaluatedProperties: false

required:
  - reg

examples:
  - |
    thermal: thermal@1800c2c0 {
        compatible = "brcm,ns-thermal";
        reg = <0x1800c2c0 0x10>;
        #thermal-sensor-cells = <0>;
    };

    thermal-zones {
        cpu-thermal {
            polling-delay-passive = <0>;
            polling-delay = <1000>;
            coefficients = <(-556) 418000>;
            thermal-sensors = <&thermal>;

            trips {
                cpu-crit {
                    temperature = <125000>;
                    hysteresis = <0>;
                    type = "critical";
                };
            };

            cooling-maps {
            };
        };
    };
```

## Documentation/devicetree/bindings/thermal/brcm,sr-thermal_cn.txt
~~~~
此绑定描述了作为Stingray系统级芯片(SoC)一部分的温度传感器。

**必需属性：**
- `compatible`：必须为"brcm,sr-thermal"。
- `reg`：tmon数据将可用的内存地址。
- `brcm,tmon-mask`：有效TMON源的一个单元位掩码。每个比特代表一个单独的TMON源。
- `#thermal-sensor-cells`：温度传感器phandler。
- `polling-delay`：两次轮询之间最大等待的毫秒数。
- `thermal-sensors`：温度传感器phandle列表及其指定符。指定符值是TMON ID，应与`brcm,tmon-mask`相对应。
- `temperature`：临界温度阈值（单位：千分之一摄氏度）。

**示例：**

```text
tmons {
    compatible = "simple-bus";
    #address-cells = <1>;
    #size-cells = <1>;
    ranges = <0x0 0x0 0x8f100000 0x100>;

    tmon: tmon@0 {
        compatible = "brcm,sr-thermal";
        reg = <0x0 0x40>;
        brcm,tmon-mask = <0x3f>;
        #thermal-sensor-cells = <1>;
    };
};

thermal-zones {
    ihost0_thermal: ihost0-thermal {
        polling-delay-passive = <0>;
        polling-delay = <1000>;
        thermal-sensors = <&tmon 0>;
        trips {
            cpu-crit {
                temperature = <105000>;
                hysteresis = <0>;
                type = "critical";
            };
        };
    };

    ihost1_thermal: ihost1-thermal {
        polling-delay-passive = <0>;
        polling-delay = <1000>;
        thermal-sensors = <&tmon 1>;
        trips {
            cpu-crit {
                temperature = <105000>;
                hysteresis = <0>;
                type = "critical";
            };
        };
    };

    ihost2_thermal: ihost2-thermal {
        polling-delay-passive = <0>;
        polling-delay = <1000>;
        thermal-sensors = <&tmon 2>;
        trips {
            cpu-crit {
                temperature = <105000>;
                hysteresis = <0>;
                type = "critical";
            };
        };
    };

    ihost3_thermal: ihost3-thermal {
        polling-delay-passive = <0>;
        polling-delay = <1000>;
        thermal-sensors = <&tmon 3>;
        trips {
            cpu-crit {
                temperature = <105000>;
                hysteresis = <0>;
                type = "critical";
            };
        };
    };

    crmu_thermal: crmu-thermal {
        polling-delay-passive = <0>;
        polling-delay = <1000>;
        thermal-sensors = <&tmon 4>;
        trips {
            cpu-crit {
                temperature = <105000>;
                hysteresis = <0>;
                type = "critical";
            };
        };
    };

    nitro_thermal: nitro-thermal {
        polling-delay-passive = <0>;
        polling-delay = <1000>;
        thermal-sensors = <&tmon 5>;
        trips {
            cpu-crit {
                temperature = <105000>;
                hysteresis = <0>;
                type = "critical";
            };
        };
    };
};
```

这段配置描述了一个使用Broadcom Stingray SoC中的温度监测功能的示例。在该示例中，定义了六个热区(`ihost0_thermal`到`nitro_thermal`)，每个热区都配置有相同的轮询延迟和温度阈值，并指定了不同的TMON ID以监控不同的温度源。
~~~~

## Documentation/devicetree/bindings/thermal/db8500-thermal_cn.txt
~~~~
*ST-Ericsson DB8500 热管理节点

**热管理节点属性：

- 兼容性: "stericsson,db8500-thermal";
- reg : 热传感器寄存器的地址范围；
- interrupts : 由PRCMU产生的中断；
- interrupt-names : "IRQ_HOTMON_LOW" 和 "IRQ_HOTMON_HIGH";
- num-trips : 总的温度阈值点数量，这是必需的，如果没有则设置为0，
  如果大于0，则必须定义以下属性；
- tripN-temp : 阈值点N的温度，应按升序排列；
- tripN-type : 阈值点N的类型，应为"active" "passive" "hot"
  "critical"之一；
- tripN-cdev-num : 可以绑定到阈值点N的冷却设备数量，如果定义了阈值点N，则这是必需的，如果没有则设置为0，
  否则必须定义以下冷却设备名称；
- tripN-cdev-nameM : 阈值点N的第M个冷却设备的名称；

通常，num-trips和tripN-***在与板级相关的DTS文件中是分开的。
示例：
```
thermal@801573c0 {
	compatible = "stericsson,db8500-thermal";
	reg = <0x801573c0 0x40>;
	interrupts = <21 0x4>, <22 0x4>;
	interrupt-names = "IRQ_HOTMON_LOW", "IRQ_HOTMON_HIGH";

	num-trips = <3>;

	trip0-temp = <75000>;
	trip0-type = "active";
	trip0-cdev-num = <1>;
	trip0-cdev-name0 = "thermal-cpufreq-0";

	trip1-temp = <80000>;
	trip1-type = "active";
	trip1-cdev-num = <2>;
	trip1-cdev-name0 = "thermal-cpufreq-0";
	trip1-cdev-name1 = "thermal-fan";

	trip2-temp = <85000>;
	trip2-type = "critical";
	trip2-cdev-num = <0>;
}
```

这个配置描述了一个ST-Ericsson DB8500平台上的热管理节点。它定义了三个温度阈值点（trip points），每个阈值点都有特定的温度、类型以及可绑定的冷却设备数量和名称。这些信息用于控制处理器频率或风扇速度等，以防止过热。
~~~~

## Documentation/devicetree/bindings/thermal/dlg,da9062-thermal_cn.yaml
~~~~yaml
```yaml
# SPDX-许可证标识符: (GPL-2.0-only 或 BSD-2-Clause)
%YAML 1.2
---
$id: http://devicetree.org/schemas/thermal/dlg,da9062-thermal.yaml#
$schema: http://devicetree.org/meta-schemas/core.yaml#

title: Dialog DA9062/61 TJUNC 温度模块

maintainers:
  - Biju Das <biju.das.jz@bp.renesas.com>

description: |
  此模块是 DA9061/DA9062 的一部分。关于整个 DA906{1,2} 芯片的更多详细信息，请参阅 Documentation/devicetree/bindings/mfd/dlg,da9063.yaml

  结温温度模块使用中断信号来识别 PMIC 设备上的高 THERMAL_TRIP_HOT 温度
properties:
  compatible:
    oneOf:
      - const: dlg,da9062-thermal
      - items:
          - const: dlg,da9061-thermal
          - const: dlg,da9062-thermal

  polling-delay-passive:
    description:
      指定在毫秒中测量的热区域设备更新检查之间的轮询周期
required:
  - compatible

additionalProperties: false
```
请注意，此翻译尽量保持了原文格式和结构，并对某些词汇进行了本地化翻译以适应中文习惯。例如，“junction temperature”被翻译为“结温”，这是电子工程领域的一个常见术语。
~~~~

## Documentation/devicetree/bindings/thermal/dove-thermal_cn.txt
~~~~
*Dove Thermal*

此驱动程序适用于包含温度传感器的Dove系统级芯片（SoC）。
所需属性：
- compatible（兼容性）: "marvell,dove-thermal"
- reg（寄存器区域）: 温度寄存器的地址范围

`reg` 属性应包含两个范围。第一个范围用于三个 Thermal Manager 寄存器，而第二个范围则包含了 Thermal Diode Control 寄存器。
示例：

```plaintext
thermal@10078 { 
	compatible = "marvell,dove-thermal"; 
	reg = <0xd001c 0x0c>, <0xd005c 0x08>; 
};
```

这里的 `thermal@10078` 表示该设备的基地址为 `10078`，`compatible = "marvell,dove-thermal"` 指定此设备与 `"marvell,dove-thermal"` 兼容，而 `reg` 则定义了两个寄存器区域：`<0xd001c 0x0c>` 和 `<0xd005c 0x08>`，分别对应 Thermal Manager 寄存器和 Thermal Diode Control 寄存器。
~~~~

## Documentation/devicetree/bindings/thermal/fsl,scu-thermal_cn.yaml
~~~~yaml
```yaml
# SPDX-许可证标识符: (GPL-2.0-only 或 BSD-2-Clause)
%YAML 1.2
---
$id: http://devicetree.org/schemas/thermal/fsl,scu-thermal.yaml#
$schema: http://devicetree.org/meta-schemas/core.yaml#

title: i.MX SCU 客户端设备节点 - 基于 SCU 消息协议的热管理

maintainers:
  - Dong Aisheng <aisheng.dong@nxp.com>

description: i.MX SCU 客户端设备节点
  客户端节点作为相关 i.MX-SCU 设备节点的子节点进行维护
allOf:
  - $ref: thermal-sensor.yaml#

properties:
  compatible:
    items:
      - enum:
          - fsl,imx8dxl-sc-thermal
          - fsl,imx8qxp-sc-thermal
      - const: fsl,imx-sc-thermal

  '#thermal-sensor-cells':
    const: 1

required:
  - compatible

additionalProperties: false

examples:
  - |
    thermal-sensor {
        compatible = "fsl,imx8qxp-sc-thermal", "fsl,imx-sc-thermal";
        #thermal-sensor-cells = <1>;
    };
```

这段 YAML 文件描述了 i.MX 系列处理器中基于 SCU (System Control Unit) 消息协议的热传感器配置。它定义了一个热传感器节点的兼容性，并指出了该节点如何被集成到 Device Tree 中，以及具体的配置示例。
~~~~

## Documentation/devicetree/bindings/thermal/generic-adc-thermal_cn.yaml
```yaml
# SPDX-许可证标识符: GPL-2.0-only OR BSD-2-Clause
%YAML 1.2
---
$id: http://devicetree.org/schemas/thermal/generic-adc-thermal.yaml#
$schema: http://devicetree.org/meta-schemas/core.yaml#

标题: 通用型模拟到数字转换器（ADC）为基础的温度传感器

维护者:
  - Laxman Dewangan <ldewangan@nvidia.com>

描述:
  在某些平台上，像热敏电阻这样的温度传感器连接到ADC通道之一，并通过传感器电阻上的电压读取传感器电阻。在传感器上读取的电压映射为温度使用电压-温度查找表。
$ref: thermal-sensor.yaml#

属性:
  compatible:
    常量: generic-adc-thermal

  '#thermal-sensor-cells':
    常量: 0

  io-channels:
    最大项数: 1

  io-channel-names:
    常量: sensor-channel

  temperature-lookup-table:
    描述: |
      查找表用来映射ADC值和温度之间的关系
当读取ADC时，其值会在表中查找以获得等效温度
如果没有指定，则驱动程序假设ADC通道直接给出毫摄氏度
$ref: /schemas/types.yaml#/definitions/int32-matrix
    项:
      项:
        - 描述: 毫摄氏度的温度
        - 描述: ADC读取值

必需:
  - compatible
  - io-channels
  - io-channel-names

未评估属性: false

示例:
  - |
    #include <dt-bindings/thermal/thermal.h>

    thermal-sensor {
        compatible = "generic-adc-thermal";
        #thermal-sensor-cells = <0>;
        io-channels = <&ads1015 1>;
        io-channel-names = "sensor-channel";
        temperature-lookup-table = <
              (-40000) 2578
              (-39000) 2577
              (-38000) 2576
              (-37000) 2575
              (-36000) 2574
              (-35000) 2573
              (-34000) 2572
              (-33000) 2571
              (-32000) 2569
              (-31000) 2568
              (-30000) 2567
              /* 跳过 */
              118000 254
              119000 247
              120000 240
              121000 233
              122000 226
              123000 220
              124000 214
              125000 208>;
    };
..
```

## Documentation/devicetree/bindings/thermal/hisilicon,tsensor_cn.yaml
~~~~yaml
```yaml
# SPDX-许可证标识符: GPL-2.0-only 或 BSD-2-Clause
%YAML 1.2
---
$id: http://devicetree.org/schemas/thermal/hisilicon,tsensor.yaml#
$schema: http://devicetree.org/meta-schemas/core.yaml#

title: 基于HiSilicon SoC的温度传感器

maintainers:
  - Abdulrasaq Lawani <abdulrasaqolawani@gmail.com>

allOf:
  - $ref: thermal-sensor.yaml

properties:
  compatible:
    enum:
      - hisilicon,tsensor
      - hisilicon,hi3660-tsensor

  reg:
    maxItems: 1

  clocks:
    maxItems: 1

  clock-names:
    items:
      - const: thermal_clk

  interrupts:
    maxItems: 1

  '#thermal-sensor-cells':
    const: 1

required:
  - compatible
  - reg
  - interrupts
  - '#thermal-sensor-cells'

unevaluatedProperties: false

examples:
  - |
    #include <dt-bindings/clock/hi6220-clock.h>
    #include <dt-bindings/interrupt-controller/arm-gic.h>

    temperature-sensor@f7030700 {
        compatible = "hisilicon,tsensor";
        reg = <0xf7030700 0x1000>;
        interrupts = <GIC_SPI 7 IRQ_TYPE_LEVEL_HIGH>;
        clocks = <&sys_ctrl HI6220_TSENSOR_CLK>;
        clock-names = "thermal_clk";
        #thermal-sensor-cells = <1>;
    };
```
请注意，`SPDX-许可证标识符`的翻译并不常见，这里为了保持语句的正确性而进行了直译。实际使用时，可以保留英文或根据具体上下文进行适当调整。
~~~~

## Documentation/devicetree/bindings/thermal/imx-thermal_cn.yaml
```yaml
这段 Device Tree 文件描述了 NXP i.MX 系列处理器中的温度监控模块的配置。以下是中文翻译：

# SPDX-License-Identifier: (GPL-2.0-only OR BSD-2-Clause)
%YAML 1.2
---
$id: http://devicetree.org/schemas/thermal/imx-thermal.yaml#
$schema: http://devicetree.org/meta-schemas/core.yaml#

标题: NXP i.MX 温度监控

维护者:
  - Shawn Guo <shawnguo@kernel.org>

属性:
  compatible:
    oneOf:
      - 枚举:
          - fsl,imx6q-tempmon
          - fsl,imx6sx-tempmon
          - fsl,imx7d-tempmon
      - items:
          - 枚举:
              - fsl,imx6sll-tempmon
              - fsl,imx6ul-tempmon
          - 常量: fsl,imx6sx-tempmon

  interrupts:
    描述: |
      控制器的中断输出，i.MX6Q 有一个 IRQ_HIGH，当温度高于高阈值时触发；
      i.MX6SX 和 i.MX7S/D 比 i.MX6Q 多两个 IRQ，一个是 IRQ_LOW，
      另一个是 IRQ_PANIC；当温度低于低阈值时 IRQ_LOW 被触发；
      当温度高于恐慌阈值时 IRQ_PANIC 被触发，系统可以通过 SRC 模块为 IRQ_PANIC 配置自动重启。
      IRQ_HIGH、IRQ_LOW 和 IRQ_PANIC 共享控制器的同一个中断输出。
    最大项数: 1

  nvmem-cells:
    items:
      - 描述: 指向由 ocotp 提供的校准数据的 Phandle
      - 描述: 指向由 ocotp 提供的温度等级的 Phandle

  nvmem-cell-names:
    items:
      - 常量: calib
      - 常量: temp_grade

  fsl,tempmon:
    $ref: /schemas/types.yaml#/definitions/phandle
    描述: 指向 anatop 系统控制器节点的 Phandle
  fsl,tempmon-data:
    $ref: /schemas/types.yaml#/definitions/phandle
    描述: |
      已弃用的属性，指向包含 TEMPMON 校准数据的熔丝控制器的 Phandle，
      例如 iMX6Q 上的 OCOTP。有关校准数据的详细信息，请参阅 SoC 参考手册。
    已弃用: true

  clocks:
    最大项数: 1

  "#thermal-sensor-cells":
    常量: 0

必需:
  - compatible
  - interrupts
  - fsl,tempmon
  - nvmem-cells
  - nvmem-cell-names

allOf:
  - $ref: thermal-sensor.yaml#

附加属性: false

示例:
  - |
    #include <dt-bindings/clock/imx6sx-clock.h>
    #include <dt-bindings/interrupt-controller/arm-gic.h>

    efuse@21bc000 {
         #address-cells = <1>;
         #size-cells = <1>;
         compatible = "fsl,imx6sx-ocotp", "syscon";
         reg = <0x021bc000 0x4000>;
         clocks = <&clks IMX6SX_CLK_OCOTP>;

         tempmon_calib: calib@38 {
             reg = <0x38 4>;
         };

         tempmon_temp_grade: temp-grade@20 {
             reg = <0x20 4>;
         };
    };

    anatop@20c8000 {
        compatible = "fsl,imx6q-anatop", "syscon", "simple-mfd";
        reg = <0x020c8000 0x1000>;
        interrupts = <0 49 IRQ_TYPE_LEVEL_HIGH>,
                     <0 54 IRQ_TYPE_LEVEL_HIGH>,
                     <0 127 IRQ_TYPE_LEVEL_HIGH>;

        tempmon {
             compatible = "fsl,imx6sx-tempmon";
             interrupts = <GIC_SPI 49 IRQ_TYPE_LEVEL_HIGH>;
             fsl,tempmon = <&anatop>;
             nvmem-cells = <&tempmon_calib>, <&tempmon_temp_grade>;
             nvmem-cell-names = "calib", "temp_grade";
             clocks = <&clks IMX6SX_CLK_PLL3_USB_OTG>;
             #thermal-sensor-cells = <0>;
        };
    };
```
