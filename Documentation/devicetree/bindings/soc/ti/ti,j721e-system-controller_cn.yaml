## Documentation/devicetree/bindings/soc/ti/ti,j721e-system-controller_cn.yaml
~~~~yaml
以下是提供的 YAML 文件的中文翻译：

```
# SPDX-许可证标识符: (GPL-2.0-only 或 BSD-2-Clause)
# 版权所有 (C) 2020 德州仪器公司 - http://www.ti.com/
%YAML 1.2
---
$id: http://devicetree.org/schemas/soc/ti/ti,j721e-system-controller.yaml#
$schema: http://devicetree.org/meta-schemas/core.yaml#

title: TI J721e 系统控制器寄存器读写

description: |
  此文件表示了 SoC 上系统控制器节点中的控制模块寄存器（CTRL_MMR0）。
  系统控制器节点代表一组包含各种寄存器的区域。这些寄存器不够连贯，无法作为特定类型的设备来表示。典型的用例是其他节点的驱动程序或平台特定代码获取系统控制器节点的引用（例如通过 phandle、节点路径或使用特定兼容值搜索），查询节点（或相关操作系统驱动程序）以确定寄存器的位置，并直接访问这些寄存器。
maintainers:
  - Kishon Vijay Abraham I <kishon@kernel.org>
  - Roger Quadros <rogerq@kernel.org>

properties:
  compatible:
    items:
      - enum:
          - ti,j7200-system-controller
          - ti,j721e-system-controller
          - ti,j721s2-system-controller
      - const: syscon
      - const: simple-mfd

  reg:
    maxItems: 1

  "#address-cells":
    const: 1

  "#size-cells":
    const: 1

  ranges: true

patternProperties:
  # 可选子节点
  "^mux-controller@[0-9a-f]+$":
    type: object
    description:
      这是 SERDES 车道控制多路复用器
"^clock-controller@[0-9a-f]+$":
    type: object
    $ref: /schemas/clock/ti,am654-ehrpwm-tbclk.yaml#
    description:
      为 TI EHRPWM 节点提供时钟
"phy@[0-9a-f]+$":
    type: object
    $ref: /schemas/phy/ti,phy-gmii-sel.yaml#
    description:
      对应于以太网 MAC 的 PHY 节点
"^chipid@[0-9a-f]+$":
    type: object
    $ref: /schemas/hwinfo/ti,k3-socinfo.yaml#
    description:
      对应 SoC 芯片识别的节点
required:
  - compatible
  - reg
  - "#address-cells"
  - "#size-cells"
  - ranges

additionalProperties: false

examples:
  - |
    scm_conf: scm-conf@100000 {
        compatible = "ti,j721e-system-controller", "syscon", "simple-mfd";
        reg = <0x00100000 0x1c000>;
        #address-cells = <1>;
        #size-cells = <1>;
        ranges;

        serdes_ln_ctrl: mux-controller@4080 {
            compatible = "mmio-mux";
            reg = <0x00004080 0x50>;

            #mux-control-cells = <1>;
            mux-reg-masks =
                <0x4080 0x3>, <0x4084 0x3>, /* SERDES0 车道0/1选择 */
                <0x4090 0x3>, <0x4094 0x3>, /* SERDES1 车道0/1选择 */
                <0x40a0 0x3>, <0x40a4 0x3>, /* SERDES2 车道0/1选择 */
                <0x40b0 0x3>, <0x40b4 0x3>, /* SERDES3 车道0/1选择 */
                <0x40c0 0x3>, <0x40c4 0x3>, <0x40c8 0x3>, <0x40cc 0x3>;
                /* SERDES4 车道0/1/2/3选择 */
        };

        clock-controller@4140 {
            compatible = "ti,am654-ehrpwm-tbclk";
            reg = <0x4140 0x18>;
            #clock-cells = <1>;
        };

        chipid@14 {
            compatible = "ti,am654-chipid";
            reg = <0x14 0x4>;
        };
    };
```
~~~~

## Documentation/devicetree/bindings/soc/ti/ti,pruss_cn.yaml
```yaml
# SPDX-许可证标识符: (GPL-2.0-only 或 BSD-2-Clause)
%YAML 1.2
---
$id: http://devicetree.org/schemas/soc/ti/ti,pruss.yaml#
$schema: http://devicetree.org/meta-schemas/core.yaml#

title: |+
  TI 可编程实时单元与工业通信子系统

maintainers:
  - Suman Anna <s-anna@ti.com>

description: |+

  可编程实时单元与工业通信子系统（PRU-ICSS，又称为 PRUSS）存在于多种 TI 系统级芯片中，如 AM335x、AM437x、Keystone 66AK2G、OMAP-L138/DA850 等。一个 PRUSS 包含双 32 位精简指令集计算核心（可编程实时单元，简称 PRU）、共享 RAM、数据和指令 RAM、一些内部外设模块以支持工业通信以及中断控制器。
  PRU 的可编程特性提供了实现自定义外设接口、快速实时响应或专门的数据处理的灵活性。
  常见的外设模块包括：
    - 带有两个 MII 端口的以太网 MII_RT 模块
    - 用于控制外部以太网 PHY 的 MDIO 端口
    - 用于管理和生成工业以太网功能的工业以太网外设 (IEP)
    - 增强型捕获模块 (eCAP)
    - 具有 7/9 个捕获事件和 16 个比较事件的工业以太网定时器
    - 支持 PROFIBUS 的 16550 兼容 UART
    - 具有异步捕获和串行支持的增强型 GPIO

  一个 PRU-ICSS 子系统最多可以有三个共享数据内存。一个 PRU 核心在其地址 0x0 处作用于主数据 RAM（通常有 2 个数据 RAM），但也能访问其地址 0x2000 处的另一个 PRU 核心的主数据 RAM。如果存在共享数据 RAM，则两个 PRU 核心都可以访问它。中断控制器 (INTC) 和 CFG 模块对于两个 PRU 核心来说是通用的。每个 PRU 核心也有自己的指令 RAM，并且有特定的寄存器空间用于控制和调试功能。
  PRU-ICSS 子系统中的各种子模块作为单独的节点表示，并根据它们在 IP 和 SoC 中的集成情况使用父-子层次结构定义。这些节点将在以下各节中描述。
PRU-ICSS 节点
  ==============
  每个 PRU-ICSS 实例都以其自己的节点表示，其中各个 PRU 处理器核心、内存节点、INTC 节点和 MDIO 节点作为子节点表示在这个 PRUSS 节点内。这个节点应该是相应互联总线节点或目标模块节点的子节点。
有关通用 SysCon 绑定详细信息，请参阅 ../../mfd/syscon.yaml
属性:
  $nodename:
    模式: "^(pruss|icssg)@[0-9a-f]+$"

  compatible:
    枚举:
      - ti,am3356-pruss  # 对于 AM335x SoC 家族
      - ti,am4376-pruss0 # 对于 AM437x SoC 家族和 PRUSS 单元 0
      - ti,am4376-pruss1 # 对于 AM437x SoC 家族和 PRUSS 单元 1
      - ti,am5728-pruss  # 对于 AM57xx SoC 家族
      - ti,am625-pruss   # 对于 K3 AM62x SoC 家族
      - ti,am642-icssg   # 对于 K3 AM64x SoC 家族
      - ti,am654-icssg   # 对于 K3 AM65x SoC 家族
      - ti,j721e-icssg   # 对于 K3 J721E SoC 家族
      - ti,k2g-pruss     # 对于 66AK2G SoC 家族

  reg:
    最大项数: 1

  "#address-cells":
    常量: 1

  "#size-cells":
    常量: 1

  ranges:
    最大项数: 1

  dma-ranges:
    最大项数: 1

  dma-coherent: true

  power-domains:
    描述: |
      此属性符合 sci-pm-domain.txt 中的规定
patternProperties:

  memories@[a-f0-9]+$:
    描述: |
      单个 PRU-ICSS 单元内的各种数据 RAM 作为一个节点表示，名称为 'memories'
类型: 对象

    属性:
      reg:
        最小项数: 2 # 在 AM437x 上的一个 PRUSS 单元可能不包含共享 RAM
项目:
          - 描述: 数据 RAM0 的地址和大小
描述：Data RAM1 的地址和大小
描述：|
      共享数据 RAM 的地址和大小。需要注意的是，在 AM437x 上，两个 PRUSS 单元中的一个不包含共享 RAM，而另一个则有。

reg-names:
        minItems: 2
        items:
          - const: dram0
          - const: dram1
          - const: shrdram2

    required:
      - reg
      - reg-names

    additionalProperties: false

  cfg@[a-f0-9]+$:
    description: |
      PRU-ICSS 配置空间。CFG 子模块以 SysCon 的形式表示。
type: object
    additionalProperties: false

    properties:
      compatible:
        items:
          - const: ti,pruss-cfg
          - const: syscon

      "#address-cells":
        const: 1

      "#size-cells":
        const: 1

      reg:
        maxItems: 1

      ranges:
        maxItems: 1

      clocks:
        type: object

        properties:
          "#address-cells":
            const: 1

          "#size-cells":
            const: 0

        patternProperties:
          coreclk-mux@[a-f0-9]+$:
            description: |
              这仅适用于 ICSSG（K3 SoC）。ICSSG 模块的核心时钟可以设置为两种来源之一：ICSSG_CORE_CLK 或 ICSSG_ICLK。此节点模拟这个时钟多路复用器，并应命名为 "coreclk-mux"。
type: object

            properties:
              '#clock-cells':
                const: 0

              clocks:
                items:
                  - description: ICSSG_CORE 时钟
                  - description: ICSSG_ICLK 时钟

              assigned-clocks:
                maxItems: 1

              assigned-clock-parents:
                maxItems: 1
                description: |
                  标准的 assigned-clocks-parents 定义用于选择多路复用器父级（多路复用器输入之一）
reg:
                maxItems: 1

            required:
              - clocks

            additionalProperties: false

          iepclk-mux@[a-f0-9]+$:
            description: |
              IEP 模块可以从两种来源获取其时钟：ICSSG_IEP_CLK 或 CORE_CLK（在较旧的 SoC 中称为 OCP_CLK）。此节点模拟这个时钟多路复用器，并应命名为 "iepclk-mux"。
type: object

            properties:
              '#clock-cells':
                const: 0

              clocks:
                items:
                  - description: ICSSG_IEP 时钟
                  - description: 核心时钟（在较旧的 SoC 中为 OCP 时钟）

              assigned-clocks:
                maxItems: 1

              assigned-clock-parents:
                maxItems: 1
                description: |
                  标准的 assigned-clocks-parents 定义用于选择多路复用器父级（多路复用器输入之一）
reg:
                maxItems: 1

            required:
              - clocks

            additionalProperties: false

        additionalProperties: false

  iep@[a-f0-9]+$:
    description: |
      工业以太网外设，用于管理和生成工业以太网功能，例如时间戳。每个 PRUSS 要么有一个 IEP（在 AM335x、AM437x、AM57xx 和 66AK2G SoC 上），要么有两个 IEP（在 K3 AM65x、J721E 和 AM64x SoC 上）。
IEP 用于创建 PTP 时钟和生成 PPS 信号。
type: object

  mii-rt@[a-f0-9]+$:
    description: |
      实时以太网，用于支持多种工业通信协议。
下面是提供的 YAML 格式的英文描述及其翻译为中文的版本：

MII-RT 子模块表示为 SysCon 类型:
类型: 对象

属性:
  compatible:
    项:
      - 常量: ti,pruss-mii
      - 常量: syscon

  reg:
    最大项数: 1

附加属性: 不允许

mii-g-rt@[a-f0-9]+$:
描述: |
  实时媒体独立接口（MII）以支持多种工业通信协议（G 表示千兆）。MII-G-RT 子模块表示为 SysCon 类型。
类型: 对象

属性:
  compatible:
    项:
      - 常量: ti,pruss-mii-g
      - 常量: syscon

  reg:
    最大项数: 1

附加属性: 不允许

interrupt-controller@[a-f0-9]+$:
描述: |
  PRUSS 中断控制器节点。每个 PRUSS 拥有一个中断控制器实例，该实例被所有 PRU 内核共享。这应该表示为一个中断控制器节点。
$ref: /schemas/interrupt-controller/ti,pruss-intc.yaml#
类型: 对象

mdio@[a-f0-9]+$:
描述: |
  MDIO 节点。每个 PRUSS 包含一个 MDIO 模块，可以用于控制外部 PHY。PRU-ICSS 中使用的 MDIO 模块是 TI Davinci 系统芯片中所用 MDIO 控制器的一个实例。
$ref: /schemas/net/ti,davinci-mdio.yaml#
类型: 对象

"^(pru|rtu|txpru)@[0-9a-f]+$":
描述: |
  PRU 节点。每个 PRUSS 包含两个 PRU 内核，每个内核通过一个 PRU 子节点表示为一个 RemoteProc 设备。每个节点可以通过使用标准的 DT 字符串属性 "status" 来选择性地设置为非活动状态。K3 系统芯片上的 ICSSG IP 还包含一些辅助 PRU 内核，这些内核具有略微不同的 IP 集成。
$ref: /schemas/remoteproc/ti,pru-rproc.yaml#
类型: 对象

必需:
  - compatible
  - reg
  - ranges

附加属性: 不允许

# 由于无法正确验证带有 @address 的子节点，以下必需的子节点目前被注释掉
# 必需:
# - memories
# - interrupt-controller
# - pru

allOf:
  - 如果:
      属性:
        compatible:
          包含:
            枚举:
              - ti,k2g-pruss
              - ti,am654-icssg
              - ti,j721e-icssg
              - ti,am642-icssg
    则:
      必需:
        - power-domains

  - 如果:
      属性:
        compatible:
          包含:
            枚举:
              - ti,k2g-pruss
    则:
      必需:
        - dma-coherent

示例:
  - |

    /* 示例 1 AM33xx PRU-ICSS */
    pruss: pruss@0 {
        compatible = "ti,am3356-pruss";
        reg = <0x0 0x80000>;
        #address-cells = <1>;
        #size-cells = <1>;
        ranges;

        pruss_mem: memories@0 {
            reg = <0x0 0x2000>,
                  <0x2000 0x2000>,
                  <0x10000 0x3000>;
            reg-names = "dram0", "dram1", "shrdram2";
        };

        pruss_cfg: cfg@26000 {
            compatible = "ti,pruss-cfg", "syscon";
            #address-cells = <1>;
            #size-cells = <1>;
            reg = <0x26000 0x2000>;
            ranges = <0x00 0x26000 0x2000>;

            clocks {
                #address-cells = <1>;
                #size-cells = <0>;

                pruss_iepclk_mux: iepclk-mux@30 {
                    reg = <0x30>;
                    #clock-cells = <0>;
                    clocks = <&l3_gclk>,        /* icss_iep */
                             <&pruss_ocp_gclk>; /* icss_ocp */
                };
            };
        };

        pruss_mii_rt: mii-rt@32000 {
            compatible = "ti,pruss-mii", "syscon";
            reg = <0x32000 0x58>;
        };

        pruss_intc: interrupt-controller@20000 {
            compatible = "ti,pruss-intc";
            reg = <0x20000 0x2000>;
            interrupt-controller;
            #interrupt-cells = <3>;
            interrupts = <20 21 22 23 24 25 26 27>;
            interrupt-names = "host_intr0", "host_intr1",
                              "host_intr2", "host_intr3",
                              "host_intr4", "host_intr5",
                              "host_intr6", "host_intr7";
        };

        pru0: pru@34000 {
            compatible = "ti,am3356-pru";
            reg = <0x34000 0x2000>,
                  <0x22000 0x400>,
                  <0x22400 0x100>;
            reg-names = "iram", "control", "debug";
            firmware-name = "am335x-pru0-fw";
        };

        pru1: pru@38000 {
            compatible = "ti,am3356-pru";
            reg = <0x38000 0x2000>,
                  <0x24000 0x400>,
                  <0x24400 0x100>;
            reg-names = "iram", "control", "debug";
            firmware-name = "am335x-pru1-fw";
        };

        pruss_mdio: mdio@32400 {
            compatible = "ti,davinci_mdio";
            reg = <0x32400 0x90>;
            clocks = <&dpll_core_m4_ck>;
            clock-names = "fck";
            bus_freq = <1000000>;
            #address-cells = <1>;
            #size-cells = <0>;
        };
    };

  - |

    /* 示例 2 AM43xx PRU-ICSS 包含 PRUSS1 节点 */
    #include <dt-bindings/interrupt-controller/arm-gic.h>
    pruss1: pruss@0 {
        compatible = "ti,am4376-pruss1";
        reg = <0x0 0x40000>;
        #address-cells = <1>;
        #size-cells = <1>;
        ranges;

        pruss1_mem: memories@0 {
            reg = <0x0 0x2000>,
                  <0x2000 0x2000>,
                  <0x10000 0x8000>;
            reg-names = "dram0", "dram1", "shrdram2";
        };

        pruss1_cfg: cfg@26000 {
            compatible = "ti,pruss-cfg", "syscon";
            #address-cells = <1>;
            #size-cells = <1>;
            reg = <0x26000 0x2000>;
            ranges = <0x00 0x26000 0x2000>;

            clocks {
                #address-cells = <1>;
                #size-cells = <0>;

                pruss1_iepclk_mux: iepclk-mux@30 {
                    reg = <0x30>;
                    #clock-cells = <0>;
                    clocks = <&sysclk_div>,     /* icss_iep */
                             <&pruss_ocp_gclk>; /* icss_ocp */
                };
            };
        };

        pruss1_mii_rt: mii-rt@32000 {
            compatible = "ti,pruss-mii", "syscon";
            reg = <0x32000 0x58>;
        };

        pruss1_intc: interrupt-controller@20000 {
            compatible = "ti,pruss-intc";
            reg = <0x20000 0x2000>;
            interrupt-controller;
            #interrupt-cells = <3>;
            interrupts = <GIC_SPI 20 IRQ_TYPE_LEVEL_HIGH>,
                         <GIC_SPI 21 IRQ_TYPE_LEVEL_HIGH>,
                         <GIC_SPI 22 IRQ_TYPE_LEVEL_HIGH>,
                         <GIC_SPI 23 IRQ_TYPE_LEVEL_HIGH>,
                         <GIC_SPI 24 IRQ_TYPE_LEVEL_HIGH>,
                         <GIC_SPI 26 IRQ_TYPE_LEVEL_HIGH>,
                         <GIC_SPI 27 IRQ_TYPE_LEVEL_HIGH>;
            interrupt-names = "host_intr0", "host_intr1",
                              "host_intr2", "host_intr3",
                              "host_intr4",
                              "host_intr6", "host_intr7";
            ti,irqs-reserved = /bits/ 8 <0x20>; /* BIT(5) */
        };

        pru1_0: pru@34000 {
            compatible = "ti,am4376-pru";
            reg = <0x34000 0x3000>,
                  <0x22000 0x400>,
                  <0x22400 0x100>;
            reg-names = "iram", "control", "debug";
            firmware-name = "am437x-pru1_0-fw";
        };

        pru1_1: pru@38000 {
            compatible = "ti,am4376-pru";
            reg = <0x38000 0x3000>,
                  <0x24000 0x400>,
                  <0x24400 0x100>;
            reg-names = "iram", "control", "debug";
            firmware-name = "am437x-pru1_1-fw";
        };

        pruss1_mdio: mdio@32400 {
            compatible = "ti,davinci_mdio";
            reg = <0x32400 0x90>;
            clocks = <&dpll_core_m4_ck>;
            clock-names = "fck";
            bus_freq = <1000000>;
            #address-cells = <1>;
            #size-cells = <0>;
        };
    };
```
