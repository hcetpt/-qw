## Documentation/devicetree/bindings/soc/ti/wkup-m3-ipc_cn.yaml
~~~~yaml
# SPDX-许可证标识符: (GPL-2.0-only 或 BSD-2-Clause)
%YAML 1.2
---
$id: http://devicetree.org/schemas/soc/ti/wkup-m3-ipc.yaml#
$schema: http://devicetree.org/meta-schemas/core.yaml#

标题: 唤醒 M3 IPC 设备

维护者:
  - Dave Gerlach <d-gerlach@ti.com>
  - Drew Fustini <dfustini@baylibre.com>

描述: |+
  TI AM33xx 和 AM43xx 系列设备使用一个小型 Cortex M3 协处理器（通常称为唤醒 M3 或 CM3）来帮助处理各种无法从 MPU 控制的低功耗任务，如挂起/恢复和 CPU 闲置时的某些深度 C 状态。一旦 wkup_m3_ipc 驱动程序使用 wkup_m3_rproc 驱动程序启动了 wkup_m3，它就会通过 SoC 控制模块中的 IPC 寄存器和邮箱与 CM3 进行通信。wkup_m3_ipc 提供了一个 API，允许 SoC PM 代码执行特定的 PM 任务。
唤醒 M3 设备节点
  ====================
  一个 wkup_m3_ipc 设备节点用于表示 SoC 内部的 IPC 寄存器。
支持 GPIO 引脚控制的 VTT 切换
  ====================================
  在一些板子上，例如 AM335x EVM-SK 和 AM437x GP EVM，一个 GPIO 引脚连接到 DDR VTT 调节器的使能引脚上。这使得调节器可以在挂起时禁用，并在恢复时启用。请注意，GPIO 引脚必须是 GPIO0 模块的一部分，因为只有这个 GPIO 模块位于唤醒电源域中。
支持 IO 隔离
  ========================
  对于 AM437x SoC，当激活 IO 隔离时，某些引脚可以被强制进入替代状态。这些引脚有以 'CTRL_CONF_' 开头的垫控制寄存器，其中包含 DS0（例如，深度睡眠）配置位，这些配置位可以在 IO 隔离活动时覆盖引脚现有的偏置（上拉/下拉）和值（高/低）。
支持 I2C PMIC 电压缩放
  ====================================
  可以将二进制文件的名称传递给 CM3 内存加载。二进制数据是 CM3 在进入低功耗模式期间发送给 PMIC 的 I2C 序列。
属性:
  compatible:
    枚举:
      - ti,am3352-wkup-m3-ipc # 对于 AM33xx SoC
      - ti,am4372-wkup-m3-ipc # 对于 AM43xx SoC

  reg:
    描述:
      与唤醒 M3 处理器进行通信的 IPC 寄存器地址空间
    最大项数: 1

  interrupts:
    描述: 唤醒 M3 中断，用于向 MPU 发送信号
    最大项数: 1

  ti,rproc:
    $ref: /schemas/types.yaml#/definitions/phandle
    描述:
      用于 IPC 驱动程序引导它的 wkup_m3 rproc 节点的 phandle

  mboxes:
    描述:
      IPC 框架使用的 phandle 以获取正确的邮箱通道进行通信。必须指向适当的 mbox_wkupm3 子节点
最大项数: 1

  firmware-name:
    描述:
      包含 I2C 序列用于 PMIC 电压缩放的二进制文件的名称

  ti,vtt-gpio-pin:
    $ref: /schemas/types.yaml#/definitions/uint32
    描述: 连接到 VTT 调节器使能引脚上的 GPIO 引脚

  ti,set-io-isolation:
    类型: 布尔值
    描述:
      如果存在此属性，则 wkup_m3_ipc 驱动程序会指示 CM3 固件在暂停到深度睡眠时激活 IO 隔离。
      这可以被板级设计利用，以将板上的其他设备置于低功耗状态
allOf:
  - 如果:
      属性:
        compatible:
          不:
            包含:
              常量: ti,am4372-wkup-m3-ipc
    然后:
      属性:
        ti,set-io-isolation: false

必需:
  - compatible
  - reg
  - interrupts
  - ti,rproc
  - mboxes

额外属性: false

示例:
  - |
    /* AM335x SoC 示例 */
    soc {
        #address-cells = <1>;
        #size-cells = <1>;

        am335x_mailbox: mailbox {
            #mbox-cells = <1>;
        };

        wkup_m3_ipc@1324 {
           compatible = "ti,am3352-wkup-m3-ipc";
           reg = <0x1324 0x24>;
           interrupts = <78>;
           ti,rproc = <&wkup_m3>;
           mboxes = <&am335x_mailbox &mbox_wkupm3>;
           ti,vtt-gpio-pin = <7>;
           firmware-name = "am335x-evm-scale-data.bin";
        };
    };

  - |
    /*
     * AM473x SoC 示例:
     * 在 AM437x-GP-EVM 板上，gpio5_7 连接到 DDR VTT 调节器的使能引脚。'ddr_vtt_toggle_default' pinmux 节点配置了 gpio5_7，在正常系统操作期间为上拉。然而，该引脚的 DS0（深度睡眠）状态配置为下拉，因此当 IO 隔离激活时，VTT 调节器将被禁用以节省电力。请注意，这种方法是使用 'ti,vtt-gpio-pin' 属性的一个替代方案。
这段代码是 Device Tree Blob (DTB) 的一部分，用于配置基于 AM43xx 系列处理器的硬件。下面是中文翻译：

```plaintext
#include <dt-bindings/pinctrl/am43xx.h>

soc { // 社区（即SoC，System on Chip）
    #address-cells = <1>; // 地址单元数为1
    #size-cells = <1>; // 大小单元数为1

    am437x_mailbox: mailbox { // 邮箱通信模块
        #mbox-cells = <1>; // 邮箱单元数为1
    };

    am43xx_pinmux { // AM43xx引脚复用器
        pinctrl-names = "default"; // 引脚控制器名称
        pinctrl-0 = <&ddr3_vtt_toggle_default>; // 引脚控制器组0

        ddr3_vtt_toggle_default: ddr_vtt_toggle_default { // DDR3 VTT切换默认配置
             pinctrl-single,pins = <
                0x25C (DS0_PULL_UP_DOWN_EN | PIN_OUTPUT_PULLUP | DS0_FORCE_OFF_MODE | MUX_MODE7) // 设置引脚0x25C的属性
             >;
        };
    };

    wkup_m3_ipc@1324 { // 在地址0x1324处的唤醒M3 IPC
       compatible = "ti,am4372-wkup-m3-ipc"; // 兼容性声明
       reg = <0x1324 0x24>; // 寄存器地址范围
       interrupts = <78>; // 中断号
       ti,rproc = <&wkup_m3>; // 关联的远程处理器
       mboxes = <&am437x_mailbox &mbox_wkupm3>; // 邮箱列表
       ti,set-io-isolation; // 设置I/O隔离
       firmware-name = "am43x-evm-scale-data.bin"; // 固件名称
    };
};
```

请注意，这里的翻译主要是对代码中的注释和语义进行解释，并非直接的逐字翻译。
~~~~

## Documentation/devicetree/bindings/soc/xilinx/xilinx_cn.yaml
```yaml
# SPDX-许可证标识符: GPL-2.0
%YAML 1.2
---
$id: http://devicetree.org/schemas/soc/xilinx/xilinx.yaml#
$schema: http://devicetree.org/meta-schemas/core.yaml#

标题: Xilinx Zynq 平台

维护者:
  - 米哈尔·西梅克 <michal.simek@amd.com>

描述: |
  使用 Zynq-7000 SOC 或 Zynq UltraScale+ MPSoC 的 Xilinx 板卡

属性:
  $nodename:
    常量: '/'
  compatible:
    oneOf:
      - items:
          - 枚举:
              - adapteva,parallella
              - digilent,zynq-zybo
              - digilent,zynq-zybo-z7
              - ebang,ebaz4205
              - myir,zynq-zturn-v5
              - myir,zynq-zturn
              - xlnx,zynq-cc108
              - xlnx,zynq-zc702
              - xlnx,zynq-zc706
              - xlnx,zynq-zc770-xm010
              - xlnx,zynq-zc770-xm011
              - xlnx,zynq-zc770-xm012
              - xlnx,zynq-zc770-xm013
          - 常量: xlnx,zynq-7000

      - items:
          - 常量: avnet,zynq-microzed
          - 常量: xlnx,zynq-microzed
          - 常量: xlnx,zynq-7000

      - items:
          - 常量: avnet,zynq-zed
          - 常量: xlnx,zynq-zed
          - 常量: xlnx,zynq-7000

      - items:
          - 枚举:
              - xlnx,zynqmp-zc1751
          - 常量: xlnx,zynqmp

      - 描述: Xilinx 内部板卡 zc1232
        items:
          - 常量: xlnx,zynqmp-zc1232-revA
          - 常量: xlnx,zynqmp-zc1232
          - 常量: xlnx,zynqmp

      - 描述: Xilinx 内部板卡 zc1254
        items:
          - 常量: xlnx,zynqmp-zc1254-revA
          - 常量: xlnx,zynqmp-zc1254
          - 常量: xlnx,zynqmp

      - 描述: Xilinx 评估板 zcu1275
        items:
          - 常量: xlnx,zynqmp-zcu1275-revA
          - 常量: xlnx,zynqmp-zcu1275
          - 常量: xlnx,zynqmp

      - 描述: Xilinx 兼容 96boards 的板卡 zcu100
        items:
          - 常量: xlnx,zynqmp-zcu100-revC
          - 常量: xlnx,zynqmp-zcu100
          - 常量: xlnx,zynqmp

      - 描述: Xilinx 兼容 96boards 的板卡 Ultra96
        items:
          - 常量: avnet,ultra96-rev1
          - 常量: avnet,ultra96
          - 常量: xlnx,zynqmp-zcu100-revC
          - 常量: xlnx,zynqmp-zcu100
          - 常量: xlnx,zynqmp

      - 描述: Xilinx 评估板 zcu102
        items:
          - 枚举:
              - xlnx,zynqmp-zcu102-revA
              - xlnx,zynqmp-zcu102-revB
              - xlnx,zynqmp-zcu102-rev1.0
              - xlnx,zynqmp-zcu102-rev1.1
          - 常量: xlnx,zynqmp-zcu102
          - 常量: xlnx,zynqmp

      - 描述: Xilinx 评估板 zcu104
        items:
          - 枚举:
              - xlnx,zynqmp-zcu104-revA
              - xlnx,zynqmp-zcu104-revC
              - xlnx,zynqmp-zcu104-rev1.0
          - 常量: xlnx,zynqmp-zcu104
          - 常量: xlnx,zynqmp

      - 描述: Xilinx 评估板 zcu106
        items:
          - 枚举:
              - xlnx,zynqmp-zcu106-revA
              - xlnx,zynqmp-zcu106-rev1.0
          - 常量: xlnx,zynqmp-zcu106
          - 常量: xlnx,zynqmp

      - 描述: Xilinx 评估板 zcu111
        items:
          - 枚举:
              - xlnx,zynqmp-zcu111-revA
              - xlnx,zynqmp-zcu111-rev1.0
          - 常量: xlnx,zynqmp-zcu111
          - 常量: xlnx,zynqmp

      - 描述: Xilinx Kria SOMs
        minItems: 3
        items:
          枚举:
            - xlnx,zynqmp-sm-k26-rev2
            - xlnx,zynqmp-sm-k26-rev1
            - xlnx,zynqmp-sm-k26-revB
            - xlnx,zynqmp-sm-k26-revA
            - xlnx,zynqmp-sm-k26
            - xlnx,zynqmp
        allOf:
          - 包含:
              常量: xlnx,zynqmp
          - 包含:
              常量: xlnx,zynqmp-sm-k26

      - 描述: Xilinx Kria SOMs (starter)
        minItems: 3
        items:
          枚举:
            - xlnx,zynqmp-smk-k26-rev2
            - xlnx,zynqmp-smk-k26-rev1
            - xlnx,zynqmp-smk-k26-revB
            - xlnx,zynqmp-smk-k26-revA
            - xlnx,zynqmp-smk-k26
            - xlnx,zynqmp
        allOf:
          - 包含:
              常量: xlnx,zynqmp
          - 包含:
              常量: xlnx,zynqmp-smk-k26

      - 描述: Xilinx Kria SOM KV260 revA/Y/Z
        minItems: 3
        items:
          枚举:
            - xlnx,zynqmp-sk-kv260-revA
            - xlnx,zynqmp-sk-kv260-revY
            - xlnx,zynqmp-sk-kv260-revZ
            - xlnx,zynqmp-sk-kv260
            - xlnx,zynqmp
        allOf:
          - 包含:
              常量: xlnx,zynqmp-sk-kv260-revA
          - 包含:
              常量: xlnx,zynqmp-sk-kv260
          - 包含:
              常量: xlnx,zynqmp

      - 描述: Xilinx Kria SOM KV260 rev2/1/B
        minItems: 3
        items:
          枚举:
            - xlnx,zynqmp-sk-kv260-rev2
            - xlnx,zynqmp-sk-kv260-rev1
            - xlnx,zynqmp-sk-kv260-revB
            - xlnx,zynqmp-sk-kv260
            - xlnx,zynqmp
        allOf:
          - 包含:
              常量: xlnx,zynqmp-sk-kv260-revB
          - 包含:
              常量: xlnx,zynqmp-sk-kv260
          - 包含:
              常量: xlnx,zynqmp

      - 描述: AMD MicroBlaze V (QEMU)
        items:
          - 常量: qemu,mbv
          - 常量: amd,mbv

其他属性: 真

..
```

## Documentation/devicetree/bindings/soc/xilinx/xlnx,vcu-settings_cn.yaml
```yaml
# SPDX-许可证标识符: (GPL-2.0 或 BSD-2-Clause)
%YAML 1.2
---
$id: http://devicetree.org/schemas/soc/xilinx/xlnx,vcu-settings.yaml#
$schema: http://devicetree.org/meta-schemas/core.yaml#

标题: Xilinx VCU 设置

维护者:
  - Michael Tretter <kernel@pengutronix.de>

描述: |
  Xilinx VCU 设置提供了关于视频编解码器单元配置的信息。
属性:
  compatible:
    项目:
      - 常量: xlnx,vcu-settings
      - 常量: syscon

  reg:
    最大项数: 1

必需:
  - compatible
  - reg

额外属性: false

示例:
  - |
    fpga {
        #address-cells = <2>;
        #size-cells = <2>;

        xlnx_vcu: vcu@a0041000 {
            compatible = "xlnx,vcu-settings", "syscon";
            reg = <0x0 0xa0041000 0x0 0x1000>;
        };
    };
```

## Documentation/devicetree/bindings/soc/xilinx/xlnx,vcu_cn.txt
~~~~
---

**LogicoreIP 设计为与 Xilinx ZYNQ 系列兼容**

### 总体概念

LogicoreIP 设计用于在处理系统和可编程逻辑之间提供隔离。同时，它还提供了一系列寄存器集来配置频率。

### 必需的属性：
- `compatible`：必须是以下之一：
  - `"xlnx,vcu"`
  - `"xlnx,vcu-logicoreip-1.0"`
- `reg`：VCU_PL_SLCR 寄存器空间的基本偏移量和大小
- `clocks`：aclk 和 pll_ref 时钟源的 phandle
- `clock-names`：标识字符串 "aclk" 是 AXI 时钟所必需的。"pll_ref" 对于 PLL 也是必需的

### 示例：

```yaml
xlnx_vcu: vcu@a0040000 {
    compatible = "xlnx,vcu-logicoreip-1.0";
    reg = <0x0 0xa0040000 0x0 0x1000>;
    clocks = <&si570_1>, <&clkc 71>;
    clock-names = "pll_ref", "aclk";
};
```
以上示例展示了如何定义一个与 Xilinx ZYNQ 系列兼容的 LogicoreIP 设备。
~~~~

## Documentation/devicetree/bindings/thermal/amazon,al-thermal_cn.txt
~~~~
亚马逊的Annapurna Labs温感器

一种简单的温感设备，允许通过单一的MMIO（内存映射I/O）交易来读取温度。
所需属性：
- compatible（兼容性）: "amazon,al-thermal"
- reg（寄存器）: 传感器寄存器的物理基地址和长度
- #thermal-sensor-cells: 必须为1。详情描述请参考Documentation/devicetree/bindings/thermal/thermal-sensor.yaml
示例：
```device-tree
thermal: 温感器 {
	compatible = "amazon,al-thermal";
	reg = <0x0 0x05002860 0x0 0x1>; // 物理基地址与长度
	#thermal-sensor-cells = <0x1>;
};

温区配置 {
	温区z0 {
		被动轮询延迟 = <250>;
		主动轮询延迟 = <1000>;
		温感器 = <&温感器 0>;
		阈值设置 {
			临界状态 {
				温度 = <105000>;
				迟滞 = <2000>;
				类型 = "临界状态";
			};
		};

	};
};
```

说明：
这段代码定义了一个使用亚马逊Annapurna Labs技术的温感器设备。该设备通过单一的MMIO交易实现温度读取功能。在示例中，定义了一个名为`thermal`的温感器，并指定了它的兼容性、寄存器配置等属性。此外，还定义了一个名为`温区配置`的结构，其中包含一个名为`温区z0`的温区，该温区设置了轮询延迟、关联的温感器以及温度阈值设置，包括临界状态的温度值和迟滞值。
~~~~

## Documentation/devicetree/bindings/thermal/amlogic,thermal_cn.yaml
~~~~yaml
```yaml
# SPDX-License-Identifier: (GPL-2.0 OR BSD-2-Clause)
%YAML 1.2
---
$id: 'http://devicetree.org/schemas/thermal/amlogic,thermal.yaml#'
$schema: 'http://devicetree.org/meta-schemas/core.yaml#'

title: Amlogic 温度监控

maintainers:
  - Guillaume La Roque <glaroque@baylibre.com>

description: Amlogic 温度监控设备树绑定

$ref: 'thermal-sensor.yaml#'

properties:
  compatible:
    oneOf:
      - items:
          - enum:
              - amlogic,g12a-cpu-thermal
              - amlogic,g12a-ddr-thermal
          - const: amlogic,g12a-thermal
      - const: amlogic,a1-cpu-thermal

  reg:
    maxItems: 1

  interrupts:
    maxItems: 1

  clocks:
    maxItems: 1

  amlogic,ao-secure:
    description: 指向 ao-secure 系统控制器的 phandle
    $ref: '/schemas/types.yaml#/definitions/phandle'

  '#thermal-sensor-cells':
    const: 0

required:
  - compatible
  - reg
  - interrupts
  - clocks
  - amlogic,ao-secure

unevaluatedProperties: false

examples:
  - |
    temperature-sensor@ff634800 {
        compatible = "amlogic,g12a-cpu-thermal",
                     "amlogic,g12a-thermal";
        reg = <0xff634800 0x50>;
        interrupts = <0x0 0x24 0x0>;
        clocks = <&clk 164>;
        #thermal-sensor-cells = <0>;
        amlogic,ao-secure = <&sec_AO>;
    };
```

此文档定义了用于Amlogic温度监控模块的设备树绑定，包括兼容性声明、寄存器配置、中断设置、时钟配置等属性，并提供了一个示例。
~~~~

## Documentation/devicetree/bindings/thermal/armada-thermal_cn.txt
```
* Marvell Armada 370/375/380/XP 热管理

所需属性：

- compatible: 应设置为以下之一：
    * marvell,armada370-thermal
    * marvell,armada375-thermal
    * marvell,armada380-thermal
    * marvell,armadaxp-thermal
    * marvell,armada-ap806-thermal
    * marvell,armada-ap807-thermal
    * marvell,armada-cp110-thermal

注意：对于 AP806/CP110，这些绑定已被弃用，而应当遵循以下文档中描述的规则：
Documentation/devicetree/bindings/arm/marvell/ap80x-system-controller.txt
Documentation/devicetree/bindings/arm/marvell/cp110-system-controller.txt

- reg: 设备的寄存器空间
预期有两个条目，请参见下面的例子。第一个指向状态寄存器（4字节）。第二个指向控制寄存器（8字节）。
注意：兼容项 marvell,armada370-thermal、marvell,armada380-thermal 和 marvell,armadaxp-thermal 必须指向 "control MSB/control 1"，大小为4字节（已弃用的绑定），或者指向 "control LSB/control 0"，大小为8字节（当前绑定）。所有其他兼容项必须指向 "control LSB/control 0"，大小为8字节。

示例：

	/* 过时的绑定 */
	thermal@d0018300 {
		compatible = "marvell,armada370-thermal";
		reg = <0xd0018300 0x4
		       0xd0018304 0x4>;
	};

	ap_thermal: thermal@6f8084 {
		compatible = "marvell,armada-ap806-thermal";
		reg = <0x6f808C 0x4>,
		      <0x6f8084 0x8>;
	};
```

## Documentation/devicetree/bindings/thermal/brcm,avs-ro-thermal_cn.yaml
```yaml
# SPDX-许可证标识符: (GPL-2.0-only 或 BSD-2-Clause)
%YAML 1.2
---
$id: http://devicetree.org/schemas/thermal/brcm,avs-ro-thermal.yaml#
$schema: http://devicetree.org/meta-schemas/core.yaml#

标题: Broadcom AVS 环振荡器热传感器

维护者:
  - Stefan Wahren <wahrenst@gmx.net>

描述: |+
  热节点应该是具有以下必需属性的 syscon 节点的子节点：

  - 兼容性: 应该是以下之一:
                "brcm,bcm2711-avs-monitor", "syscon", "simple-mfd"

  参考文档中的绑定描述：
  Documentation/devicetree/bindings/mfd/syscon.yaml

$ref: thermal-sensor.yaml#

属性:
  compatible:
    常量: brcm,bcm2711-thermal

  "#thermal-sensor-cells":
    常量: 0

必需:
  - compatible

未评估属性: false

示例:
  - |
    avs-monitor@7d5d2000 {
        compatible = "brcm,bcm2711-avs-monitor",
                     "syscon", "simple-mfd";
        reg = <0x7d5d2000 0xf00>;

        thermal: thermal {
            compatible = "brcm,bcm2711-thermal";
            #thermal-sensor-cells = <0>;
        };
    };
..
```

## Documentation/devicetree/bindings/thermal/brcm,avs-tmon_cn.yaml
~~~~yaml
```yaml
# SPDX-许可证标识符: (GPL-2.0-only 或 BSD-2-Clause)
%YAML 1.2
---
$id: http://devicetree.org/schemas/thermal/brcm,avs-tmon.yaml#
$schema: http://devicetree.org/meta-schemas/core.yaml#

title: Broadcom STB 温度管理

description: 由 AVS TMON 硬件块提供的温度管理核心
maintainers:
  - Florian Fainelli <f.fainelli@gmail.com>

allOf:
  - $ref: thermal-sensor.yaml#

properties:
  compatible:
    items:
      - enum:
          - brcm,avs-tmon-bcm7216
          - brcm,avs-tmon-bcm7445
      - const: brcm,avs-tmon

  reg:
    maxItems: 1
    description: >
      AVS TMON 寄存器的地址范围

  interrupts:
    maxItems: 1

  interrupt-names:
    items:
      - const: tmon

  "#thermal-sensor-cells":
    const: 0

additionalProperties: false

required:
  - compatible
  - reg

examples:
  - |
    thermal@f04d1500 {
        compatible = "brcm,avs-tmon-bcm7445", "brcm,avs-tmon";
        reg = <0xf04d1500 0x28>;
        interrupts = <0x6>;
        interrupt-names = "tmon";
        interrupt-parent = <&avs_host_l2_intc>;
        #thermal-sensor-cells = <0>;
    };
```

请注意，上述翻译保持了原有的 YAML 格式和内容结构，并将注释、标题、描述等翻译成了中文。
~~~~
