## Documentation/devicetree/bindings/soc/qcom/qcom,gsbi_cn.yaml
```yaml
# SPDX-许可证标识符: GPL-2.0 或 BSD-2-条款
%YAML 1.2
---
$id: http://devicetree.org/schemas/soc/qcom/qcom,gsbi.yaml#
$schema: http://devicetree.org/meta-schemas/core.yaml#

title: 高通通用串行总线接口 (GSBI)

maintainers:
  - Andy Gross <agross@kernel.org>
  - Bjorn Andersson <bjorn.andersson@linaro.org>
  - Krzysztof Kozlowski <krzysztof.kozlowski@linaro.org>

description:
  GSBI 控制器被建模为一个节点，该节点可以有零个或多个子节点，每个子节点代表一个串行子设备，这些子设备作为 GSBI 配置设置的一部分进行多路复用。模式设置将控制 GSBI 的 4 个 IO 的输入/输出模式。
一个 GSBI 控制器节点可以包含零个或多个表示串行设备的子节点。这些串行设备可以是高通 UART、I2C 控制器、SPI 控制器，或者是上述设备的某种组合。
properties:
  compatible:
    const: qcom,gsbi-v1.0.0

  '#address-cells':
    const: 1

  cell-index:
    $ref: /schemas/types.yaml#/definitions/uint32
    description:
      GSBI 索引
clocks:
    maxItems: 1

  clock-names:
    const: iface

  qcom,crci:
    $ref: /schemas/types.yaml#/definitions/uint32
    description:
      用于 QUP CRCI 端口的 CRCI 多路选择值。请参考 include/dt-bindings/soc/qcom,gsbi.h 以获取有效的 CRCI 多路选择值。
qcom,mode:
    $ref: /schemas/types.yaml#/definitions/uint32
    description:
      用于配置串行接口的多路选择值。请参考 include/dt-bindings/soc/qcom,gsbi.h 以获取有效的多路选择值。
'#size-cells':
    const: 1

  syscon-tcsr:
    $ref: /schemas/types.yaml#/definitions/phandle
    description:
      TCSR syscon 节点的 phandle。如果子设备使用 DMA，则必须指定。
ranges: true

  reg:
    maxItems: 1

patternProperties:
  "spi@[0-9a-f]+$":
    type: object
    $ref: /schemas/spi/qcom,spi-qup.yaml#

  "i2c@[0-9a-f]+$":
    type: object
    $ref: /schemas/i2c/qcom,i2c-qup.yaml#

  "serial@[0-9a-f]+$":
    type: object
    $ref: /schemas/serial/qcom,msm-uartdm.yaml#

required:
  - compatible
  - cell-index
  - clocks
  - clock-names
  - qcom,mode
  - reg

additionalProperties: false

examples:
  - |
    #include <dt-bindings/clock/qcom,gcc-msm8960.h>
    #include <dt-bindings/interrupt-controller/arm-gic.h>
    #include <dt-bindings/soc/qcom,gsbi.h>

    gsbi@12440000 {
        compatible = "qcom,gsbi-v1.0.0";
        reg = <0x12440000 0x100>;
        cell-index = <1>;
        clocks = <&gcc GSBI1_H_CLK>;
        clock-names = "iface";
        #address-cells = <1>;
        #size-cells = <1>;
        ranges;

        syscon-tcsr = <&tcsr>;
        qcom,mode = <GSBI_PROT_I2C_UART>;

        serial@12450000 {
            compatible = "qcom,msm-uartdm-v1.3", "qcom,msm-uartdm";
            reg = <0x12450000 0x100>,
                  <0x12400000 0x03>;
            interrupts = <0 193 IRQ_TYPE_LEVEL_HIGH>;
            clocks = <&gcc GSBI1_UART_CLK>, <&gcc GSBI1_H_CLK>;
            clock-names = "core", "iface";
        };

        i2c@12460000 {
            compatible = "qcom,i2c-qup-v1.1.1";
            reg = <0x12460000 0x1000>;
            pinctrl-0 = <&i2c1_pins>;
            pinctrl-1 = <&i2c1_pins_sleep>;
            pinctrl-names = "default", "sleep";
            interrupts = <0 194 IRQ_TYPE_LEVEL_HIGH>;
            clocks = <&gcc GSBI1_QUP_CLK>, <&gcc GSBI1_H_CLK>;
            clock-names = "core", "iface";
            #address-cells = <1>;
            #size-cells = <0>;

            status = "disabled"; /* 选择了 UART */
        };
    };
```

## Documentation/devicetree/bindings/soc/qcom/qcom,msm8976-ramp-controller_cn.yaml
```yaml
# SPDX-许可证标识符: (GPL-2.0 或 BSD-2-Clause)
%YAML 1.2
---
$id: http://devicetree.org/schemas/soc/qcom/qcom,msm8976-ramp-controller.yaml#
$schema: http://devicetree.org/meta-schemas/core.yaml#

title: Qualcomm 坡道控制器

maintainers:
  - 安杰洛·乔阿基诺·德尔·雷格诺 <angelo.gioacchino.delregno@collabora.com>

description:
  坡道控制器用于编程脉冲吞咽的序列ID，启用序列，并为一些Qualcomm系统级芯片上的CPU核心链接序列ID（SIDs）。

properties:
  compatible:
    enum:
      - qcom,msm8976-ramp-controller

  reg:
    maxItems: 1

required:
  - compatible
  - reg

additionalProperties: false

examples:
  - |
    cpu-power-controller@b014000 {
        compatible = "qcom,msm8976-ramp-controller";
        reg = <0x0b014000 0x68>;
    };
```

## Documentation/devicetree/bindings/soc/qcom/qcom,pbs_cn.yaml
~~~~yaml
```yaml
# SPDX-许可证标识符: (GPL-2.0-only 或 BSD-2-Clause)
%YAML 1.2
---
$id: http://devicetree.org/schemas/soc/qcom/qcom,pbs.yaml#
$schema: http://devicetree.org/meta-schemas/core.yaml#

title: 高通技术公司可编程启动排序器

maintainers:
  - Anjelique Melendez <quic_amelende@quicinc.com>

description: |
  高通技术公司的可编程启动排序器（PBS）
  支持根据请求触发客户的上电和下电序列
properties:
  compatible:
    items:
      - enum:
          - qcom,pmi632-pbs
      - const: qcom,pbs

  reg:
    maxItems: 1

required:
  - compatible
  - reg

additionalProperties: false

examples:
  - |
    #include <dt-bindings/spmi/spmi.h>

    pmic@0 {
      reg = <0x0 SPMI_USID>;
      #address-cells = <1>;
      #size-cells = <0>;

      pbs@7400 {
        compatible = "qcom,pmi632-pbs", "qcom,pbs";
        reg = <0x7400>;
      };
    };
```

请注意，某些部分如注释、代码示例等可能没有直接的中文翻译版本，因此这部分内容保持了原文的形式。上述翻译尽可能保留了原意和技术细节。
~~~~

## Documentation/devicetree/bindings/soc/qcom/qcom,pmic-glink_cn.yaml
~~~~yaml
```yaml
# SPDX-许可证标识符: (GPL-2.0-only 或 BSD-2-Clause)
%YAML 1.2
---
$id: http://devicetree.org/schemas/soc/qcom/qcom,pmic-glink.yaml#
$schema: http://devicetree.org/meta-schemas/core.yaml#

title: 高通 PMIC GLINK 固件接口用于电池管理、USB Type-C 及其他功能
maintainers:
  - Bjorn Andersson <andersson@kernel.org>

description:
  PMIC GLINK 服务运行在一些现代高通平台的协处理器上，并实现了 USB Type-C 的处理和电池管理。此绑定描述了操作系统中用于与固件通信以及将其资源连接到设备树中所描述资源的组件，特别是 USB Type-C 控制器与 USB 和 DisplayPort 组件之间的关系。
properties:
  compatible:
    oneOf:
      - items:
          - enum:
              - qcom,qcm6490-pmic-glink
              - qcom,sc8180x-pmic-glink
              - qcom,sc8280xp-pmic-glink
              - qcom,sm8350-pmic-glink
              - qcom,sm8450-pmic-glink
              - qcom,sm8550-pmic-glink
          - const: qcom,pmic-glink
      - items:
          - enum:
              - qcom,sm8650-pmic-glink
              - qcom,x1e80100-pmic-glink
          - const: qcom,sm8550-pmic-glink
          - const: qcom,pmic-glink

  '#address-cells':
    const: 1

  '#size-cells':
    const: 0

  orientation-gpios:
    description: 用于指示 Type-C 连接器方向的输入 GPIO 数组
      GPIO 指示用于检测 Type-C 连接器的方向
      该数组应包含每个 PMIC Glink 连接器的 GPIO 条目，按 reg 顺序排列
      定义 GPIO 的活动级别表示 "CC2" 或反转/翻转方向
patternProperties:
  '^connector@\d$':
    $ref: /schemas/connector/usb-connector.yaml#
    required:
      - reg

required:
  - compatible

additionalProperties: false

examples:
  - |+
    pmic-glink {
        compatible = "qcom,sc8280xp-pmic-glink", "qcom,pmic-glink";

        #address-cells = <1>;
        #size-cells = <0>;

        connector@0 {
            compatible = "usb-c-connector";
            reg = <0>;
            power-role = "dual";
            data-role = "dual";

            ports {
                #address-cells = <1>;
                #size-cells = <0>;

                port@0 {
                    reg = <0>;
                    endpoint {
                        remote-endpoint = <&usb_role>;
                    };
                };

                port@1 {
                    reg = <1>;
                    endpoint {
                        remote-endpoint = <&ss_phy_out>;
                    };
                };

                port@2 {
                    reg = <2>;
                    endpoint {
                        remote-endpoint = <&sbu_mux>;
                    };
                };
            };
        };
    };
```
请注意，此翻译尽可能保持了原文的结构和格式。
~~~~

## Documentation/devicetree/bindings/soc/qcom/qcom,rpm-master-stats_cn.yaml
```yaml
### 许可证标识符: (GPL-2.0-only 或 BSD-2-Clause)
#### YAML 1.2
---
$id: http://devicetree.org/schemas/soc/qcom/qcom,rpm-master-stats.yaml#
$schema: http://devicetree.org/meta-schemas/core.yaml#

标题: 高通技术公司 (QTI) RPM 主统计信息

维护者:
  - Konrad Dybcio <konrad.dybcio@linaro.org>

描述: |
  高通的资源电源管理器 (RPM) 架构中包含了一个“RPM 主”概念。
  这些主可以被认为是“本地的领头羊”，通常覆盖单一子系统（例如，应用处理器子系统 (APSS)、音频数字信号处理器 (ADSP)、连接数字信号处理器 (CDSP)）。
  所有的 RPM 决策（尤其是进入硬件驱动的低功耗模式：晶振关断 (XO shutdown) 和整个系统的电源完全关闭）首先在主级别做出，然后汇总到整个系统。
  主统计信息提供了一些有用的指标，可用于评估设备是否进入了期望的低功耗模式，需要多长时间才能进入该模式，保持该模式的时间长度，重新上线所需时间，
  以及每个睡眠状态被进入了多少次和哪些内核正在积极投票以保持唤醒状态。
  此方案已在 2013-2023 年代的各种片上系统 (SoC) 中使用，一些较新或高端的设计通过共享内存 (SMEM) 查询提供这些信息。

属性:
  compatible:
    常量: qcom,rpm-master-stats

  qcom,rpm-msg-ram:
    $ref: /schemas/types.yaml#/definitions/phandle-array
    描述: 指向包含主统计信息的 RPM MSG RAM 片段的句柄
    最小项数: 1
    最大项数: 5
    项:
      最大项数: 1

  qcom,master-names:
    $ref: /schemas/types.yaml#/definitions/string-array
    描述:
      拥有此主统计信息实例所在 MSG RAM 片段的 RPM 主的名称
    最小项数: 1
    最大项数: 5

必需:
  - compatible
  - qcom,rpm-msg-ram
  - qcom,master-names

额外属性: false

示例:
  - |
    stats {
      compatible = "qcom,rpm-master-stats";
      qcom,rpm-msg-ram = <&apss_master_stats>,
                         <&mpss_master_stats>,
                         <&adsp_master_stats>,
                         <&cdsp_master_stats>,
                         <&tz_master_stats>;
      qcom,master-names = "APSS",
                          "MPSS",
                          "ADSP",
                          "CDSP",
                          "TZ";
    };
```

## Documentation/devicetree/bindings/soc/qcom/qcom,rpm_cn.yaml
```yaml
# SPDX-许可证标识符: (GPL-2.0 或 BSD-2-Clause)
%YAML 1.2
---
$id: http://devicetree.org/schemas/soc/qcom/qcom,rpm.yaml#
$schema: http://devicetree.org/meta-schemas/core.yaml#

标题: 高通资源电源管理器 (RPM)

描述:
  此驱动程序用于与在各种高通平台中发现的资源电源管理器 (RPM) 进行接口。RPM允许系统中的每个组件对系统资源（如时钟、稳压器和总线频率）的状态进行投票。
维护者:
  - Bjorn Andersson <andersson@kernel.org>

属性:
  compatible:
    枚举:
      - qcom,rpm-apq8064
      - qcom,rpm-msm8660
      - qcom,rpm-msm8960
      - qcom,rpm-ipq8064
      - qcom,rpm-mdm9615

  reg:
    最大项目数: 1

  interrupts:
    最大项目数: 3

  interrupt-names:
    项目:
      - 常量: ack
      - 常量: err
      - 常量: wakeup

  qcom,ipc:
    $ref: /schemas/types.yaml#/definitions/phandle-array
    项目:
      - 项目:
          - 描述: 指向表示APCS寄存器的syscon节点的phandle
          - 描述: 表示在syscon内的寄存器偏移的u32
          - 描述: 表示寄存器中的ipc位的u32
    描述:
      三个条目指定了用于向RPM发送信号的传出ipc位
模式属性:
  "^regulators(-[01])?$":
    类型: 对象
    $ref: /schemas/regulator/qcom,rpm-regulator.yaml#
    未评估属性: false

必需:
  - compatible
  - reg
  - interrupts
  - interrupt-names
  - qcom,ipc

附加属性: false

示例:
  - |
    #include <dt-bindings/interrupt-controller/arm-gic.h>
    #include <dt-bindings/interrupt-controller/irq.h>
    #include <dt-bindings/mfd/qcom-rpm.h>

    rpm@108000 {
      compatible = "qcom,rpm-msm8960";
      reg = <0x108000 0x1000>;
      qcom,ipc = <&apcs 0x8 2>;

      interrupts = <GIC_SPI 19 IRQ_TYPE_NONE>, <GIC_SPI 21 IRQ_TYPE_NONE>, <GIC_SPI 22 IRQ_TYPE_NONE>;
      interrupt-names = "ack", "err", "wakeup";

      regulators {
        compatible = "qcom,rpm-pm8921-regulators";
        vdd_l1_l2_l12_l18-supply = <&pm8921_s4>;

        s1 {
          regulator-min-microvolt = <1225000>;
          regulator-max-microvolt = <1225000>;

          bias-pull-down;

          qcom,switch-mode-frequency = <3200000>;
        };

        pm8921_s4: s4 {
          regulator-min-microvolt = <1800000>;
          regulator-max-microvolt = <1800000>;

          qcom,switch-mode-frequency = <1600000>;
          bias-pull-down;

          qcom,force-mode = <QCOM_RPM_FORCE_MODE_AUTO>;
        };
      };
    };
```

## Documentation/devicetree/bindings/soc/qcom/qcom,rpmh-rsc_cn.yaml
```yaml
# SPDX-许可证标识符: GPL-2.0-only
%YAML 1.2
---
$id: http://devicetree.org/schemas/soc/qcom/qcom,rpmh-rsc.yaml#
$schema: http://devicetree.org/meta-schemas/core.yaml#

标题: Qualcomm RPMH RSC

维护者:
  - Bjorn Andersson <bjorn.andersson@linaro.org>

描述: |
  资源电源管理硬化 (RPMH) 是与 Qualcomm 系统芯片上的硬化资源加速器通信的机制。对资源的请求可以写入触发命令集 (TCS) 寄存器，并通过 (地址, 值) 对来触发。TCS 中的消息随后按顺序通过内部总线发送。
硬件模块 (直接资源投票器或 DRV) 是实体 (资源状态协调器，即 RSC) 的一部分，能够处理多个休眠和活动/唤醒资源请求。一个系统级芯片中可能存在多个这样的 DRV，并且可以从 Linux 写入。每个 DRV 的结构遵循相同的模板，有一些变化由这里的属性捕捉。
TCS 可能从 Linux 触发，或者在所有 CPU 关闭以实现空闲功耗节省后由固件触发。TCS 可以分类为：
    活动  - 由 Linux 触发
    休眠  - 由固件触发
    唤醒  - 由固件触发
    控制  - 由固件触发
参见:: <dt-bindings/soc/qcom,rpmh-rsc.h>

在设备树中描述它们的顺序应该与硬件配置相匹配。
当子系统处于活动状态或空闲状态时，可以提出对资源状态的请求。当所有子系统（如调制解调器、GPU 和 CPU）都处于空闲状态时，资源状态将是这些子系统各自的休眠投票的汇总。客户端除了活动模式请求之外，还可以为其共享资源请求休眠值。
想要使用 RSC 与 RPMH 进行通信的驱动程序必须将它们的绑定指定为与其希望通信的 RSC 控制器的子节点。
属性:
  compatible:
    常量: qcom,rpmh-rsc

  interrupts:
    minItems: 1
    maxItems: 4
    描述:
      当从该 DRV 收到消息完成/响应时触发的中断
中断的数量必须与 DRV 块的数量相匹配
标签:
    描述:
      RSC 的名称。此名称将在跟踪日志中使用
qcom,drv-id:
    $ref: /schemas/types.yaml#/definitions/uint32
    描述:
      将被此控制器使用的 RSC 块中的 DRV 的 ID
qcom,tcs-config:
    $ref: /schemas/types.yaml#/definitions/uint32-matrix
    minItems: 4
    maxItems: 4
    items:
      items:
        - 描述: |
            TCS 类型::
             - ACTIVE_TCS
             - SLEEP_TCS
             - WAKE_TCS
             - CONTROL_TCS
          枚举: [ 0, 1, 2, 3 ]
        - 描述: TCS 的数量
    描述: |
      定义 TCS 配置的元组。必须包含两个单元格来描述每种 TCS 类型。TCS 的顺序必须与硬件配置相匹配
The provided text describes a Device Tree (DT) schema for configuring a Resource Sharing Controller (RSC) from Qualcomm (QCOM), along with examples of how to use it in Device Tree files. Here's a translation of the key components:

### `qcom,tcs-offset`:
- **Type**: Unsigned 32-bit integer (`uint32`)
- **Description**: The offset of the TCS (Trust Control System) blocks.

### `reg`:
- **Minimum Items**: 1
- **Maximum Items**: 4
- This property defines the register ranges used by the RSC.

### `reg-names`:
- **Minimum Items**: 1
- **Items**:
  - Constant: `drv-0`
  - Constant: `drv-1`
  - Constant: `drv-2`
  - Constant: `drv-3`
- These are names for the register regions defined by `reg`.

### `power-domains`:
- **Maximum Items**: 1
- This property links the RSC to its power domain.

### `bcm-voter`, `clock-controller`, `power-controller`:
- Each of these properties references another YAML file that defines their respective schemas.
  - `bcm-voter`: Refers to a voter component that decides which power level to apply.
  - `clock-controller`: Refers to a clock controller component.
  - `power-controller`: Refers to a power controller component.

### `patternProperties`:
- Defines a pattern for properties that match the regular expression `'^regulators(-[0-9])?$'`.
  - References a regulator schema.

### `required`:
- Lists properties that must be present in the configuration:
  - `compatible`
  - `interrupts`
  - `qcom,drv-id`
  - `qcom,tcs-config`
  - `qcom,tcs-offset`
  - `reg`
  - `reg-names`
  - `power-domains`

### `additionalProperties`:
- Set to `false`, indicating no additional properties beyond those specified are allowed.

### Examples:
#### Example 1:
- **RSC Base Address**: 0x179C0000
- **DRV ID**: 2
- **Register Offsets for DRV2**: Start at 0xD00
- **Interrupts**: GIC_SPI 3, GIC_SPI 4, GIC_SPI 5 (all level-triggered high)
- **TCS Configuration**:
  - Active TCS: 2
  - Sleep TCS: 3
  - Wake TCS: 3
  - Control TCS: 1
- **Power Domain**: Linked to `CLUSTER_PD`

#### Example 2:
- **RSC Base Address**: 0xAF20000
- **DRV ID**: 0
- **Register Offsets for DRV0**: Start at 0x1C00
- **Interrupt**: GIC_SPI 129 (level-triggered high)
- **TCS Configuration**:
  - Active TCS: 0
  - Sleep TCS: 1
  - Wake TCS: 1
  - Control TCS: 0
- **Power Domain**: Linked to `CLUSTER_PD`

#### Example 3:
- Similar to Example 1 but includes configurations for a clock controller and a power controller, as well as a voter component.
```
