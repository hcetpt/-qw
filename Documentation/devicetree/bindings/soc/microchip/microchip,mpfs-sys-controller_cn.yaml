## Documentation/devicetree/bindings/soc/microchip/microchip,mpfs-sys-controller_cn.yaml
```yaml
# SPDX-许可证标识符: (GPL-2.0-only 或 BSD-2-Clause)
%YAML 1.2
---
$id: http://devicetree.org/schemas/soc/microchip/microchip,mpfs-sys-controller.yaml#
$schema: http://devicetree.org/meta-schemas/core.yaml#

标题: Microchip PolarFire SoC (MPFS) MSS (微处理器子系统) 系统控制器

维护者:
  - Conor Dooley <conor.dooley@microchip.com>

描述: |
  PolarFire SoC 设备包含一个充当系统控制器的微控制器，它为主处理器和 FPGA 布局提供“服务”。这些服务包括硬件随机数生成器、FPGA 的重新编程以及 eNVM 内容验证等。有关这些服务的更多信息可以在网上找到，位于
  https://onlinedocs.microchip.com/pr/GUID-1409CF11-8EF9-4C24-A94E-70979A688632-en-US-1/index.html

  与系统控制器通信是通过一个邮箱完成的，其中客户端部分在这里进行文档说明。
属性:
  mboxes:
    maxItems: 1

  compatible:
    const: microchip,mpfs-sys-controller

  microchip,bitstream-flash:
    $ref: /schemas/types.yaml#/definitions/phandle
    描述:
      连接到系统控制器 QSPI 控制器的 SPI 闪存
系统控制器可以从该闪存中获取 FPGA 位流以执行在应用编程 (IAP) 或在设备初始化期间用于自动更新。MSS 和系统控制器有独立的 QSPI 控制器，此闪存连接到两者。在 MSS 中运行的软件可以将位流写入到闪存中。
必需:
  - compatible
  - mboxes

附加属性: false

示例:
  - |
    syscontroller {
      compatible = "microchip,mpfs-sys-controller";
      mboxes = <&mbox 0>;
    };
```

## Documentation/devicetree/bindings/soc/nuvoton/nuvoton,gfxi_cn.yaml
```yaml
# SPDX-许可证标识符: (GPL-2.0-only 或 BSD-2-Clause)
%YAML 1.2
---
$id: http://devicetree.org/schemas/soc/nuvoton/nuvoton,gfxi.yaml#
$schema: http://devicetree.org/meta-schemas/core.yaml#

title: Nuvoton SoC 中的图形核心信息块

维护者:
  - Joseph Liu <kwliu@nuvoton.com>
  - Marvin Lin <kflin@nuvoton.com>

描述:
  图形核心信息（GFXI）是 Nuvoton 系统级芯片 (SoC) 中的一组寄存器，用于分析图形核心的行为，并在寄存器中提供相关信息。

属性:
  compatible:
    项目:
      - 枚举:
          - nuvoton,npcm750-gfxi
          - nuvoton,npcm845-gfxi
      - 常量: syscon

  reg:
    最大项数: 1

必需:
  - compatible
  - reg

附加属性: false

示例:
  - |
    gfxi: gfxi@e000 {
      compatible = "nuvoton,npcm750-gfxi", "syscon";
      reg = <0xe000 0x100>;
    };
```

## Documentation/devicetree/bindings/soc/nuvoton/nuvoton,npcm-gcr_cn.yaml
```yaml
# SPDX-许可证标识符: GPL-2.0-only 或 BSD-2-Clause
%YAML 1.2
---
$id: http://devicetree.org/schemas/soc/nuvoton/nuvoton,npcm-gcr.yaml#
$schema: http://devicetree.org/meta-schemas/core.yaml#

title: Nuvoton SoC 中的全局控制寄存器模块

maintainers:
  - Jonathan Neuschäfer <j.neuschaefer@gmx.net>
  - Tomer Maimon <tmaimon77@gmail.com>

description:
  全局控制寄存器 (GCR) 是 Nuvoton 系统级芯片 (SoC) 中的一组寄存器块，
  提供了诸如芯片型号和版本信息、引脚复用设置等功能。

properties:
  compatible:
    items:
      - enum:
          - nuvoton,wpcm450-gcr
          - nuvoton,npcm750-gcr
          - nuvoton,npcm845-gcr
      - const: syscon
      - const: simple-mfd

  reg:
    maxItems: 1

required:
  - compatible
  - reg

additionalProperties:
  type: object

examples:
  - |
    gcr: syscon@800000 {
      compatible = "nuvoton,npcm750-gcr", "syscon", "simple-mfd";
      reg = <0x800000 0x1000>;

      mux-controller {
        compatible = "mmio-mux";
        #mux-control-cells = <1>;
        mux-reg-masks = <0x38 0x07>;
        idle-states = <2>;
      };
    };
```

## Documentation/devicetree/bindings/soc/qcom/qcom,aoss-qmp_cn.yaml
```yaml
# SPDX-许可证标识符: (GPL-2.0-only 或 BSD-2-Clause)
%YAML 1.2
---
$id: http://devicetree.org/schemas/soc/qcom/qcom,aoss-qmp.yaml#
$schema: http://devicetree.org/meta-schemas/core.yaml#

标题: 高通始终在线子系统旁路通道

维护者:
  - Bjorn Andersson <bjorn.andersson@linaro.org>

描述:
  此绑定描述了负责与始终在线子系统（AOSS）进行旁路请求的硬件组件，该系统用于处理某些电源管理请求，这些请求不由标准RPMh接口处理。SoC中的每个客户端都有自己的消息RAM块和IRQ来与AOSS通信。
通信中使用的消息RAM中的协议被称为高通消息协议（QMP）。

  AOSS旁路通道提供了一组资源的控制，用于控制一组与调试相关的时钟，并影响与次级子系统相关的资源的低功耗状态。
属性:
  compatible:
    items:
      - 枚举:
          - qcom,qdu1000-aoss-qmp
          - qcom,sa8775p-aoss-qmp
          - qcom,sc7180-aoss-qmp
          - qcom,sc7280-aoss-qmp
          - qcom,sc8180x-aoss-qmp
          - qcom,sc8280xp-aoss-qmp
          - qcom,sdx75-aoss-qmp
          - qcom,sdm845-aoss-qmp
          - qcom,sm6350-aoss-qmp
          - qcom,sm8150-aoss-qmp
          - qcom,sm8250-aoss-qmp
          - qcom,sm8350-aoss-qmp
          - qcom,sm8450-aoss-qmp
          - qcom,sm8550-aoss-qmp
          - qcom,sm8650-aoss-qmp
          - qcom,x1e80100-aoss-qmp
      - 常量: qcom,aoss-qmp

  reg:
    maxItems: 1
    描述:
      此客户端与AOSS通信的消息RAM的基地址和大小

  interrupts:
    maxItems: 1
    描述:
      应指定此客户端的AOSS消息IRQ

  mboxes:
    maxItems: 1
    描述:
      引用代表此客户端APCS中传出门铃的邮箱，如mailbox/mailbox.txt所述

  "#clock-cells":
    常量: 0
    描述:
      单个时钟代表QDSS时钟
必需:
  - compatible
  - reg
  - interrupts
  - mboxes
  - "#clock-cells"

additionalProperties: false

模式属性:
  "^(cx|mx|ebi)$":
    类型: 对象
    描述:
      AOSS旁路通道还提供了对三个冷却设备的控制，这些设备作为QMP节点的子节点表示。节点的名称用于标识资源，因此必须为"cx"、"mx"或"ebi"
属性:
      "#cooling-cells":
        常量: 2

    必需:
      - "#cooling-cells"

    additionalProperties: false

示例:
  - |
    #include <dt-bindings/interrupt-controller/arm-gic.h>

    aoss_qmp: qmp@c300000 {
      compatible = "qcom,sdm845-aoss-qmp", "qcom,aoss-qmp";
      reg = <0x0c300000 0x100000>;
      interrupts = <GIC_SPI 389 IRQ_TYPE_EDGE_RISING>;
      mboxes = <&apss_shared 0>;

      #clock-cells = <0>;

      cx_cdev: cx {
        #cooling-cells = <2>;
      };

      mx_cdev: mx {
        #cooling-cells = <2>;
      };
    };
..
```

## Documentation/devicetree/bindings/soc/qcom/qcom,apr_cn.yaml
```yaml
### SPDX 许可标识符: (GPL-2.0 或 BSD-2-Clause)
%YAML 1.2
---
$id: http://devicetree.org/schemas/soc/qcom/qcom,apr.yaml#
$schema: http://devicetree.org/meta-schemas/core.yaml#

标题: Qualcomm APR/GPR (异步/通用数据包路由器)

维护者:
  - Srinivas Kandagatla <srinivas.kandagatla@linaro.org>

描述: |
  此绑定描述了Qualcomm APR/GPR，APR/GPR是一种用于Application处理器和QDSP之间通信的IPC协议。APR/GPR主要用于QDSP上的音频/语音服务。
属性:
  compatible:
    枚举:
      - qcom,apr
      - qcom,apr-v2
      - qcom,gpr

  power-domains:
    最大项数: 1

  qcom,apr-domain:
    $ref: /schemas/types.yaml#/definitions/uint32
    枚举: [1, 2, 3, 4, 5, 6, 7]
    描述:
      选择APR的处理器域
        1 = APR模拟器
        2 = PC域
        3 = 调制解调器域
        4 = ADSP域
        5 = 应用处理器域
        6 = 调制解调器2域
        7 = 应用处理器2域
    过时: true

  qcom,domain:
    $ref: /schemas/types.yaml#/definitions/uint32
    最小值: 1
    最大值: 7
    描述:
      选择APR的处理器域
        1 = APR模拟器
        2 = PC域
        3 = 调制解调器域
        4 = ADSP域
        5 = 应用处理器域
        6 = 调制解调器2域
        7 = 应用处理器2域
      选择GPR的处理器域
        1 = 调制解调器域
        2 = 音频DSP域
        3 = 应用处理器域

  qcom,glink-channels:
    $ref: /schemas/types.yaml#/definitions/string-array
    描述: 用于通信的通道名称
    最大项数: 1

  qcom,intents:
    $ref: /schemas/types.yaml#/definitions/uint32-matrix
    最少项数: 1
    最大项数: 32
    项:
      项:
        - 描述: 每个意图预分配的大小
        - 描述: 预分配的意图数量
          最小值: 1
    描述:
      列表，包含(size, amount)对，描述了此虚拟通道应预分配哪些意图。这可以用来调整通道默认可用的意图，以满足远端的期望。

  qcom,smd-channels:
    $ref: /schemas/types.yaml#/definitions/string-array
    描述: 用于通信的通道名称
    项:
      - 常量: apr_audio_svc

  '#address-cells':
    常量: 1

  '#size-cells':
    常量: 0

模式属性:
  "^service@[1-9a-d]$":
    类型: 对象
    $ref: /schemas/soc/qcom/qcom,apr-services.yaml
    其他属性: true
    描述:
      APR/GPR静态端口服务
属性:
  compatible:
    枚举:
      - qcom,q6core
      - qcom,q6asm
      - qcom,q6afe
      - qcom,q6adm
      - qcom,q6apm
      - qcom,q6prm

必需:
  - compatible
  - qcom,domain

allOf:
  - 如果:
      属性:
        compatible:
          枚举:
            - qcom,gpr
    然后:
      属性:
        qcom,glink-channels:
          项:
            - 常量: adsp_apps
        power-domains: false
    否则:
      属性:
        qcom,glink-channels:
          项:
            - 常量: apr_audio_svc

  - 如果:
      必需:
        - qcom,glink-channels
    然后:
      属性:
        qcom,smd-channels: false

  - 如果:
      必需:
        - qcom,smd-channels
    然后:
      属性:
        qcom,glink-channels: false

其他属性: false

示例:
  - |
    #include <dt-bindings/soc/qcom,apr.h>
    apr {
        compatible = "qcom,apr-v2";
        qcom,domain = <APR_DOMAIN_ADSP>;
        qcom,glink-channels = "apr_audio_svc";
        qcom,intents = <512 20>;
        #address-cells = <1>;
        #size-cells = <0>;

        q6core: service@3 {
            compatible = "qcom,q6core";
            reg = <APR_SVC_ADSP_CORE>;
            qcom,protection-domain = "avs/audio", "msm/adsp/audio_pd";
        };

        service@4 {
            compatible = "qcom,q6afe";
            reg = <APR_SVC_AFE>;
            qcom,protection-domain = "avs/audio", "msm/adsp/audio_pd";

            clock-controller {
                compatible = "qcom,q6afe-clocks";
                #clock-cells = <2>;
            };

            dais {
                compatible = "qcom,q6afe-dais";
                #address-cells = <1>;
                #size-cells = <0>;
                #sound-dai-cells = <1>;
                /* ... */
            };
            /* ... */
        };
    };

  - |
    #include <dt-bindings/soc/qcom,gpr.h>
    gpr {
        compatible = "qcom,gpr";
        qcom,domain = <GPR_DOMAIN_ID_ADSP>;
        qcom,glink-channels = "adsp_apps";
        qcom,intents = <512 20>;
        #address-cells = <1>;
        #size-cells = <0>;

        service@1 {
            compatible = "qcom,q6apm";
            reg = <GPR_APM_MODULE_IID>;
            #sound-dai-cells = <0>;
            qcom,protection-domain = "avs/audio", "msm/adsp/audio_pd";

            dais {
                compatible = "qcom,q6apm-dais";
                iommus = <&apps_smmu 0x1801 0x0>;
            };

            bedais {
                compatible = "qcom,q6apm-lpass-dais";
                #sound-dai-cells = <1>;
            };
        };
    };
```

## Documentation/devicetree/bindings/soc/qcom/qcom,dcc_cn.yaml
```yaml
# SPDX-许可证标识符: (GPL-2.0-or-later 或 BSD-2-Clause)
%YAML 1.2
---
$id: http://devicetree.org/schemas/soc/qcom/qcom,dcc.yaml#
$schema: http://devicetree.org/meta-schemas/core.yaml#

title: 数据捕获与比较

maintainers:
  - Souradeep Chowdhury <quic_schowdhu@quicinc.com>

description: |
    DCC（数据捕获与比较）是一种DMA引擎，用于在灾难性故障或软件触发时保存配置数据或系统内存内容。
    DCC用于捕获和存储数据以供调试之用。

properties:
  compatible:
    items:
      - enum:
          - qcom,sm8150-dcc
          - qcom,sc7280-dcc
          - qcom,sc7180-dcc
          - qcom,sdm845-dcc
      - const: qcom,dcc

  reg:
    items:
      - description: DCC基地址
      - description: DCC RAM基地址

required:
  - compatible
  - reg

additionalProperties: false

examples:
  - |
    dma@10a2000{
        compatible = "qcom,sm8150-dcc", "qcom,dcc";
        reg = <0x010a2000 0x1000>,
              <0x010ad000 0x2000>;
    };
```

## Documentation/devicetree/bindings/soc/qcom/qcom,eud_cn.yaml
~~~~yaml
```yaml
# SPDX-许可证标识符: (GPL-2.0 或 BSD-2-Clause)
%YAML 1.2
---
$id: http://devicetree.org/schemas/soc/qcom/qcom,eud.yaml#
$schema: http://devicetree.org/meta-schemas/core.yaml#

title: 高通嵌入式USB调试器

maintainers:
  - Souradeep Chowdhury <quic_schowdhu@quicinc.com>

description:
  此绑定用于描述高通嵌入式USB调试器，它是在芯片上实现的一个小型USB集线器以支持基于USB的调试功能。
properties:
  compatible:
    items:
      - enum:
          - qcom,sc7280-eud
      - const: qcom,eud

  reg:
    items:
      - description: EUD 基地址寄存器区域
      - description: EUD 模式管理器寄存器

  interrupts:
    description: EUD 中断
    maxItems: 1

  ports:
    $ref: /schemas/graph.yaml#/properties/ports
    description:
      这些端口应连接到DWC3控制器节点的端点和Type C连接器节点。控制器具有"usb-role-switch"属性
properties:
      port@0:
        $ref: /schemas/graph.yaml#/properties/port
        description: 此端口应连接到DWC3控制器
port@1:
        $ref: /schemas/graph.yaml#/properties/port
        description: 此端口应连接到Type C连接器
required:
  - compatible
  - reg
  - ports

additionalProperties: false

examples:
  - |
    eud@88e0000 {
           compatible = "qcom,sc7280-eud", "qcom,eud";
           reg = <0x88e0000 0x2000>,
                 <0x88e2000 0x1000>;

           ports {
                   #address-cells = <1>;
                   #size-cells = <0>;
                   port@0 {
                           reg = <0>;
                           eud_ep: endpoint {
                                   remote-endpoint = <&usb2_role_switch>;
                           };
                   };

                   port@1 {
                           reg = <1>;
                           eud_con: endpoint {
                                   remote-endpoint = <&con_eud>;
                           };
                   };
           };
    };
```

以上是对给定内容的中文翻译。请注意，由于原内容中包含了一些专有名词和技术细节，这些词汇在中文中的对应表达可能没有统一的标准，但已尽量保持其准确性和可读性。
~~~~

## Documentation/devicetree/bindings/soc/qcom/qcom,geni-se_cn.yaml
```yaml
# SPDX-许可证标识符: (GPL-2.0 或 BSD-2-Clause)
%YAML 1.2
---
$id: http://devicetree.org/schemas/soc/qcom/qcom,geni-se.yaml#
$schema: http://devicetree.org/meta-schemas/core.yaml#

标题: 基于GENI的Qualcomm通用外设（QUP）封装控制器

维护者:
  - Bjorn Andersson <bjorn.andersson@linaro.org>

描述: |
  通用接口（GENI）为基础的Qualcomm通用外设（QUP）封装是一种可编程模块，支持广泛的串行接口如UART、SPI、I2C、I3C等。单个QUP模块最多可以提供8个串行接口，通过其内部的串行引擎实现。基于GENI串行引擎的QUP封装控制器被建模为一个节点，该节点可以有零个或多个子节点，每个子节点代表一个串行引擎。
属性:
  compatible:
    枚举:
      - qcom,geni-se-qup
      - qcom,geni-se-i2c-master-hub

  reg:
    描述: QUP封装公共寄存器地址和长度
maxItems: 1

  clock-names:
    minItems: 1
    maxItems: 2

  clocks:
    minItems: 1
    maxItems: 2

  "#address-cells":
    常量: 2

  "#size-cells":
    常量: 2

  ranges: true

  interconnects:
    maxItems: 1

  interconnect-names:
    常量: qup-core

  iommus:
    maxItems: 1

  dma-coherent: true

必需:
  - compatible
  - reg
  - clock-names
  - clocks
  - "#address-cells"
  - "#size-cells"
  - ranges

模式属性:
  "spi@[0-9a-f]+$":
    类型: 对象
    描述: 基于GENI串行引擎的SPI控制器。SPI在主模式下支持高达50MHz的速度，支持多达四个芯片选择，数据路径从4位到32位可编程，并支持多种协议变体
$ref: /schemas/spi/qcom,spi-geni-qcom.yaml#

  "i2c@[0-9a-f]+$":
    类型: 对象
    描述: 基于GENI串行引擎的I2C控制器
$ref: /schemas/i2c/qcom,i2c-geni-qcom.yaml#

  "serial@[0-9a-f]+$":
    类型: 对象
    描述: 基于GENI串行引擎的UART控制器
$ref: /schemas/serial/qcom,serial-geni-qcom.yaml#

allOf:
  - 如果:
      属性:
        compatible:
          包含:
            常量: qcom,geni-se-i2c-master-hub
    则:
      属性:
        clock-names:
          项:
            - 常量: s-ahb

        clocks:
          项:
            - 描述: 从AHB时钟

        iommus: false

      模式属性:
        "spi@[0-9a-f]+$": false
        "serial@[0-9a-f]+$": false
    否则:
      属性:
        clock-names:
          项:
            - 常量: m-ahb
            - 常量: s-ahb

        clocks:
          项:
            - 描述: 主AHB时钟
            - 描述: 从AHB时钟

additionalProperties: false

示例:
  - |
    #include <dt-bindings/clock/qcom,gcc-sdm845.h>
    #include <dt-bindings/interrupt-controller/arm-gic.h>

    soc {
        #address-cells = <2>;
        #size-cells = <2>;

        geniqup@8c0000 {
            compatible = "qcom,geni-se-qup";
            reg = <0 0x008c0000 0 0x6000>;
            clock-names = "m-ahb", "s-ahb";
            clocks = <&gcc GCC_QUPV3_WRAP_0_M_AHB_CLK>,
                <&gcc GCC_QUPV3_WRAP_0_S_AHB_CLK>;
            #address-cells = <2>;
            #size-cells = <2>;
            ranges;

            i2c0: i2c@a94000 {
                compatible = "qcom,geni-i2c";
                reg = <0 0xa94000 0 0x4000>;
                interrupts = <GIC_SPI 358 IRQ_TYPE_LEVEL_HIGH>;
                clock-names = "se";
                clocks = <&gcc GCC_QUPV3_WRAP0_S5_CLK>;
                pinctrl-names = "default", "sleep";
                pinctrl-0 = <&qup_1_i2c_5_active>;
                pinctrl-1 = <&qup_1_i2c_5_sleep>;
                #address-cells = <1>;
                #size-cells = <0>;
            };

            uart0: serial@a88000 {
                compatible = "qcom,geni-uart";
                reg = <0 0xa88000 0 0x7000>;
                interrupts = <GIC_SPI 355 IRQ_TYPE_LEVEL_HIGH>;
                clock-names = "se";
                clocks = <&gcc GCC_QUPV3_WRAP0_S0_CLK>;
                pinctrl-names = "default", "sleep";
                pinctrl-0 = <&qup_1_uart_3_active>;
                pinctrl-1 = <&qup_1_uart_3_sleep>;
            };
        };
    };
```
