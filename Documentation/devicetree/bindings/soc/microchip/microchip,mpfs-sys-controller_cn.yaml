## Documentation/devicetree/bindings/soc/qcom/qcom,saw2_cn.yaml
```yaml
### 许可证标识符: (GPL-2.0 或 BSD-2-Clause)
%%YAML 1.2
---
$id: http://devicetree.org/schemas/soc/qcom/qcom,saw2.yaml#
$schema: http://devicetree.org/meta-schemas/core.yaml#

title: 高通子系统电源管理器 / SPM AVS 包装器 2 (SAW2)

maintainers:
  - Andy Gross <agross@kernel.org>
  - Bjorn Andersson <bjorn.andersson@linaro.org>

description: |
  高通子系统电源管理器用于控制高通平台中应用核心周围的外围逻辑。
  SAW2是围绕子系统电源管理器（SPM）和自适应电压缩放（AVS）硬件的包装器。SPM是一个可编程电源控制器，它通过直接连接到PMIC将硬件（如处理器或子系统）转换为低功耗模式并从中退出。它还可以与其他系统中的处理器相连，在进入或退出低功耗状态时通知它们。

properties:
  compatible:
    items:
      - enum:
          - qcom,ipq4019-saw2-cpu
          - qcom,ipq4019-saw2-l2
          - qcom,ipq8064-saw2-cpu
          - qcom,sdm660-gold-saw2-v4.1-l2
          - qcom,sdm660-silver-saw2-v4.1-l2
          - qcom,msm8998-gold-saw2-v4.1-l2
          - qcom,msm8998-silver-saw2-v4.1-l2
          - qcom,msm8909-saw2-v3.0-cpu
          - qcom,msm8916-saw2-v3.0-cpu
          - qcom,msm8939-saw2-v3.0-cpu
          - qcom,msm8226-saw2-v2.1-cpu
          - qcom,msm8226-saw2-v2.1-l2
          - qcom,msm8960-saw2-cpu
          - qcom,msm8974-saw2-v2.1-cpu
          - qcom,msm8974-saw2-v2.1-l2
          - qcom,msm8976-gold-saw2-v2.3-l2
          - qcom,msm8976-silver-saw2-v2.3-l2
          - qcom,apq8084-saw2-v2.1-cpu
          - qcom,apq8084-saw2-v2.1-l2
          - qcom,apq8064-saw2-v1.1-cpu
      - const: qcom,saw2

  reg:
    items:
      - description: SPM寄存器区域的基本地址和大小
      - description: 别名寄存器区域的基本地址和大小
    minItems: 1

  regulator:
    $ref: /schemas/regulator/regulator.yaml#
    description: 表示此SPM设备作为其所属核心（CPU或缓存）的调节设备
      设备工作

required:
  - compatible
  - reg

additionalProperties: false

examples:
  - |

    /* 示例 1: 使用SAW2和kpss-acc-v2 CPU空闲的SoC */
    cpus {
        #address-cells = <1>;
        #size-cells = <0>;

        cpu@0 {
            compatible = "qcom,kryo";
            device_type = "cpu";
            enable-method = "qcom,kpss-acc-v2";
            qcom,saw = <&saw0>;
            reg = <0x0>;
            operating-points-v2 = <&cpu_opp_table>;
        };
    };

    saw0: power-manager@f9089000 {
        compatible = "qcom,msm8974-saw2-v2.1-cpu", "qcom,saw2";
        reg = <0xf9089000 0x1000>;
    };

  - |

    /*
     * 示例 2: 新一代多集群SoC仅使用SAW用于L2；
     * 这不需要任何cpuidle驱动程序，也不需要任何cpu phandle
*/
    power-manager@17812000 {
        compatible = "qcom,msm8998-gold-saw2-v4.1-l2", "qcom,saw2";
        reg = <0x17812000 0x1000>;
    };

    power-manager@17912000 {
        compatible = "qcom,msm8998-silver-saw2-v4.1-l2", "qcom,saw2";
        reg = <0x17912000 0x1000>;
    };

  - |
    /*
     * 示例 3: 带有捆绑调节器定义的SAW2
*/
    power-manager@2089000 {
        compatible = "qcom,apq8064-saw2-v1.1-cpu", "qcom,saw2";
        reg = <0x02089000 0x1000>, <0x02009000 0x1000>;

        regulator {
            regulator-min-microvolt = <850000>;
            regulator-max-microvolt = <1300000>;
        };
    };
```

## Documentation/devicetree/bindings/soc/qcom/qcom,smd-rpm_cn.yaml
~~~~yaml
```yaml
# SPDX-许可证标识符: (GPL-2.0 或 BSD-2-Clause)
%YAML 1.2
---
$id: http://devicetree.org/schemas/soc/qcom/qcom,smd-rpm.yaml#
$schema: http://devicetree.org/meta-schemas/core.yaml#

title: 高通资源电源管理器 (RPM) 通过 SMD/GLINK

description: |
  此驱动程序用于与在各种高通平台上发现的资源电源管理器 (RPM) 进行交互。
  RPM 允许系统中的每个组件对系统资源（如时钟、稳压器和总线频率）的状态进行投票。
  应填写 RPM 边缘的 SMD 或 GLINK 信息。参见 qcom,smd.yaml 以获取所需的边缘属性。
  所有 SMD/GLINK 相关属性都将位于 RPM 节点本身内。
  RPM 向其子节点暴露资源。rpm_requests 节点必须存在，此子节点可以包含指定稳压器资源的子项。
  有关可以在 rpm_requests 下存在的稳压器子节点的信息，请参阅 Documentation/devicetree/bindings/regulator/qcom,smd-rpm-regulator.yaml。
maintainers:
  - Andy Gross <agross@kernel.org>
  - Bjorn Andersson <bjorn.andersson@linaro.org>

properties:
  compatible:
    enum:
      - qcom,rpm-apq8084
      - qcom,rpm-ipq6018
      - qcom,rpm-ipq9574
      - qcom,rpm-mdm9607
      - qcom,rpm-msm8226
      - qcom,rpm-msm8610
      - qcom,rpm-msm8909
      - qcom,rpm-msm8916
      - qcom,rpm-msm8917
      - qcom,rpm-msm8936
      - qcom,rpm-msm8937
      - qcom,rpm-msm8952
      - qcom,rpm-msm8953
      - qcom,rpm-msm8974
      - qcom,rpm-msm8976
      - qcom,rpm-msm8994
      - qcom,rpm-msm8996
      - qcom,rpm-msm8998
      - qcom,rpm-qcm2290
      - qcom,rpm-qcs404
      - qcom,rpm-sdm660
      - qcom,rpm-sm6115
      - qcom,rpm-sm6125
      - qcom,rpm-sm6375

  clock-controller:
    $ref: /schemas/clock/qcom,rpmcc.yaml#
    unevaluatedProperties: false

  power-controller:
    $ref: /schemas/power/qcom,rpmpd.yaml#

  qcom,glink-channels:
    $ref: /schemas/types.yaml#/definitions/string-array
    description: 用于 RPM 通信的通道名称
    items:
      - const: rpm_requests

  qcom,smd-channels:
    $ref: /schemas/types.yaml#/definitions/string-array
    description: 用于 RPM 通信的通道名称
    items:
      - const: rpm_requests

patternProperties:
  "^regulators(-[01])?$":
    $ref: /schemas/regulator/qcom,smd-rpm-regulator.yaml#
    unevaluatedProperties: false

if:
  properties:
    compatible:
      contains:
        enum:
          - qcom,rpm-apq8084
          - qcom,rpm-mdm9607
          - qcom,rpm-msm8226
          - qcom,rpm-msm8610
          - qcom,rpm-msm8909
          - qcom,rpm-msm8916
          - qcom,rpm-msm8917
          - qcom,rpm-msm8936
          - qcom,rpm-msm8937
          - qcom,rpm-msm8952
          - qcom,rpm-msm8953
          - qcom,rpm-msm8974
          - qcom,rpm-msm8976
          - qcom,rpm-msm8994
then:
  properties:
    qcom,glink-channels: false
  required:
    - qcom,smd-channels
else:
  properties:
    qcom,smd-channels: false
  required:
    - qcom,glink-channels

required:
  - compatible

additionalProperties: false

examples:
  - |
    #include <dt-bindings/interrupt-controller/arm-gic.h>
    #include <dt-bindings/interrupt-controller/irq.h>

    remoteproc {
        compatible = "qcom,msm8916-rpm-proc", "qcom,rpm-proc";

        smd-edge {
            interrupts = <GIC_SPI 168 IRQ_TYPE_EDGE_RISING>;
            qcom,ipc = <&apcs 8 0>;
            qcom,smd-edge = <15>;

            rpm-requests {
                compatible = "qcom,rpm-msm8916";
                qcom,smd-channels = "rpm_requests";

                clock-controller {
                    compatible = "qcom,rpmcc-msm8916", "qcom,rpmcc";
                    #clock-cells = <1>;
                    clocks = <&xo_board>;
                    clock-names = "xo";
                };

                power-controller {
                    compatible = "qcom,msm8916-rpmpd";
                    #power-domain-cells = <1>;
                    operating-points-v2 = <&rpmpd_opp_table>;

                    rpmpd_opp_table: opp-table {
                        compatible = "operating-points-v2";

                        opp-1 {
                            opp-level = <1>;
                        };
                        opp-2 {
                            opp-level = <2>;
                        };
                    };
                };
            };
        };
    };
```
以上是 YAML 文件的中文翻译版本。
~~~~

## Documentation/devicetree/bindings/soc/qcom/qcom,smd_cn.yaml
```yaml
# SPDX-许可证标识符: GPL-2.0-only 或 BSD-2-Clause
%YAML 1.2
---
$id: http://devicetree.org/schemas/soc/qcom/qcom,smd.yaml#
$schema: http://devicetree.org/meta-schemas/core.yaml#

标题: 高通共享内存驱动程序

维护者:
  - Andy Gross <agross@kernel.org>
  - Bjorn Andersson <bjorn.andersson@linaro.org>
  - Krzysztof Kozlowski <krzysztof.kozlowski@linaro.org>

描述:
  高通共享内存驱动程序是一个基于FIFO的通信通道，用于在高通平台中的各个子系统之间发送数据。
  使用顶级SMD节点已废弃。相反，SMD边缘现在直接定义在代表相应远程子系统或远程处理器的设备节点下。
废弃: true

属性:
  compatible:
    常量: qcom,smd

模式属性:
  "^smd-edge|rpm$":
    $ref: /schemas/remoteproc/qcom,smd-edge.yaml#
    unevaluatedProperties: false
    描述:
      SMD节点的每个子节点代表一个远程子系统或某种形式的远程处理器 - 或用SMD语言来说是“边缘”。边缘的名称并不重要。
必需:
  - compatible

额外属性: false

示例:
  # 下面的例子表示一个SMD节点，其中一个边缘代表了"rpm"子系统。对于"rpm"子系统，我们有一个与"rpm_request"通道相关的设备。
  # 注意: 这种表示方法已废弃，应使用"qcom,rpm-proc"来表示RPM。
- |
    #include <dt-bindings/interrupt-controller/arm-gic.h>

    shared-memory {
        compatible = "qcom,smd";

        rpm {
            interrupts = <GIC_SPI 168 IRQ_TYPE_EDGE_RISING>;
            qcom,ipc = <&apcs 8 0>;
            qcom,smd-edge = <15>;

            rpm-requests {
                compatible = "qcom,rpm-msm8974";
                qcom,smd-channels = "rpm_requests";

                clock-controller {
                    compatible = "qcom,rpmcc-msm8974", "qcom,rpmcc";
                    #clock-cells = <1>;
                };

            };
        };
    };
```

## Documentation/devicetree/bindings/soc/qcom/qcom,smem_cn.yaml
```yaml
# SPDX-License-Identifier: (GPL-2.0 OR BSD-2-Clause)
%YAML 1.2
---
$id: http://devicetree.org/schemas/soc/qcom/qcom,smem.yaml#
$schema: http://devicetree.org/meta-schemas/core.yaml#

标题: 高通共享内存管理器

维护者:
  - Andy Gross <agross@kernel.org>
  - Bjorn Andersson <bjorn.andersson@linaro.org>

描述:
  此绑定描述了高通共享内存管理器，这是一个预留内存区域，用于在高通平台中的各种子系统和操作系统之间共享数据。
属性:
  compatible:
    常量: qcom,smem

  reg:
    最大项数: 1

  memory-region:
    最大项数: 1
    描述: 主SMEM内存区域的内存预留句柄
hwlocks:
    最大项数: 1

  qcom,rpm-msg-ram:
    $ref: /schemas/types.yaml#/definitions/phandle
    描述: RPM消息内存资源的句柄

  no-map: true

必需:
  - compatible
  - hwlocks

oneOf:
  - 必需:
      - reg
      - no-map
  - 必需:
      - memory-region

额外属性: false

示例:
  - |
    reserved-memory {
        #address-cells = <1>;
        #size-cells = <1>;
        ranges;

        smem@fa00000 {
            compatible = "qcom,smem";
            reg = <0xfa00000 0x200000>;
            no-map;

            hwlocks = <&tcsr_mutex 3>;
        };
    };
  - |
    reserved-memory {
        #address-cells = <1>;
        #size-cells = <1>;
        ranges;

        smem_region: smem@fa00000 {
            reg = <0xfa00000 0x200000>;
            no-map;
        };
    };

    smem {
        compatible = "qcom,smem";

        memory-region = <&smem_region>;
        qcom,rpm-msg-ram = <&rpm_msg_ram>;

        hwlocks = <&tcsr_mutex 3>;
    };

    soc {
        #address-cells = <1>;
        #size-cells = <1>;
        ranges;

        rpm_msg_ram: sram@fc428000 {
            compatible = "qcom,rpm-msg-ram";
            reg = <0xfc428000 0x4000>;
        };
    };

..
```

## Documentation/devicetree/bindings/soc/qcom/qcom,smp2p_cn.yaml
~~~~yaml
# SPDX-许可证标识符: GPL-2.0-only OR BSD-2-Clause
%YAML 1.2
---
$id: http://devicetree.org/schemas/soc/qcom/qcom,smp2p.yaml#
$schema: http://devicetree.org/meta-schemas/core.yaml#

标题: 高通共享内存点对点通信

维护者:
  - Andy Gross <agross@kernel.org>
  - Bjorn Andersson <bjorn.andersson@linaro.org>
  - Krzysztof Kozlowski <krzysztof.kozlowski@linaro.org>

描述:
  共享内存点到点（SMP2P）协议便于两个处理器之间单个32位值的通信。每个值有一个写入端（本地侧）和一个读取端（远程侧）。系统中值通过有向边（本地处理器ID到远程处理器ID）和一个字符串标识符唯一确定。

属性:
  compatible:
    常量: qcom,smp2p

  interrupts:
    最大项数: 1

  mboxes:
    最大项数: 1
    描述:
      指向表示此客户端在APCS中的出站门铃的邮箱的引用
qcom,ipc:
    $ref: /schemas/types.yaml#/definitions/phandle-array
    项:
      - 项:
          - 描述: 指向代表APCS寄存器的syscon节点的phandle
          - 描述: 表示寄存器内偏移的u32
          - 描述: 表示寄存器内的ipc位的u32
    描述:
      三个条目指定用于通知smp2p边的远程端点的出站ipc位
过时: true

  qcom,local-pid:
    $ref: /schemas/types.yaml#/definitions/uint32
    描述:
      此边的本地端点的标识符
qcom,remote-pid:
    $ref: /schemas/types.yaml#/definitions/uint32
    描述:
      此边的远程端点的标识符
qcom,smem:
    $ref: /schemas/types.yaml#/definitions/uint32-array
    项:
      最大项数: 2
    描述:
      两个标识符，分别表示此边使用的入站和出站smem项
模式属性:
  "^master-kernel|slave-kernel|ipa-ap-to-modem|ipa-modem-to-ap|wlan-ap-to-wpss|wlan-wpss-to-ap$":
    类型: 对象
    描述:
      每个SMP2P对包含一组入站和出站条目，这些条目在smp2p设备节点的子节点中描述。节点名称不重要
属性:
      interrupt-controller:
        描述:
          标记此条目为入站；该节点应指定为双单元中断控制器。如果没有指定，此节点将表示出站条目
'#interrupt-cells':
        常量: 2

      qcom,entry-name:
        $ref: /schemas/types.yaml#/definitions/string
        描述:
          此条目的名称，对于入站条目，这将用于与远程分配的条目匹配，并且对于出站条目，此名称用于分配条目
'#qcom,smem-state-cells':
        $ref: /schemas/types.yaml#/definitions/uint32
        常量: 1
        描述:
          出站条目必需
这段文本定义了一个设备树 (Device Tree) 的配置片段，用于描述高通 (Qualcomm) 系统中的共享内存和处理器间通信的配置。下面是这段文本的中文翻译：

```plaintext
# 必需字段：
#   - qcom,entry-name

# 以下两个条件之一必须满足：
#   - 包含interrupt-controller 和 "#interrupt-cells"
#   - 包含 "#qcom,smem-state-cells"

# 不允许额外属性

# 必需字段：
#   - compatible
#   - interrupts
#   - qcom,local-pid
#   - qcom,remote-pid
#   - qcom,smem

# 以下两个条件之一必须满足：
#   - 包含 mboxes
#   - 包含 qcom,ipc

# 不允许额外属性

# 示例
# 下面的例子展示了从8974应用处理器的角度来看与无线处理器之间的SMP2P设置。它包含一个入向通道和一个出向通道。
- |
    #include <dt-bindings/interrupt-controller/arm-gic.h>

    shared-memory {
        compatible = "qcom,smp2p";
        qcom,smem = <431>, <451>;
        interrupts = <GIC_SPI 143 IRQ_TYPE_EDGE_RISING>;
        mboxes = <&apcs 18>;
        qcom,local-pid = <0>;
        qcom,remote-pid = <4>;

        wcnss_smp2p_out: master-kernel {
            qcom,entry-name = "master-kernel";
            #qcom,smem-state-cells = <1>;
        };

        wcnss_smp2p_in: slave-kernel {
            qcom,entry-name = "slave-kernel";
            interrupt-controller;
            #interrupt-cells = <2>;
        };
    };
```

说明：
- `#` 表示注释或元数据。
- `required` 和 `oneOf` 是 YAML 格式的语法，用于指定配置项的结构要求。
- `additionalProperties: false` 指定不允许有超出指定之外的其他属性。
- `examples` 部分提供了一个具体的配置示例，展示了如何在设备树中具体使用这些配置项。
~~~~
