## Documentation/devicetree/bindings/soc/qcom/qcom,smsm_cn.yaml
```yaml
# SPDX-License-Identifier: GPL-2.0-only OR BSD-2-Clause
%YAML 1.2
---
$id: http://devicetree.org/schemas/soc/qcom/qcom,smsm.yaml#
$schema: http://devicetree.org/meta-schemas/core.yaml#

title: 高通共享内存状态机

maintainers:
  - Andy Gross <agross@kernel.org>
  - Bjorn Andersson <bjorn.andersson@linaro.org>
  - Krzysztof Kozlowski <krzysztof.kozlowski@linaro.org>

description:
  共享内存状态机促进了高通SoC中处理器间单比特状态信息的广播。每个处理器被分配了32位的状态信息，这些信息可以被修改。一个处理器可以通过位图矩阵信号来订阅特定远程处理器所拥有的某个比特的变化通知。

properties:
  compatible:
    const: qcom,smsm

  '#address-cells':
    const: 1

  qcom,local-host:
    $ref: /schemas/types.yaml#/definitions/uint32
    default: 0
    description:
      本地处理器在主机列表中的标识符，或者说代表本地处理器的订阅矩阵中的列索引。
mboxes:
    minItems: 1
    maxItems: 5
    description:
      指向表示此客户端APCS中出站门铃的邮箱的引用。每个条目通过索引（从0开始）代表第N个远程处理器。
'#size-cells':
    const: 0

patternProperties:
  "^qcom,ipc-[1-4]$":
    $ref: /schemas/types.yaml#/definitions/phandle-array
    items:
      - items:
          - description: 指向表示APCS寄存器的syscon节点的phandle
          - description: 表示syscon内寄存器偏移量的u32
          - description: 寄存器内的ipc比特
    description:
      三个条目指定了用于标记第N个远程处理器的出站ipc比特。
deprecated: true

  "@[0-9a-f]$":
    type: object
    description:
      每个处理器的状态比特由SMSM设备节点的子节点描述。节点可以标记为中断控制器以表示远程处理器的状态比特或本地处理器的状态比特。节点名称不重要。
properties:
      reg:
        maxItems: 1

      interrupt-controller:
        description:
          标记该条目为中断控制器，并且状态比特属于远程处理器。
'#interrupt-cells':
        const: 2

      interrupts:
        maxItems: 1
        description:
          一个条目指定远程处理器用于标记其状态比特变化的远程IRQ。
'#qcom,smem-state-cells':
        $ref: /schemas/types.yaml#/definitions/uint32
        const: 1
        description:
          对于本地条目是必需的。表示比特号。
required:
      - reg

    oneOf:
      - required:
          - '#qcom,smem-state-cells'
      - required:
          - interrupt-controller
          - '#interrupt-cells'
          - interrupts

    additionalProperties: false

required:
  - compatible
  - '#address-cells'
  - '#size-cells'

oneOf:
  - required:
      - mboxes
  - anyOf:
      - required:
          - qcom,ipc-1
      - required:
          - qcom,ipc-2
      - required:
          - qcom,ipc-3
      - required:
          - qcom,ipc-4

additionalProperties: false

examples:
  # 下面的例子展示了从8974应用程序处理器的角度控制无线处理器特性的SMEM设置。它包括一个出站条目和无线处理器的出站中断。
- |
    #include <dt-bindings/interrupt-controller/arm-gic.h>

    shared-memory {
        compatible = "qcom,smsm";
        #address-cells = <1>;
        #size-cells = <0>;
        mboxes = <0>, <0>, <0>, <&apcs 19>;

        apps_smsm: apps@0 {
            reg = <0>;
            #qcom,smem-state-cells = <1>;
        };

        wcnss_smsm: wcnss@7 {
            reg = <7>;
            interrupts = <GIC_SPI 144 IRQ_TYPE_EDGE_RISING>;
            interrupt-controller;
            #interrupt-cells = <2>;
        };
    };
```

## Documentation/devicetree/bindings/soc/qcom/qcom,wcnss_cn.yaml
```yaml
# SPDX-文件许可人: GPL-2.0-only 或 BSD-2-Clause
%YAML 1.2
---
$id: http://devicetree.org/schemas/soc/qcom/qcom,wcnss.yaml#
$schema: http://devicetree.org/meta-schemas/core.yaml#

title: 高通 WCNSS

maintainers:
  - Andy Gross <agross@kernel.org>
  - Bjorn Andersson <bjorn.andersson@linaro.org>

description:
  高通 WCNSS 硬件由控制块和一个包含蓝牙（BT）、Wi-Fi 和调频（FM）无线电模块组成，所有这些都使用 SMD 作为命令通道。
properties:
  compatible:
    const: qcom,wcnss

  firmware-name:
    $ref: /schemas/types.yaml#/definitions/string
    default: wlan/prima/WCNSS_qcom_wlan_nv.bin
    description:
      Wi-Fi NV blob 固件图像的相对路径
qcom,mmio:
    $ref: /schemas/types.yaml#/definitions/phandle
    description: |
      指向指定 wcnss "ccu" 和 "dxe" 寄存器块的节点的引用
节点必须与以下之一兼容：
           - qcom,riva"
           - qcom,pronto"

  qcom,smd-channels:
    $ref: /schemas/types.yaml#/definitions/string
    const: WCNSS_CTRL
    description:
      标准 SMD 属性，用于指定与 Wi-Fi 固件通信所使用的 SMD 通道
bluetooth:
    type: object
    additionalProperties: false
    allOf:
      - $ref: /schemas/net/bluetooth/bluetooth-controller.yaml#
    properties:
      compatible:
        const: qcom,wcnss-bt

      local-bd-address: true

    required:
      - compatible

  wifi:
    additionalProperties: false
    type: object
    properties:
      compatible:
        const: qcom,wcnss-wlan

      interrupts:
        maxItems: 2

      interrupt-names:
        items:
          - const: tx
          - const: rx

      qcom,smem-states:
        $ref: /schemas/types.yaml#/definitions/phandle-array
        maxItems: 2
        description:
          应该引用 tx-enable 和 tx-rings-empty 的 SMEM 状态
qcom,smem-state-names:
        items:
          - const: tx-enable
          - const: tx-rings-empty
        description:
          SMEM 状态的名称
required:
      - compatible
      - interrupts
      - interrupt-names
      - qcom,smem-states
      - qcom,smem-state-names

required:
  - compatible
  - qcom,mmio
  - qcom,smd-channels

additionalProperties: false

examples:
  - |
    #include <dt-bindings/interrupt-controller/arm-gic.h>

    smd-edge {
        interrupts = <GIC_SPI 142 IRQ_TYPE_EDGE_RISING>;

        qcom,ipc = <&apcs 8 17>;
        qcom,smd-edge = <6>;
        qcom,remote-pid = <4>;

        label = "pronto";

        wcnss {
            compatible = "qcom,wcnss";
            qcom,smd-channels = "WCNSS_CTRL";

            qcom,mmio = <&pronto>;

            bluetooth {
                compatible = "qcom,wcnss-bt";
                /* 由启动固件更新（小端序） */
                local-bd-address = [ 00 00 00 00 00 00 ];
            };

            wifi {
                compatible = "qcom,wcnss-wlan";

                interrupts = <GIC_SPI 145 IRQ_TYPE_LEVEL_HIGH>,
                             <GIC_SPI 146 IRQ_TYPE_LEVEL_HIGH>;
                interrupt-names = "tx", "rx";

                qcom,smem-states = <&apps_smsm 10>, <&apps_smsm 9>;
                qcom,smem-state-names = "tx-enable", "tx-rings-empty";
            };
        };
    };
```

## Documentation/devicetree/bindings/soc/qcom/qcom-stats_cn.yaml
```yaml
# SPDX-许可证标识符: (GPL-2.0-only 或 BSD-2-Clause)
%YAML 1.2
---
$id: http://devicetree.org/schemas/soc/qcom/qcom-stats.yaml#
$schema: http://devicetree.org/meta-schemas/core.yaml#

标题: 高通技术公司 (QTI) 统计信息

维护者:
  - Maulik Shah <quic_mkshah@quicinc.com>

描述:
  始终在线处理器/资源电源管理器维护了涉及关闭电压轨和振荡器时钟的SoC休眠模式的统计信息。
  统计信息包括SoC休眠模式类型、进入低功耗模式的次数、最后一次进入的时间、最后一次退出的时间以及累积的睡眠持续时间。
属性:
  compatible:
    枚举:
      - qcom,rpmh-stats
      - qcom,sdm845-rpmh-stats
      - qcom,rpm-stats
      # 对于旧版RPM固件版本，其中睡眠统计信息有固定的偏移量
      - qcom,apq8084-rpm-stats
      - qcom,msm8226-rpm-stats
      - qcom,msm8916-rpm-stats
      - qcom,msm8974-rpm-stats

  reg:
    maxItems: 1

  qcom,qmp:
    $ref: /schemas/types.yaml#/definitions/phandle
    描述: 引用到始终在线侧通道消息RAM

必需:
  - compatible
  - reg

allOf:
  - if:
      not:
        properties:
          compatible:
            const: qcom,rpmh-stats
    then:
      properties:
        qcom,qmp: false

additionalProperties: false

示例:
  # rpmh睡眠统计信息的示例
  - |
    sram@c3f0000 {
      compatible = "qcom,rpmh-stats";
      reg = <0x0c3f0000 0x400>;
    };
  # rpm睡眠统计信息的示例
  - |
    sram@4690000 {
      compatible = "qcom,rpm-stats";
      reg = <0x04690000 0x10000>;
    };
```

## Documentation/devicetree/bindings/soc/renesas/renesas,r9a09g011-sys_cn.yaml
```yaml
# SPDX-许可证标识符: (GPL-2.0-only 或 BSD-2-Clause)
%YAML 1.2
---
$id: http://devicetree.org/schemas/soc/renesas/renesas,r9a09g011-sys.yaml#
$schema: http://devicetree.org/meta-schemas/core.yaml#

标题: Renesas RZ/V2M 系统配置 (SYS)

维护者:
  - Geert Uytterhoeven <geert+renesas@glider.be>

描述:
  RZ/V2M 类似的 SYS (系统配置) 控制整体的 LSI 配置，并支持以下功能：
  - DMAC 的银行地址设置
  - ICB 单元的银行地址设置
  - ETHER AxCACHE[1] (C 位) 控制功能
  - RAMA 初始化控制
  - MD[7:0] 引脚监控
  - LSI 版本
  - PCIe 相关设置
  - WDT 停止控制
  - 温度传感器 (TSU) 监控

属性:
  compatible:
    常量: renesas,r9a09g011-sys

  reg:
    最大项数: 1

必需:
  - compatible
  - reg

附加属性: false

示例:
  - |
    sys: system-controller@a3f03000 {
      compatible = "renesas,r9a09g011-sys";
      reg = <0xa3f03000 0x400>;
    };
```
