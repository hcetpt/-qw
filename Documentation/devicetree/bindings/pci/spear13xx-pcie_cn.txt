## Documentation/devicetree/bindings/pci/v3-v360epc-pci_cn.txt
~~~~
V3 Semiconductor V360 EPC PCI桥接器

此桥接器可在ARM Integrator/AP（应用平台）中找到。

必需属性：
- compatible：应为以下之一：
  "v3,v360epc-pci"
  "arm,integrator-ap-pci", "v3,v360epc-pci"
- reg：应包含两个寄存器区域：
  第一个为V3主机桥控制器的基本地址，64KB
  第二个为配置区域寄存器空间，16MB
- interrupts：应包含对系统上路由的V3错误中断的引用
- bus-range：参见pci.txt
- ranges：这遵循IEEE标准1275-1994中的标准PCI绑定（参见pci.txt），具有以下限制：
  - 非预取和可预取内存窗口各自必须正好为256MB（0x10000000）大小
- 可预取内存窗口必须紧邻非预取内存窗口
- dma-ranges：三个范围用于入站内存区域。这些范围必须与1MB边界对齐，并且可以为1MB、2MB、4MB、8MB、16MB、32MB、64MB、128MB、256MB、512MB、1GB或2GB大小。内存应标记为可预取。硬件支持两个范围
Integrator特定必需属性：
- syscon：应包含到syscon设备节点的链接，因为在Integrator上，syscon中的一些寄存器对于操作V3主机桥是必需的
示例：

```txt
pci: pciv3@62000000 {
	compatible = "arm,integrator-ap-pci", "v3,v360epc-pci";
	#interrupt-cells = <1>;
	#size-cells = <2>;
	#address-cells = <3>;
	reg = <0x62000000 0x10000>, <0x61000000 0x01000000>;
	interrupt-parent = <&pic>;
	interrupts = <17>; /* 总线错误IRQ */
	clocks = <&pciclk>;
	bus-range = <0x00 0xff>;
	ranges = 0x01000000 0 0x00000000 /* I/O空间@00000000 */
		0x60000000 0 0x01000000 /* 16 MiB @ LB 60000000 */
		0x02000000 0 0x40000000 /* 非预取内存@40000000 */
		0x40000000 0 0x10000000 /* 256 MiB @ LB 40000000 1:1 */
		0x42000000 0 0x50000000 /* 可预取内存@50000000 */
		0x50000000 0 0x10000000>; /* 256 MiB @ LB 50000000 1:1 */
	dma-ranges = <0x02000000 0 0x20000000 /* EBI内存空间 */
		0x20000000 0 0x20000000 /* 512 MB @ LB 20000000 1:1 */
		0x02000000 0 0x80000000 /* 核心模块别名内存 */
		0x80000000 0 0x40000000>; /* 1GB @ LB 80000000 */
	interrupt-map-mask = <0xf800 0 0 0x7>;
	interrupt-map = <
	/* IDSEL 9 */
	0x4800 0 0 1 &pic 13 /* 插槽9上的INT A是irq 13 */
	0x4800 0 0 2 &pic 14 /* 插槽9上的INT B是irq 14 */
	0x4800 0 0 3 &pic 15 /* 插槽9上的INT C是irq 15 */
	0x4800 0 0 4 &pic 16 /* 插槽9上的INT D是irq 16 */
	/* IDSEL 10 */
	0x5000 0 0 1 &pic 14 /* 插槽10上的INT A是irq 14 */
	0x5000 0 0 2 &pic 15 /* 插槽10上的INT B是irq 15 */
	0x5000 0 0 3 &pic 16 /* 插槽10上的INT C是irq 16 */
	0x5000 0 0 4 &pic 13 /* 插槽10上的INT D是irq 13 */
	/* IDSEL 11 */
	0x5800 0 0 1 &pic 15 /* 插槽11上的INT A是irq 15 */
	0x5800 0 0 2 &pic 16 /* 插槽11上的INT B是irq 16 */
	0x5800 0 0 3 &pic 13 /* 插槽11上的INT C是irq 13 */
	0x5800 0 0 4 &pic 14 /* 插槽11上的INT D是irq 14 */
	/* IDSEL 12 */
	0x6000 0 0 1 &pic 16 /* 插槽12上的INT A是irq 16 */
	0x6000 0 0 2 &pic 13 /* 插槽12上的INT B是irq 13 */
	0x6000 0 0 3 &pic 14 /* 插槽12上的INT C是irq 14 */
	0x6000 0 0 4 &pic 15 /* 插槽12上的INT D是irq 15 */
	>;
};
```
请注意，上述翻译尽量保持了原文的技术细节和格式不变，以确保准确性和可读性。
~~~~

## Documentation/devicetree/bindings/pci/versatile_cn.yaml
```yaml
# SPDX-文件许可人: (GPL-2.0-only 或 BSD-2-Clause)
%YAML 1.2
---
$id: http://devicetree.org/schemas/pci/versatile.yaml#
$schema: http://devicetree.org/meta-schemas/core.yaml#

标题: ARM Versatile 平台基板的 PCI 接口

维护者:
  - Rob Herring <robh@kernel.org>

描述: |+
  在 ARM Versatile PB 板上的 FPGA 中找到的 PCI 主控制器
allOf:
  - $ref: /schemas/pci/pci-host-bridge.yaml#

属性:
  compatible:
    常量: arm,versatile-pci

  reg:
    项目:
      - 描述: 特定于 Versatile 的寄存器
      - 描述: 自配置空间
      - 描述: 配置空间

  ranges:
    最大项数: 3

  "#interrupt-cells": true

  interrupt-map:
    最大项数: 16

  interrupt-map-mask:
    项目:
      - 常量: 0x1800
      - 常量: 0
      - 常量: 0
      - 常量: 7

必需:
  - compatible
  - reg
  - ranges
  - "#interrupt-cells"
  - interrupt-map
  - interrupt-map-mask

未评估的属性: false

示例:
  - |
    pci@10001000 {
      compatible = "arm,versatile-pci";
      device_type = "pci";
      reg = <0x10001000 0x1000>,
            <0x41000000 0x10000>,
            <0x42000000 0x100000>;
      bus-range = <0 0xff>;
      #address-cells = <3>;
      #size-cells = <2>;
      #interrupt-cells = <1>;

      ranges =
          <0x01000000 0 0x00000000 0x43000000 0 0x00010000>,  /* 下游 I/O */
          <0x02000000 0 0x50000000 0x50000000 0 0x10000000>,  /* 不可预取内存 */
          <0x42000000 0 0x60000000 0x60000000 0 0x10000000>;  /* 可预取内存 */

      interrupt-map-mask = <0x1800 0 0 7>;
      interrupt-map = <0x1800 0 0 1 &sic 28>,
          <0x1800 0 0 2 &sic 29>,
          <0x1800 0 0 3 &sic 30>,
          <0x1800 0 0 4 &sic 27>,

          <0x1000 0 0 1 &sic 27>,
          <0x1000 0 0 2 &sic 28>,
          <0x1000 0 0 3 &sic 29>,
          <0x1000 0 0 4 &sic 30>,

          <0x0800 0 0 1 &sic 30>,
          <0x0800 0 0 2 &sic 27>,
          <0x0800 0 0 3 &sic 28>,
          <0x0800 0 0 4 &sic 29>,

          <0x0000 0 0 1 &sic 29>,
          <0x0000 0 0 2 &sic 30>,
          <0x0000 0 0 3 &sic 27>,
          <0x0000 0 0 4 &sic 28>;
    };
```

## Documentation/devicetree/bindings/pci/xgene-pci-msi_cn.txt
```
* AppliedMicro X-Gene v1 PCIe MSI 控制器

所需属性：

- compatible: 应为 "apm,xgene1-msi" 以标识
              X-Gene v1 PCIe MSI 控制器模块
- msi-controller: 表明这是一个 X-Gene v1 PCIe MSI 控制器节点
- reg: 控制器的物理基地址（0x79000000）和长度（0x900000）。这些寄存器包括 MSI 终止地址与数据寄存器以及 MSI 中断状态寄存器
- reg-names: 不需要
- interrupts: 控制器的 16 个中断输出列表，从中断编号 0x10 到 0x1f
- interrupt-names: 不需要

每个 PCIe 节点都需要有 msi-parent 属性，指向一个 MSI 控制器节点

示例：

SoC 设备树源文件（DTSI）:

	+ MSI 节点：
	msi@79000000 {
		compatible = "apm,xgene1-msi";
		msi-controller;
		reg = <0x00 0x79000000 0x0 0x900000>;
		interrupts = 	<0x0 0x10 0x4>
				<0x0 0x11 0x4>
				<0x0 0x12 0x4>
				<0x0 0x13 0x4>
				<0x0 0x14 0x4>
				<0x0 0x15 0x4>
				<0x0 0x16 0x4>
				<0x0 0x17 0x4>
				<0x0 0x18 0x4>
				<0x0 0x19 0x4>
				<0x0 0x1a 0x4>
				<0x0 0x1b 0x4>
				<0x0 0x1c 0x4>
				<0x0 0x1d 0x4>
				<0x0 0x1e 0x4>
				<0x0 0x1f 0x4>;
	};

	+ 带有指向 MSI 节点的 msi-parent 属性的 PCIe 控制器节点：
	pcie0: pcie@1f2b0000 {
		device_type = "pci";
		compatible = "apm,xgene-storm-pcie", "apm,xgene-pcie";
		#interrupt-cells = <1>;
		#size-cells = <2>;
		#address-cells = <3>;
		reg = < 0x00 0x1f2b0000 0x0 0x00010000   /* 控制器寄存器 */
			0xe0 0xd0000000 0x0 0x00040000>; /* PCI 配置空间 */
		reg-names = "csr", "cfg";
		ranges = <0x01000000 0x00 0x00000000 0xe0 0x10000000 0x00 0x00010000   /* IO */
			  0x02000000 0x00 0x80000000 0xe1 0x80000000 0x00 0x80000000>; /* 内存 */
		dma-ranges = <0x42000000 0x80 0x00000000 0x80 0x00000000 0x00 0x80000000
			      0x42000000 0x00 0x00000000 0x00 0x00000000 0x80 0x00000000>;
		interrupt-map-mask = <0x0 0x0 0x0 0x7>;
		interrupt-map = <0x0 0x0 0x0 0x1 &gic 0x0 0xc2 0x1
				 0x0 0x0 0x0 0x2 &gic 0x0 0xc3 0x1
				 0x0 0x0 0x0 0x3 &gic 0x0 0xc4 0x1
				 0x0 0x0 0x0 0x4 &gic 0x0 0xc5 0x1>;
		dma-coherent;
		clocks = <&pcie0clk 0>;
		msi-parent= <&msi>;
	};
```

## Documentation/devicetree/bindings/pci/xgene-pci_cn.txt
~~~~
此段描述了应用于AppliedMicro X-Gene服务器处理器中的PCIe接口相关的配置属性。下面是这些属性的中文翻译：

* AppliedMicro X-Gene PCIe 接口

必需属性：
- `device_type`：设置为"pci"
- `compatible`：应包含"apm,xgene-pcie"以标识核心
- `reg`：控制器寄存器集的每个物理基地址和长度的列表。对于`reg-names`属性中的每一项都必须有一个对应的条目。
- `reg-names`：必须包括以下条目：
  - `"csr"`：控制器配置寄存器
  - `"cfg"`：PCIe配置空间寄存器
- `#address-cells`：设置为 `<3>`
- `#size-cells`：设置为 `<2>`
- `ranges`：为外向内存、I/O区域的范围
- `dma-ranges`：为内向内存区域的范围
- `#interrupt-cells`：设置为 `<1>`
- `interrupt-map-mask` 和 `interrupt-map`：标准PCI属性，用于定义PCIe接口到中断号的映射
- `clocks`：从通用时钟绑定：指向PCI时钟的句柄

可选属性：
- `status`：可以是"ok"或"disabled"
- `dma-coherent`：如果DMA操作是一致的，则存在该属性

示例：

```yaml
pcie0: pcie@1f2b0000 { 
    status = "disabled"; 
    device_type = "pci"; 
    compatible = "apm,xgene-storm-pcie", "apm,xgene-pcie"; 
    #interrupt-cells = <1>; 
    #size-cells = <2>; 
    #address-cells = <3>; 
    reg = < 0x00 0x1f2b0000 0x0 0x00010000   /* 控制器寄存器 */ 
        0xe0 0xd0000000 0x0 0x00040000>; /* PCIe配置空间 */ 
    reg-names = "csr", "cfg"; 
    ranges = <0x01000000 0x00 0x00000000 0xe0 0x10000000 0x00 0x00010000   /* IO */ 
          0x02000000 0x00 0x80000000 0xe1 0x80000000 0x00 0x80000000>; /* 内存 */ 
    dma-ranges = <0x42000000 0x80 0x00000000 0x80 0x00000000 0x00 0x80000000 
              0x42000000 0x00 0x00000000 0x00 0x00000000 0x80 0x00000000>; 
    interrupt-map-mask = <0x0 0x0 0x0 0x7>; 
    interrupt-map = <0x0 0x0 0x0 0x1 &gic 0x0 0xc2 0x1 
                0x0 0x0 0x0 0x2 &gic 0x0 0xc3 0x1 
                0x0 0x0 0x0 0x3 &gic 0x0 0xc4 0x1 
                0x0 0x0 0x0 0x4 &gic 0x0 0xc5 0x1>; 
    dma-coherent; 
    clocks = <&pcie0clk 0>; 
};
```

请注意，上面的示例使用了特定的语法格式来描述硬件设备配置。这些属性通常用于设备树文件中，以在启动时告知操作系统如何正确配置和初始化硬件设备。
~~~~

## Documentation/devicetree/bindings/pci/xilinx-versal-cpm_cn.yaml
```yaml
这段 YAML 描述了针对 Xilinx Versal 系统级芯片 (SoC) 的 CPM (Configurable Platform Management) 主控制器的设备树规范。

# SPDX 许可标识符: (GPL-2.0-only 或 BSD-2-Clause)
%YAML 1.2
---
$id: http://devicetree.org/schemas/pci/xilinx-versal-cpm.yaml#
$schema: http://devicetree.org/meta-schemas/core.yaml#

title: 对于 Xilinx Versal SoC 的 CPM 主控制器设备树规范

maintainers:
  - Bharat Kumar Gogada <bharat.kumar.gogada@amd.com>

allOf:
  - $ref: /schemas/pci/pci-host-bridge.yaml#

properties:
  compatible:
    enum:
      - xlnx,versal-cpm-host-1.00
      - xlnx,versal-cpm5-host

  reg:
    items:
      - description: CPM 系统级控制和状态寄存器
      - description: 配置空间区域和桥接寄存器
      - description: CPM5 控制和状态寄存器
    minItems: 2

  reg-names:
    items:
      - const: cpm_slcr
      - const: cfg
      - const: cpm_csr
    minItems: 2

  interrupts:
    maxItems: 1

  msi-map:
    description: 映射请求者ID到MSI控制器及其相关的MSI侧带数据
    maxItems: 2

  "#interrupt-cells":
    const: 1

  interrupt-controller:
    description: 用于处理传统PCI中断的中断控制器节点
    type: object
    additionalProperties: false
    properties:
      "#address-cells":
        const: 0

      "#interrupt-cells":
        const: 1

      interrupt-controller: true

required:
  - reg
  - reg-names
  - "#interrupt-cells"
  - interrupts
  - interrupt-map
  - interrupt-map-mask
  - bus-range
  - msi-map
  - interrupt-controller

unevaluatedProperties: false

examples:
  - |

    versal {
               #address-cells = <2>;
               #size-cells = <2>;
               cpm_pcie: pcie@fca10000 {
                       compatible = "xlnx,versal-cpm-host-1.00";
                       device_type = "pci";
                       #address-cells = <3>;
                       #interrupt-cells = <1>;
                       #size-cells = <2>;
                       interrupts = <0 72 4>;
                       interrupt-parent = <&gic>;
                       interrupt-map-mask = <0 0 0 7>;
                       interrupt-map = <0 0 0 1 &pcie_intc_0 0>,
                                       <0 0 0 2 &pcie_intc_0 1>,
                                       <0 0 0 3 &pcie_intc_0 2>,
                                       <0 0 0 4 &pcie_intc_0 3>;
                       bus-range = <0x00 0xff>;
                       ranges = <0x02000000 0x0 0xe0000000 0x0 0xe0000000 0x0 0x10000000>,
                                <0x43000000 0x80 0x00000000 0x80 0x00000000 0x0 0x80000000>;
                       msi-map = <0x0 &its_gic 0x0 0x10000>;
                       reg = <0x0 0xfca10000 0x0 0x1000>,
                             <0x6 0x00000000 0x0 0x10000000>;
                       reg-names = "cpm_slcr", "cfg";
                       pcie_intc_0: interrupt-controller {
                               #address-cells = <0>;
                               #interrupt-cells = <1>;
                               interrupt-controller;
                       };
               };

               cpm5_pcie: pcie@fcdd0000 {
                       compatible = "xlnx,versal-cpm5-host";
                       device_type = "pci";
                       #address-cells = <3>;
                       #interrupt-cells = <1>;
                       #size-cells = <2>;
                       interrupts = <0 72 4>;
                       interrupt-parent = <&gic>;
                       interrupt-map-mask = <0 0 0 7>;
                       interrupt-map = <0 0 0 1 &pcie_intc_1 0>,
                                       <0 0 0 2 &pcie_intc_1 1>,
                                       <0 0 0 3 &pcie_intc_1 2>,
                                       <0 0 0 4 &pcie_intc_1 3>;
                       bus-range = <0x00 0xff>;
                       ranges = <0x02000000 0x0 0xe0000000 0x0 0xe0000000 0x0 0x10000000>,
                                <0x43000000 0x80 0x00000000 0x80 0x00000000 0x0 0x80000000>;
                       msi-map = <0x0 &its_gic 0x0 0x10000>;
                       reg = <0x00 0xfcdd0000 0x00 0x1000>,
                             <0x06 0x00000000 0x00 0x1000000>,
                             <0x00 0xfce20000 0x00 0x1000000>;
                       reg-names = "cpm_slcr", "cfg", "cpm_csr";

                       pcie_intc_1: interrupt-controller {
                               #address-cells = <0>;
                               #interrupt-cells = <1>;
                               interrupt-controller;
                       };
               };

    };
```
