## Documentation/devicetree/bindings/pci/spear13xx-pcie_cn.txt
```
SPEAr13XX PCIe DT 详情：
================================

SPEAr13XX 使用 Synopsys DesignWare PCIe 控制器和 ST MiPHY 作为 PHY 控制器。
必需的属性：
- compatible    ：应为 "st,spear1340-pcie"、"snps,dw-pcie"
- phys          ：与 PCIe 控制器关联的 PHY 节点的 phandle
- phy-names     ：必须是 "pcie-phy"
- 所有其他定义遵循通用 PCI 绑定

可选属性：
- st,pcie-is-gen1 表示需要强制初始化为第一代 (Gen1)
```

## Documentation/devicetree/bindings/pci/ti,am65-pci-ep_cn.yaml
```yaml
此文档定义了德州仪器 (TI) AM65 PCI 终端点设备树规范。

# 许可证声明：(GPL-2.0-only 或 BSD-2-Clause)
# 版权所有 (C) 2021 德州仪器公司 - http://www.ti.com/
%YAML 1.2
---
$id: http://devicetree.org/schemas/pci/ti,am65-pci-ep.yaml#
$schema: http://devicetree.org/meta-schemas/core.yaml#

标题: TI AM65 PCI 终端点

维护者:
  - Kishon Vijay Abraham I <kishon@ti.com>

allOf:
  - $ref: pci-ep.yaml#

属性:
  compatible:
    枚举:
      - ti,am654-pcie-ep

  reg:
    最大项数: 4

  reg-names:
    项:
      - 常量: app
      - 常量: dbics
      - 常量: addr_space
      - 常量: atu

  power-domains:
    最大项数: 1

  ti,syscon-pcie-mode:
    $ref: /schemas/types.yaml#/definitions/phandle-array
    项:
      - 项:
          - 描述: SYSCON 条目的 phandle
          - 描述: 在 SYSCON 中的 pcie_ctrl 寄存器偏移
    描述: 配置 PCIe 为 Root Complex (RC) 或终端点 (EP) 模式所需的 SYSCON 条目 phandle
中断:
    最小项数: 1

  dma-coherent: true

必需:
  - compatible
  - reg
  - reg-names
  - max-link-speed
  - power-domains
  - ti,syscon-pcie-mode
  - dma-coherent

未评估属性: false

示例:
  - |
    #include <dt-bindings/interrupt-controller/arm-gic.h>
    #include <dt-bindings/interrupt-controller/irq.h>
    #include <dt-bindings/soc/ti,sci_pm_domain.h>

    pcie0_ep: pcie-ep@5500000 {
        compatible = "ti,am654-pcie-ep";
        reg =  <0x5500000 0x1000>,
               <0x5501000 0x1000>,
               <0x10000000 0x8000000>,
               <0x5506000 0x1000>;
        reg-names = "app", "dbics", "addr_space", "atu";
        power-domains = <&k3_pds 120 TI_SCI_PD_EXCLUSIVE>;
        ti,syscon-pcie-mode = <&scm_conf 0x4060>;
        max-link-speed = <2>;
        dma-coherent;
        interrupts = <GIC_SPI 340 IRQ_TYPE_EDGE_RISING>;
    };
```

## Documentation/devicetree/bindings/pci/ti,am65-pci-host_cn.yaml
```yaml
以下是提供的 Device Tree (DT) 片段的中文翻译：

# SPDX-许可证标识符: (GPL-2.0-only 或 BSD-2-Clause)
# 版权所有 (C) 2021 德州仪器公司 - http://www.ti.com/
%YAML 1.2
---
$id: http://devicetree.org/schemas/pci/ti,am65-pci-host.yaml#
$schema: http://devicetree.org/meta-schemas/core.yaml#

标题: TI AM65 PCI 主控制器

维护者:
  - Kishon Vijay Abraham I <kishon@ti.com>

allOf:
  - $ref: /schemas/pci/pci-host-bridge.yaml#

属性:
  compatible:
    枚举:
      - ti,am654-pcie-rc
      - ti,keystone-pcie

  reg:
    最大项数: 4

  reg-names:
    项:
      - 常量: app
      - 常量: dbics
      - 常量: config
      - 常量: atu

  interrupts:
    最大项数: 1

  power-domains:
    最大项数: 1

  ti,syscon-pcie-id:
    $ref: /schemas/types.yaml#/definitions/phandle-array
    项:
      - 项:
          - 描述: SYSCON 条目的 phandle
          - 描述: 在 SYSCON 内的 pcie_device_id 寄存器偏移量
    描述: 获取 PCIe 设备/供应商 ID 所需的 SYSCON 条目的 phandle

  ti,syscon-pcie-mode:
    $ref: /schemas/types.yaml#/definitions/phandle-array
    项:
      - 项:
          - 描述: SYSCON 条目的 phandle
          - 描述: 在 SYSCON 内的 pcie_ctrl 寄存器偏移量
    描述: 配置 PCIe 为 RC 或 EP 模式所需的 SYSCON 条目的 phandle
msi-map: true

  dma-coherent: true

  num-viewport:
    $ref: /schemas/types.yaml#/definitions/uint32

  phys:
    描述: 每通道 PHY
    最小项数: 1
    最大项数: 2

  phy-names:
    最小项数: 1
    最大项数: 2
    项:
      正则表达式: '^pcie-phy[0-1]$'

必需:
  - compatible
  - reg
  - reg-names
  - max-link-speed
  - ti,syscon-pcie-id
  - ti,syscon-pcie-mode
  - ranges

如果:
  属性:
    compatible:
      枚举:
        - ti,am654-pcie-rc
那么:
  必需:
    - dma-coherent
    - power-domains
    - msi-map
    - num-viewport

未评估属性: false

示例:
  - |
    #include <dt-bindings/interrupt-controller/arm-gic.h>
    #include <dt-bindings/interrupt-controller/irq.h>
    #include <dt-bindings/phy/phy.h>
    #include <dt-bindings/soc/ti,sci_pm_domain.h>

    pcie0_rc: pcie@5500000 {
        compatible = "ti,am654-pcie-rc";
        reg =  <0x5500000 0x1000>,
               <0x5501000 0x1000>,
               <0x10000000 0x2000>,
               <0x5506000 0x1000>;
        reg-names = "app", "dbics", "config", "atu";
        power-domains = <&k3_pds 120 TI_SCI_PD_EXCLUSIVE>;
        #address-cells = <3>;
        #size-cells = <2>;
        ranges = <0x81000000 0 0          0x10020000 0 0x00010000>,
                 <0x82000000 0 0x10030000 0x10030000 0 0x07FD0000>;
        ti,syscon-pcie-id = <&scm_conf 0x0210>;
        ti,syscon-pcie-mode = <&scm_conf 0x4060>;
        bus-range = <0x0 0xff>;
        num-viewport = <16>;
        max-link-speed = <2>;
        dma-coherent;
        interrupts = <GIC_SPI 340 IRQ_TYPE_EDGE_RISING>;
        msi-map = <0x0 &gic_its 0x0 0x10000>;
        device_type = "pci";
        num-lanes = <1>;
        phys = <&serdes0 PHY_TYPE_PCIE 0>;
        phy-names = "pcie-phy0";
    };
```

## Documentation/devicetree/bindings/pci/ti,j721e-pci-ep_cn.yaml
```yaml
以下是提供的 Device Tree (DT) 片段的中文翻译：

# SPDX-许可证标识符: (GPL-2.0-only 或 BSD-2-Clause)
# 版权所有 (C) 2020 德州仪器公司 - http://www.ti.com/
%YAML 1.2
---
$id: http://devicetree.org/schemas/pci/ti,j721e-pci-ep.yaml#
$schema: http://devicetree.org/meta-schemas/core.yaml#

标题: TI J721E PCI EP (PCIe 封装器)

维护者:
  - Kishon Vijay Abraham I <kishon@ti.com>

属性:
  compatible:
    oneOf:
      - 常量: ti,j721e-pcie-ep
      - 常量: ti,j784s4-pcie-ep
      - 描述: AM64 中的 PCIe EP 控制器
        项:
          - 常量: ti,am64-pcie-ep
          - 常量: ti,j721e-pcie-ep
      - 描述: J7200 中的 PCIe EP 控制器
        项:
          - 常量: ti,j7200-pcie-ep
          - 常量: ti,j721e-pcie-ep

  reg:
    最大项数: 4

  reg-names:
    项:
      - 常量: intd_cfg
      - 常量: user_cfg
      - 常量: reg
      - 常量: mem

  ti,syscon-pcie-ctrl:
    $ref: /schemas/types.yaml#/definitions/phandle-array
    项:
      - 项:
          - 描述: SYSCON 入口的 phandle
          - 描述: SYSCON 内部的 pcie_ctrl 寄存器偏移
    描述: 用于配置 PCIe 模式和链路速度的指定

power-domains:
    最大项数: 1

  clocks:
    最大项数: 1
    描述: 表示输入到 PCIe 的时钟指定

  clock-names:
    项:
      - 常量: fck

  dma-coherent:
    描述: 指示 PCIe IP 块可以确保一致性

  interrupts:
    最大项数: 1

  interrupt-names:
    项:
      - 常量: link_state

allOf:
  - $ref: cdns-pcie-ep.yaml#
  - 如果:
      属性:
        compatible:
          枚举:
            - ti,am64-pcie-ep
    然后:
      属性:
        num-lanes:
          常量: 1

  - 如果:
      属性:
        compatible:
          枚举:
            - ti,j7200-pcie-ep
            - ti,j721e-pcie-ep
    然后:
      属性:
        num-lanes:
          最小值: 1
          最大值: 2

  - 如果:
      属性:
        compatible:
          枚举:
            - ti,j784s4-pcie-ep
    然后:
      属性:
        num-lanes:
          最小值: 1
          最大值: 4

必需:
  - compatible
  - reg
  - reg-names
  - ti,syscon-pcie-ctrl
  - max-link-speed
  - num-lanes
  - power-domains
  - clocks
  - clock-names
  - max-functions
  - phys
  - phy-names

未评估属性: false

示例:
  - |
    #include <dt-bindings/soc/ti,sci_pm_domain.h>

    bus {
        #address-cells = <2>;
        #size-cells = <2>;

        pcie0_ep: pcie-ep@d000000 {
           compatible = "ti,j721e-pcie-ep";
           reg = <0x00 0x02900000 0x00 0x1000>,
                 <0x00 0x02907000 0x00 0x400>,
                 <0x00 0x0d000000 0x00 0x00800000>,
                 <0x00 0x10000000 0x00 0x08000000>;
           reg-names = "intd_cfg", "user_cfg", "reg", "mem";
           ti,syscon-pcie-ctrl = <&pcie0_ctrl 0x4070>;
           max-link-speed = <3>;
           num-lanes = <2>;
           power-domains = <&k3_pds 239 TI_SCI_PD_EXCLUSIVE>;
           clocks = <&k3_clks 239 1>;
           clock-names = "fck";
           max-functions = /bits/ 8 <6>;
           dma-coherent;
           phys = <&serdes0_pcie_link>;
           phy-names = "pcie-phy";
       };
    };
```

## Documentation/devicetree/bindings/pci/ti,j721e-pci-host_cn.yaml
```yaml
以下是提供的 Device Tree (设备树) YAML 文件的中文翻译：

# SPDX 许可证标识符: (GPL-2.0-only 或 BSD-2-Clause)
# 版权所有 (C) 2019 德州仪器公司 - http://www.ti.com/
%YAML 1.2
---
$id: http://devicetree.org/schemas/pci/ti,j721e-pci-host.yaml#
$schema: http://devicetree.org/meta-schemas/core.yaml#

标题: TI J721E PCI 主控制器 (PCIe 包装器)

维护者:
  - Kishon Vijay Abraham I <kishon@ti.com>

属性:
  compatible:
    oneOf:
      - const: ti,j721e-pcie-host
      - const: ti,j784s4-pcie-host
      - 描述: AM64 中的 PCIe 控制器
        items:
          - const: ti,am64-pcie-host
          - const: ti,j721e-pcie-host
      - 描述: J7200 中的 PCIe 控制器
        items:
          - const: ti,j7200-pcie-host
          - const: ti,j721e-pcie-host
      - 描述: J722S 中的 PCIe 控制器
        items:
          - const: ti,j722s-pcie-host
          - const: ti,j721e-pcie-host

  reg:
    maxItems: 4

  reg-names:
    items:
      - const: intd_cfg
      - const: user_cfg
      - const: reg
      - const: cfg

  ti,syscon-pcie-ctrl:
    $ref: /schemas/types.yaml#/definitions/phandle-array
    items:
      - items:
          - 描述: SYSCON 条目的 phandle
          - 描述: SYSCON 内的 pcie_ctrl 寄存器偏移量
    描述: 配置 PCIe 模式和链路速度的指定项
电源域:
    maxItems: 1

  clocks:
    minItems: 1
    maxItems: 2
    描述: |+
      表示输入到 PCIe 的时钟规格，对于单个项
第二个项（如果存在）表示连接器的参考时钟
clock-names:
    minItems: 1
    items:
      - const: fck
      - const: pcie_refclk

  dma-coherent: true

  vendor-id:
    const: 0x104c

  device-id:
    enum:
      - 0xb00d
      - 0xb00f
      - 0xb010
      - 0xb012
      - 0xb013

  msi-map: true

  interrupts:
    maxItems: 1

  interrupt-names:
    items:
      - const: link_state

  interrupt-controller:
    类型: 对象
    additionalProperties: false

    属性:
      interrupt-controller: true

      '#interrupt-cells':
        const: 1

      interrupts:
        maxItems: 1

allOf:
  - $ref: cdns-pcie-host.yaml#
  - 如果:
      属性:
        compatible:
          enum:
            - ti,am64-pcie-host
    然后:
      属性:
        num-lanes:
          const: 1

  - 如果:
      属性:
        compatible:
          enum:
            - ti,j7200-pcie-host
            - ti,j721e-pcie-host
    然后:
      属性:
        num-lanes:
          最小值: 1
          最大值: 2

  - 如果:
      属性:
        compatible:
          enum:
            - ti,j784s4-pcie-host
    然后:
      属性:
        num-lanes:
          最小值: 1
          最大值: 4

必需:
  - compatible
  - reg
  - reg-names
  - ti,syscon-pcie-ctrl
  - max-link-speed
  - num-lanes
  - power-domains
  - clocks
  - clock-names
  - vendor-id
  - device-id
  - msi-map
  - dma-ranges
  - ranges
  - reset-gpios
  - phys
  - phy-names

未评估的属性: false

示例:
  - |
    #include <dt-bindings/soc/ti,sci_pm_domain.h>
    #include <dt-bindings/gpio/gpio.h>

    总线 {
        #address-cells = <2>;
        #size-cells = <2>;

        pcie0_rc: pcie@2900000 {
            compatible = "ti,j721e-pcie-host";
            reg = <0x00 0x02900000 0x00 0x1000>,
                  <0x00 0x02907000 0x00 0x400>,
                  <0x00 0x0d000000 0x00 0x00800000>,
                  <0x00 0x10000000 0x00 0x00001000>;
            reg-names = "intd_cfg", "user_cfg", "reg", "cfg";
            ti,syscon-pcie-ctrl = <&pcie0_ctrl 0x4070>;
            max-link-speed = <3>;
            num-lanes = <2>;
            power-domains = <&k3_pds 239 TI_SCI_PD_EXCLUSIVE>;
            clocks = <&k3_clks 239 1>;
            clock-names = "fck";
            device_type = "pci";
            #address-cells = <3>;
            #size-cells = <2>;
            bus-range = <0x0 0xf>;
            vendor-id = <0x104c>;
            device-id = <0xb00d>;
            msi-map = <0x0 &gic_its 0x0 0x10000>;
            dma-coherent;
            reset-gpios = <&exp1 6 GPIO_ACTIVE_HIGH>;
            phys = <&serdes0_pcie_link>;
            phy-names = "pcie-phy";
            ranges = <0x01000000 0x0 0x10001000  0x00 0x10001000  0x0 0x0010000>,
                     <0x02000000 0x0 0x10011000  0x00 0x10011000  0x0 0x7fef000>;
            dma-ranges = <0x02000000 0x0 0x0 0x0 0x0 0x10000 0x0>;
        };
    };
```

## Documentation/devicetree/bindings/pci/ti-pci_cn.txt
~~~~
TI PCI 控制器

PCIe DesignWare 控制器
- 兼容性：对于 RC（已废弃）应为 "ti,dra7-pcie"
          对于 EP（已废弃）应为 "ti,dra7-pcie-ep"
          对于 dra74x/dra76 在 RC 模式下应为 "ti,dra746-pcie-rc"
          对于 dra74x/dra76 在 EP 模式下应为 "ti,dra746-pcie-ep"
          对于 dra72x 在 RC 模式下应为 "ti,dra726-pcie-rc"
          对于 dra72x 在 EP 模式下应为 "ti,dra726-pcie-ep"
- phys：PHY 规格列表（用于通用 PHY 框架）
- phy-names：必须是 "pcie-phy0", "pcie-phy1", "pcie-phyN"…，基于 *phys* 属性中指定的 PHY 数量
- ti,hwmods：与 PCIe 关联的 hwmod 名称，格式为 "pcie<X>"，其中 <X> 是从硬件规范中得出的 PCIe 实例编号
- num-lanes：如 ../snps,dw-pcie.yaml 中所指定
- ti,syscon-lane-sel：phandle/偏移对。指向系统控制模块的 phandle 和用于指定通道选择的寄存器偏移量
主机模式
==========
- reg：根据 reg-names 属性列出的两个寄存器范围
- reg-names：第一个条目必须是 "ti-conf"，用于 TI 特定寄存器；第二个条目必须是 "rc-dbics"，用于 DesignWare PCIe 寄存器；第三个条目必须是 "config"，用于 PCIe 配置空间
- interrupts：必须指定两个中断条目。第一个用于主中断线，第二个用于 MSI 中断线
- #address-cells,
   #size-cells,
   #interrupt-cells,
   device_type,
   ranges,
   interrupt-map-mask,
   interrupt-map：如 ../snps,dw-pcie.yaml 中所指定
- ti,syscon-unaligned-access：指向 syscon 设备树节点的 phandle。第一个参数应包含在 syscon 内的寄存器偏移量，第二个参数应包含位字段以设置位启用未对齐访问
设备模式
==========
- reg：根据 reg-names 属性列出的四个寄存器范围
- reg-names："ti-conf" 用于 TI 特定寄存器；"ep_dbics" 用于作为本地访问 DIF CS 空间中的标准配置寄存器；"ep_dbics2" 用于作为本地访问 DIF CS2 空间中的标准配置寄存器；"addr_space" 用于映射远程 RC 地址空间
- interrupts：必须指定一个主中断条目
- num-ib-windows：入站地址转换窗口的数量
- num-ob-windows：出站地址转换窗口的数量
- ti,syscon-unaligned-access：指向 syscon 设备树节点的 phandle。第一个参数应包含在 syscon 内的寄存器偏移量，第二个参数应包含位字段以设置位启用未对齐访问
可选属性：
- gpios：如果需要一个 GPIO 线路来驱动 PERST# 线，则应添加此属性

注意：每个 PCI 控制器可以添加两个设备树节点：一个用于主机模式，另一个用于设备模式。因此，为了让 PCI 在主机模式下工作，必须禁用 EP 模式设备树节点；为了让 PCI 在 EP 模式下工作，必须禁用主机模式设备树节点。主机模式和 EP 模式是互斥的。
示例：
```
axi {
    compatible = "simple-bus";
    #size-cells = <1>;
    #address-cells = <1>;
    ranges = <0x51000000 0x51000000 0x3000
              0x0	     0x20000000 0x10000000>;
    pcie@51000000 {
        compatible = "ti,dra7-pcie";
        reg = <0x51000000 0x2000>, <0x51002000 0x14c>, <0x1000 0x2000>;
        reg-names = "rc_dbics", "ti_conf", "config";
        interrupts = <0 232 0x4>, <0 233 0x4>;
        #address-cells = <3>;
        #size-cells = <2>;
        device_type = "pci";
        ranges = <0x81000000 0 0          0x03000 0 0x00010000
                  0x82000000 0 0x20013000 0x13000 0 0xffed000>;
        #interrupt-cells = <1>;
        num-lanes = <1>;
        ti,hwmods = "pcie1";
        phys = <&pcie1_phy>;
        phy-names = "pcie-phy0";
        interrupt-map-mask = <0 0 0 7>;
        interrupt-map = <0 0 0 1 &pcie_intc 1>,
                        <0 0 0 2 &pcie_intc 2>,
                        <0 0 0 3 &pcie_intc 3>,
                        <0 0 0 4 &pcie_intc 4>;
        pcie_intc: interrupt-controller {
            interrupt-controller;
            #address-cells = <0>;
            #interrupt-cells = <1>;
        };
    };
};
```
~~~~
