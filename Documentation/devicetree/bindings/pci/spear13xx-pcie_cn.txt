## Documentation/devicetree/bindings/pci/xlnx,nwl-pcie_cn.yaml
~~~~yaml
这段 Device Tree 代码描述了一个 Xilinx 的 NWL PCIe 根端口桥接器。以下是翻译后的中文版本：

```yaml
# SPDX-License-Identifier: (GPL-2.0-only OR BSD-2-Clause)
%YAML 1.2
---
$id: http://devicetree.org/schemas/pci/xlnx,nwl-pcie.yaml#
$schema: http://devicetree.org/meta-schemas/core.yaml#

标题: Xilinx NWL PCIe 根端口桥接器

维护者:
  - Thippeswamy Havalige <thippeswamy.havalige@amd.com>

allOf:
  - $ref: /schemas/pci/pci-host-bridge.yaml#
  - $ref: /schemas/interrupt-controller/msi-controller.yaml#

属性:
  compatible:
    常量: xlnx,nwl-pcie-2.11

  reg:
    项目:
      - 描述: PCIe 桥接寄存器位置
- 描述: PCIe 控制器寄存器位置
- 描述: PCIe 配置空间区域
reg-names:
    项目:
      - 常量: breg
      - 常量: pcireg
      - 常量: cfg

  interrupts:
    项目:
      - 描述: 在收到杂项中断时被断言的中断
      - 描述: 未使用的中断(虚拟)
      - 描述: 在收到传统中断时被断言的中断
      - 描述: 当收到 MSI 时被断言的 msi1 中断
      - 描述: 当收到 MSI 时被断言的 msi0 中断

  interrupt-names:
    项目:
      - 常量: misc
      - 常量: dummy
      - 常量: intx
      - 常量: msi1
      - 常量: msi0

  interrupt-map-mask:
    项目:
      - 常量: 0
      - 常量: 0
      - 常量: 0
      - 常量: 7

  "#interrupt-cells":
    常量: 1

  msi-parent:
    描述: 设备能够使用的 MSI 控制器
interrupt-map:
    最大项目数: 4

  power-domains:
    最大项目数: 1

  iommus:
    最大项目数: 1

  dma-coherent:
    描述: 可选，仅在 DMA 操作是连贯的情况下需要
clocks:
    最大项目数: 1
    描述: 可选，输入时钟指定符
legacy-interrupt-controller:
    描述: 处理传统 PCI 中断的中断控制器节点
类型: 对象
    属性:
      "#address-cells":
        常量: 0

      "#interrupt-cells":
        常量: 1

      interrupt-controller: 真

    必须包含:
      - "#address-cells"
      - "#interrupt-cells"
      - interrupt-controller

    不允许额外属性: 错误

必须包含:
  - compatible
  - reg
  - reg-names
  - interrupts
  - "#interrupt-cells"
  - interrupt-map
  - interrupt-map-mask
  - msi-controller
  - power-domains

不允许未评估的属性: 错误

示例:
  - |
    #include <dt-bindings/interrupt-controller/arm-gic.h>
    #include <dt-bindings/interrupt-controller/irq.h>
    #include <dt-bindings/power/xlnx-zynqmp-power.h>
    soc {
        #address-cells = <2>;
        #size-cells = <2>;
        nwl_pcie: pcie@fd0e0000 {
            compatible = "xlnx,nwl-pcie-2.11";
            reg = <0x0 0xfd0e0000 0x0 0x1000>,
                  <0x0 0xfd480000 0x0 0x1000>,
                  <0x80 0x00000000 0x0 0x10000000>;
            reg-names = "breg", "pcireg", "cfg";
            ranges = <0x02000000 0x0 0xe0000000 0x0 0xe0000000 0x0 0x10000000>,
                     <0x43000000 0x00000006 0x0 0x00000006 0x0 0x00000002 0x0>;
            #address-cells = <3>;
            #size-cells = <2>;
            #interrupt-cells = <1>;
            msi-controller;
            device_type = "pci";
            interrupt-parent = <&gic>;
            interrupts = <GIC_SPI 118 IRQ_TYPE_LEVEL_HIGH>, <GIC_SPI 116 IRQ_TYPE_EDGE_RISING>,
                         <GIC_SPI 116 IRQ_TYPE_LEVEL_HIGH>, <GIC_SPI 115 IRQ_TYPE_EDGE_RISING>,
                         <GIC_SPI 114 IRQ_TYPE_LEVEL_HIGH>;
            interrupt-names = "misc", "dummy", "intx", "msi1", "msi0";
            interrupt-map-mask = <0x0 0x0 0x0 0x7>;
            interrupt-map = <0x0 0x0 0x0 0x1 &pcie_intc 0x1>,
                            <0x0 0x0 0x0 0x2 &pcie_intc 0x2>,
                            <0x0 0x0 0x0 0x3 &pcie_intc 0x3>,
                            <0x0 0x0 0x0 0x4 &pcie_intc 0x4>;
            msi-parent = <&nwl_pcie>;
            power-domains = <&zynqmp_firmware PD_PCIE>;
            iommus = <&smmu 0x4d0>;
            pcie_intc: legacy-interrupt-controller {
                interrupt-controller;
                #address-cells = <0>;
                #interrupt-cells = <1>;
            };
        };
    };
```

请注意，这里的翻译尽量保持了原文件的结构和格式，但部分术语和技术细节的翻译可能需要根据具体上下文进行调整。
~~~~

## Documentation/devicetree/bindings/pci/xlnx,xdma-host_cn.yaml
~~~~yaml
下面是给定 YAML 文档的中文翻译：

```yaml
# SPDX-许可证标识符: (GPL-2.0-only 或 BSD-2-Clause)
%YAML 1.2
---
$id: http://devicetree.org/schemas/pci/xlnx,xdma-host.yaml#
$schema: http://devicetree.org/meta-schemas/core.yaml#

标题: Xilinx XDMA PL PCIe 根端口桥接器

维护者:
  - Thippeswamy Havalige <thippeswamy.havalige@amd.com>

allOf:
  - $ref: /schemas/pci/pci-host-bridge.yaml#

属性:
  compatible:
    常量: xlnx,xdma-host-3.00

  reg:
    最大项数: 1

  ranges:
    最大项数: 2

  interrupts:
    项:
      - 描述: 当接收到杂项中断时断言的中断
      - 描述: 接收 MSI 时断言的 msi0 中断
      - 描述: 接收 MSI 时断言的 msi1 中断
  interrupt-names:
    项:
      - 常量: misc
      - 常量: msi0
      - 常量: msi1

  interrupt-map-mask:
    项:
      - 常量: 0
      - 常量: 0
      - 常量: 0
      - 常量: 7

  interrupt-map:
    最大项数: 4

  "#interrupt-cells":
    常量: 1

  interrupt-controller:
    描述: 标识节点为中断控制器
    类型: 对象
    属性:
      interrupt-controller: true

      "#address-cells":
        常量: 0

      "#interrupt-cells":
        常量: 1

    必需:
      - interrupt-controller
      - "#address-cells"
      - "#interrupt-cells"

    其他属性: false

必需:
  - compatible
  - reg
  - ranges
  - interrupts
  - interrupt-map
  - interrupt-map-mask
  - "#interrupt-cells"
  - interrupt-controller

未评估属性: false

示例:

  - |
    #include <dt-bindings/interrupt-controller/arm-gic.h>
    #include <dt-bindings/interrupt-controller/irq.h>

    soc {
        #address-cells = <2>;
        #size-cells = <2>;
        pcie@a0000000 {
            compatible = "xlnx,xdma-host-3.00";
            reg = <0x0 0xa0000000 0x0 0x10000000>;
            ranges = <0x2000000 0x0 0xb0000000 0x0 0xb0000000 0x0 0x1000000>,
                     <0x43000000 0x5 0x0 0x5 0x0 0x0 0x1000000>;
            #address-cells = <3>;
            #size-cells = <2>;
            #interrupt-cells = <1>;
            device_type = "pci";
            interrupt-parent = <&gic>;
            interrupts = <GIC_SPI 89 IRQ_TYPE_LEVEL_HIGH>, <GIC_SPI 90 IRQ_TYPE_LEVEL_HIGH>,
                         <GIC_SPI 91 IRQ_TYPE_LEVEL_HIGH>;
            interrupt-names = "misc", "msi0", "msi1";
            interrupt-map-mask = <0x0 0x0 0x0 0x7>;
            interrupt-map = <0 0 0 1 &pcie_intc_0 0>,
                            <0 0 0 2 &pcie_intc_0 1>,
                            <0 0 0 3 &pcie_intc_0 2>,
                            <0 0 0 4 &pcie_intc_0 3>;
            pcie_intc_0: interrupt-controller {
                #address-cells = <0>;
                #interrupt-cells = <1>;
                interrupt-controller;
            };
        };
    };
```

请注意，上述 YAML 文档中的代码和符号（例如 `#`, `$`, `%`, `|` 等）以及 YAML 结构保持不变，仅对描述性文本进行了翻译。
~~~~

## Documentation/devicetree/bindings/peci/nuvoton,npcm-peci_cn.yaml
```yaml
# SPDX-许可证标识符: (GPL-2.0-only 或 BSD-2-Clause)
%YAML 1.2
---
$id: http://devicetree.org/schemas/peci/nuvoton,npcm-peci.yaml#
$schema: http://devicetree.org/meta-schemas/core.yaml#

title: Nuvoton PECI 总线

maintainers:
  - Tomer Maimon <tmaimon77@gmail.com>

allOf:
  - $ref: peci-controller.yaml#

properties:
  compatible:
    enum:
      - nuvoton,npcm750-peci
      - nuvoton,npcm845-peci

  reg:
    maxItems: 1

  interrupts:
    maxItems: 1

  clocks:
    description:
      PECI 控制器的时钟源。应当引用 APB 时钟。
    maxItems: 1

  cmd-timeout-ms:
    minimum: 1
    maximum: 1000
    default: 1000

required:
  - compatible
  - reg
  - interrupts
  - clocks

additionalProperties: false

examples:
  - |
    #include <dt-bindings/clock/nuvoton,npcm7xx-clock.h>
    #include <dt-bindings/interrupt-controller/arm-gic.h>
    peci-controller@f0100000 {
      compatible = "nuvoton,npcm750-peci";
      reg = <0xf0100000 0x200>;
      interrupts = <GIC_SPI 6 IRQ_TYPE_LEVEL_HIGH>;
      clocks = <&clk NPCM7XX_CLK_APB3>;
      cmd-timeout-ms = <1000>;
    };
```

## Documentation/devicetree/bindings/peci/peci-aspeed_cn.yaml
```yaml
# SPDX-许可证标识符: (GPL-2.0-only 或 BSD-2-Clause)
%YAML 1.2
---
$id: http://devicetree.org/schemas/peci/peci-aspeed.yaml#
$schema: http://devicetree.org/meta-schemas/core.yaml#

title: Aspeed PECI 总线

maintainers:
  - Iwona Winiarska <iwona.winiarska@intel.com>
  - Jae Hyun Yoo <jae.hyun.yoo@linux.intel.com>

allOf:
  - $ref: peci-controller.yaml#

properties:
  compatible:
    enum:
      - aspeed,ast2400-peci
      - aspeed,ast2500-peci
      - aspeed,ast2600-peci

  reg:
    maxItems: 1

  interrupts:
    maxItems: 1

  clocks:
    description:
      PECI 控制器的时钟源。应引用外部振荡器时钟。
    maxItems: 1

  resets:
    maxItems: 1

  cmd-timeout-ms:
    minimum: 1
    maximum: 1000
    default: 1000

  clock-frequency:
    description:
      PECI 控制器期望的工作频率（赫兹Hz）
    minimum: 2000
    maximum: 2000000
    default: 1000000

required:
  - compatible
  - reg
  - interrupts
  - clocks
  - resets

additionalProperties: false

examples:
  - |
    #include <dt-bindings/interrupt-controller/arm-gic.h>
    #include <dt-bindings/clock/ast2600-clock.h>
    peci-controller@1e78b000 {
      compatible = "aspeed,ast2600-peci";
      reg = <0x1e78b000 0x100>;
      interrupts = <GIC_SPI 38 IRQ_TYPE_LEVEL_HIGH>;
      clocks = <&syscon ASPEED_CLK_GATE_REF0CLK>;
      resets = <&syscon ASPEED_RESET_PECI>;
      cmd-timeout-ms = <1000>;
      clock-frequency = <1000000>;
    };
```

## Documentation/devicetree/bindings/peci/peci-controller_cn.yaml
```yaml
# SPDX-许可证标识符: (GPL-2.0-only 或 BSD-2-Clause)
%YAML 1.2
---
$id: http://devicetree.org/schemas/peci/peci-controller.yaml#
$schema: http://devicetree.org/meta-schemas/core.yaml#

title: PECI 的通用规范

maintainers:
  - Iwona Winiarska <iwona.winiarska@intel.com>

description:
  PECI（平台环境控制接口）是一种提供从 Intel 处理器和芯片组组件到外部监控或控制设备通信通道的接口。
properties:
  $nodename:
    pattern: "^peci-controller(@.*)?$"

  cmd-timeout-ms:
    description:
      命令超时时间单位为毫秒(ms)
additionalProperties: true

examples:
  - |
    peci-controller@1e78b000 {
      reg = <0x1e78b000 0x100>;
      cmd-timeout-ms = <500>;
    };
```

## Documentation/devicetree/bindings/platform/acer,aspire1-ec_cn.yaml
```yaml
# SPDX-许可证标识符: (GPL-2.0-only 或 BSD-2-Clause)
%YAML 1.2
---
$id: http://devicetree.org/schemas/platform/acer,aspire1-ec.yaml#
$schema: http://devicetree.org/meta-schemas/core.yaml#

标题: Acer Aspire 1 嵌入式控制器

维护者:
  - Nikita Travkin <nikita@trvn.ru>

描述:
  Acer Aspire 1 笔记本电脑使用嵌入式控制器来控制电池
  和充电，同时提供一系列其他功能，例如笔记本盖状态和
  USB Type-C 显示端口替代模式的 HPD 事件。
属性:
  兼容性:
    固定值: acer,aspire1-ec

  地址:
    固定值: 0x76

  中断:
    最大项目数: 1

  连接器:
    $ref: /schemas/connector/usb-connector.yaml#

必需项:
  - 兼容性
  - 地址
  - 中断

额外属性: false

示例:
  - |
    #include <dt-bindings/interrupt-controller/irq.h>
    i2c {
        #address-cells = <1>;
        #size-cells = <0>;

        embedded-controller@76 {
            compatible = "acer,aspire1-ec";
            reg = <0x76>;

            interrupts-extended = <&tlmm 30 IRQ_TYPE_LEVEL_LOW>;

            connector {
                compatible = "usb-c-connector";

                port {
                    ec_dp_in: endpoint {
                        remote-endpoint = <&mdss_dp_out>;
                    };
                };
            };
        };
    };
```

## Documentation/devicetree/bindings/platform/lenovo,yoga-c630-ec_cn.yaml
~~~~yaml
```yaml
# SPDX-文件许可标识: (GPL-2.0-only 或 BSD-2-Clause)
%YAML 1.2
---
$id: http://devicetree.org/schemas/platform/lenovo,yoga-c630-ec.yaml#
$schema: http://devicetree.org/meta-schemas/core.yaml#

title: Lenovo Yoga C630 嵌入式控制器
maintainers:
  - Bjorn Andersson <andersson@kernel.org>

description:
  基于 Qualcomm Snapdragon 的 Lenovo Yoga C630 配备了一个嵌入式控制器 (EC)，该控制器处理诸如电池和 USB Type-C 等事务。此绑定描述了通过 I2C 总线与该 EC 的接口。
properties:
  compatible:
    const: lenovo,yoga-c630-ec

  reg:
    const: 0x70

  '#address-cells':
    const: 1

  '#size-cells':
    const: 0

  interrupts:
    maxItems: 1

patternProperties:
  '^connector@[01]$':
    $ref: /schemas/connector/usb-connector.yaml#

    properties:
      reg:
        maxItems: 1

    unevaluatedProperties: false

required:
  - compatible
  - reg
  - interrupts

additionalProperties: false

examples:
  - |+
    #include <dt-bindings/interrupt-controller/irq.h>
    i2c1 {
        clock-frequency = <400000>;

        #address-cells = <1>;
        #size-cells = <0>;

        embedded-controller@70 {
            compatible = "lenovo,yoga-c630-ec";
            reg = <0x70>;

            interrupts-extended = <&tlmm 20 IRQ_TYPE_LEVEL_HIGH>;

            #address-cells = <1>;
            #size-cells = <0>;

            connector@0 {
                compatible = "usb-c-connector";
                reg = <0>;
                power-role = "source";
                data-role = "host";
            };

            connector@1 {
                compatible = "usb-c-connector";
                reg = <1>;
                power-role = "source";
                data-role = "host";
            };
        };
    };
..
```

这段 YAML 文件定义了一个设备树的绑定，用于描述基于 Qualcomm Snapdragon 的 Lenovo Yoga C630 设备中的嵌入式控制器 (EC)。这个控制器负责管理电池和 USB Type-C 接口等功能，并且通过 I2C 总线进行通信。同时，它还定义了两个 USB Type-C 连接器的属性。
~~~~

## Documentation/devicetree/bindings/power/actions,owl-sps_cn.txt
~~~~
这段文档描述了如何在设备树（Device Tree）中配置 Actions Semi Owl 智能电源系统 (Smart Power System, SPS)。下面是翻译后的中文版本：

### Actions Semi Owl 智能电源系统 (SPS)

**必需属性：**
- **compatible** : 对于 S500 应为 `"actions,s500-sps"`
                      对于 S700 应为 `"actions,s700-sps"`
                      对于 S900 应为 `"actions,s900-sps"`
- **reg**        : 设备寄存器集的偏移量和长度
- **#power-domain-cells** : 必须是 1

**参考宏定义：**
- 对于 S500，在 `include/dt-bindings/power/owl-s500-powergate.h` 中查找
- 对于 S700，在 `include/dt-bindings/power/owl-s700-powergate.h` 中查找
- 对于 S900，在 `include/dt-bindings/power/owl-s900-powergate.h` 中查找

**示例：**

```device-tree
sps: power-controller@b01b0100 {
    compatible = "actions,s500-sps";
    reg = <0xb01b0100 0x100>;
    #power-domain-cells = <1>;
};
```

这段示例代码表示配置了一个位于地址 `0xb01b0100`、长度为 `0x100` 的智能电源控制器，兼容性设置为 `"actions,s500-sps"`，表示它适用于 S500 系列设备，并且指定了一个电源域单元格的数量为 1。
~~~~

## Documentation/devicetree/bindings/power/allwinner,sun20i-d1-ppu_cn.yaml
```yaml
# SPDX-许可证标识符: (GPL-2.0-only 或 BSD-2-Clause)
%YAML 1.2
---
$id: http://devicetree.org/schemas/power/allwinner,sun20i-d1-ppu.yaml#
$schema: http://devicetree.org/meta-schemas/core.yaml#

标题: Allwinner 系统级芯片 (SoC) 的 PPU 电源域控制器

维护者:
  - Samuel Holland <samuel@sholland.org>

描述:
  D1 和相关 SoC 包含一个用于 CPU、GPU 和视频相关硬件的电源域控制器。
属性:
  compatible:
    枚举:
      - allwinner,sun20i-d1-ppu

  reg:
    最大项数: 1

  clocks:
    描述: 总线时钟
    最大项数: 1

  resets:
    最大项数: 1

  '#power-domain-cells':
    常量: 1

必需:
  - compatible
  - reg
  - clocks
  - resets
  - '#power-domain-cells'

额外属性: false

示例:
  - |
    #include <dt-bindings/clock/sun20i-d1-r-ccu.h>
    #include <dt-bindings/reset/sun20i-d1-r-ccu.h>

    ppu: power-controller@7001000 {
        compatible = "allwinner,sun20i-d1-ppu";
        reg = <0x7001000 0x1000>;
        clocks = <&r_ccu CLK_BUS_R_PPU>;
        resets = <&r_ccu RST_BUS_R_PPU>;
        #power-domain-cells = <1>;
    };
```
