## Documentation/devicetree/bindings/power/amlogic,meson-ee-pwrc_cn.yaml
~~~~yaml
以下是提供的 YAML 文件的中文翻译：

```yaml
# SPDX-文件许可标识符: (GPL-2.0 或 BSD-2-Clause)
# 版权所有 2019 BayLibre, SAS
%YAML 1.2
---
$id: http://devicetree.org/schemas/power/amlogic,meson-ee-pwrc.yaml#
$schema: http://devicetree.org/meta-schemas/core.yaml#

标题: Amlogic Meson 其他一切电源域

维护者:
  - 尼尔·阿姆斯特朗 <neil.armstrong@linaro.org>

描述: |+
  “其他一切电源域”节点应当是具有以下所需属性的 syscon 节点的子节点:

  - 兼容性: 应当为以下内容之一:
                "amlogic,meson-gx-hhi-sysctrl", "simple-mfd", "syscon"

  参见在文档中描述的绑定
  Documentation/devicetree/bindings/mfd/syscon.yaml

属性:
  compatible:
    枚举:
      - amlogic,meson8-pwrc
      - amlogic,meson8b-pwrc
      - amlogic,meson8m2-pwrc
      - amlogic,meson-gxbb-pwrc
      - amlogic,meson-axg-pwrc
      - amlogic,meson-g12a-pwrc
      - amlogic,meson-sm1-pwrc

  clocks:
    最少项目数: 1
    最大项目数: 2

  clock-names:
    最少项目数: 1
    项目:
      - 常量: vpu
      - 常量: vapb

  resets:
    最少项目数: 5
    最大项目数: 12

  reset-names:
    最少项目数: 5
    最大项目数: 12

  "#power-domain-cells":
    常量: 1

  amlogic,ao-sysctrl:
    描述: AO sysctrl 节点的 phandle
    $ref: /schemas/types.yaml#/definitions/phandle

allOf:
  - 如果:
      属性:
        compatible:
          枚举:
            - amlogic,meson8b-pwrc
            - amlogic,meson8m2-pwrc
    那么:
      属性:
        reset-names:
          项目:
            - 常量: dblk
            - 常量: pic_dc
            - 常量: hdmi_apb
            - 常量: hdmi_system
            - 常量: venci
            - 常量: vencp
            - 常量: vdac
            - 常量: vencl
            - 常量: viu
            - 常量: venc
            - 常量: rdma
      必需:
        - resets
        - reset-names

  - 如果:
      属性:
        compatible:
          枚举:
            - amlogic,meson-gxbb-pwrc
    那么:
      属性:
        reset-names:
          项目:
            - 常量: viu
            - 常量: venc
            - 常量: vcbus
            - 常量: bt656
            - 常量: dvin
            - 常量: rdma
            - 常量: venci
            - 常量: vencp
            - 常量: vdac
            - 常量: vdi6
            - 常量: vencl
            - 常量: vid_lock
      必需:
        - resets
        - reset-names

  - 如果:
      属性:
        compatible:
          枚举:
            - amlogic,meson-axg-pwrc
    那么:
      属性:
        reset-names:
          项目:
            - 常量: viu
            - 常量: venc
            - 常量: vcbus
            - 常量: vencl
            - 常量: vid_lock
      必需:
        - resets
        - reset-names

  - 如果:
      属性:
        compatible:
          枚举:
            - amlogic,meson-g12a-pwrc
            - amlogic,meson-sm1-pwrc
    那么:
      属性:
        reset-names:
          项目:
            - 常量: viu
            - 常量: venc
            - 常量: vcbus
            - 常量: bt656
            - 常量: rdma
            - 常量: venci
            - 常量: vencp
            - 常量: vdac
            - 常量: vdi6
            - 常量: vencl
            - 常量: vid_lock
      必需:
        - resets
        - reset-names

必需:
  - compatible
  - clocks
  - clock-names
  - "#power-domain-cells"
  - amlogic,ao-sysctrl

附加属性: false

示例:
  - |
    pwrc: power-controller {
          compatible = "amlogic,meson-sm1-pwrc";
          #power-domain-cells = <1>;
          amlogic,ao-sysctrl = <&rti>;
          resets = <&reset_viu>,
                   <&reset_venc>,
                   <&reset_vcbus>,
                   <&reset_bt656>,
                   <&reset_rdma>,
                   <&reset_venci>,
                   <&reset_vencp>,
                   <&reset_vdac>,
                   <&reset_vdi6>,
                   <&reset_vencl>,
                   <&reset_vid_lock>;
          reset-names = "viu", "venc", "vcbus", "bt656",
                        "rdma", "venci", "vencp", "vdac",
                        "vdi6", "vencl", "vid_lock";
          clocks = <&clk_vpu>, <&clk_vapb>;
          clock-names = "vpu", "vapb";
    };
```

请注意，由于 YAML 的特殊格式和缩进要求，翻译时尽量保持了原有的结构和格式。
~~~~

## Documentation/devicetree/bindings/power/amlogic,meson-gx-pwrc_cn.txt
~~~~
Amlogic Meson 电源控制器（已废弃）
===========================================

Amlogic Meson 系统级芯片 (SoC) 内嵌了一个内部电源域控制器。

VPU 电源域
----------------

视频处理单元 (VPU) 电源域由这个电源控制器控制，但该域需要一些外部资源以满足正确的电源序列要求。绑定必须遵循 `power-domain.yaml` 文件中描述的电源域绑定规范。

设备树绑定：
---------------------

必需属性：
- compatible：应为以下之一：
    - 对于 Meson GX SoC，“amlogic,meson-gx-pwrc-vpu”
    - 对于 Meson G12A SoC，“amlogic,meson-g12a-pwrc-vpu”
- #power-domain-cells：应为 0
- amlogic,hhi-sysctrl：指向 HHI sysctrl 节点的句柄
- resets：指向此电源域序列所需复位线的句柄，如在 `../reset/reset.txt` 中所描述
- clocks：遵循通用时钟绑定规范：指向 VPU 和 VAPB 时钟的句柄
- clock-names：遵循通用时钟绑定规范：必须包含“vpu”、“vapb”，与 clocks 属性中的条目相对应

父节点应具有以下属性：
- compatible：“amlogic,meson-gx-ao-sysctrl”、“syscon”、“simple-mfd”
- reg：AO 系统控制寄存器空间的基地址和大小

示例：
-------
```device-tree
ao_sysctrl: sys-ctrl@0 {
	compatible = "amlogic,meson-gx-ao-sysctrl", "syscon", "simple-mfd";
	reg = <0x0 0x0 0x0 0x100>;

	pwrc_vpu: power-controller-vpu {
		compatible = "amlogic,meson-gx-pwrc-vpu";
		#power-domain-cells = <0>;
		amlogic,hhi-sysctrl = <&sysctrl>;
		resets = <&reset RESET_VIU>,
			 <&reset RESET_VENC>,
			 <&reset RESET_VCBUS>,
			 <&reset RESET_BT656>,
			 <&reset RESET_DVIN_RESET>,
			 <&reset RESET_RDMA>,
			 <&reset RESET_VENCI>,
			 <&reset RESET_VENCP>,
			 <&reset RESET_VDAC>,
			 <&reset RESET_VDI6>,
			 <&reset RESET_VENCL>,
			 <&reset RESET_VID_LOCK>;
		clocks = <&clkc CLKID_VPU>,
			 <&clkc CLKID_VAPB>;
		clock-names = "vpu", "vapb";
	};
};
```
~~~~

## Documentation/devicetree/bindings/power/amlogic,meson-sec-pwrc_cn.yaml
~~~~yaml
```yaml
# SPDX-许可证标识符: (GPL-2.0+ 或 MIT)
# 版权所有 (c) 2019 Amlogic, Inc
# 作者: 潘建欣 <jianxin.pan@amlogic.com>
%YAML 1.2
---
$id: http://devicetree.org/schemas/power/amlogic,meson-sec-pwrc.yaml#
$schema: http://devicetree.org/meta-schemas/core.yaml#

title: Amlogic Meson 安全电源域

maintainers:
  - 潘建欣 <jianxin.pan@amlogic.com>

description: |+
  在 Meson A1/C1/S4 与 C3/T7 系统级芯片中使用的安全电源域，应当作为安全监视器节点的子节点。
properties:
  compatible:
    enum:
      - amlogic,meson-a1-pwrc
      - amlogic,meson-s4-pwrc
      - amlogic,a4-pwrc
      - amlogic,a5-pwrc
      - amlogic,c3-pwrc
      - amlogic,t7-pwrc

  "#power-domain-cells":
    const: 1

required:
  - compatible
  - "#power-domain-cells"

additionalProperties: false

examples:
  - |
    secure-monitor {
        compatible = "amlogic,meson-gxbb-sm";

        pwrc: power-controller {
            compatible = "amlogic,meson-a1-pwrc";
            #power-domain-cells = <1>;
        };
    };
```

这段 YAML 文件定义了 Amlogic Meson 系列 SoC 中的安全电源域配置，并提供了示例。
~~~~

## Documentation/devicetree/bindings/power/apple,pmgr-pwrstate_cn.yaml
~~~~yaml
```yaml
# SPDX-文件许可人: (GPL-2.0-only 或 BSD-2-Clause)
%YAML 1.2
---
$id: http://devicetree.org/schemas/power/apple,pmgr-pwrstate.yaml#
$schema: http://devicetree.org/meta-schemas/core.yaml#

title: Apple SoC PMGR 电源状态

maintainers:
  - Hector Martin <marcan@marcan.st>

allOf:
  - $ref: power-domain.yaml#

description: |
  Apple 系统芯片包含负责电源管理的 PMGR 模块，
  可以控制各种时钟、复位、电源状态和性能特性。此绑定描述了设备电源状态寄存器，
  它们控制电源状态和复位。
PMGR syscon 节点内的每个电源控制器实例都代表一个通用的电源域提供者，如
  文档 Documentation/devicetree/bindings/power/power-domain.yaml 中所述。
该提供者控制单个 SoC 块。电源层次结构通过这些节点之间的 power-domains 关系表示。
参见 Documentation/devicetree/bindings/arm/apple/apple,pmgr.yaml 获取顶层 PMGR 节点文档。

properties:
  compatible:
    items:
      - enum:
          - apple,t8103-pmgr-pwrstate
          - apple,t8112-pmgr-pwrstate
          - apple,t6000-pmgr-pwrstate
      - const: apple,pmgr-pwrstate

  reg:
    maxItems: 1

  "#power-domain-cells":
    const: 0

  "#reset-cells":
    const: 0

  power-domains:
    description:
      对父级电源域的引用。一个域可以有多个父级，
      当它被加电时所有父级都会被加电
minItems: 1
    maxItems: 8 # 任意值，应该足够用

  label:
    description:
      指定所控制的 SoC 域的名称。这用于命名电源/复位域

  apple,always-on:
    description:
      强制此电源域始终处于加电状态
type: boolean

  apple,min-state:
    description:
      指定自动电源管理的最小电源状态
0 = 电源门控, 4 = 时钟门控, 15 = 开启
$ref: /schemas/types.yaml#/definitions/uint32
    minimum: 0
    maximum: 15

required:
  - compatible
  - reg
  - "#power-domain-cells"
  - "#reset-cells"
  - label

additionalProperties: false
```

请注意，某些 YAML 特定的语法（如 `$ref`）在中文翻译中无法直接呈现，但这里已经尽可能地进行了相应的解释。
~~~~
