## Documentation/devicetree/bindings/pci/qcom,pcie-sc8180x_cn.yaml
```yaml
这段 Device Tree 配置描述了 Qualcomm SC8180x SoC 的 PCI Express 根复合控制器。以下是中文翻译：

# SPDX-许可证标识符: (GPL-2.0-only 或 BSD-2-Clause)
%YAML 1.2
---
$id: http://devicetree.org/schemas/pci/qcom,pcie-sc8180x.yaml#
$schema: http://devicetree.org/meta-schemas/core.yaml#

标题: Qualcomm SC8180x PCI Express 根复合控制器

维护者:
  - Bjorn Andersson <andersson@kernel.org>
  - Manivannan Sadhasivam <manivannan.sadhasivam@linaro.org>

描述:
  Qualcomm SC8180x 系统级芯片的 PCI Express 根复合控制器基于 Synopsys DesignWare PCIe IP。

属性:
  compatible:
    常量: qcom,pcie-sc8180x

  reg:
    最小项目数: 5
    最大项目数: 6

  reg-names:
    最小项目数: 5
    项目:
      - 常量: parf # Qualcomm 特定寄存器
      - 常量: dbi # DesignWare PCIe 寄存器
      - 常量: elbi # 外部本地总线接口寄存器
      - 常量: atu # ATU 地址空间
      - 常量: config # PCI Express 配置空间
      - 常量: mhi # MHI 寄存器

  clocks:
    最小项目数: 8
    最大项目数: 8

  clock-names:
    项目:
      - 常量: pipe # PIPE 时钟
      - 常量: aux # 辅助时钟
      - 常量: cfg # 配置时钟
      - 常量: bus_master # 主 AXI 时钟
      - 常量: bus_slave # 从 AXI 时钟
      - 常量: slave_q2a # 从 Q2A 时钟
      - 常量: ref # 参考时钟
      - 常量: tbu # PCI Express TBU 时钟

  interrupts:
    最小项目数: 8
    最大项目数: 8

  interrupt-names:
    项目:
      - 常量: msi0
      - 常量: msi1
      - 常量: msi2
      - 常量: msi3
      - 常量: msi4
      - 常量: msi5
      - 常量: msi6
      - 常量: msi7

  resets:
    最大项目数: 1

  reset-names:
    项目:
      - 常量: pci

allOf:
  - $ref: qcom,pcie-common.yaml#

unevaluatedProperties: false

示例:
  - |
    #include <dt-bindings/clock/qcom,gcc-sc8180x.h>
    #include <dt-bindings/interconnect/qcom,sc8180x.h>
    #include <dt-bindings/interrupt-controller/arm-gic.h>

    soc {
        #address-cells = <2>;
        #size-cells = <2>;

        pcie@1c00000 {
            compatible = "qcom,pcie-sc8180x";
            reg = <0 0x01c00000 0 0x3000>,
                  <0 0x60000000 0 0xf1d>,
                  <0 0x60000f20 0 0xa8>,
                  <0 0x60001000 0 0x1000>,
                  <0 0x60100000 0 0x100000>;
            reg-names = "parf",
                        "dbi",
                        "elbi",
                        "atu",
                        "config";
            ranges = <0x01000000 0x0 0x60200000 0x0 0x60200000 0x0 0x100000>,
                     <0x02000000 0x0 0x60300000 0x0 0x60300000 0x0 0x3d00000>;

            bus-range = <0x00 0xff>;
            device_type = "pci";
            linux,pci-domain = <0>;
            num-lanes = <2>;

            #address-cells = <3>;
            #size-cells = <2>;

            assigned-clocks = <&gcc GCC_PCIE_0_AUX_CLK>;
            assigned-clock-rates = <19200000>;

            clocks = <&gcc GCC_PCIE_0_PIPE_CLK>,
                     <&gcc GCC_PCIE_0_AUX_CLK>,
                     <&gcc GCC_PCIE_0_CFG_AHB_CLK>,
                     <&gcc GCC_PCIE_0_MSTR_AXI_CLK>,
                     <&gcc GCC_PCIE_0_SLV_AXI_CLK>,
                     <&gcc GCC_PCIE_0_SLV_Q2A_AXI_CLK>,
                     <&gcc GCC_PCIE_0_CLKREF_CLK>,
                     <&gcc GCC_AGGRE_NOC_PCIE_TBU_CLK>;
            clock-names = "pipe",
                          "aux",
                          "cfg",
                          "bus_master",
                          "bus_slave",
                          "slave_q2a",
                          "ref",
                          "tbu";

            dma-coherent;

            interrupts = <GIC_SPI 141 IRQ_TYPE_LEVEL_HIGH>,
                         <GIC_SPI 142 IRQ_TYPE_LEVEL_HIGH>,
                         <GIC_SPI 143 IRQ_TYPE_LEVEL_HIGH>,
                         <GIC_SPI 144 IRQ_TYPE_LEVEL_HIGH>,
                         <GIC_SPI 145 IRQ_TYPE_LEVEL_HIGH>,
                         <GIC_SPI 146 IRQ_TYPE_LEVEL_HIGH>,
                         <GIC_SPI 147 IRQ_TYPE_LEVEL_HIGH>,
                         <GIC_SPI 148 IRQ_TYPE_LEVEL_HIGH>;
            interrupt-names = "msi0",
                          "msi1",
                          "msi2",
                          "msi3",
                          "msi4",
                          "msi5",
                          "msi6",
                          "msi7";
            #interrupt-cells = <1>;
            interrupt-map-mask = <0 0 0 0x7>;
            interrupt-map = <0 0 0 1 &intc 0 149 IRQ_TYPE_LEVEL_HIGH>, /* int_a */
                            <0 0 0 2 &intc 0 150 IRQ_TYPE_LEVEL_HIGH>, /* int_b */
                            <0 0 0 3 &intc 0 151 IRQ_TYPE_LEVEL_HIGH>, /* int_c */
                            <0 0 0 4 &intc 0 152 IRQ_TYPE_LEVEL_HIGH>; /* int_d */

            interconnects = <&aggre2_noc MASTER_PCIE 0 &mc_virt SLAVE_EBI_CH0 0>,
                            <&gem_noc MASTER_AMPSS_M0 0 &config_noc SLAVE_PCIE_0 0>;
            interconnect-names = "pcie-mem", "cpu-pcie";

            iommu-map = <0x0 &apps_smmu 0x1d80 0x1>,
                        <0x100 &apps_smmu 0x1d81 0x1>;

            phys = <&pcie0_phy>;
            phy-names = "pciephy";

            power-domains = <&gcc PCIE_0_GDSC>;

            resets = <&gcc GCC_PCIE_0_BCR>;
            reset-names = "pci";
        };
    };
```

## Documentation/devicetree/bindings/pci/qcom,pcie-sc8280xp_cn.yaml
~~~~yaml
下面是给定 YAML 文档的中文翻译：

```yaml
# SPDX-许可证标识符: (GPL-2.0-only 或 BSD-2-Clause)
%YAML 1.2
---
$id: http://devicetree.org/schemas/pci/qcom,pcie-sc8280xp.yaml#
$schema: http://devicetree.org/meta-schemas/core.yaml#

标题: Qualcomm SC8280XP PCI Express 根复合体控制器

维护者:
  - Bjorn Andersson <andersson@kernel.org>
  - Manivannan Sadhasivam <manivannan.sadhasivam@linaro.org>

描述:
  Qualcomm SC8280XP 系统芯片的 PCI Express 根复合体控制器基于 Synopsys 的 DesignWare PCIe IP。

属性:
  compatible:
    枚举:
      - qcom,pcie-sa8540p
      - qcom,pcie-sc8280xp

  reg:
    最小项数: 5
    最大项数: 6

  reg-names:
    最小项数: 5
    项:
      - 常量: parf # Qualcomm 特有的寄存器
      - 常量: dbi # DesignWare PCIe 寄存器
      - 常量: elbi # 外部本地总线接口寄存器
      - 常量: atu # ATU 地址空间
      - 常量: config # PCI Express 配置空间
      - 常量: mhi # MHI 寄存器

  clocks:
    最小项数: 8
    最大项数: 9

  clock-names:
    最小项数: 8
    项:
      - 常量: aux # 辅助时钟
      - 常量: cfg # 配置时钟
      - 常量: bus_master # 主 AXI 时钟
      - 常量: bus_slave # 从 AXI 时钟
      - 常量: slave_q2a # 从 Q2A 时钟
      - 常量: ddrss_sf_tbu # PCIe SF TBU 时钟
      - 常量: noc_aggr_4 # NoC 聚合 4 时钟
      - 常量: noc_aggr_south_sf # NoC 聚合 South SF 时钟
      - 常量: cnoc_qx # 配置 NoC QX 时钟

  resets:
    最大项数: 1

  reset-names:
    项:
      - 常量: pci

  vddpe-3v3-supply:
    描述: PCIe 终端电源供应的 phandle

必需:
  - interconnects
  - interconnect-names

allOf:
  - $ref: qcom,pcie-common.yaml#
  - 如果:
      属性:
        compatible:
          包含:
            枚举:
              - qcom,pcie-sc8280xp
    那么:
      属性:
        interrupts:
          最小项数: 4
          最大项数: 4
        interrupt-names:
          项:
            - 常量: msi0
            - 常量: msi1
            - 常量: msi2
            - 常量: msi3
    否则:
      属性:
        interrupts:
          最大项数: 1
        interrupt-names:
          项:
            - 常量: msi

未评估属性: false

示例:
  - |
    #include <dt-bindings/clock/qcom,gcc-sc8280xp.h>
    #include <dt-bindings/gpio/gpio.h>
    #include <dt-bindings/interconnect/qcom,sc8280xp.h>
    #include <dt-bindings/interrupt-controller/arm-gic.h>

    soc {
        #address-cells = <2>;
        #size-cells = <2>;

        pcie@1c20000 {
            compatible = "qcom,pcie-sc8280xp";
            reg = <0x0 0x01c20000 0x0 0x3000>,
                  <0x0 0x3c000000 0x0 0xf1d>,
                  <0x0 0x3c000f20 0x0 0xa8>,
                  <0x0 0x3c001000 0x0 0x1000>,
                  <0x0 0x3c100000 0x0 0x100000>,
                  <0x0 0x01c23000 0x0 0x1000>;
            reg-names = "parf", "dbi", "elbi", "atu", "config", "mhi";
            ranges = <0x01000000 0x0 0x00000000 0x0 0x3c200000 0x0 0x100000>,
                     <0x02000000 0x0 0x3c300000 0x0 0x3c300000 0x0 0x1d00000>;

            bus-range = <0x00 0xff>;
            device_type = "pci";
            linux,pci-domain = <2>;
            num-lanes = <4>;

            #address-cells = <3>;
            #size-cells = <2>;

            assigned-clocks = <&gcc GCC_PCIE_2A_AUX_CLK>;
            assigned-clock-rates = <19200000>;
            clocks = <&gcc GCC_PCIE_2A_AUX_CLK>,
                     <&gcc GCC_PCIE_2A_CFG_AHB_CLK>,
                     <&gcc GCC_PCIE_2A_MSTR_AXI_CLK>,
                     <&gcc GCC_PCIE_2A_SLV_AXI_CLK>,
                     <&gcc GCC_PCIE_2A_SLV_Q2A_AXI_CLK>,
                     <&gcc GCC_DDRSS_PCIE_SF_TBU_CLK>,
                     <&gcc GCC_AGGRE_NOC_PCIE_4_AXI_CLK>,
                     <&gcc GCC_AGGRE_NOC_PCIE_SOUTH_SF_AXI_CLK>;
            clock-names = "aux",
                          "cfg",
                          "bus_master",
                          "bus_slave",
                          "slave_q2a",
                          "ddrss_sf_tbu",
                          "noc_aggr_4",
                          "noc_aggr_south_sf";

            dma-coherent;

            interrupts = <GIC_SPI 86 IRQ_TYPE_LEVEL_HIGH>,
                         <GIC_SPI 523 IRQ_TYPE_LEVEL_HIGH>,
                         <GIC_SPI 524 IRQ_TYPE_LEVEL_HIGH>,
                         <GIC_SPI 525 IRQ_TYPE_LEVEL_HIGH>;
            interrupt-names = "msi0", "msi1", "msi2", "msi3";
            #interrupt-cells = <1>;
            interrupt-map-mask = <0 0 0 0x7>;
            interrupt-map = <0 0 0 1 &intc 0 0 GIC_SPI 530 IRQ_TYPE_LEVEL_HIGH>,
                            <0 0 0 2 &intc 0 0 GIC_SPI 531 IRQ_TYPE_LEVEL_HIGH>,
                            <0 0 0 3 &intc 0 0 GIC_SPI 532 IRQ_TYPE_LEVEL_HIGH>,
                            <0 0 0 4 &intc 0 0 GIC_SPI 533 IRQ_TYPE_LEVEL_HIGH>;

            interconnects = <&aggre2_noc MASTER_PCIE_2A 0 &mc_virt SLAVE_EBI1 0>,
                            <&gem_noc MASTER_APPSS_PROC 0 &config_noc SLAVE_PCIE_2A 0>;
            interconnect-names = "pcie-mem", "cpu-pcie";

            phys = <&pcie2a_phy>;
            phy-names = "pciephy";

            pinctrl-0 = <&pcie2a_default>;
            pinctrl-names = "default";

            power-domains = <&gcc PCIE_2A_GDSC>;

            resets = <&gcc GCC_PCIE_2A_BCR>;
            reset-names = "pci";

            perst-gpios = <&tlmm 143 GPIO_ACTIVE_LOW>;
            wake-gpios = <&tlmm 145 GPIO_ACTIVE_LOW>;
            vddpe-3v3-supply = <&vreg_nvme>;
        };
    };
```
请注意，上述翻译尽量保持了 YAML 的格式和内容的一致性。在实际使用时，请根据具体场景进行适当调整。
~~~~

## Documentation/devicetree/bindings/pci/qcom,pcie-sm8150_cn.yaml
~~~~yaml
```yaml
# SPDX-文件许可标识: (GPL-2.0-only 或 BSD-2-Clause)
%YAML 1.2
---
$id: http://devicetree.org/schemas/pci/qcom,pcie-sm8150.yaml#
$schema: http://devicetree.org/meta-schemas/core.yaml#

title: 高通 SM8150 PCI Express 根复合控制器

maintainers:
  - Bjorn Andersson <andersson@kernel.org>
  - Manivannan Sadhasivam <manivannan.sadhasivam@linaro.org>

description:
  高通 SM8150 SoC 的 PCI Express 根复合控制器基于 Synopsys
  DesignWare PCIe IP
properties:
  compatible:
    const: qcom,pcie-sm8150

  reg:
    minItems: 5
    maxItems: 6

  reg-names:
    minItems: 5
    items:
      - const: parf # 高通特定寄存器
      - const: dbi # DesignWare PCIe 寄存器
      - const: elbi # 外部本地总线接口寄存器
      - const: atu # ATU 地址空间
      - const: config # PCI Express 配置空间
      - const: mhi # MHI 寄存器

  clocks:
    minItems: 8
    maxItems: 8

  clock-names:
    items:
      - const: pipe # PIPE 时钟
      - const: aux # 辅助时钟
      - const: cfg # 配置时钟
      - const: bus_master # 主 AXI 时钟
      - const: bus_slave # 从 AXI 时钟
      - const: slave_q2a # 从 Q2A 时钟
      - const: tbu # PCI Express TBU 时钟
      - const: ref # 参考时钟

  interrupts:
    minItems: 8
    maxItems: 8

  interrupt-names:
    items:
      - const: msi0
      - const: msi1
      - const: msi2
      - const: msi3
      - const: msi4
      - const: msi5
      - const: msi6
      - const: msi7

  resets:
    maxItems: 1

  reset-names:
    items:
      - const: pci

allOf:
  - $ref: qcom,pcie-common.yaml#

unevaluatedProperties: false

examples:
  - |
    #include <dt-bindings/clock/qcom,gcc-sm8150.h>
    #include <dt-bindings/clock/qcom,rpmh.h>
    #include <dt-bindings/gpio/gpio.h>
    #include <dt-bindings/interconnect/qcom,sm8150.h>
    #include <dt-bindings/interrupt-controller/arm-gic.h>

    soc {
        #address-cells = <2>;
        #size-cells = <2>;
        pcie@1c00000 {
            compatible = "qcom,pcie-sm8150";
            reg = <0 0x01c00000 0 0x3000>,
                  <0 0x60000000 0 0xf1d>,
                  <0 0x60000f20 0 0xa8>,
                  <0 0x60001000 0 0x1000>,
                  <0 0x60100000 0 0x100000>;
            reg-names = "parf", "dbi", "elbi", "atu", "config";
            ranges = <0x01000000 0x0 0x00000000 0x0 0x60200000 0x0 0x100000>,
                     <0x02000000 0x0 0x60300000 0x0 0x60300000 0x0 0x3d00000>;

            bus-range = <0x00 0xff>;
            device_type = "pci";
            linux,pci-domain = <0>;
            num-lanes = <1>;

            #address-cells = <3>;
            #size-cells = <2>;

            clocks = <&gcc GCC_PCIE_0_PIPE_CLK>,
                     <&gcc GCC_PCIE_0_AUX_CLK>,
                     <&gcc GCC_PCIE_0_CFG_AHB_CLK>,
                     <&gcc GCC_PCIE_0_MSTR_AXI_CLK>,
                     <&gcc GCC_PCIE_0_SLV_AXI_CLK>,
                     <&gcc GCC_PCIE_0_SLV_Q2A_AXI_CLK>,
                     <&gcc GCC_AGGRE_NOC_PCIE_TBU_CLK>,
                     <&rpmhcc RPMH_CXO_CLK>;
            clock-names = "pipe",
                          "aux",
                          "cfg",
                          "bus_master",
                          "bus_slave",
                          "slave_q2a",
                          "tbu",
                          "ref";

            interrupts = <GIC_SPI 141 IRQ_TYPE_LEVEL_HIGH>,
                         <GIC_SPI 142 IRQ_TYPE_LEVEL_HIGH>,
                         <GIC_SPI 143 IRQ_TYPE_LEVEL_HIGH>,
                         <GIC_SPI 144 IRQ_TYPE_LEVEL_HIGH>,
                         <GIC_SPI 145 IRQ_TYPE_LEVEL_HIGH>,
                         <GIC_SPI 146 IRQ_TYPE_LEVEL_HIGH>,
                         <GIC_SPI 147 IRQ_TYPE_LEVEL_HIGH>,
                         <GIC_SPI 148 IRQ_TYPE_LEVEL_HIGH>;
            interrupt-names = "msi0", "msi1", "msi2", "msi3",
                              "msi4", "msi5", "msi6", "msi7";
            #interrupt-cells = <1>;
            interrupt-map-mask = <0 0 0 0x7>;
            interrupt-map = <0 0 0 1 &intc 0 149 IRQ_TYPE_LEVEL_HIGH>, /* int_a */
                            <0 0 0 2 &intc 0 150 IRQ_TYPE_LEVEL_HIGH>, /* int_b */
                            <0 0 0 3 &intc 0 151 IRQ_TYPE_LEVEL_HIGH>, /* int_c */
                            <0 0 0 4 &intc 0 152 IRQ_TYPE_LEVEL_HIGH>; /* int_d */

            iommu-map = <0x0 &apps_smmu 0x1d80 0x1>,
                        <0x100 &apps_smmu 0x1d81 0x1>;

            phys = <&pcie0_phy>;
            phy-names = "pciephy";

            pinctrl-0 = <&pcie0_default_state>;
            pinctrl-names = "default";

            power-domains = <&gcc PCIE_0_GDSC>;

            resets = <&gcc GCC_PCIE_0_BCR>;
            reset-names = "pci";

            perst-gpios = <&tlmm 35 GPIO_ACTIVE_HIGH>;
            wake-gpios = <&tlmm 37 GPIO_ACTIVE_HIGH>;
        };
    };
```
以上是将提供的 YAML 文档翻译成了中文。请注意，一些技术术语和专有名词没有翻译，因为它们在中文环境下也通常使用英文原词。
~~~~
