## Documentation/devicetree/bindings/pci/qcom,pcie-ep_cn.yaml
```yaml
下面是给定 YAML 示例的中文翻译：

---

SPDX 许可证标识符: (GPL-2.0-only 或 BSD-2-Clause)

%YAML 1.2
---
$id: http://devicetree.org/schemas/pci/qcom,pcie-ep.yaml#
$schema: http://devicetree.org/meta-schemas/core.yaml#

标题: 高通PCIe终端控制器

维护者:
  - Manivannan Sadhasivam <manivannan.sadhasivam@linaro.org>

属性:
  compatible:
    oneOf:
      - 枚举:
          - qcom,sdx55-pcie-ep
          - qcom,sm8450-pcie-ep
      - items:
          - 常量: qcom,sdx65-pcie-ep
          - 常量: qcom,sdx55-pcie-ep

  reg:
    items:
      - 描述: 高通特有 PARF 配置寄存器
      - 描述: DesignWare PCIe 寄存器
      - 描述: 外部本地总线接口寄存器
      - 描述: 地址转换单元 (ATU) 寄存器
      - 描述: 用于映射远程 RC 地址空间的内存区域
      - 描述: BAR 内存区域

  reg-names:
    items:
      - 常量: parf
      - 常量: dbi
      - 常量: elbi
      - 常量: atu
      - 常量: addr_space
      - 常量: mmio

  clocks:
    minItems: 7
    maxItems: 8

  clock-names:
    minItems: 7
    maxItems: 8

  qcom,perst-regs:
    描述: 对表示 TCSR 的系统控制寄存器的引用，后面跟着两个偏移量，分别对应 Perst 启用和 Perst 分离启用寄存器
    $ref: /schemas/types.yaml#/definitions/phandle-array
    items:
      - items:
          - 描述: 对 TCSR 系统寄存器的系统控制
          - 描述: Perst 启用偏移
          - 描述: Perst 分离启用偏移

  interrupts:
    items:
      - 描述: PCIe 全局中断
      - 描述: PCIe 门铃中断

  interrupt-names:
    items:
      - 常量: global
      - 常量: doorbell

  reset-gpios:
    描述: 作为 PERST# 输入信号的 GPIO
    maxItems: 1

  wake-gpios:
    描述: 作为 WAKE# 输出信号的 GPIO
    maxItems: 1

  interconnects:
    maxItems: 2

  interconnect-names:
    items:
      - 常量: pcie-mem
      - 常量: cpu-pcie

  resets:
    maxItems: 1

  reset-names:
    常量: core

  power-domains:
    maxItems: 1

  phys:
    maxItems: 1

  phy-names:
    常量: pciephy

  num-lanes:
    默认值: 2

必需:
  - compatible
  - reg
  - reg-names
  - clocks
  - clock-names
  - interrupts
  - interrupt-names
  - reset-gpios
  - interconnects
  - interconnect-names
  - resets
  - reset-names
  - power-domains

allOf:
  - $ref: pci-ep.yaml#
  - 如果:
      属性:
        compatible:
          包含:
            枚举:
              - qcom,sdx55-pcie-ep
    则:
      属性:
        clocks:
          items:
            - 描述: PCIe 辅助时钟
            - 描述: PCIe CFG AHB 时钟
            - 描述: PCIe 主控 AXI 时钟
            - 描述: PCIe 从属 AXI 时钟
            - 描述: PCIe 从属 Q2A AXI 时钟
            - 描述: PCIe 睡眠时钟
            - 描述: PCIe 参考时钟
        clock-names:
          items:
            - 常量: aux
            - 常量: cfg
            - 常量: bus_master
            - 常量: bus_slave
            - 常量: slave_q2a
            - 常量: sleep
            - 常量: ref

  - 如果:
      属性:
        compatible:
          包含:
            枚举:
              - qcom,sm8450-pcie-ep
    则:
      属性:
        clocks:
          items:
            - 描述: PCIe 辅助时钟
            - 描述: PCIe CFG AHB 时钟
            - 描述: PCIe 主控 AXI 时钟
            - 描述: PCIe 从属 AXI 时钟
            - 描述: PCIe 从属 Q2A AXI 时钟
            - 描述: PCIe 参考时钟
            - 描述: PCIe DDRSS SF TBU 时钟
            - 描述: PCIe AGGRE NOC AXI 时钟
        clock-names:
          items:
            - 常量: aux
            - 常量: cfg
            - 常量: bus_master
            - 常量: bus_slave
            - 常量: slave_q2a
            - 常量: ref
            - 常量: ddrss_sf_tbu
            - 常量: aggre_noc_axi

unevaluatedProperties: false

示例:
  - |
    #include <dt-bindings/clock/qcom,gcc-sdx55.h>
    #include <dt-bindings/gpio/gpio.h>
    #include <dt-bindings/interconnect/qcom,sdx55.h>
    #include <dt-bindings/interrupt-controller/arm-gic.h>

    pcie_ep: pcie-ep@1c00000 {
        compatible = "qcom,sdx55-pcie-ep";
        reg = <0x01c00000 0x3000>,
              <0x40000000 0xf1d>,
              <0x40000f20 0xc8>,
              <0x40001000 0x1000>,
              <0x40002000 0x1000>,
              <0x01c03000 0x3000>;
        reg-names = "parf", "dbi", "elbi", "atu", "addr_space",
                    "mmio";

        clocks = <&gcc GCC_PCIE_AUX_CLK>,
             <&gcc GCC_PCIE_CFG_AHB_CLK>,
             <&gcc GCC_PCIE_MSTR_AXI_CLK>,
             <&gcc GCC_PCIE_SLV_AXI_CLK>,
             <&gcc GCC_PCIE_SLV_Q2A_AXI_CLK>,
             <&gcc GCC_PCIE_SLEEP_CLK>,
             <&gcc GCC_PCIE_0_CLKREF_CLK>;
        clock-names = "aux", "cfg", "bus_master", "bus_slave",
                      "slave_q2a", "sleep", "ref";

        qcom,perst-regs = <&tcsr 0xb258 0xb270>;

        interrupts = <GIC_SPI 140 IRQ_TYPE_LEVEL_HIGH>,
                     <GIC_SPI 145 IRQ_TYPE_LEVEL_HIGH>;
        interrupt-names = "global", "doorbell";
        interconnects = <&system_noc MASTER_PCIE &mc_virt SLAVE_EBI_CH0>,
                        <&mem_noc MASTER_AMPSS_M0 &system_noc SLAVE_PCIE_0>;
        interconnect-names = "pcie-mem", "cpu-pcie";
        reset-gpios = <&tlmm 57 GPIO_ACTIVE_LOW>;
        wake-gpios = <&tlmm 53 GPIO_ACTIVE_LOW>;
        resets = <&gcc GCC_PCIE_BCR>;
        reset-names = "core";
        power-domains = <&gcc PCIE_GDSC>;
        phys = <&pcie0_lane>;
        phy-names = "pciephy";
        max-link-speed = <3>;
        num-lanes = <2>;
    };
```

## Documentation/devicetree/bindings/pci/qcom,pcie-sa8775p_cn.yaml
~~~~yaml
下面是给定 YAML 文档的中文翻译：

```yaml
# SPDX-许可证标识符: (GPL-2.0-only 或 BSD-2-Clause)
%YAML 1.2
---
$id: http://devicetree.org/schemas/pci/qcom,pcie-sa8775p.yaml#
$schema: http://devicetree.org/meta-schemas/core.yaml#

标题: Qualcomm SA8775p PCI Express 根复合控制器

维护者:
  - Bjorn Andersson <andersson@kernel.org>
  - Manivannan Sadhasivam <manivannan.sadhasivam@linaro.org>

描述:
  Qualcomm SA8775p 系统芯片的 PCIe 根复合控制器基于 Synopsys 的 DesignWare PCIe IP。

属性:
  compatible:
    常量: qcom,pcie-sa8775p

  reg:
    minItems: 6
    maxItems: 6

  reg-names:
    项:
      - 常量: parf # Qualcomm 特有的寄存器
      - 常量: dbi # DesignWare PCIe 寄存器
      - 常量: elbi # 外部本地总线接口寄存器
      - 常量: atu # ATU 地址空间
      - 常量: config # PCIe 配置空间
      - 常量: mhi # MHI 寄存器

  clocks:
    minItems: 5
    maxItems: 5

  clock-names:
    项:
      - 常量: aux # 辅助时钟
      - 常量: cfg # 配置时钟
      - 常量: bus_master # 主 AXI 时钟
      - 常量: bus_slave # 从 AXI 时钟
      - 常量: slave_q2a # 从 Q2A 时钟

  interrupts:
    minItems: 8
    maxItems: 8

  interrupt-names:
    项:
      - 常量: msi0
      - 常量: msi1
      - 常量: msi2
      - 常量: msi3
      - 常量: msi4
      - 常量: msi5
      - 常量: msi6
      - 常量: msi7

  resets:
    maxItems: 1

  reset-names:
    项:
      - 常量: pci

必需:
  - interconnects
  - interconnect-names

allOf:
  - $ref: qcom,pcie-common.yaml#

unevaluatedProperties: false

示例:
  - |
    #include <dt-bindings/clock/qcom,sa8775p-gcc.h>
    #include <dt-bindings/clock/qcom,rpmh.h>
    #include <dt-bindings/gpio/gpio.h>
    #include <dt-bindings/interrupt-controller/arm-gic.h>
    #include <dt-bindings/interconnect/qcom,sa8775p-rpmh.h>

    soc {
        #address-cells = <2>;
        #size-cells = <2>;

        pcie@1c00000 {
            compatible = "qcom,pcie-sa8775p";
            reg = <0x0 0x01c00000 0x0 0x3000>,
                  <0x0 0x40000000 0x0 0xf20>,
                  <0x0 0x40000f20 0x0 0xa8>,
                  <0x0 0x40001000 0x0 0x4000>,
                  <0x0 0x40100000 0x0 0x100000>,
                  <0x0 0x01c03000 0x0 0x1000>;
            reg-names = "parf", "dbi", "elbi", "atu", "config", "mhi";
            ranges = <0x01000000 0x0 0x00000000 0x0 0x40200000 0x0 0x100000>,
                     <0x02000000 0x0 0x40300000 0x0 0x40300000 0x0 0x1fd00000>;

            bus-range = <0x00 0xff>;
            device_type = "pci";
            linux,pci-domain = <0>;
            num-lanes = <2>;

            #address-cells = <3>;
            #size-cells = <2>;

            assigned-clocks = <&gcc GCC_PCIE_0_AUX_CLK>;
            assigned-clock-rates = <19200000>;

            clocks = <&gcc GCC_PCIE_0_AUX_CLK>,
                     <&gcc GCC_PCIE_0_CFG_AHB_CLK>,
                     <&gcc GCC_PCIE_0_MSTR_AXI_CLK>,
                     <&gcc GCC_PCIE_0_SLV_AXI_CLK>,
                     <&gcc GCC_PCIE_0_SLV_Q2A_AXI_CLK>;
            clock-names = "aux",
                          "cfg",
                          "bus_master",
                          "bus_slave",
                          "slave_q2a";

            dma-coherent;

            interrupts = <GIC_SPI 307 IRQ_TYPE_LEVEL_HIGH>,
                         <GIC_SPI 308 IRQ_TYPE_LEVEL_HIGH>,
                         <GIC_SPI 309 IRQ_TYPE_LEVEL_HIGH>,
                         <GIC_SPI 312 IRQ_TYPE_LEVEL_HIGH>,
                         <GIC_SPI 313 IRQ_TYPE_LEVEL_HIGH>,
                         <GIC_SPI 314 IRQ_TYPE_LEVEL_HIGH>,
                         <GIC_SPI 374 IRQ_TYPE_LEVEL_HIGH>,
                         <GIC_SPI 375 IRQ_TYPE_LEVEL_HIGH>;
            interrupt-names = "msi0",
                              "msi1",
                              "msi2",
                              "msi3",
                              "msi4",
                              "msi5",
                              "msi6",
                              "msi7";
            #interrupt-cells = <1>;
            interrupt-map-mask = <0 0 0 0x7>;
            interrupt-map = <0 0 0 1 &intc GIC_SPI 434 IRQ_TYPE_LEVEL_HIGH>,
                            <0 0 0 2 &intc GIC_SPI 435 IRQ_TYPE_LEVEL_HIGH>,
                            <0 0 0 3 &intc GIC_SPI 438 IRQ_TYPE_LEVEL_HIGH>,
                            <0 0 0 4 &intc GIC_SPI 439 IRQ_TYPE_LEVEL_HIGH>;

            interconnects = <&pcie_anoc MASTER_PCIE_0 0 &mc_virt SLAVE_EBI1 0>,
                            <&gem_noc MASTER_APPSS_PROC 0 &config_noc SLAVE_PCIE_0 0>;
            interconnect-names = "pcie-mem", "cpu-pcie";

            iommu-map = <0x0 &pcie_smmu 0x0000 0x1>,
                        <0x100 &pcie_smmu 0x0001 0x1>;

            phys = <&pcie0_phy>;
            phy-names = "pciephy";

            power-domains = <&gcc PCIE_0_GDSC>;

            resets = <&gcc GCC_PCIE_0_BCR>;
            reset-names = "pci";

            perst-gpios = <&tlmm 2 GPIO_ACTIVE_LOW>;
            wake-gpios = <&tlmm 0 GPIO_ACTIVE_HIGH>;
        };
    };
```

请注意，代码和配置文件中的注释及字符串已尽可能进行了翻译。由于 YAML 文件的结构特性，某些元素（如数字、符号等）保持不变。
~~~~

## Documentation/devicetree/bindings/pci/qcom,pcie-sc7280_cn.yaml
```yaml
这段 Device Tree 代码描述了 Qualcomm SC7280 SoC 中的 PCI Express 根复合控制器。下面是翻译后的中文描述：

# SPDX-License-Identifier: (GPL-2.0-only OR BSD-2-Clause)
%YAML 1.2
---
$id: http://devicetree.org/schemas/pci/qcom,pcie-sc7280.yaml#
$schema: http://devicetree.org/meta-schemas/core.yaml#

标题: Qualcomm SC7280 PCI Express 根复合控制器

维护者:
  - Bjorn Andersson <andersson@kernel.org>
  - Manivannan Sadhasivam <manivannan.sadhasivam@linaro.org>

描述:
  Qualcomm SC7280 SoC 的 PCI Express 根复合控制器基于 Synopsys DesignWare PCIe IP。

属性:
  compatible:
    常量: qcom,pcie-sc7280

  reg:
    最小项数: 5
    最大项数: 6

  reg-names:
    最小项数: 5
    项:
      - 常量: parf # Qualcomm 特定寄存器
      - 常量: dbi # DesignWare PCIe 寄存器
      - 常量: elbi # 外部本地总线接口寄存器
      - 常量: atu # ATU 地址空间
      - 常量: config # PCI Express 配置空间
      - 常量: mhi # MHI 寄存器

  clocks:
    最小项数: 13
    最大项数: 13

  clock-names:
    项:
      - 常量: pipe # PIPE 时钟
      - 常量: pipe_mux # PIPE MUX
      - 常量: phy_pipe # PIPE 输出时钟
      - 常量: ref # 参考时钟
      - 常量: aux # 辅助时钟
      - 常量: cfg # 配置时钟
      - 常量: bus_master # 主 AXI 时钟
      - 常量: bus_slave # 从 AXI 时钟
      - 常量: slave_q2a # 从 Q2A 时钟
      - 常量: tbu # PCIe TBU 时钟
      - 常量: ddrss_sf_tbu # PCIe SF TBU 时钟
      - 常量: aggre0 # Aggre NoC PCIe CENTER SF AXI 时钟
      - 常量: aggre1 # Aggre NoC PCIe1 AXI 时钟

  interrupts:
    最大项数: 1

  interrupt-names:
    项:
      - 常量: msi

  resets:
    最大项数: 1

  reset-names:
    项:
      - 常量: pci

  vddpe-3v3-supply:
    描述: PCIe 终端电源供应

allOf:
  - $ref: qcom,pcie-common.yaml#

unevaluatedProperties: false

示例:
  - |
    #include <dt-bindings/clock/qcom,gcc-sc7280.h>
    #include <dt-bindings/clock/qcom,rpmh.h>
    #include <dt-bindings/gpio/gpio.h>
    #include <dt-bindings/interrupt-controller/arm-gic.h>

    soc {
        #address-cells = <2>;
        #size-cells = <2>;

        pcie@1c08000 {
            compatible = "qcom,pcie-sc7280";
            reg = <0 0x01c08000 0 0x3000>,
                  <0 0x40000000 0 0xf1d>,
                  <0 0x40000f20 0 0xa8>,
                  <0 0x40001000 0 0x1000>,
                  <0 0x40100000 0 0x100000>;
            reg-names = "parf", "dbi", "elbi", "atu", "config";
            ranges = <0x01000000 0x0 0x00000000 0x0 0x40200000 0x0 0x100000>,
                     <0x02000000 0x0 0x40300000 0x0 0x40300000 0x0 0x1fd00000>;

            bus-range = <0x00 0xff>;
            device_type = "pci";
            linux,pci-domain = <1>;
            num-lanes = <2>;

            #address-cells = <3>;
            #size-cells = <2>;

            assigned-clocks = <&gcc GCC_PCIE_1_AUX_CLK>;
            assigned-clock-rates = <19200000>;

            clocks = <&gcc GCC_PCIE_1_PIPE_CLK>,
                     <&gcc GCC_PCIE_1_PIPE_CLK_SRC>,
                     <&pcie1_phy>,
                     <&rpmhcc RPMH_CXO_CLK>,
                     <&gcc GCC_PCIE_1_AUX_CLK>,
                     <&gcc GCC_PCIE_1_CFG_AHB_CLK>,
                     <&gcc GCC_PCIE_1_MSTR_AXI_CLK>,
                     <&gcc GCC_PCIE_1_SLV_AXI_CLK>,
                     <&gcc GCC_PCIE_1_SLV_Q2A_AXI_CLK>,
                     <&gcc GCC_AGGRE_NOC_PCIE_TBU_CLK>,
                     <&gcc GCC_DDRSS_PCIE_SF_CLK>,
                     <&gcc GCC_AGGRE_NOC_PCIE_CENTER_SF_AXI_CLK>,
                     <&gcc GCC_AGGRE_NOC_PCIE_1_AXI_CLK>;

            clock-names = "pipe",
                          "pipe_mux",
                          "phy_pipe",
                          "ref",
                          "aux",
                          "cfg",
                          "bus_master",
                          "bus_slave",
                          "slave_q2a",
                          "tbu",
                          "ddrss_sf_tbu",
                          "aggre0",
                          "aggre1";

            dma-coherent;

            interrupts = <GIC_SPI 307 IRQ_TYPE_LEVEL_HIGH>;
            interrupt-names = "msi";
            #interrupt-cells = <1>;
            interrupt-map-mask = <0 0 0 0x7>;
            interrupt-map = <0 0 0 1 &intc 0 0 0 434 IRQ_TYPE_LEVEL_HIGH>,
                            <0 0 0 2 &intc 0 0 0 435 IRQ_TYPE_LEVEL_HIGH>,
                            <0 0 0 3 &intc 0 0 0 438 IRQ_TYPE_LEVEL_HIGH>,
                            <0 0 0 4 &intc 0 0 0 439 IRQ_TYPE_LEVEL_HIGH>;

            iommu-map = <0x0 &apps_smmu 0x1c80 0x1>,
                        <0x100 &apps_smmu 0x1c81 0x1>;

            phys = <&pcie1_phy>;
            phy-names = "pciephy";

            pinctrl-names = "default";
            pinctrl-0 = <&pcie1_clkreq_n>;

            power-domains = <&gcc GCC_PCIE_1_GDSC>;

            resets = <&gcc GCC_PCIE_1_BCR>;
            reset-names = "pci";

            perst-gpios = <&tlmm 2 GPIO_ACTIVE_LOW>;
            vddpe-3v3-supply = <&pp3300_ssd>;
        };
    };

以上是 Device Tree 的配置示例，用于配置 Qualcomm SC7280 SoC 中的 PCI Express 根复合控制器。
```
