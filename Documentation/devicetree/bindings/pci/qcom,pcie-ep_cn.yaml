## Documentation/devicetree/bindings/pci/rockchip,rk3399-pcie_cn.yaml
~~~~yaml
下面是给定的 YAML 文档的中文翻译：

```yaml
# SPDX-文件许可标识: (GPL-2.0 或 BSD-2-Clause)
%YAML 1.2
---
$id: http://devicetree.org/schemas/pci/rockchip,rk3399-pcie.yaml#
$schema: http://devicetree.org/meta-schemas/core.yaml#

标题: Rockchip AXI PCIe 根端口桥接主机

维护者:
  - Shawn Lin <shawn.lin@rock-chips.com>

allOf:
  - $ref: /schemas/pci/pci-host-bridge.yaml#
  - $ref: rockchip,rk3399-pcie-common.yaml#

属性:
  compatible:
    常量: rockchip,rk3399-pcie

  reg: 真

  reg-names:
    项目:
      - 常量: axi-base
      - 常量: apb-base

  interrupts:
    最大项数: 3

  interrupt-names:
    项目:
      - 常量: sys
      - 常量: legacy
      - 常量: client

  aspm-no-l0s:
    描述: 如果使用 24MHz 振荡器为 RC 的 PHY, 需要此属性
ep-gpios:
    最大项数: 1
    描述: 预复位 GPIO

  vpcie12v-supply:
    描述: 用于 PCIe 的 12V 稳压器
vpcie3v3-supply:
    描述: 用于 PCIe 的 3.3V 稳压器
vpcie1v8-supply:
    描述: 用于 PCIe 的 1.8V 稳压器
vpcie0v9-supply:
    描述: 用于 PCIe 的 0.9V 稳压器
interrupt-controller:
    类型: 对象
    其他属性: 假

    属性:
      '#address-cells':
        常量: 0

      '#interrupt-cells':
        常量: 1

      interrupt-controller: 真

必需:
  - ranges
  - "#interrupt-cells"
  - interrupts
  - interrupt-controller
  - interrupt-map
  - interrupt-map-mask
  - msi-map

未评估属性: 假

示例:
  - |
    #include <dt-bindings/interrupt-controller/arm-gic.h>
    #include <dt-bindings/gpio/gpio.h>
    #include <dt-bindings/clock/rk3399-cru.h>

    总线 {
        #address-cells = <2>;
        #size-cells = <2>;

        pcie@f8000000 {
            compatible = "rockchip,rk3399-pcie";
            device_type = "pci";
            #address-cells = <3>;
            #size-cells = <2>;
            clocks = <&cru ACLK_PCIE>, <&cru ACLK_PERF_PCIE>,
              <&cru PCLK_PCIE>, <&cru SCLK_PCIE_PM>;
            clock-names = "aclk", "aclk-perf",
                    "hclk", "pm";
            interrupts = <GIC_SPI 49 IRQ_TYPE_LEVEL_HIGH 0>,
                  <GIC_SPI 50 IRQ_TYPE_LEVEL_HIGH 0>,
                  <GIC_SPI 51 IRQ_TYPE_LEVEL_HIGH 0>;
            interrupt-names = "sys", "legacy", "client";
            ep-gpios = <&gpio3 13 GPIO_ACTIVE_HIGH>;
            ranges = <0x83000000 0x0 0xfa000000 0x0 0xfa000000 0x0 0x600000
                0x81000000 0x0 0xfa600000 0x0 0xfa600000 0x0 0x100000>;
            num-lanes = <4>;
            msi-map = <0x0 &its 0x0 0x1000>;
            reg = <0x0 0xf8000000 0x0 0x2000000>, <0x0 0xfd000000 0x0 0x1000000>;
            reg-names = "axi-base", "apb-base";
            resets = <&cru SRST_PCIE_CORE>, <&cru SRST_PCIE_MGMT>,
              <&cru SRST_PCIE_MGMT_STICKY>, <&cru SRST_PCIE_PIPE> ,
              <&cru SRST_PCIE_PM>, <&cru SRST_P_PCIE>, <&cru SRST_A_PCIE>;
            reset-names = "core", "mgmt", "mgmt-sticky", "pipe",
                    "pm", "pclk", "aclk";
            /* 过时的旧 PHY 模型 */
            phys = <&pcie_phy>;
            phy-names = "pcie-phy";
            pinctrl-names = "default";
            pinctrl-0 = <&pcie_clkreq>;
            #interrupt-cells = <1>;
            interrupt-map-mask = <0 0 0 7>;
            interrupt-map = <0 0 0 1 &pcie0_intc 0>,
                <0 0 0 2 &pcie0_intc 1>,
                <0 0 0 3 &pcie0_intc 2>,
                <0 0 0 4 &pcie0_intc 3>;

            pcie0_intc: interrupt-controller {
                interrupt-controller;
                #address-cells = <0>;
                #interrupt-cells = <1>;
            };
        };
    };
..
```

请注意，由于 YAML 是一种结构化数据格式，并且在不同语言中语法保持一致，所以这里主要对注释和描述进行了翻译。
~~~~

## Documentation/devicetree/bindings/pci/rockchip-dw-pcie_cn.yaml
```yaml
这段 Device Tree 代码描述了基于 Rockchip 系统芯片 (SoC) 上的 Synopsys DesignWare PCIe 控制器。下面是翻译后的中文版本：

# SPDX 许可标识符: (GPL-2.0-only 或 BSD-2-Clause)
%YAML 1.2
---
$id: http://devicetree.org/schemas/pci/rockchip-dw-pcie.yaml#
$schema: http://devicetree.org/meta-schemas/core.yaml#

标题: 基于 DesignWare 的 Rockchip SoC 中的 PCIe 主控制器

维护者:
  - Shawn Lin <shawn.lin@rock-chips.com>
  - Simon Xue <xxm@rock-chips.com>
  - Heiko Stuebner <heiko@sntech.de>

描述: |+
  RK3568 系统芯片 (SoC) 的 PCIe 主控制器基于 Synopsys DesignWare PCIe IP，因此继承了在 `snps,dw-pcie.yaml` 中定义的所有通用属性。
allOf:
  - $ref: /schemas/pci/snps,dw-pcie.yaml#

属性:
  compatible:
    oneOf:
      - const: rockchip,rk3568-pcie
      - items:
          - enum:
              - rockchip,rk3588-pcie
          - const: rockchip,rk3568-pcie

  reg:
    items:
      - 描述: 数据总线接口 (DBI) 寄存器
      - 描述: Rockchip 设计的配置寄存器
      - 描述: 配置寄存器

  reg-names:
    items:
      - const: dbi
      - const: apb
      - const: config

  clocks:
    minItems: 5
    items:
      - 描述: 用于 PCIe 主机的 AHB 时钟
      - 描述: 用于 PCIe 从机的 AHB 时钟
      - 描述: 用于 PCIe DBI 的 AHB 时钟
      - 描述: 用于 PCIe 的 APB 时钟
      - 描述: 用于 PCIe 的辅助时钟
      - 描述: PIPE 时钟
      - 描述: 用于 PCIe 的参考时钟

  clock-names:
    minItems: 5
    items:
      - const: aclk_mst
      - const: aclk_slv
      - const: aclk_dbi
      - const: pclk
      - const: aux
      - const: pipe
      - const: ref

  interrupts:
    items:
      - 描述:
          组合系统中断，用于指示以下中断 - phy_link_up, dll_link_up, link_req_rst_not, hp_pme, hp, hp_msi, link_auto_bw, link_auto_bw_msi, bw_mgt, bw_mgt_msi, edma_wr, edma_rd, dpa_sub_upd, rbar_update, link_eq_req, ep_elbi_app
      - 描述:
          组合电源管理 (PM) 中断，用于指示以下中断 - linkst_in_l1sub, linkst_in_l1, linkst_in_l2, linkst_in_l0s, linkst_out_l1sub, linkst_out_l1, linkst_out_l2, linkst_out_l0s, pm_dstate_update
      - 描述:
          组合消息中断，用于指示以下中断 - ven_msg, unlock_msg, ltr_msg, cfg_pme, cfg_pme_msi, pm_pme, pm_to_ack, pm_turnoff, obff_idle, obff_obff, obff_cpu_active
      - 描述:
          组合传统中断，用于指示以下中断 - inta, intb, intc, intd
      - 描述:
          组合错误中断，用于指示以下中断 - aer_rc_err, aer_rc_err_msi, rx_cpl_timeout, tx_cpl_timeout, cor_err_sent, nf_err_sent, f_err_sent, cor_err_rx, nf_err_rx, f_err_rx, radm_qoverflow

  interrupt-names:
    items:
      - const: sys
      - const: pmc
      - const: msg
      - const: legacy
      - const: err

  legacy-interrupt-controller:
    描述: 用于处理传统 PCI 中断的中断控制器节点
类型: 对象
    additionalProperties: false
    属性:
      "#address-cells":
        const: 0

      "#interrupt-cells":
        const: 1

      interrupt-controller: true

      interrupts:
        items:
          - 描述: 组合传统中断
    必需:
      - "#address-cells"
      - "#interrupt-cells"
      - interrupt-controller
      - interrupts

  msi-map: true

  num-lanes: true

  phys:
    maxItems: 1

  phy-names:
    const: pcie-phy

  power-domains:
    maxItems: 1

  ranges:
    minItems: 2
    maxItems: 3

  resets:
    minItems: 1
    maxItems: 2

  reset-names:
    oneOf:
      - const: pipe
      - items:
          - const: pwr
          - const: pipe

  vpcie3v3-supply: true

必需:
  - compatible
  - reg
  - reg-names
  - clocks
  - clock-names
  - msi-map
  - num-lanes
  - phys
  - phy-names
  - power-domains
  - resets
  - reset-names

unevaluatedProperties: false

示例:
  - |
    #include <dt-bindings/interrupt-controller/arm-gic.h>

    bus {
        #address-cells = <2>;
        #size-cells = <2>;

        pcie3x2: pcie@fe280000 {
            compatible = "rockchip,rk3568-pcie";
            reg = <0x3 0xc0800000 0x0 0x390000>,
                  <0x0 0xfe280000 0x0 0x10000>,
                  <0x3 0x80000000 0x0 0x100000>;
            reg-names = "dbi", "apb", "config";
            bus-range = <0x20 0x2f>;
            clocks = <&cru 143>, <&cru 144>,
                     <&cru 145>, <&cru 146>,
                     <&cru 147>;
            clock-names = "aclk_mst", "aclk_slv",
                          "aclk_dbi", "pclk",
                          "aux";
            device_type = "pci";
            interrupts = <GIC_SPI 160 IRQ_TYPE_LEVEL_HIGH>,
                         <GIC_SPI 159 IRQ_TYPE_LEVEL_HIGH>,
                         <GIC_SPI 158 IRQ_TYPE_LEVEL_HIGH>,
                         <GIC_SPI 157 IRQ_TYPE_LEVEL_HIGH>,
                         <GIC_SPI 156 IRQ_TYPE_LEVEL_HIGH>;
            interrupt-names = "sys", "pmc", "msg", "legacy", "err";
            linux,pci-domain = <2>;
            max-link-speed = <2>;
            msi-map = <0x2000 &its 0x2000 0x1000>;
            num-lanes = <2>;
            phys = <&pcie30phy>;
            phy-names = "pcie-phy";
            power-domains = <&power 15>;
            ranges = <0x81000000 0x0 0x80800000 0x3 0x80800000 0x0 0x100000>,
                     <0x83000000 0x0 0x80900000 0x3 0x80900000 0x0 0x3f700000>;
            resets = <&cru 193>;
            reset-names = "pipe";
            #address-cells = <3>;
            #size-cells = <2>;

            legacy-interrupt-controller {
                interrupt-controller;
                #address-cells = <0>;
                #interrupt-cells = <1>;
                interrupt-parent = <&gic>;
                interrupts = <GIC_SPI 72 IRQ_TYPE_EDGE_RISING>;
            };
        };
    };
..
```

## Documentation/devicetree/bindings/pci/samsung,exynos-pcie_cn.yaml
```yaml
下面是给定 YAML 文档的中文翻译：

# SPDX-许可证标识符: (GPL-2.0-only 或 BSD-2-Clause)
%YAML 1.2
---
$id: http://devicetree.org/schemas/pci/samsung,exynos-pcie.yaml#
$schema: http://devicetree.org/meta-schemas/core.yaml#

title: Samsung 系列 SoC 的 PCIe 主控制器

maintainers:
  - Marek Szyprowski <m.szyprowski@samsung.com>
  - Jaehoon Chung <jh80.chung@samsung.com>

description: |+
  Exynos5433 SoC 的 PCIe 主控制器基于 Synopsys DesignWare PCIe IP，因此继承了在 snps,dw-pcie.yaml 中定义的所有通用属性。
allOf:
  - $ref: /schemas/pci/snps,dw-pcie.yaml#

properties:
  compatible:
    const: samsung,exynos5433-pcie

  reg:
    items:
      - description: 数据总线接口（DBI）寄存器
      - description: 外部局部总线接口（ELBI）寄存器
      - description: PCIe 配置空间区域
  reg-names:
    items:
      - const: dbi
      - const: elbi
      - const: config

  interrupts:
    maxItems: 1

  clocks:
    items:
      - description: PCIe 桥接时钟
      - description: PCIe 总线时钟

  clock-names:
    items:
      - const: pcie
      - const: pcie_bus

  phys:
    maxItems: 1

  vdd10-supply:
    description:
      对提供 1.0V 电源到 PCIe 块的电压调节器的句柄
  vdd18-supply:
    description:
      对提供 1.8V 电源到 PCIe 块的电压调节器的句柄
  num-lanes:
    const: 1

  num-viewport:
    const: 3

required:
  - reg
  - reg-names
  - interrupts
  - "#address-cells"
  - "#size-cells"
  - "#interrupt-cells"
  - interrupt-map
  - interrupt-map-mask
  - ranges
  - bus-range
  - device_type
  - num-lanes
  - num-viewport
  - clocks
  - clock-names
  - phys
  - vdd10-supply
  - vdd18-supply

unevaluatedProperties: false

examples:
  - |
    #include <dt-bindings/interrupt-controller/irq.h>
    #include <dt-bindings/interrupt-controller/arm-gic.h>
    #include <dt-bindings/clock/exynos5433.h>

    pcie: pcie@15700000 {
        compatible = "samsung,exynos5433-pcie";
        reg = <0x15700000 0x1000>, <0x156b0000 0x1000>, <0x0c000000 0x1000>;
        reg-names = "dbi", "elbi", "config";
        #address-cells = <3>;
        #size-cells = <2>;
        #interrupt-cells = <1>;
        device_type = "pci";
        interrupts = <GIC_SPI 245 IRQ_TYPE_LEVEL_HIGH>;
        clocks = <&cmu_fsys CLK_PCIE>, <&cmu_fsys CLK_PCLK_PCIE_PHY>;
        clock-names = "pcie", "pcie_bus";
        phys = <&pcie_phy>;
        pinctrl-0 = <&pcie_bus &pcie_wlanen>;
        pinctrl-names = "default";
        num-lanes = <1>;
        num-viewport = <3>;
        bus-range = <0x00 0xff>;
        ranges = <0x81000000 0 0     0x0c001000 0 0x00010000>,
                 <0x82000000 0 0x0c011000 0x0c011000 0 0x03feefff>;
        vdd10-supply = <&ldo6_reg>;
        vdd18-supply = <&ldo7_reg>;
        interrupt-map-mask = <0 0 0 0>;
        interrupt-map = <0 0 0 0 &gic GIC_SPI 245 IRQ_TYPE_LEVEL_HIGH>;
    };
..
```

## Documentation/devicetree/bindings/pci/sifive,fu740-pcie_cn.yaml
~~~~yaml
以下是提供的 YAML 文件的中文翻译：

```yaml
# SPDX-文件许可标识符: (GPL-2.0-only 或 BSD-2-Clause)
%YAML 1.2
---
$id: http://devicetree.org/schemas/pci/sifive,fu740-pcie.yaml#
$schema: http://devicetree.org/meta-schemas/core.yaml#

title: SiFive FU740 PCIe 主控制器

description: |+
  SiFive FU740 PCIe 主控制器基于 Synopsys DesignWare
  PCI 核心。它与 DesignWare PCIe 核心具有共同的特点，并继承了
  文档/devicetree/bindings/pci/snps,dw-pcie.yaml 中定义的通用属性。
maintainers:
  - Paul Walmsley <paul.walmsley@sifive.com>
  - Greentime Hu <greentime.hu@sifive.com>

allOf:
  - $ref: /schemas/pci/snps,dw-pcie.yaml#

properties:
  compatible:
    const: sifive,fu740-pcie

  reg:
    maxItems: 3

  reg-names:
    items:
      - const: dbi
      - const: config
      - const: mgmt

  dma-coherent: true

  num-lanes:
    const: 8

  msi-parent: true

  interrupt-names:
    items:
      - const: msi
      - const: inta
      - const: intb
      - const: intc
      - const: intd

  resets:
    description: 指向 PCIe 上电复位线的 phandle
maxItems: 1

  clocks:
    maxItems: 1

  clock-names:
    const: pcie_aux

  pwren-gpios:
    description: 应指定用于控制 PCI 总线设备上电的 GPIO
maxItems: 1

  reset-gpios:
    maxItems: 1

required:
  - dma-coherent
  - num-lanes
  - interrupts
  - interrupt-names
  - interrupt-map-mask
  - interrupt-map
  - clocks
  - clock-names
  - resets
  - pwren-gpios
  - reset-gpios

unevaluatedProperties: false

examples:
  - |
    bus {
        #address-cells = <2>;
        #size-cells = <2>;
        #include <dt-bindings/clock/sifive-fu740-prci.h>

        pcie@e00000000 {
            compatible = "sifive,fu740-pcie";
            #address-cells = <3>;
            #size-cells = <2>;
            #interrupt-cells = <1>;
            reg = <0xe 0x00000000 0x0 0x80000000>,
                  <0xd 0xf0000000 0x0 0x10000000>,
                  <0x0 0x100d0000 0x0 0x1000>;
            reg-names = "dbi", "config", "mgmt";
            device_type = "pci";
            dma-coherent;
            bus-range = <0x0 0xff>;
            ranges = <0x81000000  0x0 0x60080000  0x0 0x60080000 0x0 0x10000>,      /* I/O */
                     <0x82000000  0x0 0x60090000  0x0 0x60090000 0x0 0xff70000>,    /* mem */
                     <0x82000000  0x0 0x70000000  0x0 0x70000000 0x0 0x1000000>,    /* mem */
                     <0xc3000000 0x20 0x00000000 0x20 0x00000000 0x20 0x00000000>;  /* 可预取内存 */
            num-lanes = <0x8>;
            interrupts = <56>, <57>, <58>, <59>, <60>, <61>, <62>, <63>, <64>;
            interrupt-names = "msi", "inta", "intb", "intc", "intd";
            interrupt-parent = <&plic0>;
            interrupt-map-mask = <0x0 0x0 0x0 0x7>;
            interrupt-map = <0x0 0x0 0x0 0x1 &plic0 57>,
                            <0x0 0x0 0x0 0x2 &plic0 58>,
                            <0x0 0x0 0x0 0x3 &plic0 59>,
                            <0x0 0x0 0x0 0x4 &plic0 60>;
            clock-names = "pcie_aux";
            clocks = <&prci FU740_PRCI_CLK_PCIE_AUX>;
            resets = <&prci 4>;
            pwren-gpios = <&gpio 5 0>;
            reset-gpios = <&gpio 8 0>;
        };
    };
```

请注意，某些字段如 `phandle`、`interrupt-parent` 等在中文翻译中保留了英文名称，因为这些术语在 Device Tree 语境中通常使用其英文形式。
~~~~
