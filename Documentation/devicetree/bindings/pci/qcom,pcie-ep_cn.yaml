## Documentation/devicetree/bindings/pci/snps,dw-pcie-common_cn.yaml
```yaml
# SPDX-许可证标识符: (GPL-2.0-only OR BSD-2-Clause)
%YAML 1.2
---
$id: http://devicetree.org/schemas/pci/snps,dw-pcie-common.yaml#
$schema: http://devicetree.org/meta-schemas/core.yaml#

title: Synopsys DWC PCIe 根端口和终端控制器

maintainers:
  - Jingoo Han <jingoohan1@gmail.com>
  - Gustavo Pimentel <gustavo.pimentel@synopsys.com>

description:
  通用的 Synopsys DesignWare PCIe 根端口和终端控制器属性
select: false

properties:
  reg:
    description:
      DWC PCIe 的 CSR 空间通常通过专用的数据总线接口（DBI）访问。根据参考手册，寄存器配置空间属于配置依赖模块（CDM），并被划分为几个子部分：标准 PCIe 配置空间、端口逻辑寄存器（PL）、影子配置空间寄存器、iATU/eDMA 寄存器等。特定的子空间由 CDM/ELBI (dbi_cs) 和 CS2 (dbi_cs2) 信号（选择位）选定。这种配置为系统工程师提供了灵活的接口，可以将特定的空间映射到所需的 MMIO 地址，或者如果选择了纯本机或 AXI 桥 DBI 访问，则可以将它们保留在连续的内存空间中。请注意，PCIe CFG 空间、PL 和影子寄存器对于每个激活的功能都是特定的，而其余的子空间对于所有功能来说是共用的（如果有多个的话）。
minItems: 2
    maxItems: 7

  reg-names:
    minItems: 2
    maxItems: 7

  interrupts:
    description:
      通常有两个主要的子模块能够生成中断。它们分别是系统信息接口和 MSI 接口。前者有一些主机和终端控制器通用的 IRQ 信号，而后者显然是根复合体特有的，因为它负责处理传入的 MSI 消息信号。系统信息 IRQ 信号主要用于报告通用的 PCIe 层次结构和根复合体事件，如 VPD IO 请求、一般 AER、PME、热插拔、链路带宽变化、链路均衡请求、INTx 断言/非断言消息检测、嵌入式 DMA 发送/接收/错误等。
minItems: 1
    maxItems: 26

  interrupt-names:
    minItems: 1
    maxItems: 26

  clocks:
    description:
      DWC PCIe 参考手册明确定义了一组时钟，这些时钟对于使控制器正常工作是必需的。总体上，它们可以分为两组：“应用”时钟和“核心”时钟。请注意，平台可能在某些情况下未指定时钟源，如果相应的域是从一个共同的时钟源供电的话。
minItems: 1
    maxItems: 7

  clock-names:
    minItems: 1
    maxItems: 7
    items:
      oneOf:
        - description:
            数据总线接口（DBI）时钟。配置依赖模块的 AXI 总线接口的时钟信号，该模块基本上是一组控制器 CSR。
const: dbi
        - description:
            应用 AXI 总线主接口时钟。这基本上是控制器 DMA 接口（PCI 到 CPU）的时钟。
const: mstr
        - description:
            应用 AXI 总线从接口时钟。这是 CPU 到 PCI 内存 I/O 接口的时钟。
const: slv
        - description:
            控制器核心-PCS PIPE 接口时钟。通常由外部 PCS-PHY 提供。
const: pipe
        - description:
            控制器主时钟。假设除了复位信号外，所有输入信号都与该时钟同步。
const: core
        - description:
            控制器 PMC 域的辅助时钟。控制器分区意味着在某些电源管理状态下，某些部分需要使用这个时钟运行。
const: aux_pmc
The provided text describes configuration options and specifications for a PCIe controller, focusing on clocks, resets, and PHY interfaces. Below is a translation of the key parts into Chinese:

### 常量: aux
- **描述**:
    通用参考时钟。如果有多个接口共享同一个时钟源，建议使用此名称进行定义（例如，pipe、core 和 aux 可以连接到同一个周期信号源）。

### 常量: ref
- **描述**:
    PHY寄存器接口的时钟。最初这是一个基于PHY视图的接口，但某些平台可能有专门设计的接口。

### 常量: phy_reg
- **描述**:
    厂商特定的时钟名称。对于新的绑定，请考虑使用上述通用名称。

### oneOf:
    - **描述**: 有关详细信息，请参阅本机'dbi'时钟。
      - 枚举: [ pcie, pcie_apb_sys, aclk_dbi ]
    - **描述**: 有关详细信息，请参阅本机'mstr/slv'时钟。
      - 枚举: [ pcie_bus, pcie_inbound_axi, pcie_aclk, aclk_mst, aclk_slv ]
    - **描述**: 有关详细信息，请参阅本机'pipe'时钟。
      - 枚举: [ pcie_phy, pcie_phy_ref, link ]
    - **描述**: 有关详细信息，请参阅本机'aux'时钟。
      - 枚举: [ pcie_aux ]
    - **描述**: 有关详细信息，请参阅本机'ref'时钟。
      - 枚举: [ gio ]
    - **描述**: 有关详细信息，请参阅本机'phy_reg'时钟。
      - 枚举: [ pcie_apb_phy, pclk ]

### 重置信号(resets):
    - **描述**:
        DWC PCIe参考手册明确定义了一组需要解除断言的重置信号，以便正确激活控制器的各个部分。所有这些信号可以分为两组：应用重置和核心重置，根据它们所要复位的主要子域划分。请注意，平台可能会有一些信号未指定，如果这些信号自动处理或聚合到一个综合控制模块中。

### 最小项目数(minItems): 1
    - 最大项目数(maxItems): 10

### 重置名称(reset-names):
    - 最小项目数(minItems): 1
    - 最大项目数(maxItems): 10
    - 项目(items):
        - **Data Bus Interface (DBI) 域重置**
          - 常量(const): dbi
        - **AXI-bus Master 接口重置**
          - 常量(const): mstr
        - **AXI-bus Slave 接口重置**
          - 常量(const): slv
        - **应用程序相关接口重置**
          - 常量(const): app
        - **控制器非粘性CSR标志重置**
          - 常量(const): non-sticky
        - **控制器粘性CSR标志重置**
          - 常量(const): sticky
        - **PIPE接口（Core-PCS）逻辑重置**
          - 常量(const): pipe
        - **控制器主重置（除了PMC模块以外的所有内容）**
          - 常量(const): core
        - **PCS/PHY块重置**
          - 常量(const): phy
        - **PMC热重置信号**
          - 常量(const): hot
        - **冷重置信号**
          - 常量(const): pwr
        - **厂商特定的重置名称**。对于新的绑定，请考虑使用上述通用名称。
        - 枚举(enum):
            - **描述**: 有关详细信息，请参阅本机'app'重置。
              - 枚举: [ apps, gio, apb ]
            - **描述**: 有关详细信息，请参阅本机'phy'重置。
              - 枚举: [ pciephy, link ]
            - **描述**: 有关详细信息，请参阅本机'pwr'重置。
              - 枚举: [ turnoff ]

### PHY接口(phys):
    - **描述**:
        可以指定与线路顺序对应的最多PHY数量的phandle数组。显然，每个指定的PHY都应该能够以DWC PCIe控制器所暗示的速度在PCIe模式下工作。
    - 最小项目数(minItems): 1
    - 最大项目数(maxItems): 16

### PHY名称(phy-names):
    - 最小项目数(minItems): 1
    - 最大项目数(maxItems): 16
    - **一个选项(oneOf)**:
        - **描述**: 通用PHY名称。
          - 项(items): 
            - 模式(pattern): '^pcie[0-9]+$'
        - **描述**: 厂商特定的PHY名称。对于新的绑定，请考虑使用上述通用名称。
          - 项(items):
            - 模式(pattern): '^pcie(-?phy[0-9]*)?$'
            - 模式(pattern): '^p2u-[0-7]$'

### 通过GPIO控制的重置(reset-gpio):
    - **已弃用(deprecated):** true
    - **描述**:
        引用通过GPIO控制的PERST#信号。用于重置PCIe总线上所有外围设备。
    - 最大项目数(maxItems): 1

### 通过GPIO控制的重置(reset-gpios):
    - **描述**:
        引用通过GPIO控制的PERST#信号。用于重置PCIe总线上所有外围设备。
下面是提供的配置项及其描述的中文翻译：

最大项目数: 1

最大链接速度:
    最大值: 5

PCIe通道数量:
    描述:
        要使用的PCIe链路通道的数量。如果打算保留已激活的链路，则可以省略此设置。
    最大值: 16

出站地址转换窗口数量:
    引用: /schemas/types.yaml#/definitions/uint32
    过时: true
    描述:
        出站地址转换窗口的数量。此参数可以根据iATU内存可写性自动检测，因此没有必要为此参数设置一个专门的数据表属性。
    最大值: 256

入站地址转换窗口数量:
    引用: /schemas/types.yaml#/definitions/uint32
    过时: true
    描述:
        入站地址转换窗口的数量。与出站地址转换窗口一样，此参数可以根据iATU内存可写性自动检测，因此也没有必要为此参数设置一个专门的数据表属性。
    最大值: 256

视口数量:
    引用: /schemas/types.yaml#/definitions/uint32
    过时: true
    描述:
        硬件中配置的出站视口数量。这与出站地址转换窗口的数量相同。
    最大值: 256

snps,启用CDM检查:
    引用: /schemas/types.yaml#/definitions/flag
    描述:
        启用对CDM（配置依赖模块）寄存器进行数据损坏的自动检查。CDM寄存器包括标准PCIe配置空间寄存器、端口逻辑寄存器、DMA和iATU寄存器。该功能自DWC PCIe v4.80a版本起可用。
    DMA一致性: true

额外属性: true

...
```

## Documentation/devicetree/bindings/pci/snps,dw-pcie_cn.yaml
~~~~yaml
# SPDX-许可证标识符: GPL-2.0
%YAML 1.2
---
$id: http://devicetree.org/schemas/pci/snps,dw-pcie.yaml#
$schema: http://devicetree.org/meta-schemas/core.yaml#

标题: Synopsys DesignWare PCIe 接口

维护者:
  - Jingoo Han <jingoohan1@gmail.com>
  - Gustavo Pimentel <gustavo.pimentel@synopsys.com>

描述: |
  Synopsys DesignWare PCIe 主控制器

# 请为您的 DWC PCIe 根端口控制器创建一个单独的 DT 架构
# 并确保它被分配了特定于供应商的兼容字符串
选择:
  属性:
    compatible:
      常量: snps,dw-pcie
  必需:
    - compatible

allOf:
  - $ref: /schemas/pci/pci-host-bridge.yaml#
  - $ref: /schemas/pci/snps,dw-pcie-common.yaml#
  - 如果:
      不:
        必需:
          - msi-map
    那么:
      属性:
        interrupt-names:
          包含:
            常量: msi

属性:
  reg:
    描述:
      控制器正常工作至少需要 DBI 寄存器空间和外围设备 CFG 空间输出窗口。如果空间未展开（IP 核版本 >= 4.80a），还需要 iATU 内存 IO 区域
最小项: 2
    最大项: 7

  reg-names:
    最小项: 2
    最大项: 7
    项:
      任一:
        - 描述:
            通过 DBI 接口访问的基本 DWC PCIe 控制器配置空间。这个内存空间可以通过设置 CDM/ELBI = 0 和 CS2 = 0 激活，或者是一个包含所有空间的连续内存区域。请注意，在 v4.80a 之前的 DWC PCIe 控制器中，iATU/eDMA CSRs 是通过 PL 视图间接访问的
常量: dbi
        - 描述:
            DWC PCIe 配置空间寄存器的镜像。通过设置 CDM/ELBI = 0 和 CS2 = 1 选择此空间。这是 PCI-SIG PCIe CFG 空间与一些 PCI 头部空间、PCI 标准和扩展结构的镜像寄存器的混合。它主要适用于端点控制器配置，但仍有一些根端口模式可用的镜像寄存器
常量: dbi2
        - 描述:
            外部本地总线寄存器。这是一个通常由平台工程师定义的应用程序相关寄存器。可以通过设置 CDM/ELBI = 1 和 CS2 = 0 或通过某些平台特定方式（例如作为系统控制器的一部分）来选择此空间
枚举: [ elbi, app ]
        - 描述:
            所有设备功能共用的 iATU/eDMA 寄存器。这是一个具有内部地址转换单元和增强型 DMA 的展开内存空间，通过设置 CDM/ELBI = 1 和 CS2 = 1 来选择。对于 v4.80a 之前的 IP 核版本，这些寄存器是通过使用一组映射到 PL 空间的视图寄存器进行间接寻址方案编程的。请注意，iATU 通常映射到此区域的 0x0 地址，而 eDMA 可在 0x80000 基地址处获取
常量: atu
        - 描述:
            平台特定的 eDMA 寄存器。一些平台可能有非标准基地址的 eDMA CSRs 映射。寄存器偏移可以更改，或者可以在内存 IO 交易到达 DW PCIe 从接口之前，在附加的 RTL 块中附加地址的 MS/LS 位
常量: dma
        - 描述:
            PHY/PCS 配置寄存器。一些平台可以通过专用内存映射区域访问 PCS 和 PHY CSRs，但主要通过嵌入式 PHY 视图方案或某些平台特定方法间接访问这些寄存器
常量: phy
        - 描述:
            用于访问外围 PCIe 设备配置空间的 iATU 能力的内存区域
常量: config
        - 描述:
            特定于供应商的 CSR 名称。考虑为新的绑定使用上述通用名称
这段文档描述了与硬件配置相关的规范，特别是针对某些特定的中断和配置空间（CSR）区域。下面是翻译后的中文版本：

`oneOf`:
    - `description`: 有关详情，请参见原生 'elbi/app' CSR 区域
`enum`: [apb, mgmt, link, ulreg, appl]
    - `description`: 有关详情，请参见原生 'atu' CSR 区域
`enum`: [atu_dma]
    - `description`: 与 Syscon 相关的 CSR 区域
`enum`: [smu, mpu]
    - `description`: Tegra234 孔径
`enum`: [ecam]

`allOf`:
    - `contains`:
        `const`: dbi
    - `contains`:
        `const`: config

`interrupts`:
    `description`:
        DWC PCIe 根端口/复合体专用的中断信号。主机控制器至少应指定一个 MSI 中断信号。
`minItems`: 1
    `maxItems`: 26

`interrupt-names`:
    `minItems`: 1
    `maxItems`: 26
    `items`:
        `oneOf`:
            - `description`:
                控制器请求从/向 VPD 能力寄存器读取或写入虚拟产品数据
`const`: vpd
            - `description`:
                链路状态 2 寄存器中的链路均衡请求标志被设置（如果在链路控制 3 寄存器中启用了相应的中断）
`const`: l_eq
            - `description`:
                表明 eDMA 发送/接收传输已完成或相应通道上发生了错误。eDMA 可以有八个发送（写入）和接收（读取）eDMA 通道，总共支持最多 16 个中断信号。根据默认的 edma_int[*] 总线设置，写入 eDMA 通道应在有序行中排在首位
`pattern`: '^dma([0-9]|1[0-5])?$'
            - `description`:
                汽车/安全特性检测到 PCIe 协议可纠正错误或数据路径保护可纠正错误
`const`: sft_ce
            - `description`:
                表明内部安全机制检测到了无法纠正的错误
`const`: sft_ue
            - `description`:
                基于供应商特定事件的基础之上引发的应用程序特定的中断
The provided text describes various interrupt types and their descriptions within a PCI Express (PCIe) context, followed by an example configuration snippet using the Device Tree Format (DTF). Below is the translation into Chinese:

### 中断常量定义
- **app**: 
    - 描述: 检测到 DSP AXI MSI 中断。当不再有待处理的 MSI 中断时，该中断会被取消激活。此中断与 iMSI-RX - 集成 MSI 接收器（AXI 桥接器）相关。
- **msi**: 
    - 描述: 传统的 A/B/C/D 中断信号。基本上是由下游设备发送的 `Assert_INT{A,B,C,D}/Deassert_INT{A,B,C,D}` 消息触发的。
- **pattern**: `"^int(a|b|c|d)$"`: 
    - 描述: 检测到错误条件，并在 AER 能力的根错误状态寄存器中设置标志。当 RC 内部生成错误或收到错误消息时被激活。
- **aer**: 
    - 描述: 在端口上接收到 PME 消息。这意味着在根状态寄存器中设置了 PME 状态位（该事件应该在根控制寄存器中未被屏蔽）。
- **pme**: 
    - 描述: 检测到热插拔事件。即 Slot 状态寄存器中的某个位被设置，并且在 Slot 控制寄存器中启用了相应的事件。
- **hp**: 
    - 描述: 在 Link 状态寄存器中设置了 Link 自主带宽状态标志（该事件应该在 Link 控制寄存器中未被屏蔽）。
- **bw_au**: 
    - 描述: 在 Link 状态寄存器中设置了带宽管理状态标志（该事件应该在 Link 控制寄存器中未被屏蔽）。
- **bw_mg**: 
    - 描述: 组合的传统的 A/B/C/D 中断信号。详情见 `"^int(a|b|c|d)$"`。
- **legacy**: 
    - 描述: 厂商特定的 IRQ 名称。对于新的绑定，考虑使用上述通用名称。
- **oneOf**:
    - 描述: 参见原生 "app" IRQ 的详细信息
    - 枚举值: `[ intr, sys, pmc, msg, err ]`

### 其他属性
- **additionalProperties**: `true`

### 必须包含的属性
- **compatible**
- **reg**
- **reg-names**

### 示例配置
```plaintext
pcie@dfc00000 {
  compatible = "snps,dw-pcie";
  device_type = "pci";
  reg = <0xdfc00000 0x0001000>, /* IP 寄存器 */
        <0xd0000000 0x0002000>; /* 配置空间 */
  reg-names = "dbi", "config";
  #address-cells = <3>;
  #size-cells = <2>;
  ranges = <0x81000000 0 0x00000000 0xde000000 0 0x00010000>,
           <0x82000000 0 0xd0400000 0xd0400000 0 0x0d000000>;
  bus-range = <0x0 0xff>;

  interrupts = <25>, <24>;
  interrupt-names = "msi", "hp";
  #interrupt-cells = <1>;

  reset-gpios = <&port0 0 1>;

  phys = <&pcie_phy>;
  phy-names = "pcie";

  num-lanes = <1>;
  max-link-speed = <3>;
};
```
This configuration represents a PCIe device with specific properties and interrupts defined according to the DTF.
~~~~
