## Documentation/devicetree/bindings/pci/qcom,pcie-sm8250_cn.yaml
~~~~yaml
下面是给定 YAML 示例的中文翻译：

```yaml
# SPDX 许可证标识符: (GPL-2.0-only 或 BSD-2-Clause)
%YAML 1.2
---
$id: http://devicetree.org/schemas/pci/qcom,pcie-sm8250.yaml#
$schema: http://devicetree.org/meta-schemas/core.yaml#

标题: Qualcomm SM8250 PCI Express 根复合控制器

维护者:
  - Bjorn Andersson <andersson@kernel.org>
  - Manivannan Sadhasivam <manivannan.sadhasivam@linaro.org>

描述:
  Qualcomm SM8250 系统级芯片 (SoC) 的 PCI Express 根复合控制器基于 Synopsys DesignWare PCIe IP。
属性:
  compatible:
    常量: qcom,pcie-sm8250

  reg:
    minItems: 5
    maxItems: 6

  reg-names:
    minItems: 5
    items:
      - 常量: parf # Qualcomm 特定寄存器
      - 常量: dbi # DesignWare PCIe 寄存器
      - 常量: elbi # 外部本地总线接口寄存器
      - 常量: atu # ATU 地址空间
      - 常量: config # PCI Express 配置空间
      - 常量: mhi # MHI 寄存器

  clocks:
    minItems: 8
    maxItems: 9

  clock-names:
    # 不幸的是，“可选”的参考时钟在列表中间使用
    oneOf:
      - items:
          - 常量: pipe # PIPE 时钟
          - 常量: aux # 辅助时钟
          - 常量: cfg # 配置时钟
          - 常量: bus_master # 主 AXI 时钟
          - 常量: bus_slave # 从 AXI 时钟
          - 常量: slave_q2a # 从 Q2A 时钟
          - 常量: ref # 参考时钟
          - 常量: tbu # PCI Express TBU 时钟
          - 常量: ddrss_sf_tbu # PCI Express SF TBU 时钟
      - items:
          - 常量: pipe # PIPE 时钟
          - 常量: aux # 辅助时钟
          - 常量: cfg # 配置时钟
          - 常量: bus_master # 主 AXI 时钟
          - 常量: bus_slave # 从 AXI 时钟
          - 常量: slave_q2a # 从 Q2A 时钟
          - 常量: tbu # PCI Express TBU 时钟
          - 常量: ddrss_sf_tbu # PCI Express SF TBU 时钟

  interrupts:
    minItems: 8
    maxItems: 8

  interrupt-names:
    items:
      - 常量: msi0
      - 常量: msi1
      - 常量: msi2
      - 常量: msi3
      - 常量: msi4
      - 常量: msi5
      - 常量: msi6
      - 常量: msi7

  resets:
    maxItems: 1

  reset-names:
    items:
      - 常量: pci

allOf:
  - $ref: qcom,pcie-common.yaml#

unevaluatedProperties: false

示例:
  - |
    #include <dt-bindings/clock/qcom,gcc-sm8250.h>
    #include <dt-bindings/gpio/gpio.h>
    #include <dt-bindings/interconnect/qcom,sm8250.h>
    #include <dt-bindings/interrupt-controller/arm-gic.h>

    soc {
        #address-cells = <2>;
        #size-cells = <2>;

        pcie@1c00000 {
            compatible = "qcom,pcie-sm8250";
            reg = <0 0x01c00000 0 0x3000>,
                  <0 0x60000000 0 0xf1d>,
                  <0 0x60000f20 0 0xa8>,
                  <0 0x60001000 0 0x1000>,
                  <0 0x60100000 0 0x100000>,
                  <0 0x01c03000 0 0x1000>;
            reg-names = "parf", "dbi", "elbi", "atu", "config", "mhi";
            ranges = <0x01000000 0x0 0x00000000 0x0 0x60200000 0x0 0x100000>,
                     <0x02000000 0x0 0x60300000 0x0 0x60300000 0x0 0x3d00000>;

            bus-range = <0x00 0xff>;
            device_type = "pci";
            linux,pci-domain = <0>;
            num-lanes = <1>;

            #address-cells = <3>;
            #size-cells = <2>;

            clocks = <&gcc GCC_PCIE_0_PIPE_CLK>,
                     <&gcc GCC_PCIE_0_AUX_CLK>,
                     <&gcc GCC_PCIE_0_CFG_AHB_CLK>,
                     <&gcc GCC_PCIE_0_MSTR_AXI_CLK>,
                     <&gcc GCC_PCIE_0_SLV_AXI_CLK>,
                     <&gcc GCC_PCIE_0_SLV_Q2A_AXI_CLK>,
                     <&gcc GCC_AGGRE_NOC_PCIE_TBU_CLK>,
                     <&gcc GCC_DDRSS_PCIE_SF_TBU_CLK>;
            clock-names = "pipe",
                          "aux",
                          "cfg",
                          "bus_master",
                          "bus_slave",
                          "slave_q2a",
                          "tbu",
                          "ddrss_sf_tbu";

            dma-coherent;

            interrupts = <GIC_SPI 141 IRQ_TYPE_LEVEL_HIGH>,
                         <GIC_SPI 142 IRQ_TYPE_LEVEL_HIGH>,
                         <GIC_SPI 143 IRQ_TYPE_LEVEL_HIGH>,
                         <GIC_SPI 144 IRQ_TYPE_LEVEL_HIGH>,
                         <GIC_SPI 145 IRQ_TYPE_LEVEL_HIGH>,
                         <GIC_SPI 146 IRQ_TYPE_LEVEL_HIGH>,
                         <GIC_SPI 147 IRQ_TYPE_LEVEL_HIGH>,
                         <GIC_SPI 148 IRQ_TYPE_LEVEL_HIGH>;
            interrupt-names = "msi0", "msi1", "msi2", "msi3",
                              "msi4", "msi5", "msi6", "msi7";
            #interrupt-cells = <1>;
            interrupt-map-mask = <0 0 0 0x7>;
            interrupt-map = <0 0 0 1 &intc 0 149 IRQ_TYPE_LEVEL_HIGH>, /* int_a */
                            <0 0 0 2 &intc 0 150 IRQ_TYPE_LEVEL_HIGH>, /* int_b */
                            <0 0 0 3 &intc 0 151 IRQ_TYPE_LEVEL_HIGH>, /* int_c */
                            <0 0 0 4 &intc 0 152 IRQ_TYPE_LEVEL_HIGH>; /* int_d */

            iommu-map = <0x0 &apps_smmu 0x1c00 0x1>,
                        <0x100 &apps_smmu 0x1c01 0x1>;

            phys = <&pcie0_phy>;
            phy-names = "pciephy";

            pinctrl-0 = <&pcie0_default_state>;
            pinctrl-names = "default";

            power-domains = <&gcc PCIE_0_GDSC>;

            resets = <&gcc GCC_PCIE_0_BCR>;
            reset-names = "pci";

            perst-gpios = <&tlmm 79 GPIO_ACTIVE_LOW>;
            wake-gpios = <&tlmm 81 GPIO_ACTIVE_HIGH>;
        };
    };
```

请注意，由于 YAML 是一种格式规范，并且上述内容是 Device Tree 的描述，因此翻译时尽量保持了原有的结构和语法。```
~~~~

## Documentation/devicetree/bindings/pci/qcom,pcie-sm8350_cn.yaml
```yaml
这段 Device Tree 配置描述了 Qualcomm SM8350 系统级芯片 (SoC) 中的 PCI Express 根复合控制器。下面是配置的中文翻译：

# SPDX-许可证标识符: (GPL-2.0-only 或 BSD-2-Clause)
%YAML 1.2
---
$id: http://devicetree.org/schemas/pci/qcom,pcie-sm8350.yaml#
$schema: http://devicetree.org/meta-schemas/core.yaml#

标题: Qualcomm SM8350 PCI Express 根复合控制器

维护者:
  - Bjorn Andersson <andersson@kernel.org>
  - Manivannan Sadhasivam <manivannan.sadhasivam@linaro.org>

描述:
  Qualcomm SM8350 系统级芯片 (SoC) 的 PCI Express 根复合控制器基于 Synopsys
  DesignWare PCIe IP。

属性:
  compatible:
    常量: qcom,pcie-sm8350

  reg:
    最小项目数: 5
    最大项目数: 6

  reg-names:
    最小项目数: 5
    项目:
      - 常量: parf # Qualcomm 特定寄存器
      - 常量: dbi # DesignWare PCIe 寄存器
      - 常量: elbi # 外部本地总线接口寄存器
      - 常量: atu # ATU 地址空间
      - 常量: config # PCIe 配置空间
      - 常量: mhi # MHI 寄存器

  clocks:
    最小项目数: 8
    最大项目数: 9

  clock-names:
    最小项目数: 8
    项目:
      - 常量: aux # 辅助时钟
      - 常量: cfg # 配置时钟
      - 常量: bus_master # 主 AXI 时钟
      - 常量: bus_slave # 从 AXI 时钟
      - 常量: slave_q2a # 从 Q2A 时钟
      - 常量: tbu # PCIe TBU 时钟
      - 常量: ddrss_sf_tbu # PCIe SF TBU 时钟
      - 常量: aggre1 # Aggre NoC PCIe1 AXI 时钟
      - 常量: aggre0 # Aggre NoC PCIe0 AXI 时钟

  interrupts:
    最小项目数: 8
    最大项目数: 8

  interrupt-names:
    项目:
      - 常量: msi0
      - 常量: msi1
      - 常量: msi2
      - 常量: msi3
      - 常量: msi4
      - 常量: msi5
      - 常量: msi6
      - 常量: msi7

  resets:
    最大项目数: 1

  reset-names:
    项目:
      - 常量: pci

allOf:
  - $ref: qcom,pcie-common.yaml#

unevaluatedProperties: false

示例:
  - |
    #include <dt-bindings/clock/qcom,gcc-sm8350.h>
    #include <dt-bindings/gpio/gpio.h>
    #include <dt-bindings/interconnect/qcom,sm8350.h>
    #include <dt-bindings/interrupt-controller/arm-gic.h>

    soc {
        #address-cells = <2>;
        #size-cells = <2>;

        pcie@1c00000 {
            compatible = "qcom,pcie-sm8350";
            reg = <0 0x01c00000 0 0x3000>,
                  <0 0x60000000 0 0xf1d>,
                  <0 0x60000f20 0 0xa8>,
                  <0 0x60001000 0 0x1000>,
                  <0 0x60100000 0 0x100000>;
            reg-names = "parf", "dbi", "elbi", "atu", "config";
            ranges = <0x01000000 0x0 0x00000000 0x0 0x60200000 0x0 0x100000>,
                     <0x02000000 0x0 0x60300000 0x0 0x60300000 0x0 0x3d00000>;

            bus-range = <0x00 0xff>;
            device_type = "pci";
            linux,pci-domain = <0>;
            num-lanes = <1>;

            #address-cells = <3>;
            #size-cells = <2>;

            clocks = <&gcc GCC_PCIE_0_AUX_CLK>,
                     <&gcc GCC_PCIE_0_CFG_AHB_CLK>,
                     <&gcc GCC_PCIE_0_MSTR_AXI_CLK>,
                     <&gcc GCC_PCIE_0_SLV_AXI_CLK>,
                     <&gcc GCC_PCIE_0_SLV_Q2A_AXI_CLK>,
                     <&gcc GCC_AGGRE_NOC_PCIE_TBU_CLK>,
                     <&gcc GCC_DDRSS_PCIE_SF_TBU_CLK>,
                     <&gcc GCC_AGGRE_NOC_PCIE_1_AXI_CLK>,
                     <&gcc GCC_AGGRE_NOC_PCIE_0_AXI_CLK>;
            clock-names = "aux",
                          "cfg",
                          "bus_master",
                          "bus_slave",
                          "slave_q2a",
                          "tbu",
                          "ddrss_sf_tbu",
                          "aggre1",
                          "aggre0";

            interrupts = <GIC_SPI 141 IRQ_TYPE_LEVEL_HIGH>,
                         <GIC_SPI 142 IRQ_TYPE_LEVEL_HIGH>,
                         <GIC_SPI 143 IRQ_TYPE_LEVEL_HIGH>,
                         <GIC_SPI 144 IRQ_TYPE_LEVEL_HIGH>,
                         <GIC_SPI 145 IRQ_TYPE_LEVEL_HIGH>,
                         <GIC_SPI 146 IRQ_TYPE_LEVEL_HIGH>,
                         <GIC_SPI 147 IRQ_TYPE_LEVEL_HIGH>,
                         <GIC_SPI 148 IRQ_TYPE_LEVEL_HIGH>;
            interrupt-names = "msi0", "msi1", "msi2", "msi3",
                              "msi4", "msi5", "msi6", "msi7";
            #interrupt-cells = <1>;
            interrupt-map-mask = <0 0 0 0x7>;
            interrupt-map = <0 0 0 1 &intc 0 149 IRQ_TYPE_LEVEL_HIGH>, /* int_a */
                            <0 0 0 2 &intc 0 150 IRQ_TYPE_LEVEL_HIGH>, /* int_b */
                            <0 0 0 3 &intc 0 151 IRQ_TYPE_LEVEL_HIGH>, /* int_c */
                            <0 0 0 4 &intc 0 152 IRQ_TYPE_LEVEL_HIGH>; /* int_d */

            iommu-map = <0x0 &apps_smmu 0x1c00 0x1>,
                        <0x100 &apps_smmu 0x1c01 0x1>;

            phys = <&pcie0_phy>;
            phy-names = "pciephy";

            pinctrl-0 = <&pcie0_default_state>;
            pinctrl-names = "default";

            power-domains = <&gcc PCIE_0_GDSC>;

            resets = <&gcc GCC_PCIE_0_BCR>;
            reset-names = "pci";

            perst-gpios = <&tlmm 94 GPIO_ACTIVE_LOW>;
            wake-gpios = <&tlmm 96 GPIO_ACTIVE_HIGH>;
        };
    };

请注意，以上是 Device Tree 配置文件的一部分，用于描述 Qualcomm SM8350 SoC 中的 PCI Express 根复合控制器的具体配置。
```

## Documentation/devicetree/bindings/pci/qcom,pcie-sm8450_cn.yaml
~~~~yaml
下面是给定 YAML 文档的中文翻译：

```yaml
# SPDX-许可证标识符: (GPL-2.0-only 或 BSD-2-Clause)
%YAML 1.2
---
$id: http://devicetree.org/schemas/pci/qcom,pcie-sm8450.yaml#
$schema: http://devicetree.org/meta-schemas/core.yaml#

标题: Qualcomm SM8450 PCI Express 根复合控制器

维护者:
  - Bjorn Andersson <andersson@kernel.org>
  - Manivannan Sadhasivam <manivannan.sadhasivam@linaro.org>

描述:
  Qualcomm SM8450 SoC 的 PCI Express 根复合控制器基于 Synopsys DesignWare PCIe IP。

属性:
  compatible:
    枚举:
      - qcom,pcie-sm8450-pcie0
      - qcom,pcie-sm8450-pcie1

  reg:
    minItems: 5
    maxItems: 6

  reg-names:
    minItems: 5
    items:
      - 常量: parf # Qualcomm 特定寄存器
      - 常量: dbi # DesignWare PCIe 寄存器
      - 常量: elbi # 外部本地总线接口寄存器
      - 常量: atu # ATU 地址空间
      - 常量: config # PCIe 配置空间
      - 常量: mhi # MHI 寄存器

  clocks:
    minItems: 11
    maxItems: 12

  clock-names:
    minItems: 11
    items:
      - 常量: pipe # PIPE 时钟
      - 常量: pipe_mux # PIPE MUX
      - 常量: phy_pipe # PIPE 输出时钟
      - 常量: ref # 参考时钟
      - 常量: aux # 辅助时钟
      - 常量: cfg # 配置时钟
      - 常量: bus_master # 主 AXI 时钟
      - 常量: bus_slave # 从 AXI 时钟
      - 常量: slave_q2a # 从 Q2A 时钟
      - 枚举: [aggre0, aggre1] # Aggre NoC PCIe0/1 AXI 时钟
      - 常量: aggre1 # Aggre NoC PCIe1 AXI 时钟

  interrupts:
    minItems: 8
    maxItems: 8

  interrupt-names:
    items:
      - 常量: msi0
      - 常量: msi1
      - 常量: msi2
      - 常量: msi3
      - 常量: msi4
      - 常量: msi5
      - 常量: msi6
      - 常量: msi7

  resets:
    maxItems: 1

  reset-names:
    items:
      - 常量: pci

allOf:
  - $ref: qcom,pcie-common.yaml#

unevaluatedProperties: false

示例:
  - |
    #include <dt-bindings/clock/qcom,gcc-sm8450.h>
    #include <dt-bindings/clock/qcom,rpmh.h>
    #include <dt-bindings/gpio/gpio.h>
    #include <dt-bindings/interconnect/qcom,sm8450.h>
    #include <dt-bindings/interrupt-controller/arm-gic.h>

    soc {
        #address-cells = <2>;
        #size-cells = <2>;

        pcie@1c00000 {
            compatible = "qcom,pcie-sm8450-pcie0";
            reg = <0 0x01c00000 0 0x3000>,
                  <0 0x60000000 0 0xf1d>,
                  <0 0x60000f20 0 0xa8>,
                  <0 0x60001000 0 0x1000>,
                  <0 0x60100000 0 0x100000>;
            reg-names = "parf", "dbi", "elbi", "atu", "config";
            ranges = <0x01000000 0x0 0x00000000 0x0 0x60200000 0x0 0x100000>,
                     <0x02000000 0x0 0x60300000 0x0 0x60300000 0x0 0x3d00000>;

            bus-range = <0x00 0xff>;
            device_type = "pci";
            linux,pci-domain = <0>;
            max-link-speed = <2>;
            num-lanes = <1>;

            #address-cells = <3>;
            #size-cells = <2>;

            clocks = <&gcc GCC_PCIE_0_PIPE_CLK>,
                     <&gcc GCC_PCIE_0_PIPE_CLK_SRC>,
                     <&pcie0_phy>,
                     <&rpmhcc RPMH_CXO_CLK>,
                     <&gcc GCC_PCIE_0_AUX_CLK>,
                     <&gcc GCC_PCIE_0_CFG_AHB_CLK>,
                     <&gcc GCC_PCIE_0_MSTR_AXI_CLK>,
                     <&gcc GCC_PCIE_0_SLV_AXI_CLK>,
                     <&gcc GCC_PCIE_0_SLV_Q2A_AXI_CLK>,
                     <&gcc GCC_DDRSS_PCIE_SF_TBU_CLK>,
                     <&gcc GCC_AGGRE_NOC_PCIE_0_AXI_CLK>,
                     <&gcc GCC_AGGRE_NOC_PCIE_1_AXI_CLK>;
            clock-names = "pipe",
                          "pipe_mux",
                          "phy_pipe",
                          "ref",
                          "aux",
                          "cfg",
                          "bus_master",
                          "bus_slave",
                          "slave_q2a",
                          "ddrss_sf_tbu",
                          "aggre0",
                          "aggre1";

            interrupts = <GIC_SPI 141 IRQ_TYPE_LEVEL_HIGH>,
                         <GIC_SPI 142 IRQ_TYPE_LEVEL_HIGH>,
                         <GIC_SPI 143 IRQ_TYPE_LEVEL_HIGH>,
                         <GIC_SPI 144 IRQ_TYPE_LEVEL_HIGH>,
                         <GIC_SPI 145 IRQ_TYPE_LEVEL_HIGH>,
                         <GIC_SPI 146 IRQ_TYPE_LEVEL_HIGH>,
                         <GIC_SPI 147 IRQ_TYPE_LEVEL_HIGH>,
                         <GIC_SPI 148 IRQ_TYPE_LEVEL_HIGH>;
            interrupt-names = "msi0", "msi1", "msi2", "msi3",
                              "msi4", "msi5", "msi6", "msi7";
            #interrupt-cells = <1>;
            interrupt-map-mask = <0 0 0 0x7>;
            interrupt-map = <0 0 0 1 &intc 0 0 0 149 IRQ_TYPE_LEVEL_HIGH>, /* int_a */
                            <0 0 0 2 &intc 0 0 0 150 IRQ_TYPE_LEVEL_HIGH>, /* int_b */
                            <0 0 0 3 &intc 0 0 0 151 IRQ_TYPE_LEVEL_HIGH>, /* int_c */
                            <0 0 0 4 &intc 0 0 0 152 IRQ_TYPE_LEVEL_HIGH>; /* int_d */
            msi-map = <0x0 &gic_its 0x5981 0x1>,
                      <0x100 &gic_its 0x5980 0x1>;
            msi-map-mask = <0xff00>;

            iommu-map = <0x0 &apps_smmu 0x1c00 0x1>,
                        <0x100 &apps_smmu 0x1c01 0x1>;

            phys = <&pcie0_phy>;
            phy-names = "pciephy";

            pinctrl-0 = <&pcie0_default_state>;
            pinctrl-names = "default";

            power-domains = <&gcc PCIE_0_GDSC>;

            resets = <&gcc GCC_PCIE_0_BCR>;
            reset-names = "pci";

            perst-gpios = <&tlmm 94 GPIO_ACTIVE_LOW>;
            wake-gpios = <&tlmm 96 GPIO_ACTIVE_HIGH>;
        };
    };
```

请注意，某些关键字如 `const` 和 `enum` 已被翻译为中文（常量、枚举），而 YAML 中的其他部分保留了原有的英文术语。此外，注释和代码结构保持不变。
~~~~
