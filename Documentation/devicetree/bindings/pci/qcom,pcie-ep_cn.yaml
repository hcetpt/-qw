## Documentation/devicetree/bindings/pci/qcom,pcie-sm8550_cn.yaml
~~~~yaml
下面是给定 YAML 文档的中文翻译：

```yaml
# SPDX-文件许可标识符: (GPL-2.0-only 或 BSD-2-Clause)
%YAML 1.2
---
$id: http://devicetree.org/schemas/pci/qcom,pcie-sm8550.yaml#
$schema: http://devicetree.org/meta-schemas/core.yaml#

标题: Qualcomm SM8550 PCI Express 根复合体

维护者:
  - Bjorn Andersson <andersson@kernel.org>
  - Manivannan Sadhasivam <manivannan.sadhasivam@linaro.org>

描述:
  Qualcomm SM8550 系统级芯片（及其兼容版本）的 PCI Express 根复合体控制器基于 Synopsys DesignWare PCI Express IP。

属性:
  compatible:
    oneOf:
      - 常量: qcom,pcie-sm8550
      - items:
          - 枚举:
              - qcom,pcie-sm8650
          - 常量: qcom,pcie-sm8550

  reg:
    minItems: 5
    maxItems: 6

  reg-names:
    minItems: 5
    items:
      - 常量: parf # Qualcomm 特定寄存器
      - 常量: dbi # DesignWare PCIe 寄存器
      - 常量: elbi # 外部本地总线接口寄存器
      - 常量: atu # ATU 地址空间
      - 常量: config # PCIe 配置空间
      - 常量: mhi # MHI 寄存器

  clocks:
    minItems: 7
    maxItems: 8

  clock-names:
    minItems: 7
    items:
      - 常量: aux # 辅助时钟
      - 常量: cfg # 配置时钟
      - 常量: bus_master # 主 AXI 时钟
      - 常量: bus_slave # 从 AXI 时钟
      - 常量: slave_q2a # 从 Q2A 时钟
      - 常量: ddrss_sf_tbu # PCIe SF TBU 时钟
      - 常量: noc_aggr # Aggre NoC PCIe AXI 时钟
      - 常量: cnoc_sf_axi # 配置 NoC PCIe1 AXI 时钟

  interrupts:
    minItems: 8
    maxItems: 8

  interrupt-names:
    items:
      - 常量: msi0
      - 常量: msi1
      - 常量: msi2
      - 常量: msi3
      - 常量: msi4
      - 常量: msi5
      - 常量: msi6
      - 常量: msi7

  resets:
    minItems: 1
    maxItems: 2

  reset-names:
    minItems: 1
    items:
      - 常量: pci # PCIe 核心复位
      - 常量: link_down # PCIe 链路复位

allOf:
  - $ref: qcom,pcie-common.yaml#

unevaluatedProperties: false

示例:
  - |
    #include <dt-bindings/clock/qcom,sm8550-gcc.h>
    #include <dt-bindings/gpio/gpio.h>
    #include <dt-bindings/interconnect/qcom,sm8550-rpmh.h>
    #include <dt-bindings/interrupt-controller/arm-gic.h>

    soc {
        #address-cells = <2>;
        #size-cells = <2>;

        pcie@1c00000 {
            compatible = "qcom,pcie-sm8550";
            reg = <0 0x01c00000 0 0x3000>,
                  <0 0x60000000 0 0xf1d>,
                  <0 0x60000f20 0 0xa8>,
                  <0 0x60001000 0 0x1000>,
                  <0 0x60100000 0 0x100000>;
            reg-names = "parf", "dbi", "elbi", "atu", "config";
            ranges = <0x01000000 0x0 0x00000000 0x0 0x60200000 0x0 0x100000>,
                     <0x02000000 0x0 0x60300000 0x0 0x60300000 0x0 0x3d00000>;

            bus-range = <0x00 0xff>;
            device_type = "pci";
            linux,pci-domain = <0>;
            num-lanes = <2>;

            #address-cells = <3>;
            #size-cells = <2>;

            clocks = <&gcc GCC_PCIE_0_AUX_CLK>,
                     <&gcc GCC_PCIE_0_CFG_AHB_CLK>,
                     <&gcc GCC_PCIE_0_MSTR_AXI_CLK>,
                     <&gcc GCC_PCIE_0_SLV_AXI_CLK>,
                     <&gcc GCC_PCIE_0_SLV_Q2A_AXI_CLK>,
                     <&gcc GCC_DDRSS_PCIE_SF_QTB_CLK>,
                     <&gcc GCC_AGGRE_NOC_PCIE_AXI_CLK>;
            clock-names = "aux",
                          "cfg",
                          "bus_master",
                          "bus_slave",
                          "slave_q2a",
                          "ddrss_sf_tbu",
                          "noc_aggr";

            dma-coherent;

            interrupts = <GIC_SPI 141 IRQ_TYPE_LEVEL_HIGH>,
                         <GIC_SPI 142 IRQ_TYPE_LEVEL_HIGH>,
                         <GIC_SPI 143 IRQ_TYPE_LEVEL_HIGH>,
                         <GIC_SPI 144 IRQ_TYPE_LEVEL_HIGH>,
                         <GIC_SPI 145 IRQ_TYPE_LEVEL_HIGH>,
                         <GIC_SPI 146 IRQ_TYPE_LEVEL_HIGH>,
                         <GIC_SPI 147 IRQ_TYPE_LEVEL_HIGH>,
                         <GIC_SPI 148 IRQ_TYPE_LEVEL_HIGH>;
            interrupt-names = "msi0", "msi1", "msi2", "msi3",
                              "msi4", "msi5", "msi6", "msi7";
            #interrupt-cells = <1>;
            interrupt-map-mask = <0 0 0 0x7>;
            interrupt-map = <0 0 0 1 &intc 0 0 0 149 IRQ_TYPE_LEVEL_HIGH>, /* int_a */
                            <0 0 0 2 &intc 0 0 0 150 IRQ_TYPE_LEVEL_HIGH>, /* int_b */
                            <0 0 0 3 &intc 0 0 0 151 IRQ_TYPE_LEVEL_HIGH>, /* int_c */
                            <0 0 0 4 &intc 0 0 0 152 IRQ_TYPE_LEVEL_HIGH>; /* int_d */

            interconnects = <&pcie_noc MASTER_PCIE_0 0 &mc_virt SLAVE_EBI1 0>,
                            <&gem_noc MASTER_APPSS_PROC 0 &cnoc_main SLAVE_PCIE_0 0>;
            interconnect-names = "pcie-mem", "cpu-pcie";

            iommu-map = <0x0 &apps_smmu 0x1400 0x1>,
                        <0x100 &apps_smmu 0x1401 0x1>;

            phys = <&pcie0_phy>;
            phy-names = "pciephy";

            pinctrl-0 = <&pcie0_default_state>;
            pinctrl-names = "default";

            power-domains = <&gcc PCIE_0_GDSC>;

            resets = <&gcc GCC_PCIE_0_BCR>;
            reset-names = "pci";

            perst-gpios = <&tlmm 94 GPIO_ACTIVE_LOW>;
            wake-gpios = <&tlmm 96 GPIO_ACTIVE_HIGH>;
        };
    };
```

请注意，上述 YAML 文档中的注释、引用和具体值未做翻译，以保持与原始文档的一致性。```
~~~~

## Documentation/devicetree/bindings/pci/qcom,pcie_cn.yaml
```yaml
### 许可证标识符: (GPL-2.0-only 或 BSD-2-Clause)

#### YAML 1.2
---
$id$: http://devicetree.org/schemas/pci/qcom,pcie.yaml#
$schema$: http://devicetree.org/meta-schemas/core.yaml#

**标题**: Qualcomm PCI Express 根复合控制器

**维护者**:
  - Bjorn Andersson <bjorn.andersson@linaro.org>
  - Manivannan Sadhasivam <manivannan.sadhasivam@linaro.org>

**描述**:
  Qualcomm PCIe 根复合控制器基于 Synopsys DesignWare PCIe IP。

**属性**:
  compatible:
    oneOf:
      - enum:
          - qcom,pcie-apq8064
          - qcom,pcie-apq8084
          - qcom,pcie-ipq4019
          - qcom,pcie-ipq6018
          - qcom,pcie-ipq8064
          - qcom,pcie-ipq8064-v2
          - qcom,pcie-ipq8074
          - qcom,pcie-ipq8074-gen3
          - qcom,pcie-msm8996
          - qcom,pcie-qcs404
          - qcom,pcie-sdm845
          - qcom,pcie-sdx55
      - items:
          - const: qcom,pcie-msm8998
          - const: qcom,pcie-msm8996

  reg:
    minItems: 4
    maxItems: 6

  reg-names:
    minItems: 4
    maxItems: 6

  interrupts:
    minItems: 1
    maxItems: 8

  interrupt-names:
    minItems: 1
    maxItems: 8

  iommu-map:
    minItems: 1
    maxItems: 16

  clocks:
    minItems: 3
    maxItems: 13

  clock-names:
    minItems: 3
    maxItems: 13

  dma-coherent: true

  interconnects:
    maxItems: 2

  interconnect-names:
    items:
      - const: pcie-mem
      - const: cpu-pcie

  resets:
    minItems: 1
    maxItems: 12

  reset-names:
    minItems: 1
    maxItems: 12

  vdda-supply:
    description: 电源供应的物理句柄到核心模拟电源

  vdda_phy-supply:
    description: 电源供应的物理句柄到 PHY 的核心模拟电源

  vdda_refclk-supply:
    description: 电源供应的物理句柄到生成参考时钟 IC 的核心模拟电源

  phys:
    maxItems: 1

  phy-names:
    items:
      - const: pciephy

  power-domains:
    maxItems: 1

  perst-gpios:
    description: GPIO 控制的连接到 PERST# 信号
    maxItems: 1

  required-opps:
    maxItems: 1

  wake-gpios:
    description: GPIO 控制的连接到 WAKE# 信号
    maxItems: 1

**必需项**:
  - compatible
  - reg
  - reg-names
  - interrupt-map-mask
  - interrupt-map
  - clocks
  - clock-names

**任选一项**:
  - required:
      - interrupts
      - interrupt-names
      - "#interrupt-cells"
  - required:
      - msi-map

**全部需要**:
  - $ref: /schemas/pci/pci-host-bridge.yaml#
  - if:
      properties:
        compatible:
          contains:
            enum:
              - qcom,pcie-apq8064
              - qcom,pcie-ipq4019
              - qcom,pcie-ipq8064
              - qcom,pcie-ipq8064v2
              - qcom,pcie-ipq8074
              - qcom,pcie-qcs404
    then:
      properties:
        reg:
          minItems: 4
          maxItems: 4
        reg-names:
          items:
            - const: dbi # DesignWare PCIe 寄存器
            - const: elbi # 外部本地总线接口寄存器
            - const: parf # Qualcomm 特定寄存器
            - const: config # PCIe 配置空间

**示例**:
  - 示例配置
  - 另一个示例配置
```

## Documentation/devicetree/bindings/pci/ralink,rt3883-pci_cn.txt
~~~~
* Mediatek/Ralink RT3883 PCI 控制器

1) 主节点

   必需属性：

   - compatible: 必须是 "ralink,rt3883-pci"

   - reg: 指定了控制器的物理基地址及内存映射区域的长度
- #address-cells: 指定编码一个地址所需的单元格数量。值必须为 1
- #size-cells: 指定表示地址大小所需的单元格数量。值必须为 1
- ranges: 指定子地址空间与父地址空间之间的转换

  可选属性：

   - status: 表示设备的操作状态
值必须是 "disabled" 或 "okay"

2) 子节点

   主节点必须有两个子节点，分别描述内置的中断控制器和 PCI 主机桥接器
a) 中断控制器：

   必需属性：

   - interrupt-controller: 标识该节点为一个中断控制器

   - #address-cells: 指定编码一个地址所需的单元格数量。值必须为 0。因此，'interrupt-map' 节点不必指定父单元地址
- #interrupt-cells: 指定编码一个中断源所需的单元格数量。值必须为 1
- interrupts: 指定父中断控制器的中断源。中断指定符的格式取决于父中断控制器
b) PCI 主机桥接器：

   必需属性：

   - #address-cells: 指定编码一个地址所需的单元格数量。值必须为 0
### Device Tree Configuration for PCI Host Bridge and Devices

#### Overview:
This configuration describes the setup for a PCI (Peripheral Component Interconnect) host bridge and its associated devices in a device tree format. It includes the necessary properties and their values for the PCI host bridge and the onboard PCI devices/PCI slots.

#### Key Properties:
- **#address-cells**: Specifies the number of cells used to represent the address.
  - For the PCI host bridge, the value must be 3.
  - For a PCI bridge, the value must be 3.
- **#size-cells**: Specifies the number of cells used to represent the size of an address.
  - For the PCI host bridge, the value must be 2.
  - For a PCI bridge, the value must be 2.
- **#interrupt-cells**: Specifies the number of cells needed to encode an interrupt source.
  - For both the PCI host bridge and PCI bridge, the value must be 1.
- **device_type**: Must be "pci".
- **bus-range**: PCI bus numbers covered.
- **ranges**: Specifies the ranges for the PCI memory and I/O regions.
- **interrupt-map-mask**, **interrupt-map**: Standard PCI properties to define the mapping of the PCI interface to interrupt numbers.

#### Sub-nodes for Onboard PCI Devices/PCI Slots:
- **reg**: Used only for interrupt mapping. Only the first four bytes are used to refer to the correct bus number and device number.
- **device_type**: Must be "pci".
- If a given sub-node represents a PCI bridge, it must also have:
  - **#address-cells**: Set to <3>.
  - **#size-cells**: Set to <2>.
  - **#interrupt-cells**: Set to <1>.
  - **interrupt-map-mask**, **interrupt-map**: To define the mapping of the PCI interface to interrupt numbers.

#### Optional Properties:
- **status**: Indicates the operational status of the sub-node. Value must be either "disabled" or "okay".

#### Example:

##### a) SoC Specific DTSI File:

```dts
pci@10140000 {
    compatible = "ralink,rt3883-pci";
    reg = <0x10140000 0x20000>;
    #address-cells = <1>;
    #size-cells = <1>;
    ranges; /* direct mapping */

    status = "disabled";

    pciintc: interrupt-controller {
        interrupt-controller;
        #address-cells = <0>;
        #interrupt-cells = <1>;

        interrupt-parent = <&cpuintc>;
        interrupts = <4>;
    };

    host-bridge {
        #address-cells = <3>;
        #size-cells = <2>;
        #interrupt-cells = <1>;

        device_type = "pci";

        bus-range = <0 255>;
        ranges = <
            0x02000000 0 0x00000000 0x20000000 0 0x10000000 /* pci memory */
            0x01000000 0 0x00000000 0x10160000 0 0x00010000 /* io space */
        >;

        interrupt-map-mask = <0xf800 0 0 7>;
        interrupt-map = <
            /* IDSEL 17 */
            0x8800 0 0 1 &pciintc 18
            0x8800 0 0 2 &pciintc 18
            0x8800 0 0 3 &pciintc 18
            0x8800 0 0 4 &pciintc 18
            /* IDSEL 18 */
            0x9000 0 0 1 &pciintc 19
            0x9000 0 0 2 &pciintc 19
            0x9000 0 0 3 &pciintc 19
            0x9000 0 0 4 &pciintc 19
        >;

        pci-bridge@1 {
            reg = <0x0800 0 0 0 0>;
            device_type = "pci";
            #interrupt-cells = <1>;
            #address-cells = <3>;
            #size-cells = <2>;

            interrupt-map-mask = <0x0 0 0 0>;
            interrupt-map = <0x0 0 0 0 &pciintc 20>;

            status = "disabled";
        };

        pci-slot@17 {
            reg = <0x8800 0 0 0 0>;
            device_type = "pci";

            status = "disabled";
        };

        pci-slot@18 {
            reg = <0x9000 0 0 0 0>;
            device_type = "pci";

            status = "disabled";
        };
    };
};
```

##### b) Board Specific DTS File:

```dts
pci@10140000 {
    status = "okay";

    host-bridge {
        pci-bridge@1 {
            status = "okay";
        };
    };
};
```
~~~~

## Documentation/devicetree/bindings/pci/rcar-gen4-pci-ep_cn.yaml
~~~~yaml
这段 Device Tree 配置描述了瑞萨电子 R-Car 第四代 (Gen4) PCIe 终端的相关属性。下面是翻译后的中文版本：

```yaml
# SPDX-许可证标识符: (GPL-2.0-only 或 BSD-2-Clause)
# 版权 (C) 2022-2023 瑞萨电子公司
%YAML 1.2
---
$id: http://devicetree.org/schemas/pci/rcar-gen4-pci-ep.yaml#
$schema: http://devicetree.org/meta-schemas/core.yaml#

title: 瑞萨 R-Car 第四代 PCIe 终端

maintainers:
  - Yoshihiro Shimoda <yoshihiro.shimoda.uh@renesas.com>

allOf:
  - $ref: snps,dw-pcie-ep.yaml#

properties:
  compatible:
    items:
      - enum:
          - renesas,r8a779f0-pcie-ep      # R-Car S4-8
          - renesas,r8a779g0-pcie-ep      # R-Car V4H
      - const: renesas,rcar-gen4-pci-ep  # R-Car 第四代

  reg:
    maxItems: 7

  reg-names:
    items:
      - const: dbi
      - const: dbi2
      - const: atu
      - const: dma
      - const: app
      - const: phy
      - const: addr_space

  interrupts:
    maxItems: 3

  interrupt-names:
    items:
      - const: dma
      - const: sft_ce
      - const: app

  clocks:
    maxItems: 2

  clock-names:
    items:
      - const: core
      - const: ref

  power-domains:
    maxItems: 1

  resets:
    maxItems: 1

  reset-names:
    items:
      - const: pwr

  max-link-speed:
    maximum: 4

  num-lanes:
    maximum: 4

  max-functions:
    maximum: 2

required:
  - compatible
  - reg
  - reg-names
  - interrupts
  - interrupt-names
  - clocks
  - clock-names
  - power-domains
  - resets
  - reset-names

unevaluatedProperties: false

examples:
  - |
    #include <dt-bindings/clock/r8a779f0-cpg-mssr.h>
    #include <dt-bindings/interrupt-controller/arm-gic.h>
    #include <dt-bindings/power/r8a779f0-sysc.h>

    soc {
        #address-cells = <2>;
        #size-cells = <2>;

        pcie0_ep: pcie-ep@e65d0000 {
            compatible = "renesas,r8a779f0-pcie-ep", "renesas,rcar-gen4-pci-ep";
            reg = <0 0xe65d0000 0 0x2000>, <0 0xe65d2000 0 0x1000>,
                  <0 0xe65d3000 0 0x2000>, <0 0xe65d5000 0 0x1200>,
                  <0 0xe65d6200 0 0x0e00>, <0 0xe65d7000 0 0x0400>,
                  <0 0xfe000000 0 0x400000>;
            reg-names = "dbi", "dbi2", "atu", "dma", "app", "phy", "addr_space";
            interrupts = <GIC_SPI 417 IRQ_TYPE_LEVEL_HIGH>,
                         <GIC_SPI 418 IRQ_TYPE_LEVEL_HIGH>,
                         <GIC_SPI 422 IRQ_TYPE_LEVEL_HIGH>;
            interrupt-names = "dma", "sft_ce", "app";
            clocks = <&cpg CPG_MOD 624>, <&pcie0_clkref>;
            clock-names = "core", "ref";
            power-domains = <&sysc R8A779F0_PD_ALWAYS_ON>;
            resets = <&cpg 624>;
            reset-names = "pwr";
            max-link-speed = <4>;
            num-lanes = <2>;
            max-functions = /bits/ 8 <2>;
        };
    };
```

此配置定义了一个 R-Car 第四代 PCIe 终端节点，并指定了必要的兼容性、地址范围、中断、时钟等信息。
~~~~
