## Documentation/devicetree/bindings/pci/host-generic-pci_cn.yaml
```yaml
# SPDX-许可证标识符: (GPL-2.0-only 或 BSD-2-Clause)
%YAML 1.2
---
$id: http://devicetree.org/schemas/pci/host-generic-pci.yaml#
$schema: http://devicetree.org/meta-schemas/core.yaml#

标题: 通用 PCI 主控制器

维护者:
  - Will Deacon <will@kernel.org>

描述: |
  由固件初始化的 PCI 主控制器和 PCI 模拟，例如在 kvmtool 和其他准虚拟化系统中发现的 virtio-pci 实现，并不需要驱动程序支持诸如调节器和时钟管理之类的复杂性。实际上，控制器甚至可能不需要操作系统配置控制接口，而是直接展示一组固定的窗口来描述一部分 IO、内存和配置空间。
配置空间假定为内存映射（而非通过 io 端口访问），并且通过将各个组件拼接形成偏移量以与 PCI 总线地址的地理布局直接对应。
对于 CAM，这个 24 位的偏移量是：

          cfg_offset(总线, 设备, 功能, 寄存器) =
                     总线 << 16 | 设备 << 11 | 功能 << 8 | 寄存器

  而 ECAM 通过扩展 4 位来容纳 4k 的功能空间：

          cfg_offset(总线, 设备, 功能, 寄存器) =
                     总线 << 20 | 设备 << 15 | 功能 << 12 | 寄存器

属性:
  compatible:
    描述: 取决于配置空间的布局（CAM 与 ECAM）。也可能有更具体的兼容项
oneOf:
      - 描述:
          基于 PLDA XpressRICH3-AXI IP 的 Arm Juno 中的 PCIe 主控制器
        items:
          - const: arm,juno-r1-pcie
          - const: plda,xpressrich3-axi
          - const: pci-host-ecam-generic
      - 描述: |
          针对 pass-1.x 硅片的 ThunderX PCI 主控制器

          固件初始化的 PCI 主控制器用于一些 Cavium ThunderX 处理器上的芯片内设备。这些设备具有基于 ECAM 的配置访问，但所有 BAR 都位于固定地址。我们通过为这些设备合成增强分配（EA）能力来处理固定地址
const: cavium,pci-host-thunder-ecam
      - 描述:
          Cavium ThunderX PEM 固件初始化的 PCIe 主控制器
        const: cavium,pci-host-thunder-pem
      - 描述:
          HiSilicon Hip06/Hip07 在几乎 ECAM 模式下的 PCIe 主桥。某些
          固件将主控制器置于一种模式，在这种模式下，除了根复合体之外的所有设备都符合 ECAM 规范
enum:
          - hisilicon,hip06-pcie-ecam
          - hisilicon,hip07-pcie-ecam
      - 描述: |
          在某些情况下，固件可能已经配置了 Synopsys DesignWare PCIe 控制器以 RC 模式并带有静态 ATU 窗口映射，
          这些映射以[基本上] ECAM 兼容的方式覆盖了所有配置、MMIO 和 I/O 空间。在这种情况下，操作系统无需执行任何底层时钟、PHY 或设备寄存器的设置，
          也没有理由让驱动程序在运行时重新配置 ATU 窗口以访问配置和/或 I/O 空间
在 IP 合成时最小 ATU 窗口大小为 64 KB 的情况下，它无法被通用 ECAM 驱动程序支持，因为它需要特殊的配置空间访问器来过滤对第一个总线上第 1 个设备及以后的访问
items:
          - enum:
              - marvell,armada8k-pcie-ecam
              - socionext,synquacer-pcie-ecam
          - const: snps,dw-pcie-ecam
      - 描述:
          没有任何特殊之处的 CAM 或 ECAM 兼容的 PCI 主控制器
        enum:
          - pci-host-cam-generic
          - pci-host-ecam-generic

  reg:
    描述:
      从父总线访问的配置空间基地址和大小。基地址对应于“bus-range”属性中的第一个总线。如果没有指定“bus-range”，这将是总线 0（默认值）。一些主控制器有一个不合规的第二地址范围，因此允许两个条目
minItems: 1
    maxItems: 2

  ranges:
    描述:
      如 IEEE 标准 1275-1994 所述，但必须至少提供非预取内存的定义。也可以提供可预取内存和 I/O 空间
minItems: 1
    maxItems: 3

  dma-coherent: true
  iommu-map: true
  iommu-map-mask: true
  msi-parent: true

required:
  - compatible
  - reg
  - ranges

allOf:
  - $ref: /schemas/pci/pci-host-bridge.yaml#
  - 如果:
      properties:
        compatible:
          contains:
            const: arm,juno-r1-pcie
    则:
      required:
        - dma-coherent

  - 如果:
      properties:
        compatible:
          not:
            contains:
              enum:
                - cavium,pci-host-thunder-pem
                - hisilicon,hip06-pcie-ecam
                - hisilicon,hip07-pcie-ecam
    则:
      properties:
        reg:
          maxItems: 1

unevaluatedProperties: false

例子:
  - |

    bus {
        #address-cells = <2>;
        #size-cells = <2>;
        pcie@40000000 {
            compatible = "pci-host-cam-generic";
            device_type = "pci";
            #address-cells = <3>;
            #size-cells = <2>;
            bus-range = <0x0 0x1>;

            // CPU_PHYSICAL(2)  SIZE(2)
            reg = <0x0 0x40000000  0x0 0x1000000>;

            // BUS_ADDRESS(3)  CPU_PHYSICAL(2)  SIZE(2)
            ranges = <0x01000000 0x0 0x01000000  0x0 0x01000000  0x0 0x00010000>,
                     <0x02000000 0x0 0x41000000  0x0 0x41000000  0x0 0x3f000000>;

            #interrupt-cells = <0x1>;

            // PCI_DEVICE(3)  INT#(1)  CONTROLLER(PHANDLE)  CONTROLLER_DATA(3)
            interrupt-map = <   0x0 0x0 0x0  0x1  &gic  0x0 0x4 0x1>,
                            < 0x800 0x0 0x0  0x1  &gic  0x0 0x5 0x1>,
                            <0x1000 0x0 0x0  0x1  &gic  0x0 0x6 0x1>,
                            <0x1800 0x0 0x0  0x1  &gic  0x0 0x7 0x1>;

            // PCI_DEVICE(3)  INT#(1)
            interrupt-map-mask = <0xf800 0x0 0x0  0x7>;
        };
    };
您没有提供需要翻译的文本。请提供需要翻译成中文的句子或词语。
```

## Documentation/devicetree/bindings/pci/intel,ixp4xx-pci_cn.yaml
~~~~yaml
```yaml
# SPDX-许可证标识符: (GPL-2.0-only 或 BSD-2-Clause)
%YAML 1.2
---
$id: http://devicetree.org/schemas/pci/intel,ixp4xx-pci.yaml#
$schema: http://devicetree.org/meta-schemas/core.yaml#

title: Intel IXP4xx PCI 控制器

maintainers:
  - Linus Walleij <linus.walleij@linaro.org>

description: 在 Intel IXP4xx 系列 SoC 中找到的 PCI 主机控制器
allOf:
  - $ref: /schemas/pci/pci-host-bridge.yaml#

properties:
  compatible:
    items:
      - enum:
          - intel,ixp42x-pci
          - intel,ixp43x-pci
    description: 支持的两个变体是 ixp42x 和 ixp43x，尽管可能存在更多变体
reg:
    items:
      - description: IXP4xx 特定寄存器

  interrupts:
    items:
      - description: 主 PCI 中断
      - description: PCI DMA 中断 1
      - description: PCI DMA 中断 2

  ranges:
    maxItems: 2
    description: 通常有一个 64MB 的内存范围和一个 64KB 的 I/O 空间范围
dma-ranges:
    maxItems: 1
    description: DMA 范围告诉 PCI 主机 RAM 的地址。它只能映射 64MB，因此如果 RAM 大于 64MB，则必须将 DMA 访问限制在这些地址上
"#interrupt-cells": true

  interrupt-map: true

  interrupt-map-mask:
    items:
      - const: 0xf800
      - const: 0
      - const: 0
      - const: 7

required:
  - compatible
  - reg
  - dma-ranges
  - "#interrupt-cells"
  - interrupt-map
  - interrupt-map-mask

unevaluatedProperties: false

examples:
  - |
    pci@c0000000 {
      compatible = "intel,ixp43x-pci";
      reg = <0xc0000000 0x1000>;
      #address-cells = <3>;
      #size-cells = <2>;
      device_type = "pci";
      bus-range = <0x00 0xff>;

      ranges =
        <0x02000000 0 0x48000000 0x48000000 0 0x04000000>,
        <0x01000000 0 0x00000000 0x4c000000 0 0x00010000>;
      dma-ranges =
        <0x02000000 0 0x00000000 0x00000000 0 0x04000000>;

      #interrupt-cells = <1>;
      interrupt-map-mask = <0xf800 0 0 7>;
      interrupt-map =
        <0x0800 0 0 1 &gpio0 11 3>, /* 插槽 1 上的 INT A 是中断 11 */
        <0x0800 0 0 2 &gpio0 10 3>, /* 插槽 1 上的 INT B 是中断 10 */
        <0x0800 0 0 3 &gpio0 9  3>, /* 插槽 1 上的 INT C 是中断 9 */
        <0x0800 0 0 4 &gpio0 8  3>, /* 插槽 1 上的 INT D 是中断 8 */
        <0x1000 0 0 1 &gpio0 10 3>, /* 插槽 2 上的 INT A 是中断 10 */
        <0x1000 0 0 2 &gpio0 9  3>, /* 插槽 2 上的 INT B 是中断 9 */
        <0x1000 0 0 3 &gpio0 8  3>, /* 插槽 2 上的 INT C 是中断 8 */
        <0x1000 0 0 4 &gpio0 11 3>, /* 插槽 2 上的 INT D 是中断 11 */
        <0x1800 0 0 1 &gpio0 9  3>, /* 插槽 3 上的 INT A 是中断 9 */
        <0x1800 0 0 2 &gpio0 8  3>, /* 插槽 3 上的 INT B 是中断 8 */
        <0x1800 0 0 3 &gpio0 11 3>, /* 插槽 3 上的 INT C 是中断 11 */
        <0x1800 0 0 4 &gpio0 10 3>; /* 插槽 3 上的 INT D 是中断 10 */
    };
```
以上是翻译后的中文版本。注意，某些关键词如 `"$schema"`、`"#interrupt-cells"` 以及 YAML 结构中的关键字等，由于其特殊性，在翻译时保持了英文原样。
~~~~

## Documentation/devicetree/bindings/pci/intel-gw-pcie_cn.yaml
~~~~yaml
```yaml
# SPDX-许可证标识符: (GPL-2.0 或 BSD-2-Clause)
%YAML 1.2
---
$id: http://devicetree.org/schemas/pci/intel-gw-pcie.yaml#
$schema: http://devicetree.org/meta-schemas/core.yaml#

title: Intel Gateway 系统芯片上的 PCIe RC 控制器

maintainers:
  - Rahul Tanwar <rtanwar@maxlinear.com>

select:
  properties:
    compatible:
      contains:
        const: intel,lgm-pcie
  required:
    - compatible

allOf:
  - $ref: /schemas/pci/snps,dw-pcie.yaml#

properties:
  compatible:
    items:
      - const: intel,lgm-pcie
      - const: snps,dw-pcie

  reg:
    items:
      - description: 控制器控制和状态寄存器
- description: PCIe 配置寄存器
- description: 控制器应用寄存器
reg-names:
    items:
      - const: dbi
      - const: config
      - const: app

  ranges:
    maxItems: 1

  resets:
    maxItems: 1

  clocks:
    maxItems: 1

  phys:
    maxItems: 1

  phy-names:
    const: pcie

  reset-gpios:
    maxItems: 1

  num-lanes:
    maximum: 2

  max-link-speed:
    enum: [1, 2, 3, 4]
    default: 1

  reset-assert-ms:
    description: |
      断言 PCIe 设备复位后延迟
maximum: 500
    default: 100

required:
  - compatible
  - reg
  - reg-names
  - ranges
  - resets
  - clocks
  - phys
  - phy-names
  - reset-gpios
  - '#interrupt-cells'
  - interrupt-map
  - interrupt-map-mask

unevaluatedProperties: false

examples:
  - |
    #include <dt-bindings/gpio/gpio.h>
    pcie10: pcie@d0e00000 {
      compatible = "intel,lgm-pcie", "snps,dw-pcie";
      device_type = "pci";
      #address-cells = <3>;
      #size-cells = <2>;
      reg = <0xd0e00000 0x1000>,
            <0xd2000000 0x800000>,
            <0xd0a41000 0x1000>;
      reg-names = "dbi", "config", "app";
      linux,pci-domain = <0>;
      max-link-speed = <4>;
      bus-range = <0x00 0x08>;
      #interrupt-cells = <1>;
      interrupt-map-mask = <0 0 0 0x7>;
      interrupt-map = <0 0 0 1 &ioapic1 27 1>,
                      <0 0 0 2 &ioapic1 28 1>,
                      <0 0 0 3 &ioapic1 29 1>,
                      <0 0 0 4 &ioapic1 30 1>;
      ranges = <0x02000000 0 0xd4000000 0xd4000000 0 0x04000000>;
      resets = <&rcu0 0x50 0>;
      clocks = <&cgu0 120>;
      phys = <&cb0phy0>;
      phy-names = "pcie";
      reset-assert-ms = <500>;
      reset-gpios = <&gpio0 3 GPIO_ACTIVE_LOW>;
      num-lanes = <2>;
    };
```

请注意，由于 YAML 格式的特殊性（如多行字符串的表示），部分描述可能需要适当调整以确保格式正确。此外，注释部分（如 `# address-cells`）在 YAML 中通常不被允许，因此它们保持原样作为示例中的注释。如果要在实际的 YAML 文件中使用，需要按照 YAML 的规则进行适当的格式化。
~~~~

## Documentation/devicetree/bindings/pci/layerscape-pcie-gen4_cn.txt
~~~~
NXP Layerscape PCIe Gen4 控制器

此 PCIe 控制器基于 Mobiveil 的 PCIe IP，因此继承了在 `mobiveil-pcie.txt` 中定义的所有通用属性。
所需属性：
- `compatible`：应包含平台标识符，例如：
  `"fsl,lx2160a-pcie"`
- `reg`：PCIe 控制器寄存器块的基地址和长度
  `"csr_axi_slave"`：桥接配置寄存器
  `"config_axi_slave"`：PCIe 控制器寄存器
- `interrupts`：控制器中断输出列表。必须为 `interrupt-names` 属性中的每一项都包含一个条目
- `interrupt-names`：可能包括以下条目：
  `"intr"`：控制器中断被断言时的中断
  `"aer"`：当芯片支持 AER 中断（无 MSI/MSI-X/INTx 模式）但存在用于 AER 的中断线时断言
  `"pme"`：当芯片支持 PME 中断（无 MSI/MSI-X/INTx 模式）但存在用于 PME 的中断线时断言
- `dma-coherent`：表示硬件 IP 块可以确保从/到 IP 块的数据传输的一致性。这可以避免软件缓存刷新/无效操作，并显著提高性能
- `msi-parent`：请参阅 `Documentation/devicetree/bindings/interrupt-controller/msi.txt` 中描述的通用 MSI 绑定

示例：

```text
pcie@3400000 {
	compatible = "fsl,lx2160a-pcie";
	reg = <0x00 0x03400000 0x0 0x00100000   /* 控制器寄存器 */
	       0x80 0x00000000 0x0 0x00001000>; /* 配置空间 */
	reg-names = "csr_axi_slave", "config_axi_slave";
	interrupts = <GIC_SPI 108 IRQ_TYPE_LEVEL_HIGH>, /* AER 中断 */
		     <GIC_SPI 108 IRQ_TYPE_LEVEL_HIGH>, /* PME 中断 */
		     <GIC_SPI 108 IRQ_TYPE_LEVEL_HIGH>; /* 控制器中断 */
	interrupt-names = "aer", "pme", "intr";
	#address-cells = <3>;
	#size-cells = <2>;
	device_type = "pci";
	apio-wins = <8>;
	ppio-wins = <8>;
	dma-coherent;
	bus-range = <0x0 0xff>;
	msi-parent = <&its>;
	ranges = <0x82000000 0x0 0x40000000 0x80 0x40000000 0x0 0x40000000>;
	#interrupt-cells = <1>;
	interrupt-map-mask = <0 0 0 7>;
	interrupt-map = <0000 0 0 1 &gic 0 0 GIC_SPI 109 IRQ_TYPE_LEVEL_HIGH>,
			<0000 0 0 2 &gic 0 0 GIC_SPI 110 IRQ_TYPE_LEVEL_HIGH>,
			<0000 0 0 3 &gic 0 0 GIC_SPI 111 IRQ_TYPE_LEVEL_HIGH>,
			<0000 0 0 4 &gic 0 0 GIC_SPI 112 IRQ_TYPE_LEVEL_HIGH>;
};
```
请注意，上述示例中的 `ranges`, `interrupt-map-mask`, 和 `interrupt-map` 属性的具体值可能会根据实际情况有所不同。
~~~~

## Documentation/devicetree/bindings/pci/loongson_cn.yaml
```yaml
# SPDX-许可证标识符: (GPL-2.0-only 或 BSD-2-Clause)
%YAML 1.2
---
$id: http://devicetree.org/schemas/pci/loongson.yaml#
$schema: http://devicetree.org/meta-schemas/core.yaml#

title: 龙芯 PCI 主机控制器

maintainers:
  - 杨佳迅 <jiaxun.yang@flygoat.com>

description: |+
  在龙芯 PCH 和 SoC 中发现的 PCI 主机控制器。
allOf:
  - $ref: /schemas/pci/pci-host-bridge.yaml#

properties:
  compatible:
    enum:
      - loongson,ls2k-pci
      - loongson,ls7a-pci
      - loongson,rs780e-pci

  reg:
    minItems: 1
    items:
      - description: CFG0 标准配置空间寄存器
      - description: CFG1 扩展配置空间寄存器

  ranges:
    minItems: 1
    maxItems: 3


required:
  - compatible
  - reg
  - ranges

unevaluatedProperties: false

examples:
  - |

    bus {
        #address-cells = <2>;
        #size-cells = <2>;
        pcie@1a000000 {
            compatible = "loongson,rs780e-pci";
            device_type = "pci";
            #address-cells = <3>;
            #size-cells = <2>;

            // CPU_PHYSICAL(2)  SIZE(2)
            reg = <0x0 0x1a000000  0x0 0x2000000>;

            // BUS_ADDRESS(3)  CPU_PHYSICAL(2)  SIZE(2)
            ranges = <0x01000000 0x0 0x00004000  0x0 0x00004000  0x0 0x00004000>,
                     <0x02000000 0x0 0x40000000  0x0 0x40000000  0x0 0x40000000>;
        };
    };
```
