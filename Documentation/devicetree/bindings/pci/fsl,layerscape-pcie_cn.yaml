## Documentation/devicetree/bindings/pci/nvidia,tegra194-pcie_cn.yaml
~~~~yaml
此PCIe控制器基于Synopsys DesignWare PCIe IP，因此继承了在`snps,dw-pcie.yaml`中定义的所有通用属性。部分控制器实例为双模式，即它们可以在Root Port模式或Endpoint模式下工作，但每次只能选择一种模式。
有关Endpoint模式设备树绑定的详细信息，请参阅`nvidia,tegra194-pcie-ep.yaml`。

属性：
compatible:
  枚举值:
    - nvidia,tegra194-pcie
    - nvidia,tegra234-pcie

reg:
  最小项数: 4
  项:
    - 描述: 控制器的应用逻辑寄存器
    - 描述: 配置寄存器
    - 描述: iATU和DMA寄存器。这是PCIe内核的iATU（内部地址转换单元）寄存器对软件访问可用的地方
    - 描述: Root Port自身的配置寄存器所在的空间
    - 描述: 通过ECAM访问配置空间的空间

reg-names:
  最小项数: 4
  项:
    - 常量: appl
    - 常量: config
    - 常量: atu_dma
    - 常量: dbi
    - 常量: ecam

interrupts:
  项:
    - 描述: 控制器中断
    - 描述: MSI中断

interrupt-names:
  项:
    - 常量: intr
    - 常量: msi

clocks:
  项:
    - 描述: 模块时钟

clock-names:
  项:
    - 常量: core

resets:
  项:
    - 描述: APB总线接口复位
    - 描述: 模块复位

reset-names:
  项:
    - 常量: apb
    - 常量: core

phys:
  最小项数: 1
  最大项数: 8

phy-names:
  最小项数: 1
  项:
    - 常量: p2u-0
    - 常量: p2u-1
    - 常量: p2u-2
    - 常量: p2u-3
    - 常量: p2u-4
    - 常量: p2u-5
    - 常量: p2u-6
    - 常量: p2u-7

power-domains:
  最大项数: 1
  描述: |
    包含控制相应PCIe控制器电源的节点的phandle以及PCIe控制器的指定名称。
    Tegra194的指定名称定义于`include/dt-bindings/power/tegra194-powergate.h`
    Tegra234的指定名称定义于`include/dt-bindings/power/tegra234-powergate.h`

interconnects:
  项:
    - 描述: 内存读取客户端
    - 描述: 内存写入客户端

interconnect-names:
  项:
    - 常量: dma-mem # 读取
    - 常量: write

dma-coherent: true

nvidia,bpmp:
  引用: /schemas/types.yaml#/definitions/phandle-array
  描述: |
    必须包含指向BPMP控制器节点的phandle对，后面跟着控制器ID。以下为每个控制器的控制器ID：

    Tegra194

      0: C0
      1: C1
      2: C2
      3: C3
      4: C4
      5: C5

    Tegra234

      0: C0
      1: C1
      2: C2
      3: C3
      4: C4
      5: C5
      6: C6
      7: C7
      8: C8
      9: C9
      10: C10

  项:
    - 项:
        - 描述: 指向BPMP控制器节点的phandle
        - 描述: PCIe控制器ID
          最大值: 10

nvidia,update-fc-fixup:
  描述: |
    这是一个布尔属性，需要存在以提高性能，当平台设计满足以下至少一个条件时，使Root Port能够与下游设备交换最佳数量的FC（流控）信用额度：

    注意：这仅适用于Tegra194
    1. 如果C0/C4/C5运行在x1/x2链路宽度（无论速度和MPS如何）
    2. 如果C0/C1/C2/C3/C4/C5在其最大链路宽度下运行，并且
       a) 速度为Gen-2且MPS为256B
       b) 速度>= Gen-3且任何MPS

  引用: /schemas/types.yaml#/definitions/flag

nvidia,aspm-cmrt-us:
  描述: 为ASPM正常运行而指定的常用模式恢复时间（单位：微秒）

nvidia,aspm-pwr-on-t-us:
  描述: 为ASPM正常运行而指定的上电时间（单位：微秒）

nvidia,aspm-l0s-entrance-latency-us:
  描述: ASPM L0s进入延迟（单位：微秒）

vddio-pex-ctl-supply:
  描述: 指向为PCIe侧带信号提供调节电源的调节器的phandle

vpcie3v3-supply:
  描述: 如果平台有一个这样的插槽（例如，在p2972-0000平台中由C5控制器拥有的x16插槽），则指向为该插槽提供3.3V的调节器节点的phandle

vpcie12v-supply:
  描述: 如果平台有一个这样的插槽（例如，在p2972-0000平台中由C5控制器拥有的x16插槽），则指向为该插槽提供12V的调节器节点的phandle
下面是给定的 YAML 配置文件的中文翻译：

```yaml
# NVIDIA 相关属性定义
nvidia,enable-srns:
  description: |
    如果控制器配置为在 SRNS（独立参考时钟，无展频时钟）模式下运行，则需要存在此布尔属性。
    注意：这仅适用于 Tegra234。
  $ref: /schemas/types.yaml#/definitions/flag

nvidia,enable-ext-refclk:
  description: |
    如果控制器配置为使用来自外部时钟源的参考时钟，而不是使用内部时钟源，则需要存在此布尔属性。
  $ref: /schemas/types.yaml#/definitions/flag

# 兼容性配置
allOf:
  - $ref: /schemas/pci/snps,dw-pcie.yaml#
  - if:
      properties:
        compatible:
          contains:
            enum:
              - nvidia,tegra194-pcie
    then:
      properties:
        reg:
          maxItems: 4
        reg-names:
          maxItems: 4

  - if:
      properties:
        compatible:
          contains:
            enum:
              - nvidia,tegra234-pcie
    then:
      properties:
        reg:
          minItems: 5
        reg-names:
          minItems: 5

unevaluatedProperties: false

# 必须包含的属性
required:
  - interrupts
  - interrupt-names
  - interrupt-map
  - interrupt-map-mask
  - clocks
  - clock-names
  - resets
  - reset-names
  - power-domains
  - vddio-pex-ctl-supply
  - num-lanes
  - phys
  - phy-names
  - nvidia,bpmp

# 示例配置
examples:
  - |
    # 包含必要的绑定
    #include <dt-bindings/clock/tegra194-clock.h>
    #include <dt-bindings/interrupt-controller/arm-gic.h>
    #include <dt-bindings/power/tegra194-powergate.h>
    #include <dt-bindings/reset/tegra194-reset.h>

    # 总线节点
    bus@0 {
        #address-cells = <2>;
        #size-cells = <2>;
        ranges = <0x0 0x0 0x0 0x8 0x0>;

        # PCIe 控制器节点
        pcie@14180000 {
            compatible = "nvidia,tegra194-pcie";
            power-domains = <&bpmp TEGRA194_POWER_DOMAIN_PCIEX8B>;
            reg = <0x0 0x14180000 0x0 0x00020000>, /* 应用寄存器 (128K) */
                  <0x0 0x38000000 0x0 0x00040000>, /* 配置空间 (256K) */
                  <0x0 0x38040000 0x0 0x00040000>, /* iATU_DMA 寄存器空间 (256K) */
                  <0x0 0x38080000 0x0 0x00040000>; /* DBI 寄存器空间 (256K) */
            reg-names = "appl", "config", "atu_dma", "dbi";

            #address-cells = <3>;
            #size-cells = <2>;
            device_type = "pci";
            num-lanes = <8>;
            linux,pci-domain = <0>;

            pinctrl-names = "default";
            pinctrl-0 = <&pex_rst_c5_out_state>, <&clkreq_c5_bi_dir_state>;

            clocks = <&bpmp TEGRA194_CLK_PEX0_CORE_0>;
            clock-names = "core";

            resets = <&bpmp TEGRA194_RESET_PEX0_CORE_0_APB>,
                     <&bpmp TEGRA194_RESET_PEX0_CORE_0>;
            reset-names = "apb", "core";

            interrupts = <GIC_SPI 72 IRQ_TYPE_LEVEL_HIGH>, /* 控制器中断 */
                         <GIC_SPI 73 IRQ_TYPE_LEVEL_HIGH>; /* MSI 中断 */
            interrupt-names = "intr", "msi";

            #interrupt-cells = <1>;
            interrupt-map-mask = <0 0 0 0>;
            interrupt-map = <0 0 0 0 &gic GIC_SPI 72 IRQ_TYPE_LEVEL_HIGH>;

            nvidia,bpmp = <&bpmp 0>;

            supports-clkreq;
            nvidia,aspm-cmrt-us = <60>;
            nvidia,aspm-pwr-on-t-us = <20>;
            nvidia,aspm-l0s-entrance-latency-us = <3>;

            bus-range = <0x0 0xff>;
            ranges = <0x81000000 0x0  0x38100000 0x0  0x38100000 0x0 0x00100000>, /* 下游 I/O */
                     <0x82000000 0x0  0x38200000 0x0  0x38200000 0x0 0x01e00000>, /* 非预取内存 */
                     <0xc2000000 0x18 0x00000000 0x18 0x00000000 0x4 0x00000000>; /* 可预取内存 */

            vddio-pex-ctl-supply = <&vdd_1v8ao>;
            vpcie3v3-supply = <&vdd_3v3_pcie>;
            vpcie12v-supply = <&vdd_12v_pcie>;

            phys = <&p2u_hsio_2>, <&p2u_hsio_3>, <&p2u_hsio_4>,
                   <&p2u_hsio_5>;
            phy-names = "p2u-0", "p2u-1", "p2u-2", "p2u-3";
        };
    };

  - |
    # 包含必要的绑定
    #include <dt-bindings/clock/tegra234-clock.h>
    #include <dt-bindings/interrupt-controller/arm-gic.h>
    #include <dt-bindings/power/tegra234-powergate.h>
    #include <dt-bindings/reset/tegra234-reset.h>

    # 总线节点
    bus@0 {
        #address-cells = <2>;
        #size-cells = <2>;
        ranges = <0x0 0x0 0x0 0x8 0x0>;

        # PCIe 控制器节点
        pcie@14160000 {
            compatible = "nvidia,tegra234-pcie";
            power-domains = <&bpmp TEGRA234_POWER_DOMAIN_PCIEX4BB>;
            reg = <0x00 0x14160000 0x0 0x00020000>, /* 应用寄存器 (128K) */
                  <0x00 0x36000000 0x0 0x00040000>, /* 配置空间 (256K) */
                  <0x00 0x36040000 0x0 0x00040000>, /* iATU_DMA 寄存器空间 (256K) */
                  <0x00 0x36080000 0x0 0x00040000>, /* DBI 寄存器空间 (256K) */
                  <0x24 0x30000000 0x0 0x10000000>; /* ECAM (256MB) */
            reg-names = "appl", "config", "atu_dma", "dbi", "ecam";

            #address-cells = <3>;
            #size-cells = <2>;
            device_type = "pci";
            num-lanes = <4>;
            num-viewport = <8>;
            linux,pci-domain = <4>;

            clocks = <&bpmp TEGRA234_CLK_PEX0_C4_CORE>;
            clock-names = "core";

            resets = <&bpmp TEGRA234_RESET_PEX0_CORE_4_APB>,
                     <&bpmp TEGRA234_RESET_PEX0_CORE_4>;
            reset-names = "apb", "core";

            interrupts = <GIC_SPI 51 IRQ_TYPE_LEVEL_HIGH>, /* 控制器中断 */
                         <GIC_SPI 52 IRQ_TYPE_LEVEL_HIGH>; /* MSI 中断 */
            interrupt-names = "intr", "msi";

            #interrupt-cells = <1>;
            interrupt-map-mask = <0 0 0 0>;
            interrupt-map = <0 0 0 0 &gic GIC_SPI 51 IRQ_TYPE_LEVEL_HIGH>;

            nvidia,bpmp = <&bpmp 4>;

            nvidia,aspm-cmrt-us = <60>;
            nvidia,aspm-pwr-on-t-us = <20>;
            nvidia,aspm-l0s-entrance-latency-us = <3>;

            bus-range = <0x0 0xff>;
            ranges = <0x43000000 0x21 0x40000000 0x21 0x40000000 0x2 0xe8000000>, /* 可预取 */
                     <0x02000000 0x0  0x40000000 0x24 0x28000000 0x0 0x08000000>, /* 非预取 */
                     <0x01000000 0x0  0x36100000 0x00 0x36100000 0x0 0x00100000>; /* 下游 I/O */

            vddio-pex-ctl-supply = <&p3701_vdd_AO_1v8>;

            phys = <&p2u_hsio_4>, <&p2u_hsio_5>, <&p2u_hsio_6>,
                   <&p2u_hsio_7>;
            phy-names = "p2u-0", "p2u-1", "p2u-2", "p2u-3";
        };
    };
```

以上是对原始 YAML 配置文件的中文翻译。
~~~~

## Documentation/devicetree/bindings/pci/nvidia,tegra20-pcie_cn.txt
~~~~
### NVIDIA Tegra PCIe 控制器

**必需属性：**
- **compatible：** 必须为以下之一：
  - `"nvidia,tegra20-pcie"`：针对 Tegra20
  - `"nvidia,tegra30-pcie"`：针对 Tegra30
  - `"nvidia,tegra124-pcie"`：针对 Tegra124 和 Tegra132
  - `"nvidia,tegra210-pcie"`：针对 Tegra210
  - `"nvidia,tegra186-pcie"`：针对 Tegra186
- **power-domains：** 用于通过 BPMP 功率门驱动程序解锁功率分区。必须包含 BPMP 的 phandle 和 PCIe 功率分区 ID。此属性仅适用于 Tegra186。
- **device_type：** 必须为 "pci"。
- **reg：** 每组控制器寄存器的物理基地址和长度列表。必须为 reg-names 属性中的每一项包含一个条目。
- **reg-names：** 必须包括以下条目：
  - `"pads"`：PADS 寄存器
  - `"afi"`：AFI 寄存器
  - `"cs"`：配置空间区域
- **interrupts：** 控制器中断输出的列表。必须为 interrupt-names 属性中的每一项包含一个条目。
- **interrupt-names：** 必须包括以下条目：
  - `"intr"`：Tegra 中断，用于控制器中断
  - `"msi"`：Tegra 中断，在接收到 MSI 时被激活
- **bus-range：** 与此控制器关联的总线编号范围。
- **#address-cells：** 根端口的地址表示（必须是 3）
  - 单元 0 指定根端口的总线和设备编号：
    - [23:16]：总线编号
    - [15:11]：设备编号
  - 单元 1 表示上层 32 位地址，并应为 0
  - 单元 2 包含下层 32 位地址，并用于转换到 CPU 地址空间
- **#size-cells：** 根端口的大小表示（必须是 2）。
- **ranges：** 描述根端口和标准 PCI 区域的地址转换。每条记录必须由 6 个单元组成，其中前三个单元对应于上面为 #address-cells 属性描述的地址，第四个单元是将要转换的物理 CPU 地址，第五个和第六个单元对应于上面为 #size-cells 属性描述的内容。
  - 前两个条目预期会转换根端口寄存器的地址，这些地址由根端口节点的 assigned-addresses 属性引用（参见下文）。
  - 剩余的条目设置标准 I/O、内存和可预取 PCI 区域的映射。第一个单元确定设置的区域类型：
    - `0x81000000`：I/O 内存区域
    - `0x82000000`：非可预取内存区域
    - `0xc2000000`：可预取内存区域
  - 请参阅标准 PCI 总线绑定文档以获取更详细的解释。
- **#interrupt-cells：** 中断的大小表示（必须是 1）。
- **interrupt-map-mask** 和 **interrupt-map**：标准 PCI IRQ 映射属性。请参阅标准 PCI 总线绑定文档以获取更详细的解释。
- **clocks：** 必须为 clock-names 中的每一项包含一个条目。详细信息请参阅 `../clocks/clock-bindings.txt`。
- **clock-names：** 必须包括以下条目：
  - `pex`
  - `afi`
  - `pll_e`
  - `cml`（Tegra20 不需要）
- **resets：** 必须为 reset-names 中的每一项包含一个条目。
请参阅 ../reset/reset.txt 获取详细信息。
- reset-names: 必须包含以下条目：
  - pex
  - afi
  - pcie_x

可选属性：
- pinctrl-names: 一组针脚控制状态名称。必须包含以下条目：
  - "default": 激活状态，将PCIe I/O从深度断电状态中移出
  - "idle": 将PCIe I/O置于深度断电状态
- pinctrl-0: 针脚配置默认/激活状态的句柄
- pinctrl-1: 针脚配置空闲状态的句柄
对于Tegra124及以后版本所需的属性（已弃用）：
- phys: 对于phy-names中的每个条目都必须有一个相应的条目
- phy-names: 必须包含以下条目：
  - pcie

这些属性已被弃用，取而代之的是在每个根端口中定义的每通道PHY（见下文）
Tegra20的电源供应：
- avdd-pex-supply: 为模拟PCIe逻辑供电。必须提供1.05V电压
- vdd-pex-supply: 为数字PCIe I/O供电。必须提供1.05V电压
- avdd-pex-pll-supply: 为专用（内部）PCIe PLL供电。必须提供1.05V电压
- avdd-plle-supply: 为PLLE供电，该电源与SATA共享。必须提供1.05V电压
- vddio-pex-clk-supply: 为PCIe时钟供电。必须提供3.3V电压
Tegra30 的电源供应：
- 必需的：
  - avdd-pex-pll-supply：为专用（内部）PCIe PLL 提供电源。必须提供 1.05V。
  - avdd-plle-supply：为 PLLE 提供电源，该电源与 SATA 共享。必须提供 1.05V。
  - vddio-pex-ctl-supply：为 PCIe 控制 I/O 分区提供电源。必须提供 1.8V。
  - hvdd-pex-supply：为 PCIe I/O 和 PCIe 输出时钟提供高压电源。必须提供 3.3V。
- 可选的：
  - 如果使用第 0 至第 3 车道：
    - avdd-pexa-supply：为模拟 PCIe 逻辑提供电源。必须提供 1.05V。
  - vdd-pexa-supply：为数字 PCIe I/O 提供电源。必须提供 1.05V。
  - 如果使用第 4 或第 5 车道：
    - avdd-pexb-supply：为模拟 PCIe 逻辑提供电源。必须提供 1.05V。
  - vdd-pexb-supply：为数字 PCIe I/O 提供电源。必须提供 1.05V。

Tegra124 的电源供应：
- 必需的：
  - avddio-pex-supply：为模拟 PCIe 逻辑提供电源。必须提供 1.05V。
下面是给定内容的中文翻译：

- `dvddio-pex-supply`: 为数字 PCIe I/O 提供电源。必须提供 1.05V 的电压。
- `hvdd-pex-supply`: 为 PCIe I/O 和 PCIe 输出时钟提供高压电源。必须提供 3.3V 的电压。
- `vddio-pex-ctl-supply`: 为 PCIe 控制 I/O 分区提供电源。必须提供 2.8 至 3.3V 的电压。

Tegra210 的电源供应：
- 必需项：
  - `hvddio-pex-supply`: 为 PCIe I/O 和 PCIe 输出时钟提供高压电源。必须提供 1.8V 的电压。
- `dvddio-pex-supply`: 为数字 PCIe I/O 提供电源。必须提供 1.05V 的电压。
- `vddio-pex-ctl-supply`: 为 PCIe 控制 I/O 分区提供电源。必须提供 1.8V 的电压。

Tegra186 的电源供应：
- 必需项：
  - `dvdd-pex-supply`: 为数字 PCIe I/O 提供电源。必须提供 1.05V 的电压。
- `hvdd-pex-pll-supply`: 为 PLLE（与 USB3 共享）提供高压电源。必须提供 1.8V 的电压。
- `hvdd-pex-supply`: 为 PCIe I/O 和 PCIe 输出时钟提供高压电源。
The provided text outlines the Device Tree Source (DTS) files for configuring PCIe controllers and their root ports on various NVIDIA Tegra SoCs. Below is the translation into simplified Chinese:

**必须提供 1.8V**
- `vddio-pexctl-aud-supply`: 为PCIe侧带信号提供的电源。**必须提供 1.8V**
根端口定义为PCIe控制器节点的子节点。
**必需属性:**
- `device_type`: 必须是"pci"
- `assigned-addresses`: 端口配置寄存器的地址和大小
- `reg`: 根端口的PCI总线地址
- `#address-cells`: 必须是3
- `#size-cells`: 必须是2
- `ranges`: 从PCIe控制器节点分配的子范围。一个空属性就足够了
- `nvidia,num-lanes`: 此端口要使用的通道数量。有效的组合是:
  - 根端口0使用4个通道，根端口1未使用
- 所有根端口都使用2个通道
对于Tegra124及以后版本的**必需属性:**
- `phys`: 必须包含PHY列表中每个条目的phandle
- `phy-names`: 必须包括每个活动通道的条目。注意条目的数量不一定（虽然通常会）等于`nvidia,num-lanes`属性中指定的通道数。条目的形式为"pcie-N"，其中N的范围是从0到`nvidia,num-lanes`属性中指定的值

**示例:**

**Tegra20:**

**SoC DTSI:**

```dts
...
```

**板级DTS:**

```dts
...
```

**注释:** PCI总线上的设备通过PCI总线枚举动态发现，因此不需要在设备树中对应设备节点。但是，如果PCI总线上的设备提供了不可探测的总线（如I2C或SPI），则需要添加设备节点以允许操作系统设备树中的适当位置实例化这些总线的子设备。

**Tegra30:**

**SoC DTSI:**

```dts
...
```

**板级DTS:**

```dts
...
```

**Tegra124:**

**SoC DTSI:**

```dts
...
```

**板级DTS:**

```dts
...
```

**Tegra210:**

**SoC DTSI:**

```dts
...
```

**板级DTS:**

```dts
...
```

**Tegra186:**

**SoC DTSI:**

```dts
...
```

**板级DTS:**

```dts
...
```

请注意，以上示例展示了如何在不同的Tegra SoC上配置PCIe控制器及其根端口。每个SoC都有其特定的兼容字符串、地址空间、中断和其他配置细节。此外，板级DTS文件指定了额外的电源管理信息和其他特定于板卡的配置。
~~~~

## Documentation/devicetree/bindings/pci/pci-armada8k_cn.txt
~~~~
* Marvell Armada 7K/8K PCIe 接口

此 PCIe 主机控制器基于 Synopsys DesignWare PCIe IP，
因此继承了在 `snps,dw-pcie.yaml` 中定义的所有通用属性。
必需的属性：
- `compatible`: "marvell,armada8k-pcie"
- `reg`: 必须包含两个寄存器区域
   - 控制寄存器区域
   - 配置空间区域
- `reg-names`:
   - "ctrl" 表示控制寄存器区域
   - "config" 表示配置空间区域
- `interrupts`: PCIe 控制器的中断指定符
- `clocks`: 对 PCIe 控制器时钟的引用
- `clock-names`: 如果存在第二个时钟，则为必填项；在此情况下，第一个时钟的名称必须为 "core"，第二个时钟的名称为 "reg"

可选属性：
- `phys`: PHY 节点的 phandle（一个或多个），这些 PHY 节点遵循通用 PHY 绑定。根据 PCIe 通道的数量，可能需要 1、2 或 4 个 PHY。
- `phy-names`: 对应于通道数量的 PHY 名称。对于 2 个 PHY，名称必须为 "cp0-pcie0-x4-lane0-phy" 和 "cp0-pcie0-x4-lane1-phy"。

示例：

```yaml
pcie@f2600000 {
    compatible = "marvell,armada8k-pcie", "snps,dw-pcie";
    reg = <0 0xf2600000 0 0x10000>, <0 0xf6f00000 0 0x80000>;
    reg-names = "ctrl", "config";
    #address-cells = <3>;
    #size-cells = <2>;
    #interrupt-cells = <1>;
    device_type = "pci";
    dma-coherent;

    bus-range = <0 0xff>;
    ranges = <0x81000000 0 0xf9000000 0  0xf9000000 0 0x10000  /* 下游 I/O */
              0x82000000 0 0xf6000000 0  0xf6000000 0 0xf00000>; /* 不可预取内存 */
    interrupt-map-mask = <0 0 0 0>;
    interrupt-map = <0 0 0 0 &gic 0 GIC_SPI 32 IRQ_TYPE_LEVEL_HIGH>;
    interrupts = <GIC_SPI 32 IRQ_TYPE_LEVEL_HIGH>;
    num-lanes = <1>;
    clocks = <&cpm_syscon0 1 13>;
};
```

以上是关于 Marvell Armada 7K/8K 系列中 PCIe 接口的配置说明和示例。
~~~~
