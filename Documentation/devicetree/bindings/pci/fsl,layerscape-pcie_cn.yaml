## Documentation/devicetree/bindings/pci/mvebu-pci_cn.txt
~~~~
* Marvell EBU PCIe 接口

必需属性：

- compatible: 必须是以下值之一：
    marvell,armada-370-pcie
    marvell,armada-xp-pcie
    marvell,dove-pcie
    marvell,kirkwood-pcie
- #address-cells, 设置为 <3>
- #size-cells, 设置为 <2>
- #interrupt-cells, 设置为 <1>
- bus-range: 覆盖的 PCI 总线编号
- device_type, 设置为 "pci"
- ranges: 描述用于控制 PCIe 接口的 MMIO 寄存器以及描述每个 PCIe 接口访问内存和 I/O 区域所需的 MBus 窗口的范围
- msi-parent: 指向服务于该 PCI 控制器的消息信号中断控制器的硬件实体
描述 MMIO 寄存器的范围具有以下布局：

    0x82000000 0 r MBUS_ID(0xf0, 0x01) r 0 s

其中：

  * r 是一个 32 位值，表示此 PCIe 接口的 MMIO 寄存器相对于内部寄存器基址的偏移量
  * s 是一个 32 位值，表示此 MMIO 寄存器区域的大小。此范围条目将 '0x82000000 0 r' PCI 地址转换为 'MBUS_ID(0xf0, 0x01) r' CPU 地址，该地址属于内部寄存器窗口（由 MBUS_ID(0xf0, 0x01) 标识）
描述 MBus 窗口的范围具有以下布局：

    0x8t000000 s 0     MBUS_ID(w, a) 0 1 0

其中：

   * t 是 MBus 窗口的类型（根据标准 PCI 设备树绑定定义），1 表示 I/O，2 表示内存
   * s 是与此 PCIe 接口对应的 PCI 插槽
   * w 是 MBus 窗口的 '目标 ID' 值
   * a 是 MBus 窗口的 '属性' 值
由于不同的 MBus 窗口在硬件中的位置和大小不是固定的，并且仅在运行时确定，因此这些范围覆盖了物理地址空间的前 4GB，并且不会转换为有效的 CPU 地址。
此外，设备树节点必须有描述每个 PCIe 接口的子节点，具有以下必需属性：

- reg: 仅用于中断映射，因此仅使用前四个字节来引用正确的总线编号和设备编号
- assigned-addresses: 对用于控制此 PCIe 接口的 MMIO 寄存器的引用
- clocks: 与此 PCIe 接口相关的时钟
- marvell,pcie-port: 物理 PCIe 端口号
- status: "disabled" 或 "okay"
- device_type, 设置为 "pci"
- #address-cells, 设置为 <3>
- #size-cells, 设置为 <2>
- #interrupt-cells, 设置为 <1>
- ranges, 将父节点的 MBus 窗口范围转换为标准 PCI 地址
下面是给定的文本翻译成中文：

- `interrupt-map-mask` 和 `interrupt-map`：标准PCI属性，用于定义PCIe接口到中断号的映射；
- 以下为可选属性：
  - `marvell,pcie-lane`：物理PCIe通道编号，针对具有多个通道的端口。如果未找到此属性，则假设其值为0。
  - `num-lanes`：该链路的SerDes PCIe通道数（1或4）。
  - `reset-gpios`：可选的GPIO至PERST#。
  - `reset-delay-us`：复位撤销后等待的时间（单位：微秒）。若未指定，则默认为100毫秒，符合PCIe规范的要求。
  - `interrupt-names`：中断名称列表，支持如下：
    - `"intx"`：由传统中断触发的中断线。
  - `interrupts` 或 `interrupts-extended`：与`interrupt-names`对应的中断源列表。如果非空，则还需要定义额外的`interrupt-controller`子节点。

示例：

```text
pcie-controller {
	compatible = "marvell,armada-xp-pcie";
	device_type = "pci";

	#address-cells = <3>;
	#size-cells = <2>;

	bus-range = <0x00 0xff>;
	msi-parent = <&mpic>;

	ranges =
	       <0x82000000 0 0x40000 MBUS_ID(0xf0, 0x01) 0x40000 0 0x00002000	/* 端口 0.0 寄存器 */
		0x82000000 0 0x42000 MBUS_ID(0xf0, 0x01) 0x42000 0 0x00002000	/* 端口 2.0 寄存器 */
		0x82000000 0 0x44000 MBUS_ID(0xf0, 0x01) 0x44000 0 0x00002000	/* 端口 0.1 寄存器 */
		0x82000000 0 0x48000 MBUS_ID(0xf0, 0x01) 0x48000 0 0x00002000	/* 端口 0.2 寄存器 */
		0x82000000 0 0x4c000 MBUS_ID(0xf0, 0x01) 0x4c000 0 0x00002000	/* 端口 0.3 寄存器 */
		0x82000000 0 0x80000 MBUS_ID(0xf0, 0x01) 0x80000 0 0x00002000	/* 端口 1.0 寄存器 */
		0x82000000 0 0x82000 MBUS_ID(0xf0, 0x01) 0x82000 0 0x00002000	/* 端口 3.0 寄存器 */
		0x82000000 0 0x84000 MBUS_ID(0xf0, 0x01) 0x84000 0 0x00002000	/* 端口 1.1 寄存器 */
		0x82000000 0 0x88000 MBUS_ID(0xf0, 0x01) 0x88000 0 0x00002000	/* 端口 1.2 寄存器 */
		0x82000000 0 0x8c000 MBUS_ID(0xf0, 0x01) 0x8c000 0 0x00002000	/* 端口 1.3 寄存器 */
		0x82000000 0x1 0     MBUS_ID(0x04, 0xe8) 0 1 0 /* 端口 0.0 内存 */
		0x81000000 0x1 0     MBUS_ID(0x04, 0xe0) 0 1 0 /* 端口 0.0 I/O  */
		0x82000000 0x2 0     MBUS_ID(0x04, 0xd8) 0 1 0 /* 端口 0.1 内存 */
		0x81000000 0x2 0     MBUS_ID(0x04, 0xd0) 0 1 0 /* 端口 0.1 I/O  */
		0x82000000 0x3 0     MBUS_ID(0x04, 0xb8) 0 1 0 /* 端口 0.2 内存 */
		0x81000000 0x3 0     MBUS_ID(0x04, 0xb0) 0 1 0 /* 端口 0.2 I/O  */
		0x82000000 0x4 0     MBUS_ID(0x04, 0x78) 0 1 0 /* 端口 0.3 内存 */
		0x81000000 0x4 0     MBUS_ID(0x04, 0x70) 0 1 0 /* 端口 0.3 I/O  */

		0x82000000 0x5 0     MBUS_ID(0x08, 0xe8) 0 1 0 /* 端口 1.0 内存 */
		0x81000000 0x5 0     MBUS_ID(0x08, 0xe0) 0 1 0 /* 端口 1.0 I/O  */
		0x82000000 0x6 0     MBUS_ID(0x08, 0xd8) 0 1 0 /* 端口 1.1 内存 */
		0x81000000 0x6 0     MBUS_ID(0x08, 0xd0) 0 1 0 /* 端口 1.1 I/O  */
		0x82000000 0x7 0     MBUS_ID(0x08, 0xb8) 0 1 0 /* 端口 1.2 内存 */
		0x81000000 0x7 0     MBUS_ID(0x08, 0xb0) 0 1 0 /* 端口 1.2 I/O  */
		0x82000000 0x8 0     MBUS_ID(0x08, 0x78) 0 1 0 /* 端口 1.3 内存 */
		0x81000000 0x8 0     MBUS_ID(0x08, 0x70) 0 1 0 /* 端口 1.3 I/O  */

		0x82000000 0x9 0     MBUS_ID(0x04, 0xf8) 0 1 0 /* 端口 2.0 内存 */
		0x81000000 0x9 0     MBUS_ID(0x04, 0xf0) 0 1 0 /* 端口 2.0 I/O  */

		0x82000000 0xa 0     MBUS_ID(0x08, 0xf8) 0 1 0 /* 端口 3.0 内存 */
		0x81000000 0xa 0     MBUS_ID(0x08, 0xf0) 0 1 0 /* 端口 3.0 I/O  */>;

	pcie@1,0 {
		device_type = "pci";
		assigned-addresses = <0x82000800 0 0x40000 0 0x2000>;
		reg = <0x0800 0 0 0 0>;
		#address-cells = <3>;
		#size-cells = <2>;
		#interrupt-cells = <1>;
		ranges = <0x82000000 0 0 0x82000000 0x1 0 1 0
			  0x81000000 0 0 0x81000000 0x1 0 1 0>;
		interrupt-map-mask = <0 0 0 0>;
		interrupt-map = <0 0 0 0 &mpic 58>;
		marvell,pcie-port = <0>;
		marvell,pcie-lane = <0>;
		num-lanes = <1>;
		/* GPIO 25 上的低电平有效的 PERST# 复位 */
		reset-gpios = <&gpio0 25 1>;
		/* 复位撤销后等待设备稳定20毫秒 */
		reset-delay-us = <20000>;
		clocks = <&gateclk 5>;
	};

	pcie@2,0 {
		device_type = "pci";
		assigned-addresses = <0x82001000 0 0x44000 0 0x2000>;
		reg = <0x1000 0 0 0 0>;
		#address-cells = <3>;
		#size-cells = <2>;
		#interrupt-cells = <1>;
		ranges = <0x82000000 0 0 0x82000000 0x2 0 1 0
			  0x81000000 0 0 0x81000000 0x2 0 1 0>;
		interrupt-map-mask = <0 0 0 0>;
		interrupt-map = <0 0 0 0 &mpic 59>;
		marvell,pcie-port = <0>;
		marvell,pcie-lane = <1>;
		num-lanes = <1>;
		clocks = <&gateclk 6>;
	};

	...

	pcie@a,0 {
		device_type = "pci";
		assigned-addresses = <0x82005000 0 0x82000 0 0x2000>;
		reg = <0x5000 0 0 0 0>;
		#address-cells = <3>;
		#size-cells = <2>;
		#interrupt-cells = <1>;
		ranges = <0x82000000 0 0 0x82000000 0xa 0 1 0
			  0x81000000 0 0 0x81000000 0xa 0 1 0>;
		interrupt-map-mask = <0 0 0 0>;
		interrupt-map = <0 0 0 0 &mpic 103>;
		marvell,pcie-port = <3>;
		marvell,pcie-lane = <0>;
		num-lanes = <1>;
		clocks = <&gateclk 27>;
	};
};
```

请注意，上述示例中省略了中间部分，以保持示例的简洁性。
~~~~

## Documentation/devicetree/bindings/pci/nvidia,tegra194-pcie-ep_cn.yaml
~~~~yaml
# SPDX-许可证标识符: (GPL-2.0-only 或 BSD-2-Clause)
%YAML 1.2
---
$id: http://devicetree.org/schemas/pci/nvidia,tegra194-pcie-ep.yaml#
$schema: http://devicetree.org/meta-schemas/core.yaml#

title: NVIDIA Tegra194 (及其后续版本) 的 PCIe 终端控制器（基于 Synopsys DesignWare 核心）

maintainers:
  - Thierry Reding <thierry.reding@gmail.com>
  - Jon Hunter <jonathanh@nvidia.com>
  - Vidya Sagar <vidyas@nvidia.com>

description: |
  此 PCIe 控制器基于 Synopsys DesignWare PCIe IP，因此继承了在 snps,dw-pcie-ep.yaml 中定义的所有通用属性。部分控制器实例支持双模式；它们可以在根端口模式或终端模式下工作，但不能同时使用两种模式。
  在 Tegra194 上，控制器 C0、C4 和 C5 支持终端模式。
  在 Tegra234 上，控制器 C5、C6、C7 和 C10 支持终端模式。
  注意：在 Tegra194 的 P2972-0000 平台上，仅 C5 控制器可以被启用以终端模式运行，这是由于平台的设计方式决定的。

properties:
  compatible:
    enum:
      - nvidia,tegra194-pcie-ep
      - nvidia,tegra234-pcie-ep

  reg:
    items:
      - description: 控制器的应用逻辑寄存器
      - description: iATU 和 DMA 寄存器。这是 PCIe 核心的 iATU（内部地址转换单元）寄存器对软件访问可用的位置
      - description: 根端口自身的配置寄存器所在的开孔
      - description: 映射远程根复合体地址空间所用的开孔

  reg-names:
    items:
      - const: appl
      - const: atu_dma
      - const: dbi
      - const: addr_space

  interrupts:
    items:
      - description: 控制器中断

  interrupt-names:
    items:
      - const: intr

  clocks:
    items:
      - description: 模块时钟

  clock-names:
    items:
      - const: core

  resets:
    items:
      - description: APB 总线接口复位
      - description: 模块复位

  reset-names:
    items:
      - const: apb
      - const: core

  reset-gpios:
    description: 必须包含指向 GPIO 控制器的 phandle 及 GPIO，该 GPIO 被用作 PERST 输入信号。请参考 pci.txt

  phys:
    minItems: 1
    maxItems: 8

  phy-names:
    minItems: 1
    items:
      - const: p2u-0
      - const: p2u-1
      - const: p2u-2
      - const: p2u-3
      - const: p2u-4
      - const: p2u-5
      - const: p2u-6
      - const: p2u-7

  power-domains:
    maxItems: 1
    description: |
      包含指向控制相应 PCIe 控制器电源的节点的 phandle 和针对 PCIe 控制器的指定名称
      Tegra194 的指定名称定义在 "include/dt-bindings/power/tegra194-powergate.h" 中
      Tegra234 的指定名称定义在 "include/dt-bindings/power/tegra234-powergate.h" 中

  interconnects:
    items:
      - description: 内存读取客户端
      - description: 内存写入客户端

  interconnect-names:
    items:
      - const: dma-mem # 读取
      - const: write

  dma-coherent: true

  nvidia,bpmp:
    $ref: /schemas/types.yaml#/definitions/phandle-array
    description: |
      必须包含指向 BPMP 控制器节点的 phandle 对以及控制器 ID。以下是每个控制器的控制器 ID：

      Tegra194

        0: C0
        1: C1
        2: C2
        3: C3
        4: C4
        5: C5

      Tegra234

        0: C0
        1: C1
        2: C2
        3: C3
        4: C4
        5: C5
        6: C6
        7: C7
        8: C8
        9: C9
        10: C10

    items:
      - items:
          - description: 指向 BPMP 控制器节点的 phandle
          - description: PCIe 控制器 ID
            maximum: 10

  nvidia,aspm-cmrt-us:
    description: 为正确操作 ASPM 规定的常用模式恢复时间（以微秒为单位）

  nvidia,aspm-pwr-on-t-us:
    description: 为正确操作 ASPM 规定的上电时间（以微秒为单位）

  nvidia,aspm-l0s-entrance-latency-us:
    description: ASPM L0s 进入延迟（以微秒为单位）

  vddio-pex-ctl-supply:
    description: 指向 PCIe 边带信号的调节电源供应的 phandle

  nvidia,refclk-select-gpios:
    maxItems: 1
    description: 用于从主机启用 REFCLK 至控制器的 GPIO

  nvidia,enable-ext-refclk:
    description: |
      如果控制器被配置为从主机接收参考时钟，则需要存在此布尔属性
      注意：这仅适用于 Tegra234
这段文本定义了两个 PCI Express Endpoint (PCIE EP) 配置示例，分别针对 NVIDIA Tegra194 和 Tegra234 平台。以下是这些配置的中文翻译：

```yaml
# 引用 flag 定义
$ref: /schemas/types.yaml#/definitions/flag

# 配置项 nvidia,enable-srns
nvidia,enable-srns:
  description: |
    如果控制器被配置为在 SRNS（分离参考时钟无展频时钟）模式下运行，则需要存在此布尔属性。
    注意：这仅适用于 Tegra234。

# 引用 snps,dw-pcie-ep.yaml 中的定义
allOf:
  - $ref: /schemas/pci/snps,dw-pcie-ep.yaml#

# 不允许未评估的属性
unevaluatedProperties: false

# 必须存在的属性
required:
  - interrupts
  - interrupt-names
  - clocks
  - clock-names
  - resets
  - reset-names
  - power-domains
  - reset-gpios
  - vddio-pex-ctl-supply
  - num-lanes
  - phys
  - phy-names
  - nvidia,bpmp

# 示例配置
examples:
  - |
    # 包含必要的绑定文件
    #include <dt-bindings/clock/tegra194-clock.h>
    #include <dt-bindings/gpio/tegra194-gpio.h>
    #include <dt-bindings/interrupt-controller/arm-gic.h>
    #include <dt-bindings/power/tegra194-powergate.h>
    #include <dt-bindings/reset/tegra194-reset.h>

    # 总线配置
    bus@0 {
        # 地址单元数
        #address-cells = <2>;
        # 大小单元数
        #size-cells = <2>;
        # 范围
        ranges = <0x0 0x0 0x0 0x8 0x0>;

        # PCIE EP 控制器配置
        pcie-ep@141a0000 {
            # 兼容性声明
            compatible = "nvidia,tegra194-pcie-ep";
            # 寄存器空间
            reg = <0x00 0x141a0000 0x0 0x00020000>, /* 应用寄存器 (128K) */
                  <0x00 0x3a040000 0x0 0x00040000>, /* iATU_DMA 寄存器空间 (256K) */
                  <0x00 0x3a080000 0x0 0x00040000>, /* DBI 寄存器空间 (256K) */
                  <0x1c 0x00000000 0x4 0x00000000>; /* 地址空间 (16G) */
            # 寄存器名称
            reg-names = "appl", "atu_dma", "dbi", "addr_space";
            # 中断
            interrupts = <GIC_SPI 53 IRQ_TYPE_LEVEL_HIGH>; /* 控制器中断 */
            # 中断名称
            interrupt-names = "intr";

            # 时钟
            clocks = <&bpmp TEGRA194_CLK_PEX1_CORE_5>;
            # 时钟名称
            clock-names = "core";

            # 重置信号
            resets = <&bpmp TEGRA194_RESET_PEX1_CORE_5_APB>,
                     <&bpmp TEGRA194_RESET_PEX1_CORE_5>;
            # 重置信号名称
            reset-names = "apb", "core";

            # 电源域
            power-domains = <&bpmp TEGRA194_POWER_DOMAIN_PCIEX8A>;
            # 引脚控制器名称
            pinctrl-names = "default";
            # 引脚控制器状态
            pinctrl-0 = <&clkreq_c5_bi_dir_state>;

            # NVIDIA BPMP 控制器
            nvidia,bpmp = <&bpmp 5>;

            # ASPM 参数
            nvidia,aspm-cmrt-us = <60>;
            nvidia,aspm-pwr-on-t-us = <20>;
            nvidia,aspm-l0s-entrance-latency-us = <3>;

            # VDDIO PEX 控制电源
            vddio-pex-ctl-supply = <&vdd_1v8ao>;

            # 重置 GPIO
            reset-gpios = <&gpio TEGRA194_MAIN_GPIO(GG, 1) GPIO_ACTIVE_LOW>;

            # 参考时钟选择 GPIO
            nvidia,refclk-select-gpios = <&gpio_aon TEGRA194_AON_GPIO(AA, 5)
                                          GPIO_ACTIVE_HIGH>;

            # 车道数量
            num-lanes = <8>;

            # 物理层设备
            phys = <&p2u_nvhs_0>, <&p2u_nvhs_1>, <&p2u_nvhs_2>,
                   <&p2u_nvhs_3>, <&p2u_nvhs_4>, <&p2u_nvhs_5>,
                   <&p2u_nvhs_6>, <&p2u_nvhs_7>;

            # 物理层设备名称
            phy-names = "p2u-0", "p2u-1", "p2u-2", "p2u-3", "p2u-4",
                        "p2u-5", "p2u-6", "p2u-7";
        };
    };

  - |
    # 包含必要的绑定文件
    #include <dt-bindings/clock/tegra234-clock.h>
    #include <dt-bindings/gpio/tegra234-gpio.h>
    #include <dt-bindings/interrupt-controller/arm-gic.h>
    #include <dt-bindings/power/tegra234-powergate.h>
    #include <dt-bindings/reset/tegra234-reset.h>

    # 总线配置
    bus@0 {
        # 地址单元数
        #address-cells = <2>;
        # 大小单元数
        #size-cells = <2>;
        # 范围
        ranges = <0x0 0x0 0x0 0x8 0x0>;

        # PCIE EP 控制器配置
        pcie-ep@141a0000 {
            # 兼容性声明
            compatible = "nvidia,tegra234-pcie-ep";
            # 电源域
            power-domains = <&bpmp TEGRA234_POWER_DOMAIN_PCIEX8A>;
            # 寄存器空间
            reg = <0x00 0x141a0000 0x0 0x00020000>, /* 应用寄存器 (128K) */
                  <0x00 0x3a040000 0x0 0x00040000>, /* iATU_DMA 寄存器空间 (256K) */
                  <0x00 0x3a080000 0x0 0x00040000>, /* DBI 寄存器空间 (256K) */
                  <0x27 0x40000000 0x4 0x00000000>; /* 地址空间 (16G) */
            # 寄存器名称
            reg-names = "appl", "atu_dma", "dbi", "addr_space";

            # 中断
            interrupts = <GIC_SPI 53 IRQ_TYPE_LEVEL_HIGH>; /* 控制器中断 */
            # 中断名称
            interrupt-names = "intr";

            # 时钟
            clocks = <&bpmp TEGRA234_CLK_PEX1_C5_CORE>;
            # 时钟名称
            clock-names = "core";

            # 重置信号
            resets = <&bpmp TEGRA234_RESET_PEX1_CORE_5_APB>,
                     <&bpmp TEGRA234_RESET_PEX1_CORE_5>;
            # 重置信号名称
            reset-names = "apb", "core";

            # NVIDIA BPMP 控制器
            nvidia,bpmp = <&bpmp 5>;

            # 启用外部参考时钟
            nvidia,enable-ext-refclk;
            # ASPM 参数
            nvidia,aspm-cmrt-us = <60>;
            nvidia,aspm-pwr-on-t-us = <20>;
            nvidia,aspm-l0s-entrance-latency-us = <3>;

            # VDDIO PEX 控制电源
            vddio-pex-ctl-supply = <&p3701_vdd_1v8_ls>;

            # 重置 GPIO
            reset-gpios = <&gpio TEGRA234_MAIN_GPIO(AF, 1) GPIO_ACTIVE_LOW>;

            # 参考时钟选择 GPIO
            nvidia,refclk-select-gpios = <&gpio_aon
                                          TEGRA234_AON_GPIO(AA, 4)
                                          GPIO_ACTIVE_HIGH>;

            # 车道数量
            num-lanes = <8>;

            # 物理层设备
            phys = <&p2u_nvhs_0>, <&p2u_nvhs_1>, <&p2u_nvhs_2>,
                   <&p2u_nvhs_3>, <&p2u_nvhs_4>, <&p2u_nvhs_5>,
                   <&p2u_nvhs_6>, <&p2u_nvhs_7>;

            # 物理层设备名称
            phy-names = "p2u-0", "p2u-1", "p2u-2", "p2u-3", "p2u-4",
                        "p2u-5", "p2u-6", "p2u-7";
        };
    };
```

请注意，这里的示例是针对特定硬件平台（NVIDIA Tegra194 和 Tegra234）的详细配置，并且包含了必要的中断、时钟、重置等信息。这些配置通常用于 Device Tree 中来描述硬件的结构和配置细节。
~~~~
