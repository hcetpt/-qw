## Documentation/devicetree/bindings/pci/fsl,layerscape-pcie_cn.yaml
```yaml
# SPDX-许可证标识符: (GPL-2.0-only 或 BSD-2-Clause)
%YAML 1.2
---
$id: http://devicetree.org/schemas/pci/fsl,layerscape-pcie.yaml#
$schema: http://devicetree.org/meta-schemas/core.yaml#

标题: Freescale Layerscape PCIe 根复合体(RC)控制器

维护者:
  - Frank Li <Frank.Li@nxp.com>

描述:
  此 PCIe RC 控制器基于 Synopsys DesignWare PCIe IP。

  此控制器从重置配置词(RCW)获取其时钟，该配置词用于在芯片复位时描述 PLL 设置。
  根据可用的参考手册，Freescale PCIe 控制器寄存器集内没有特定的“版本”寄存器，
  这使得无法确定底层 DesignWare PCIe 控制器的版本信息。
属性:
  compatible:
    枚举:
      - fsl,ls1021a-pcie
      - fsl,ls2080a-pcie
      - fsl,ls2085a-pcie
      - fsl,ls2088a-pcie
      - fsl,ls1088a-pcie
      - fsl,ls1046a-pcie
      - fsl,ls1043a-pcie
      - fsl,ls1012a-pcie
      - fsl,ls1028a-pcie
      - fsl,lx2160a-pcie

  reg:
    maxItems: 2

  reg-names:
    items:
      - 常量: regs
      - 常量: config

  fsl,pcie-scfg:
    $ref: /schemas/types.yaml#/definitions/phandle
    描述: 指向 SCFG 设备节点的 phandle。第二个条目是从 '0' 开始的物理 PCIe 控制器索引。这用于获取 SCFG PEXN 寄存器
big-endian:
    $ref: /schemas/types.yaml#/definitions/flag
    描述: 如果 PEX_LUT 和 PF 寄存器块采用大端格式，请指定此属性
dma-coherent: true

  msi-parent: true

  iommu-map: true

  interrupts:
    minItems: 1
    maxItems: 2

  interrupt-names:
    minItems: 1
    maxItems: 2

必需:
  - compatible
  - reg
  - reg-names
  - "#address-cells"
  - "#size-cells"
  - device_type
  - bus-range
  - ranges
  - interrupts
  - interrupt-names
  - "#interrupt-cells"
  - interrupt-map-mask
  - interrupt-map

allOf:
  - $ref: /schemas/pci/pci-bus.yaml#

  - 如果:
      属性:
        compatible:
          枚举:
            - fsl,ls1028a-pcie
            - fsl,ls1046a-pcie
            - fsl,ls1043a-pcie
            - fsl,ls1012a-pcie
    然后:
      属性:
        interrupts:
          maxItems: 2
        interrupt-names:
          items:
            - 常量: pme
            - 常量: aer

  - 如果:
      属性:
        compatible:
          枚举:
            - fsl,ls2080a-pcie
            - fsl,ls2085a-pcie
            - fsl,ls2088a-pcie
    然后:
      属性:
        interrupts:
          maxItems: 1
        interrupt-names:
          items:
            - 常量: intr

  - 如果:
      属性:
        compatible:
          枚举:
            - fsl,ls1088a-pcie
    然后:
      属性:
        interrupts:
          maxItems: 1
        interrupt-names:
          items:
            - 常量: aer

unevaluatedProperties: false

示例:
  - |
    #include <dt-bindings/interrupt-controller/arm-gic.h>

    soc {
      #address-cells = <2>;
      #size-cells = <2>;

      pcie@3400000 {
        compatible = "fsl,ls1088a-pcie";
        reg = <0x00 0x03400000 0x0 0x00100000>, /* 控制器寄存器 */
            <0x20 0x00000000 0x0 0x00002000>; /* 配置空间 */
        reg-names = "regs", "config";
        interrupts = <0 108 IRQ_TYPE_LEVEL_HIGH>; /* aer 中断 */
        interrupt-names = "aer";
        #address-cells = <3>;
        #size-cells = <2>;
        dma-coherent;
        device_type = "pci";
        bus-range = <0x0 0xff>;
        ranges = <0x81000000 0x0 0x00000000 0x20 0x00010000 0x0 0x00010000   /* 下游 I/O */
                 0x82000000 0x0 0x40000000 0x20 0x40000000 0x0 0x40000000>; /* 不可预取内存 */
        msi-parent = <&its>;
        #interrupt-cells = <1>;
        interrupt-map-mask = <0 0 0 7>;
        interrupt-map = <0000 0 0 1 &gic 0 0 0 109 IRQ_TYPE_LEVEL_HIGH>,
                        <0000 0 0 2 &gic 0 0 0 110 IRQ_TYPE_LEVEL_HIGH>,
                        <0000 0 0 3 &gic 0 0 0 111 IRQ_TYPE_LEVEL_HIGH>,
                        <0000 0 0 4 &gic 0 0 0 112 IRQ_TYPE_LEVEL_HIGH>;
        iommu-map = <0 &smmu 0 1>; /* 由引导加载程序修正 */
      };
    };
..
```

## Documentation/devicetree/bindings/pci/fsl,pci_cn.txt
```
飞思卡尔 PCI-X 代理模式下的总线枚举

通常，任何被配置为代理模式的飞思卡尔 PCI-X 桥接硬件都会被阻止进行总线枚举。PrPMC 形式因素要求所有中板（mezzanine）都必须是 PCI-X 代理，但每个系统中仍可以有一个进行总线枚举。
下面定义的属性将允许一个即使被配置为代理模式的 PCI-X 桥接器用于总线枚举。
必需的属性：
- `fsl,pci-agent-force-enum`：此属性没有关联值。该属性本身被视为布尔值。
示例：

	/* 知道是 PrPMC Monarch 的 PCI-X 桥接器 */
	pci0: pci@ef008000 {
		fsl,pci-agent-force-enum;
		#interrupt-cells = <1>;
		#size-cells = <2>;
		#address-cells = <3>;
		compatible = "fsl,mpc8540-pcix", "fsl,mpc8540-pci";
		device_type = "pci";
		..
		..
	};
```

## Documentation/devicetree/bindings/pci/hisilicon,kirin-pcie_cn.yaml
```yaml
# SPDX-许可证标识符: GPL-2.0
%YAML 1.2
---
$id: http://devicetree.org/schemas/pci/hisilicon,kirin-pcie.yaml#
$schema: http://devicetree.org/meta-schemas/core.yaml#

标题: HiSilicon Kirin 系统级芯片 (SoC) 的 PCIe 主机设备树描述

维护者:
  - 歌小伟 <songxiaowei@hisilicon.com>
  - 王炳辉 <wangbinghui@hisilicon.com>

描述: |
  Kirin PCIe 主控制器基于 Synopsys DesignWare PCI 核心
它与 PCIe DesignWare 核心驱动程序共享通用功能，并
继承了在
文档/devicetree/bindings/pci/snps,dw-pcie.yaml 中定义的通用属性
allOf:
  - $ref: /schemas/pci/snps,dw-pcie.yaml#

属性:
  compatible:
    包含:
      枚举:
        - hisilicon,kirin960-pcie
        - hisilicon,kirin970-pcie

  reg:
    描述: |
      应包含 DBI、APB 和配置寄存器的位置和长度
对于 hisilicon,kirin960-pcie，还应包含 PHY
minItems: 3
    maxItems: 4

  reg-names:
    minItems: 3
    maxItems: 4

  clocks: true

  clock-names:
    items:
      - 常量: pcie_phy_ref
      - 常量: pcie_aux
      - 常量: pcie_apb_phy
      - 常量: pcie_apb_sys
      - 常量: pcie_aclk

  phys:
    maxItems: 1

  hisilicon,clken-gpios:
    描述: |
      来自 PCI 设备（如以太网、M.2 和 mini-PCIe 插槽）的时钟输入使能 GPIO
所需:
  - compatible
  - reg
  - reg-names

未评估属性: false

示例:
  - |
    #include <dt-bindings/interrupt-controller/arm-gic.h>
    #include <dt-bindings/clock/hi3660-clock.h>
    #include <dt-bindings/clock/hi3670-clock.h>

    soc {
      #address-cells = <2>;
      #size-cells = <2>;

      pcie@f4000000 {
        compatible = "hisilicon,kirin960-pcie";
        reg = <0x0 0xf4000000 0x0 0x1000>,
              <0x0 0xff3fe000 0x0 0x1000>,
              <0x0 0xf3f20000 0x0 0x40000>,
              <0x0 0xf5000000 0x0 0x2000>;
        reg-names = "dbi", "apb", "phy", "config";
        bus-range = <0x0  0xff>;
        #address-cells = <3>;
        #size-cells = <2>;
        device_type = "pci";
        ranges = <0x02000000 0x0 0x00000000
                  0x0 0xf6000000
                  0x0 0x02000000>;
        num-lanes = <1>;
        #interrupt-cells = <1>;
        interrupts = <0 283 4>;
        interrupt-names = "msi";
        interrupt-map-mask = <0xf800 0 0 7>;
        interrupt-map = <0x0 0 0 1 &gic GIC_SPI 282 IRQ_TYPE_LEVEL_HIGH>,
                        <0x0 0 0 2 &gic GIC_SPI 283 IRQ_TYPE_LEVEL_HIGH>,
                        <0x0 0 0 3 &gic GIC_SPI 284 IRQ_TYPE_LEVEL_HIGH>,
                        <0x0 0 0 4 &gic GIC_SPI 285 IRQ_TYPE_LEVEL_HIGH>;
        clocks = <&crg_ctrl HI3660_PCIEPHY_REF>,
                 <&crg_ctrl HI3660_CLK_GATE_PCIEAUX>,
                 <&crg_ctrl HI3660_PCLK_GATE_PCIE_PHY>,
                 <&crg_ctrl HI3660_PCLK_GATE_PCIE_SYS>,
                 <&crg_ctrl HI3660_ACLK_GATE_PCIE>;
        clock-names = "pcie_phy_ref", "pcie_aux", "pcie_apb_phy",
                      "pcie_apb_sys", "pcie_aclk";
      };

      pcie@f5000000 {
        compatible = "hisilicon,kirin970-pcie";
        reg = <0x0 0xf4000000 0x0 0x1000000>,
              <0x0 0xfc180000 0x0 0x1000>,
              <0x0 0xf5000000 0x0 0x2000>;
        reg-names = "dbi", "apb", "config";
        bus-range = <0x0  0xff>;
        #address-cells = <3>;
        #size-cells = <2>;
        device_type = "pci";
        phys = <&pcie_phy>;
        ranges = <0x02000000 0x0 0x00000000
                  0x0 0xf6000000
                  0x0 0x02000000>;
        num-lanes = <1>;
        #interrupt-cells = <1>;
        interrupts = <GIC_SPI 283 IRQ_TYPE_LEVEL_HIGH>;
        interrupt-names = "msi";
        interrupt-map-mask = <0 0 0 7>;
        interrupt-map = <0x0 0 0 1 &gic GIC_SPI 282 IRQ_TYPE_LEVEL_HIGH>,
                        <0x0 0 0 2 &gic GIC_SPI 283 IRQ_TYPE_LEVEL_HIGH>,
                        <0x0 0 0 3 &gic GIC_SPI 284 IRQ_TYPE_LEVEL_HIGH>,
                        <0x0 0 0 4 &gic GIC_SPI 285 IRQ_TYPE_LEVEL_HIGH>;
        reset-gpios = <&gpio7 0 0>;
        hisilicon,clken-gpios = <&gpio27 3 0>, <&gpio17 0 0>, <&gpio20 6 0>;
        pcie@0,0 { // 车道 0: PCIe 交换机: 总线 1, 设备 0
          reg = <0 0 0 0 0>;
          compatible = "pciclass,0604";
          device_type = "pci";
          #address-cells = <3>;
          #size-cells = <2>;
          ranges;

          pcie@0,0 { // 车道 0: 上游
            reg = <0 0 0 0 0>;
            compatible = "pciclass,0604";
            device_type = "pci";
            #address-cells = <3>;
            #size-cells = <2>;
            ranges;

            pcie@1,0 { // 车道 4: M.2
              reg = <0x0800 0 0 0 0>;
              compatible = "pciclass,0604";
              device_type = "pci";
              reset-gpios = <&gpio3 1 0>;
              #address-cells = <3>;
              #size-cells = <2>;
              ranges;
            };

            pcie@5,0 { // 车道 5: Mini PCIe
              reg = <0x2800 0 0 0 0>;
              compatible = "pciclass,0604";
              device_type = "pci";
              reset-gpios = <&gpio27 4 0 >;
              #address-cells = <3>;
              #size-cells = <2>;
              ranges;
            };

            pcie@7,0 { // 车道 6: 以太网
              reg = <0x03800 0 0 0 0>;
              compatible = "pciclass,0604";
              device_type = "pci";
              reset-gpios = <&gpio25 2 0 >;
              #address-cells = <3>;
              #size-cells = <2>;
              ranges;
            };
          };
        };
      };
    };
```

## Documentation/devicetree/bindings/pci/hisilicon-histb-pcie_cn.txt
~~~~
海思STB PCIe主机桥接器设备树描述

海思STB PCIe主机控制器基于DesignWare PCIe内核，
它与DesignWare PCIe内核驱动程序共享通用功能，并继承了
在 `Documentation/devicetree/bindings/pci/snps,dw-pcie.yaml` 中定义的
通用属性。额外的属性在这里描述：

必需的属性
- compatible: 应该是以下字符串之一：
    - "hisilicon,hi3798cv200-pcie"
- reg: 应包含sysctl、rc_dbi、config寄存器的位置和长度
- reg-names: 必须包括以下条目：
  - "control": PCIe控制器的控制寄存器；
  - "rc-dbi": PCIe控制器的配置空间；
  - "config": PCIe控制器的配置事务空间
- bus-range: 覆盖的PCI总线编号
- interrupts: MSI中断
- interrupt-names: 必须包括 "msi" 条目
- clocks: 根据clock-names属性列出的phandle和时钟标识符对列表
- clock-names: 必须包括以下条目：
  - "aux": 辅助门控时钟；
  - "pipe": 管道门控时钟；
  - "sys": 系统门控时钟；
  - "bus": 总线门控时钟
- resets: 根据reset-names属性列出的phandle和复位标识符对列表
此段文本描述了一个 PCI Express (PCIe) 设备在设备树中的配置。下面是这段配置的中文翻译：

必须包含的重置名称条目：
- `soft`: 软重置；
- `sys`: 系统重置；
- `bus`: 总线重置

可选属性：
- `reset-gpios`: 生成 PCIe PERST# 断言和非断言信号的 GPIO
- `vpcie-supply`: 负责 PCIe 端口供电的稳压器
- `phys`: 物理层（PHY）句柄列表及 PHY 模式指定符，应为 0
- `phy-names`: 必须是 "phy"

示例：
```plaintext
pcie@f9860000 {
    compatible = "hisilicon,hi3798cv200-pcie";  // 兼容性标识
    reg = <0xf9860000 0x1000>,                  // 寄存器地址范围
          <0xf0000000 0x2000>,
          <0xf2000000 0x01000000>;
    reg-names = "control", "rc-dbi", "config";  // 寄存器名称
    #address-cells = <3>;                       // 地址单元数量
    #size-cells = <2>;                          // 大小单元数量
    device_type = "pci";                        // 设备类型
    bus-range = <0 15>;                         // 总线范围
    num-lanes = <1>;                            // 车道数
    ranges=<0x81000000 0 0 0xf4000000 0 0x00010000
        0x82000000 0 0xf3000000 0xf3000000 0 0x01000000>;  // 地址映射
    interrupts = <GIC_SPI 128 IRQ_TYPE_LEVEL_HIGH>;  // 中断信息
    interrupt-names = "msi";                    // 中断名称
    #interrupt-cells = <1>;                     // 中断单元数量
    interrupt-map-mask = <0 0 0 0>;             // 中断映射掩码
    interrupt-map = <0 0 0 0 &gic GIC_SPI 131 IRQ_TYPE_LEVEL_HIGH>;  // 中断映射
    clocks = <&crg PCIE_AUX_CLK>,               // 时钟源
             <&crg PCIE_PIPE_CLK>,
             <&crg PCIE_SYS_CLK>,
             <&crg PCIE_BUS_CLK>;
    clock-names = "aux", "pipe", "sys", "bus";  // 时钟名称
    resets = <&crg 0x18c 6>,                    // 重置源
             <&crg 0x18c 5>,
             <&crg 0x18c 4>;
    reset-names = "soft", "sys", "bus";         // 重置名称
    phys = <&combphy1 PHY_TYPE_PCIE>;           // 物理层配置
    phy-names = "phy";                          // 物理层名称
};
```

这个配置定义了 PCIe 控制器的详细信息，包括它的寄存器、中断、时钟、重置等设置。
~~~~
