## Documentation/devicetree/bindings/pci/mediatek,mt7621-pcie_cn.yaml
```yaml
以下是提供的 YAML 文档的中文翻译：

# SPDX-许可证标识符: (GPL-2.0-only 或 BSD-2-Clause)
%YAML 1.2
---
$id: http://devicetree.org/schemas/pci/mediatek,mt7621-pcie.yaml#
$schema: http://devicetree.org/meta-schemas/core.yaml#

标题: MediaTek MT7621 PCIe 控制器

维护者:
  - Sergio Paracuellos <sergio.paracuellos@gmail.com>

描述: |+
  MediaTek MT7621 PCIe 子系统支持单个根复合体（Root Complex，RC）
  具有 3 个根端口。每个根端口支持一个第一代 1 车道连接

allOf:
  - $ref: /schemas/pci/pci-host-bridge.yaml#

属性:
  compatible:
    常量: mediatek,mt7621-pci

  reg:
    项目:
      - 描述: 主机-PCI 桥接寄存器
      - 描述: PCIe 端口 0 根复合体控制寄存器
      - 描述: PCIe 端口 1 根复合体控制寄存器
      - 描述: PCIe 端口 2 根复合体控制寄存器

  ranges:
    最大项数: 2

模式属性:
  '^pcie@[0-2],0$':
    类型: 对象
    $ref: /schemas/pci/pci-pci-bridge.yaml#

    属性:
      reg:
        最大项数: 1

      resets:
        最大项数: 1

      clocks:
        最大项数: 1

      phys:
        最大项数: 1

      phy-names:
        模式: '^pcie-phy[0-2]$'

    必需:
      - "#interrupt-cells"
      - interrupt-map-mask
      - interrupt-map
      - resets
      - clocks
      - phys
      - phy-names
      - ranges

    未评估属性: false

必需:
  - compatible
  - reg
  - ranges
  - "#interrupt-cells"
  - interrupt-map-mask
  - interrupt-map
  - reset-gpios

未评估属性: false

示例:
  - |
    #include <dt-bindings/gpio/gpio.h>
    #include <dt-bindings/interrupt-controller/mips-gic.h>

    pcie: pcie@1e140000 {
        compatible = "mediatek,mt7621-pci";
        reg = <0x1e140000 0x100>,
              <0x1e142000 0x100>,
              <0x1e143000 0x100>,
              <0x1e144000 0x100>;

        #address-cells = <3>;
        #size-cells = <2>;
        pinctrl-names = "default";
        pinctrl-0 = <&pcie_pins>;
        device_type = "pci";
        ranges = <0x02000000 0 0x60000000 0x60000000 0 0x10000000>,  /* PCI 内存 */
                 <0x01000000 0 0x1e160000 0x1e160000 0 0x00010000>;  /* IO 空间 */
        #interrupt-cells = <1>;
        interrupt-map-mask = <0xF800 0 0 0>;
        interrupt-map = <0x0000 0 0 0 &gic GIC_SHARED 4 IRQ_TYPE_LEVEL_HIGH>,
                        <0x0800 0 0 0 &gic GIC_SHARED 24 IRQ_TYPE_LEVEL_HIGH>,
                        <0x1000 0 0 0 &gic GIC_SHARED 25 IRQ_TYPE_LEVEL_HIGH>;
        reset-gpios = <&gpio 19 GPIO_ACTIVE_LOW>;

        pcie@0,0 {
            reg = <0x0000 0 0 0 0>;
            #address-cells = <3>;
            #size-cells = <2>;
            device_type = "pci";
            #interrupt-cells = <1>;
            interrupt-map-mask = <0 0 0 0>;
            interrupt-map = <0 0 0 0 &gic GIC_SHARED 4 IRQ_TYPE_LEVEL_HIGH>;
            resets = <&rstctrl 24>;
            clocks = <&clkctrl 24>;
            phys = <&pcie0_phy 1>;
            phy-names = "pcie-phy0";
            ranges;
        };

        pcie@1,0 {
            reg = <0x0800 0 0 0 0>;
            #address-cells = <3>;
            #size-cells = <2>;
            device_type = "pci";
            #interrupt-cells = <1>;
            interrupt-map-mask = <0 0 0 0>;
            interrupt-map = <0 0 0 0 &gic GIC_SHARED 24 IRQ_TYPE_LEVEL_HIGH>;
            resets = <&rstctrl 25>;
            clocks = <&clkctrl 25>;
            phys = <&pcie0_phy 1>;
            phy-names = "pcie-phy1";
            ranges;
        };

        pcie@2,0 {
            reg = <0x1000 0 0 0 0>;
            #address-cells = <3>;
            #size-cells = <2>;
            device_type = "pci";
            #interrupt-cells = <1>;
            interrupt-map-mask = <0 0 0 0>;
            interrupt-map = <0 0 0 0 &gic GIC_SHARED 25 IRQ_TYPE_LEVEL_HIGH>;
            resets = <&rstctrl 26>;
            clocks = <&clkctrl 26>;
            phys = <&pcie2_phy 0>;
            phy-names = "pcie-phy2";
            ranges;
        };
    };
..
```

## Documentation/devicetree/bindings/pci/mediatek-pcie-cfg_cn.yaml
```yaml
# SPDX-许可证标识符: GPL-2.0-only 或 BSD-2-Clause
%YAML 1.2
---
$id: http://devicetree.org/schemas/pci/mediatek-pcie-cfg.yaml#
$schema: http://devicetree.org/meta-schemas/core.yaml#

title: MediaTek PCIECFG 控制器

maintainers:
  - 刘传佳 <chuanjia.liu@mediatek.com>
  - 王建均 <jianjun.wang@mediatek.com>

description: |
  MediaTek PCIECFG 控制器控制一些关于 LTSSM、ASPM 等的功能。

properties:
  compatible:
    items:
      - enum:
          - mediatek,generic-pciecfg
      - const: syscon

  reg:
    maxItems: 1

required:
  - compatible
  - reg

additionalProperties: false

examples:
  - |
    pciecfg: pciecfg@1a140000 {
        compatible = "mediatek,generic-pciecfg", "syscon";
        reg = <0x1a140000 0x1000>;
    };
```

## Documentation/devicetree/bindings/pci/mediatek-pcie_cn.txt
~~~~
### MediaTek Gen2 PCIe 控制器

**必需属性：**
- **compatible：** 应包含以下字符串之一：
    - "mediatek,mt2701-pcie"
    - "mediatek,mt2712-pcie"
    - "mediatek,mt7622-pcie"
    - "mediatek,mt7623-pcie"
    - "mediatek,mt7629-pcie"
    - "airoha,en7523-pcie"
- **device_type：** 必须为 "pci"
- **reg：** 根端口的基本地址和长度
- **reg-names：** 上述区域的名称，用于资源查找时使用
- **#address-cells：** 根端口的地址表示（必须为 3）
- **#size-cells：** 根端口的大小表示（必须为 2）
- **clocks：** 必须包含与 clock-names 中的条目相匹配的条目。详情见 ../clocks/clock-bindings.txt
- **clock-names：**
    - **必填条目：**
        - sys_ckN : 交易层和数据链路层时钟
    - **MT2701/MT7623 必需条目：**
        - free_ck : PCIe 子系统的参考时钟
    - **MT2712/MT7622 必需条目：**
        - ahb_ckN : 用于 CSR 访问和 RC 发起的 MMIO 访问的 AHB 从接口操作时钟
    - **MT7622 必需条目：**
        - axi_ckN : 应用层 MMIO 通道的操作时钟
        - aux_ckN : 当 pcie_mac_ck/pcie_pipe_ck 关闭时，pe2_mac_bridge 和 pe2_mac_core 的操作时钟
        - obff_ckN : OBFF 功能块的操作时钟
        - pipe_ckN : LTSSM 和 PHY/MAC 层的操作时钟
    - 其中 N 从 0 开始，直到根端口数量减一
- **phys：** PHY 规格列表（由通用 PHY 框架使用）
- **phy-names：** 必须是 "pcie-phy0", "pcie-phy1", "pcie-phyN" 等，基于 *phys* 属性中指定的 PHY 数量
- **power-domains：** 一个指向负责外围设备电源折叠和恢复的电源域的句柄及其电源域规格对
- **bus-range：** 与此控制器关联的总线编号范围
- **ranges：** PCI 内存和 I/O 区域的范围
### 对于MT7623/MT2701所需属性：
- `#interrupt-cells`: 中断表示的大小（必须为1）
- `interrupt-map-mask` 和 `interrupt-map`: 标准PCI中断映射属性。请参阅标准PCI总线绑定文档以获取更详细的解释。
- `resets`: 必须包含与`reset-names`条目数量相同的条目。
  - 详情见`../reset/reset.txt`
- `reset-names`: 必须是`pcie-rst0`, `pcie-rst1`, `pcie-rstN`...基于根端口的数量。

### 对于MT2712/MT7622/MT7629所需属性：
- `interrupts`: 控制器的中断输出列表，必须为每个PCIe端口有一个条目。
- `interrupt-names`: 必须包括以下条目：
  - `"pcie_irq"`: 当接收到MSI/INTX时被触发的中断。
- `linux,pci-domain`: PCI域ID。对于每个主机控制器应该是唯一的。

### 此外，设备树节点必须有描述每个PCIe端口接口的子节点，并具有以下强制性属性：

#### 强制性属性：
- `device_type`: 必须是"pci"
- `reg`: 只使用前四个字节来引用正确的总线号和设备号
- `#address-cells`: 必须为3
- `#size-cells`: 必须为2
- `#interrupt-cells`: 必须为1
- `interrupt-map-mask` 和 `interrupt-map`: 标准PCI中断映射属性。请参阅标准PCI总线绑定文档以获取更详细的解释。
- `ranges`: 从PCIe控制器节点分配的子范围。空属性就足够了。

### MT7623示例：

```plaintext
hifsys: syscon@1a000000 {
    compatible = "mediatek,mt7623-hifsys", "mediatek,mt2701-hifsys", "syscon";
    reg = <0 0x1a000000 0 0x1000>;
    #clock-cells = <1>;
    #reset-cells = <1>;
};

pcie: pcie@1a140000 {
    compatible = "mediatek,mt7623-pcie";
    device_type = "pci";
    reg = <0 0x1a140000 0 0x1000>, /* PCIe共享寄存器 */
          <0 0x1a142000 0 0x1000>, /* Port0寄存器 */
          <0 0x1a143000 0 0x1000>, /* Port1寄存器 */
          <0 0x1a144000 0 0x1000>; /* Port2寄存器 */
    reg-names = "subsys", "port0", "port1", "port2";
    #address-cells = <3>;
    #size-cells = <2>;
    #interrupt-cells = <1>;
    interrupt-map-mask = <0xf800 0 0 0>;
    interrupt-map = <0x0000 0 0 0 &sysirq GIC_SPI 193 IRQ_TYPE_LEVEL_LOW>,
                    <0x0800 0 0 0 &sysirq GIC_SPI 194 IRQ_TYPE_LEVEL_LOW>,
                    <0x1000 0 0 0 &sysirq GIC_SPI 195 IRQ_TYPE_LEVEL_LOW>;
    clocks = <&topckgen CLK_TOP_ETHIF_SEL>,
             <&hifsys CLK_HIFSYS_PCIE0>,
             <&hifsys CLK_HIFSYS_PCIE1>,
             <&hifsys CLK_HIFSYS_PCIE2>;
    clock-names = "free_ck", "sys_ck0", "sys_ck1", "sys_ck2";
    resets = <&hifsys MT2701_HIFSYS_PCIE0_RST>,
             <&hifsys MT2701_HIFSYS_PCIE1_RST>,
             <&hifsys MT2701_HIFSYS_PCIE2_RST>;
    reset-names = "pcie-rst0", "pcie-rst1", "pcie-rst2";
    phys = <&pcie0_phy PHY_TYPE_PCIE>, <&pcie1_phy PHY_TYPE_PCIE>,
           <&pcie2_phy PHY_TYPE_PCIE>;
    phy-names = "pcie-phy0", "pcie-phy1", "pcie-phy2";
    power-domains = <&scpsys MT2701_POWER_DOMAIN_HIF>;
    bus-range = <0x00 0xff>;
    ranges = <0x81000000 0 0x1a160000 0 0x1a160000 0 0x00010000> /* I/O空间 */
              <0x83000000 0 0x60000000 0 0x60000000 0 0x10000000>; /* 内存空间 */

    pcie@0,0 { ... };
    pcie@1,0 { ... };
    pcie@2,0 { ... };
};
```

### MT2712示例：

```plaintext
pcie1: pcie@112ff000 { ... };
pcie0: pcie@11700000 { ... };
```

### MT7622示例：

```plaintext
pcie0: pcie@1a143000 { ... };
pcie1: pcie@1a145000 { ... };
```

以上示例展示了如何在设备树中配置MT7623、MT2712以及MT7622的PCIe控制器及其端口。这些配置确保了硬件可以正确地初始化并运行。
~~~~

## Documentation/devicetree/bindings/pci/microchip,pcie-host_cn.yaml
```yaml
# SPDX-License-Identifier: (GPL-2.0-only OR BSD-2-Clause)
%YAML 1.2
---
$id: http://devicetree.org/schemas/pci/microchip,pcie-host.yaml#
$schema: http://devicetree.org/meta-schemas/core.yaml#

title: Microchip PCIe 根端口桥控制器

maintainers:
  - Daire McNamara <daire.mcnamara@microchip.com>

allOf:
  - $ref: /schemas/pci/pci-host-bridge.yaml#
  - $ref: /schemas/interrupt-controller/msi-controller.yaml#

properties:
  compatible:
    const: microchip,pcie-host-1.0 # PolarFire

  reg:
    maxItems: 2

  reg-names:
    items:
      - const: cfg
      - const: apb

  clocks:
    description:
      架构接口控制器（Fabric Interface Controllers, FICs）是 FPGA 架构与 PolarFire SoC 上核心复合体之间的接口。FIC 需要两个时钟，每个接口一个。本属性描述的“FIC 时钟”位于核心复合体一侧，并且若对应的时钟未启用，则无法通过 FIC 进行通信。对于根端口通过的每个接口，必须有一个时钟被启用。理论上，这可以是全部 4 个接口、单个接口或介于两者之间的任何组合。
    minItems: 1
    items:
      - description: FIC0 的时钟
      - description: FIC1 的时钟
      - description: FIC2 的时钟
      - description: FIC3 的时钟

  clock-names:
    description:
      由于任何 FIC 连接组合都是可能的，因此名称应与 clocks 属性中的顺序匹配，采用“ficN”的形式，其中 N 是 0 到 3 的数字。
    minItems: 1
    maxItems: 4
    items:
      pattern: '^fic[0-3]$'

  interrupts:
    minItems: 1
    items:
      - description: PCIe 主控制器
      - description: 内置 MSI 控制器

  interrupt-names:
    minItems: 1
    items:
      - const: pcie
      - const: msi

  ranges:
    minItems: 1
    maxItems: 3

  dma-ranges:
    minItems: 1
    maxItems: 6

  msi-controller:
    description: 标识节点为 MSI 控制器
  msi-parent:
    description: 设备能够使用的 MSI 控制器
  interrupt-controller:
    type: object
    properties:
      '#address-cells':
        const: 0

      '#interrupt-cells':
        const: 1

      interrupt-controller: true

    required:
      - '#address-cells'
      - '#interrupt-cells'
      - interrupt-controller

    additionalProperties: false

required:
  - reg
  - reg-names
  - "#interrupt-cells"
  - interrupts
  - interrupt-map-mask
  - interrupt-map
  - msi-controller

unevaluatedProperties: false

examples:
  - |
    soc {
            #address-cells = <2>;
            #size-cells = <2>;
            pcie0: pcie@2030000000 {
                    compatible = "microchip,pcie-host-1.0";
                    reg = <0x0 0x70000000 0x0 0x08000000>,
                          <0x0 0x43000000 0x0 0x00010000>;
                    reg-names = "cfg", "apb";
                    device_type = "pci";
                    #address-cells = <3>;
                    #size-cells = <2>;
                    #interrupt-cells = <1>;
                    interrupts = <119>;
                    interrupt-map-mask = <0x0 0x0 0x0 0x7>;
                    interrupt-map = <0 0 0 1 &pcie_intc0 0>,
                                    <0 0 0 2 &pcie_intc0 1>,
                                    <0 0 0 3 &pcie_intc0 2>,
                                    <0 0 0 4 &pcie_intc0 3>;
                    interrupt-parent = <&plic0>;
                    msi-parent = <&pcie0>;
                    msi-controller;
                    bus-range = <0x00 0x7f>;
                    ranges = <0x03000000 0x0 0x78000000 0x0 0x78000000 0x0 0x04000000>;
                    pcie_intc0: interrupt-controller {
                        #address-cells = <0>;
                        #interrupt-cells = <1>;
                        interrupt-controller;
                    };
            };
    };
```

## Documentation/devicetree/bindings/pci/mobiveil-pcie_cn.txt
~~~~
* Mobiveil AXI PCIe 根端口桥接器 DT 描述

Mobiveil 的 GPEX 4.0 是一款 PCIe 第四代根端口桥接器 IP。这款可配置的 IP 支持多达 8 个出站和入站窗口以进行地址转换。
所需属性：
- `#address-cells`：根端口的地址表示，设置为 `<3>`；
- `#size-cells`：根端口的大小表示，设置为 `<2>`；
- `#interrupt-cells`：指定编码中断源所需的单元格数量。该值必须是 1；
- `compatible`：应包含 `"mbvl,gpex40-pcie"`；
- `reg`：应包含 PCIe 寄存器的位置和长度；
    - 必需项：
        - `"config_axi_slave"`：PCIe 控制器寄存器
        - `"csr_axi_slave"`：桥接器配置寄存器
    - 可选项：
        - `"gpio_slave"`：用于控制插槽电源的 GPIO 寄存器
        - `"apb_csr"`：MSI 寄存器

- `device_type`：必须是 `"pci"`；
- `apio-wins`：请求的 APIO 出站窗口数量，默认配置 2 个出站窗口：
    - 1. 配置窗口
    - 2. 内存窗口
- `ppio-wins`：请求的 PPIO 入站窗口数量，默认配置 1 个入站内存窗口；
- `bus-range`：覆盖的 PCI 总线编号；
- `interrupt-controller`：将节点标识为中断控制器；
- `#interrupt-cells`：指定编码中断源所需的单元格数量。该值必须是 1；
- `interrupts`：PCIe 控制器的中断线，此字段的最后一个单元格设置为 4 以表示为 IRQ_TYPE_LEVEL_HIGH 类型的中断；
- `interrupt-map-mask`、`interrupt-map`：标准 PCI 属性，定义 PCI 接口到中断号的映射；
- `ranges`：PCI 内存区域的范围（硬件不支持 I/O 空间区域）；

请参考标准 PCI 总线绑定文档获取更详细的说明。

示例：
++++++++
``` 
pcie0: pcie@a0000000 {
	#address-cells = <3>;
	#size-cells = <2>;
	compatible = "mbvl,gpex40-pcie";
	reg =	<0xa0000000 0x00001000>,
		<0xb0000000 0x00010000>,
		<0xff000000 0x00200000>,
		<0xb0010000 0x00001000>;
	reg-names =	"config_axi_slave",
			"csr_axi_slave",
			"gpio_slave",
			"apb_csr";
	device_type = "pci";
	apio-wins = <2>;
	ppio-wins = <1>;
	bus-range = <0x00000000 0x000000ff>;
	interrupt-controller;
	interrupt-parent = <&gic>;
	#interrupt-cells = <1>;
	interrupts = < 0 89 4 >;
	interrupt-map-mask = <0 0 0 7>;
	interrupt-map = <0 0 0 0 &pci_express 0>,
			<0 0 0 1 &pci_express 1>,
			<0 0 0 2 &pci_express 2>,
			<0 0 0 3 &pci_express 3>;
	ranges = < 0x83000000 0 0x00000000 0xa8000000 0 0x8000000>;

};
```
~~~~
