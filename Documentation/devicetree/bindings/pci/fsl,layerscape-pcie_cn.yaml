## Documentation/devicetree/bindings/pci/pci-ep_cn.yaml
~~~~yaml
```yaml
# SPDX-许可证标识符: (GPL-2.0-only 或 BSD-2-Clause)
%YAML 1.2
---
$id: 'http://devicetree.org/schemas/pci/pci-ep.yaml#'
$schema: 'http://devicetree.org/meta-schemas/core.yaml#'

title: PCI 终端控制器

description: |
  PCI 终端控制器节点的通用属性
maintainers:
  - Kishon Vijay Abraham I <kishon@ti.com>

properties:
  $nodename:
    pattern: '^pcie-ep@'

  max-functions:
    description: 可配置的最大功能数量
    $ref: '/schemas/types.yaml#/$defs/uint8'
    minimum: 1
    default: 1
    maximum: 255

  max-virtual-functions:
    description: 表示对应每个物理功能的虚拟功能数量的数组
    $ref: '/schemas/types.yaml#/$defs/uint8-array'
    minItems: 1
    maxItems: 255

  max-link-speed:
    $ref: '/schemas/types.yaml#/$defs/uint32'
    enum: [ 1, 2, 3, 4 ]

  num-lanes:
    description: 最大通道数
    $ref: '/schemas/types.yaml#/$defs/uint32'
    minimum: 1
    default: 1
    maximum: 16

required:
  - compatible

additionalProperties: true
```

请注意，上述翻译将 YAML 的 `definitions` 关键字更新为 `defs`，这是因为 YAML 1.2 规范推荐使用 `defs`。此外，对于 URL 中的路径，我已将其替换为符合 YAML 语法的格式。
~~~~

## Documentation/devicetree/bindings/pci/pci-iommu_cn.txt
```
此文档描述了用于描述 PCI(e) 设备与 IOMMU(s) 之间关系的通用设备树绑定。
根复合体下的每个 PCI(e) 设备都通过其请求者 ID（简称 RID）唯一标识。请求者 ID 是总线号、设备号和功能号这三元组。
为了便于理解本文档，在作为数值处理时，RID 的格式如下：

* 第 [15:8] 位是总线号
* 第 [7:3] 位是设备号
* 第 [2:0] 位是功能号
* 任何其他用于填充的位必须为零

IOMMU 可以通过从请求者 ID 派生的辅助数据来区分 PCI 设备。虽然一个给定的 PCI 设备只能通过一个 IOMMU 进行主控，但根复合体可以将多个主控器分散到一组 IOMMU 中（例如，每条总线一个 IOMMU）。

通用的 'iommus' 属性不足以描述这种关系，因此需要一种机制来将 PCI 设备映射到相应的 IOMMU 和辅助数据。

对于通用 IOMMU 绑定，请参见
`Documentation/devicetree/bindings/iommu/iommu.txt`

PCI 根复合体
=============

可选属性
---------

- iommu-map: 将请求者 ID 映射到 IOMMU 及相关的 IOMMU 规范数据
属性是一个任意数量的元组，形式为
  (rid-base, iommu, iommu-base, length)
对于区间 [rid-base, rid-base + length) 中的任何 RID r，都会与列出的 IOMMU 关联，并使用 IOMMU 指定器 (r - rid-base + iommu-base)
- iommu-map-mask: 在每个请求者 ID 被映射到 IOMMU 指定器之前需要应用的一个掩码

示例 (1)
==========

/ {
	#address-cells = <1>;
	#size-cells = <1>;

	iommu: iommu@a {
		reg = <0xa 0x1>;
		compatible = "vendor,some-iommu";
		#iommu-cells = <1>;
	};

	pci: pci@f {
		reg = <0xf 0x1>;
		compatible = "vendor,pcie-root-complex";
		device_type = "pci";

		/*
		 * 提供给 IOMMU 的辅助数据是 RID，
		 * 以身份映射的方式
*/
		iommu-map = <0x0 &iommu 0x0 0x10000>;
	};
};


示例 (2)
==========

/ {
	#address-cells = <1>;
	#size-cells = <1>;

	iommu: iommu@a {
		reg = <0xa 0x1>;
		compatible = "vendor,some-iommu";
		#iommu-cells = <1>;
	};

	pci: pci@f {
		reg = <0xf 0x1>;
		compatible = "vendor,pcie-root-complex";
		device_type = "pci";

		/*
		 * 提供给 IOMMU 的辅助数据是经过功能位屏蔽的 RID
*/
		iommu-map = <0x0 &iommu 0x0 0x10000>;
		iommu-map-mask = <0xfff8>;
	};
};


示例 (3)
==========

/ {
	#address-cells = <1>;
	#size-cells = <1>;

	iommu: iommu@a {
		reg = <0xa 0x1>;
		compatible = "vendor,some-iommu";
		#iommu-cells = <1>;
	};

	pci: pci@f {
		reg = <0xf 0x1>;
		compatible = "vendor,pcie-root-complex";
		device_type = "pci";

		/*
		 * 提供给 IOMMU 的辅助数据是 RID，
		 * 但总线号的高位被反转了
*/
		iommu-map = <0x0000 &iommu 0x8000 0x8000>,
			    <0x8000 &iommu 0x0000 0x8000>;
	};
};


示例 (4)
==========

/ {
	#address-cells = <1>;
	#size-cells = <1>;

	iommu_a: iommu@a {
		reg = <0xa 0x1>;
		compatible = "vendor,some-iommu";
		#iommu-cells = <1>;
	};

	iommu_b: iommu@b {
		reg = <0xb 0x1>;
		compatible = "vendor,some-iommu";
		#iommu-cells = <1>;
	};

	iommu_c: iommu@c {
		reg = <0xc 0x1>;
		compatible = "vendor,some-iommu";
		#iommu-cells = <1>;
	};

	pci: pci@f {
		reg = <0xf 0x1>;
		compatible = "vendor,pcie-root-complex";
		device_type = "pci";

		/*
		 * 总线号为 0-127 的设备通过 IOMMU a 进行控制，
		 * 辅助数据为 RID[14:0]
* 总线号为 128-255 的设备通过 IOMMU b 进行控制，
		 * 辅助数据为 RID[14:0]
* 没有设备通过 IOMMU c 进行控制
*/
		iommu-map = <0x0000 &iommu_a 0x0000 0x8000>,
			    <0x8000 &iommu_b 0x0000 0x8000>;
	};
};
```

## Documentation/devicetree/bindings/pci/pci-msi_cn.txt
~~~~
此文档描述了用于描述 PCI 设备与 MSI 控制器之间关系的通用设备树绑定。
根复合体下的每个 PCI 设备通过其请求者 ID（简称 RID）唯一标识。请求者 ID 是由总线号、设备号和功能号组成的三元组。
为了本文件的目的，当作为数值处理时，RID 的格式如下：

* 位 [15:8] 是总线号
* 位 [7:3] 是设备号
* 位 [2:0] 是功能号
* 任何用于填充所需的其他位必须为零

MSI 可以部分地通过随写操作附带的边带数据来区分。对于 PCI 设备而言，这种边带数据可以源自请求者 ID。需要一种机制将设备与其可以寻址的 MSI 控制器以及与其对这些控制器的写操作相关的边带数据关联起来。
关于通用 MSI 绑定，请参阅 Documentation/devicetree/bindings/interrupt-controller/msi.txt
PCI 根复合体
=============

可选属性
---------

- msi-map：将一个请求者 ID 映射到一个 MSI 控制器及其关联的 msi-specifier 数据。该属性是任意数量的元组 (rid-base, msi-controller, msi-base, length)，其中：

  * rid-base 是一个单元格，描述该条目匹配的第一个 RID
  * msi-controller 是指向一个 MSI 控制器的单个 phandle

  * msi-base 是一个 msi-specifier，描述该条目匹配的第一个 RID 所产生的 msi-specifier
* `length` 是一个单个单元，描述紧接着 `rid-base` 后匹配的连续 RID 数量。
    任何位于区间 `[rid-base, rid-base + length)` 内的 RID `r` 都与列出的 `msi-controller` 相关联，并且具有 `msi-specifier` 值 `(r - rid-base + msi-base)`
* `msi-map-mask`: 一个在每个请求者 ID 被映射到 `msi-specifier` 之前需要应用的掩码，根据 `msi-map` 属性进行映射。
* `msi-parent`: 描述了根复合体自身的 MSI 父级。当根复合体和 MSI 控制器不通过侧带数据来写入 MSI 时，此属性可用于描述根复合体下 PCI 设备所使用的 MSI 控制器（如果在根复合体绑定中如此定义的话）。

示例 (1)
========

```
/ {
	#address-cells = <1>;
	#size-cells = <1>;

	msi: msi-controller@a {
		reg = <0xa 0x1>;
		compatible = "vendor,some-controller";
		msi-controller;
		#msi-cells = <1>;
	};

	pci: pci@f {
		reg = <0xf 0x1>;
		compatible = "vendor,pcie-root-complex";
		device_type = "pci";

		/*
		 * 提供给 MSI 控制器的侧带数据是 RID，采用身份映射
*/
		msi-map = <0x0 &msi_a 0x0 0x10000>,
	};
};
```

示例 (2)
========

```
/ {
	#address-cells = <1>;
	#size-cells = <1>;

	msi: msi-controller@a {
		reg = <0xa 0x1>;
		compatible = "vendor,some-controller";
		msi-controller;
		#msi-cells = <1>;
	};

	pci: pci@f {
		reg = <0xf 0x1>;
		compatible = "vendor,pcie-root-complex";
		device_type = "pci";

		/*
		 * 提供给 MSI 控制器的侧带数据是 RID，被掩码以仅保留设备和功能位
*/
		msi-map = <0x0 &msi_a 0x0 0x100>,
		msi-map-mask = <0xff>
	};
};
```

示例 (3)
========

```
/ {
	#address-cells = <1>;
	#size-cells = <1>;

	msi: msi-controller@a {
		reg = <0xa 0x1>;
		compatible = "vendor,some-controller";
		msi-controller;
		#msi-cells = <1>;
	};

	pci: pci@f {
		reg = <0xf 0x1>;
		compatible = "vendor,pcie-root-complex";
		device_type = "pci";

		/*
		 * 提供给 MSI 控制器的侧带数据是 RID，但忽略总线编号的高位
*/
		msi-map = <0x0000 &msi 0x0000 0x8000>,
			  <0x8000 &msi 0x0000 0x8000>;
	};
};
```

示例 (4)
========

```
/ {
	#address-cells = <1>;
	#size-cells = <1>;

	msi: msi-controller@a {
		reg = <0xa 0x1>;
		compatible = "vendor,some-controller";
		msi-controller;
		#msi-cells = <1>;
	};

	pci: pci@f {
		reg = <0xf 0x1>;
		compatible = "vendor,pcie-root-complex";
		device_type = "pci";

		/*
		 * 提供给 MSI 控制器的侧带数据是 RID，但取反总线编号的高位
*/
		msi-map = <0x0000 &msi 0x8000 0x8000>,
			  <0x8000 &msi 0x0000 0x8000>;
	};
};
```

示例 (5)
========

```
/ {
	#address-cells = <1>;
	#size-cells = <1>;

	msi_a: msi-controller@a {
		reg = <0xa 0x1>;
		compatible = "vendor,some-controller";
		msi-controller;
		#msi-cells = <1>;
	};

	msi_b: msi-controller@b {
		reg = <0xb 0x1>;
		compatible = "vendor,some-controller";
		msi-controller;
		#msi-cells = <1>;
	};

	msi_c: msi-controller@c {
		reg = <0xc 0x1>;
		compatible = "vendor,some-controller";
		msi-controller;
		#msi-cells = <1>;
	};

	pci: pci@f {
		reg = <0xf 0x1>;
		compatible = "vendor,pcie-root-complex";
		device_type = "pci";

		/*
		 * 提供给 MSI 控制器 a 的侧带数据是 RID，但取反总线编号的高位
* 提供给 MSI 控制器 b 的侧带数据是 RID，采用身份映射
```
这段代码似乎是某种配置或者描述语言的一部分（如 Device Tree Blob (DTB) 在 Linux 内核中用于硬件描述），涉及到MSI（Message Signaled Interrupts）控制器的映射。以下是中文翻译：

```
* MSI 控制器 C 不可寻址
*
* msi 映射 = <0x0000 &msi_a 0x8000 0x08000>,
*             <0x8000 &msi_a 0x0000 0x08000>,
*             <0x0000 &msi_b 0x0000 0x10000>;
* };
* };
```

这里的注释说明了 `MSI 控制器 C` 无法被访问（即不可寻址）。接下来的部分定义了其他 MSI 控制器（可能是 A 和 B）的映射关系，这些数字和符号是用来描述特定的内存区域或中断范围的。
~~~~

## Documentation/devicetree/bindings/pci/pci_cn.txt
```
PCI总线桥接器具有标准化的设备树绑定：

PCI 总线绑定至：IEEE 标准 1275-1994
https://www.devicetree.org/open-firmware/bindings/pci/pci2_1.pdf

对于中断映射部分：

开放固件推荐实践：中断映射
https://www.devicetree.org/open-firmware/practice/imap/imap0_9d.pdf

除了上述标准中规定的属性之外，主机桥接器驱动程序实现还可能支持以下属性：

- `linux,pci-domain`:
   如果存在，此属性为一个主机桥接器分配了一个固定的PCI域编号，否则将为该桥接器分配一个在启动间不稳定的唯一编号。
   必须要么完全不设置此属性，要么为系统中的所有主机桥接器设置此属性，否则可能会为不同主机桥接器后面的根总线分配潜在冲突的域编号。系统中每个主机桥接器的域编号必须是唯一的。
- `max-link-speed`:
   如果存在，此属性指定了链接能力的PCI代数。主机驱动程序可以添加此属性作为一种策略来避免对不受支持的链接速度执行不必要的操作，例如尝试对不受支持的链接速度进行训练等。对于第4代必须为 `'4'`，第3代为 `'3'`，第2代为 `'2'`，第1代为 `'1'`。任何其他值都是无效的。
- `reset-gpios`:
   如果存在，此属性指定了 PERST#（电源复位）GPIO。主机驱动程序可以解析GPIO并向端点应用基础复位。
- `supports-clkreq`:
   如果存在，此属性指定了从根端口到下游设备的CLKREQ信号路由的存在，主机桥接器驱动程序可以进行依赖于CLKREQ信号存在的编程。例如，如果不存在CLKREQ信号，则可以编程根端口使其不宣传ASPM L1子状态的支持。

### PCI-PCI 桥接器属性

PCIe根端口和交换机端口可以在设备树中明确描述，作为主机桥接器节点的子节点。尽管这些设备可以通过探测发现，但可能需要描述那些未由标准PCIe功能提供的属性。

**必需属性：**

- `reg`:
   用于识别PCI-PCI桥接器。根据IEEE 标准 1275-1994文档定义，它是一个五元地址编码为 `(phys.hi phys.mid phys.lo size.hi size.lo)`。`phys.hi` 应包含设备的BDF（总线设备功能号）作为 `0b00000000 bbbbbbbb dddddfff 00000000`。其他单元应为零。
   总线编号由固件通过标准桥接配置机制定义。如果此端口是一个交换机端口，那么固件会分配总线编号并将其写入此端口正上方的桥接器的次级总线编号寄存器中。否则，根端口的总线编号是 `bus-range` 属性中的第一个数字，默认为零。
   如果固件保持此端口上方桥接器中的ARI转发使能位被设置，那么 `phys.hi` 包含8位功能号作为 `0b00000000 bbbbbbbb ffffffff 00000000`。需要注意的是，PCIe规范建议固件仅在知道操作系统了解ARI时才保持ARI启用。

**可选属性：**

- `external-facing`:
   当存在时，表明该端口是面向外部的。从此端口向下的所有桥接器和终端设备都位于机器外部。操作系统可以利用此信息来识别不能信任以放宽DMA保护的设备，因为用户可以轻易地将恶意设备连接到此端口。
示例：

`pcie@10000000` {
	`compatible` = "pci-host-ecam-generic";
	..
`pcie@0008` {
		/* 根端口 00:01.0 是面向外部的 */
		`reg` = <0x00000800 0 0 0 0>;
		`external-facing`;
	};
};

这段代码是用设备树（Device Tree）语法编写的，用于描述硬件系统中PCI Express (PCIe) 设备的配置。以下是中文翻译：

在 `pcie@10000000` 节点下：
- `compatible` 属性被设置为 "pci-host-ecam-generic"。
- ...

在 `pcie@0008` 节点下：
- 注释说明根端口 00:01.0 是面向外部的（即该端口可以连接到外部设备）。
- `reg` 属性被设置为 `<0x00000800 0 0 0 0>`，这定义了PCIe设备的寄存器地址和大小等信息。
- `external-facing` 标记表示此端口面向外部。
```

## Documentation/devicetree/bindings/pci/pcie-al_cn.txt
~~~~
* Amazon Annapurna Labs 的 PCIe 主桥

Amazon 的 Annapurna Labs PCIe 主控制器基于 Synopsys DesignWare PCI 核心。它继承了在
`Documentation/devicetree/bindings/pci/snps-dw-pcie.yaml` 中定义的通用属性。
主控制器节点中的属性与之不同的有：

- `compatible:`  
    使用：必需  
    值类型：`<stringlist>`  
    定义：值应包含  
            - 对于 alpine_v2 版本，为 `"amazon,al-alpine-v2-pcie"`  
            - 对于 alpine_v3 版本，为 `"amazon,al-alpine-v3-pcie"`

- `reg:`  
    使用：必需  
    值类型：`<prop-encoded-array>`  
    定义：根据 `reg-names` 属性中列出的寄存器范围

- `reg-names:`  
    使用：必需  
    值类型：`<stringlist>`  
    定义：必须包括以下条目  
            - `"config"`   PCIe ECAM 空间  
            - `"controller"` AL 专有寄存器  
            - `"dbi"`     Designware PCIe 寄存器

示例：

```yaml
pcie-external0: pcie@fb600000 {
	compatible = "amazon,al-alpine-v3-pcie";
	reg = <0x0 0xfb600000 0x0 0x00100000
		  0x0 0xfd800000 0x0 0x00010000
		  0x0 0xfd810000 0x0 0x00001000>;
	reg-names = "config", "controller", "dbi";
	bus-range = <0 255>;
	device_type = "pci";
	#address-cells = <3>;
	#size-cells = <2>;
	#interrupt-cells = <1>;
	interrupts = <GIC_SPI 49 IRQ_TYPE_LEVEL_HIGH>;
	interrupt-map-mask = <0x00 0 0 7>;
	interrupt-map = <0x0000 0 0 1 &gic GIC_SPI 41 IRQ_TYPE_LEVEL_HIGH>; /* INTa */
	ranges = <0x02000000 0x0 0xc0010000 0x0 0xc0010000 0x0 0x07ff0000>;
};
```
以上示例展示了如何配置一个基于 Annapurna Labs 的 PCIe 控制器设备树节点。
~~~~
