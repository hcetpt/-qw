## Documentation/devicetree/bindings/firmware/arm,scpi_cn.yaml
```yaml
# SPDX-文件许可人: (GPL-2.0 或 BSD-2-Clause)
# 版权所有 2021 ARM 有限公司
%YAML 1.2
---
$id: http://devicetree.org/schemas/firmware/arm,scpi.yaml#
$schema: http://devicetree.org/meta-schemas/core.yaml#

title: 系统控制和电源接口 (SCPI) 消息协议

maintainers:
  - Sudeep Holla <sudeep.holla@arm.com>

description: |
  实现了 ARM 文档编号为 ARM DUI 0922B（"ARM 计算子系统 SCP：消息接口协议"）[0] 中描述的 SCPI 的固件可以被 Linux 使用来发起各种系统控制和电源操作。此绑定旨在定义在设备树中实现 SCPI 的固件为 OSPM 提供的接口。
[0] http://infocenter.arm.com/help/topic/com.arm.doc.dui0922b/index.html

properties:
  $nodename:
    const: scpi

  compatible:
    description:
      遵守 SCPI v1.0 及以上版本或遵守所有 SCPI v1.0 之前的未版本化发布的 SCPI 合规固件
    oneOf:
      - const: arm,scpi               # SCPI v1.0 及以上
      - const: arm,scpi-pre-1.0       # SCPI v1.0 之前的未版本化版本
      - items:
          - enum:
              - amlogic,meson-gxbb-scpi
          - const: arm,scpi-pre-1.0

  mboxes:
    description:
      远程 SCP 固件为 SCPI 消息协议预留的所有通道的 phandle 和邮箱通道指定符列表，这些通道可以以任何顺序指定
minItems: 1
    maxItems: 4

  shmem:
    description:
      指向使用这些邮箱进行 IPC 的处理器之间共享内存 (SHM) 区域的 phandle 列表，每个邮箱一个 SHM 可以是为这些处理器之间的通信预留的任意内存
minItems: 1
    maxItems: 4

  power-controller:
    type: object
    description:
      此子节点表示 SCPI 电源域控制器
properties:
      compatible:
        const: arm,scpi-power-domains

      '#power-domain-cells':
        const: 1

      num-domains:
        $ref: /schemas/types.yaml#/definitions/uint32
        description:
          SCPI 提供的电源域总数。这是必要的，因为 SCPI 消息协议缺乏运行时查询此信息的机制
required:
      - compatible
      - '#power-domain-cells'
      - num-domains

    additionalProperties: false

  sensors:
    type: object
    description: |
      此子节点表示 SCPI 传感器控制器
properties:
      compatible:
        oneOf:
          - const: arm,scpi-sensors
          - items:
              - enum:
                  - amlogic,meson-gxbb-scpi-sensors
              - const: arm,scpi-sensors

      '#thermal-sensor-cells':
        const: 1

    required:
      - compatible
      - '#thermal-sensor-cells'

    additionalProperties: false

  clocks:
    type: object
    description:
      这是一个容器节点。每个子节点代表一种类型的时钟控制器 —— 索引类型或全范围类型
properties:
      compatible:
        const: arm,scpi-clocks

    patternProperties:
      "^clocks-[0-9a-f]+$":
        type: object
        description: |
          此子节点代表一种类型的时钟控制器
          —— 索引类型或全范围类型
Here is the translation of the provided text into Chinese:

"arm,scpi-dvfs-clocks" - 所有可变且基于索引的时钟。这些时钟并不提供在限制范围内的所有值，而仅提供该范围内的离散点。固件为每个这样的工作频率及其关联的索引提供了映射关系。固件还适当地管理与时钟缩放相关的电压缩放。

"arm,scpi-variable-clocks" - 所有可变并且在指定范围内提供完整范围的时钟。固件提供在指定范围内的值的范围。

属性:
          compatible:
            枚举:
              - arm,scpi-dvfs-clocks
              - arm,scpi-variable-clocks

          '#clock-cells':
            常量: 1

          clock-output-names: 真

          clock-indices:
            $引用: /schemas/types.yaml#/definitions/uint32-array
            描述:
              该节点中时钟（即clock_id）的标识编号。它可以是非线性的，因此提供标识符到clock-output-names数组中的映射。
所需:
          - compatible
          - '#clock-cells'
          - clock-output-names
          - clock-indices

        额外属性: false

    必需:
      - compatible

    额外属性: false

额外属性: false

必需:
  - compatible
  - mboxes
  - shmem

示例:
  - |
    firmware {
        scpi {
            compatible = "arm,scpi";
            mboxes = <&mhuA 1>;
            shmem = <&cpu_scp_hpri>; /* HP-非安全 */

            scpi_devpd: power-controller {
                compatible = "arm,scpi-power-domains";
                num-domains = <2>;
                #power-domain-cells = <1>;
            };

            clocks {
                compatible = "arm,scpi-clocks";

                scpi_dvfs: clocks-0 {
                    compatible = "arm,scpi-dvfs-clocks";
                    #clock-cells = <1>;
                    clock-indices = <0>, <1>, <2>;
                    clock-output-names = "atlclk", "aplclk","gpuclk";
                };

                scpi_clk: clocks-1 {
                    compatible = "arm,scpi-variable-clocks";
                    #clock-cells = <1>;
                    clock-indices = <3>, <4>;
                    clock-output-names = "pxlclk0", "pxlclk1";
                };
            };

            scpi_sensors: sensors {
                compatible = "arm,scpi-sensors";
                #thermal-sensor-cells = <1>;
            };

        };
    };

    soc {
        #address-cells = <2>;
        #size-cells = <2>;

        sram@50000000 {
            compatible = "mmio-sram";
            reg = <0x0 0x50000000 0x0 0x10000>;

            #address-cells = <1>;
            #size-cells = <1>;
            ranges = <0 0x0 0x50000000 0x10000>;

            cpu_scp_lpri: scp-sram-section@0 {
                compatible = "arm,scp-shmem";
                reg = <0x0 0x200>;
            };

            cpu_scp_hpri: scp-sram-section@200 {
                compatible = "arm,scp-shmem";
                reg = <0x200 0x200>;
            };
        };
    };

  - |
    firmware {
        scpi {
            compatible = "amlogic,meson-gxbb-scpi", "arm,scpi-pre-1.0";
            mboxes = <&mailbox 1>, <&mailbox 2>;
            shmem = <&cpu_scp_lpri>, <&cpu_scp_hpri>;

            scpi_sensors1: sensors {
                compatible = "amlogic,meson-gxbb-scpi-sensors", "arm,scpi-sensors";
                #thermal-sensor-cells = <1>;
            };
        };
    };
```

## Documentation/devicetree/bindings/firmware/brcm,kona-smc_cn.yaml
```yaml
# SPDX-许可证标识符: GPL-2.0-only 或 BSD-2-Clause
%YAML 1.2
---
$id: http://devicetree.org/schemas/firmware/brcm,kona-smc.yaml#
$schema: http://devicetree.org/meta-schemas/core.yaml#

title: Broadcom Kona 系列 安全监视器缓冲区

description:
  用于非安全到安全通信的缓冲区
maintainers:
  - Florian Fainelli <f.fainelli@gmail.com>

properties:
  compatible:
    items:
      - enum:
          - brcm,bcm11351-smc
          - brcm,bcm21664-smc
          - brcm,bcm23550-smc
      - const: brcm,kona-smc

  reg:
    maxItems: 1

required:
  - compatible
  - reg

additionalProperties: false

examples:
  - |
    smc@3404c000 {
        compatible = "brcm,bcm11351-smc", "brcm,kona-smc";
        reg = <0x3404c000 0x400>; /* 1 KiB 在 SRAM 中 */
    };
```

## Documentation/devicetree/bindings/firmware/coreboot_cn.txt
~~~~
### COREBOOT 固件信息

用于向内核传达 COREBOOT 在内存中驻留的簿记结构位置的设备树节点。由于 COREBOOT 本身尚无法引导基于设备树的内核，因此需要通过第二阶段引导加载程序（COREBOOT 的“有效负载”）来插入此节点。
#### 必需属性：
- `compatible`：应为 "coreboot"
- `reg`：以下两个内存区域的地址和长度，按顺序排列：
    1. COREBOOT 表。这是一系列变长描述符的列表，其中包含各种编译时和运行时生成的固件参数。它通过其前四个字节中的魔法字符串 "LBIO" 来标识。
        - 详情请参阅 COREBOOT 的 `src/commonlib/include/commonlib/coreboot_tables.h`
    2. CBMEM 区域。这是一个向下增长的内存区域，由 COREBOOT 用来动态分配保持驻留的数据结构。该区域可能或不可能将 COREBOOT 表作为其成员之一。它通过位于该区域最顶部 8 字节中的具有魔法数字 0xc0389481 的根节点描述符来标识。
        - 详情请参阅 COREBOOT 的 `src/include/imd.h`

#### 示例：
```plaintext
firmware {
    ranges;

    coreboot {
        compatible = "coreboot";
        reg = <0xfdfea000 0x264>,
              <0xfdfea000 0x16000>;
    };
};
```
在示例中，`0xfdfea000` 地址处的前 `0x264` 字节是 COREBOOT 表的位置；接下来的 `0x16000` 字节则是 CBMEM 区域。
~~~~

## Documentation/devicetree/bindings/firmware/cznic,turris-mox-rwtm_cn.txt
~~~~
这段文本描述了在设备树(Device Tree)中定义的针对Turris Mox的rWTM固件驱动的相关属性。下面是翻译及解释：

### Turris Mox rWTM 固件驱动

**所需属性：**
- `compatible`：应当设置为 `"cznic,turris-mox-rwtm"`。
- `mboxes`：必须包含与之关联的邮箱(mailbox)的引用。

此设备树节点应用于Turris Mox，或可能适用于其他兼容A3700的设备，在其安全处理器中运行Mox的rWTM固件（例如，可以将此固件刷入EspressoBin）。

**示例：**

```plaintext
firmware {
    turris-mox-rwtm {
        compatible = "cznic,turris-mox-rwtm";
        mboxes = <&rwtm 0>;
        status = "okay";
    };
};
```

在这个例子中：
- `firmware` 节点包含了 `turris-mox-rwtm` 子节点。
- `compatible` 属性指定了兼容性标识符 `"cznic,turris-mox-rwtm"`。
- `mboxes` 属性指定了一个邮箱的引用 `<&rwtm 0>`，其中 `&rwtm` 是邮箱的标签，而 `0` 可能是用于区分不同邮箱实例的索引。
- `status` 属性表明该配置的状态为 “okay”，即正常可用。

简而言之，这段配置定义了一个针对使用rWTM固件的Turris Mox或其他兼容设备的固件驱动，确保了固件和设备之间的正确通信。
~~~~

## Documentation/devicetree/bindings/firmware/cznic,turris-omnia-mcu_cn.yaml
```yaml
# SPDX-文件许可人: (GPL-2.0 或 BSD-2-Clause)
%YAML 1.2
---
$id: http://devicetree.org/schemas/firmware/cznic,turris-omnia-mcu.yaml#
$schema: http://devicetree.org/meta-schemas/core.yaml#

title: CZ.NIC 的 Turris Omnia 微控制器单元 (MCU)

maintainers:
  - Marek Behún <kabel@kernel.org>

description:
  在 Turris Omnia 上的 MCU 作为系统控制器提供额外的 GPIO、中断、看门狗、系统关机和唤醒配置。

properties:
  compatible:
    const: cznic,turris-omnia-mcu

  reg:
    description: MCU I2C 从设备地址
    maxItems: 1

  interrupts:
    maxItems: 1

  interrupt-controller: true

  '#interrupt-cells':
    const: 2
    description: |
      第一个单元格指定中断编号（0 到 63），第二个单元格指定中断类型（可以是 IRQ_TYPE_EDGE_RISING、
      IRQ_TYPE_EDGE_FALLING 或 IRQ_TYPE_EDGE_BOTH）
中断编号依次对应 GPIO 编号，考虑 GPIO 银行：
        中断编号   GPIO 银行   银行内的 GPIO 引脚编号
           0 - 15      0           0 - 15
          16 - 47      1           0 - 31
          48 - 63      2           0 - 15
有几个例外情况：
        中断编号   含义
          11           按钮按下时 LED 面板亮度变化
          13           TRNG 熵准备就绪
          14           ECDSA 消息签名计算完成

  gpio-controller: true

  '#gpio-cells':
    const: 3
    description:
      第一个单元格是银行编号（0、1 或 2），第二个单元格是银行内的引脚编号
      （对于银行 0 和 2 为 0 到 15，对于银行 1 为 0 到 31），第三个单元格指定消费者标志。

required:
  - compatible
  - reg
  - interrupts
  - interrupt-controller
  - gpio-controller

additionalProperties: false

examples:
  - |
    #include <dt-bindings/interrupt-controller/irq.h>

    i2c {
        #address-cells = <1>;
        #size-cells = <0>;

        system-controller@2a {
            compatible = "cznic,turris-omnia-mcu";
            reg = <0x2a>;

            interrupt-parent = <&gpio1>;
            interrupts = <11 IRQ_TYPE_NONE>;

            gpio-controller;
            #gpio-cells = <3>;

            interrupt-controller;
            #interrupt-cells = <2>;
        };
    };
```

## Documentation/devicetree/bindings/firmware/fsl,scu_cn.yaml
```yaml
# SPDX-License-Identifier: (GPL-2.0-only OR BSD-2-Clause)
%YAML 1.2
---
$id: http://devicetree.org/schemas/firmware/fsl,scu.yaml#
$schema: http://devicetree.org/meta-schemas/core.yaml#

title: NXP i.MX 系统控制器固件 (SCFW)

maintainers:
  - 东艾生 <aisheng.dong@nxp.com>

description:
  系统控制器固件 (SCFW) 是一种低级系统功能，运行在一个专用的 Cortex-M 核心上，提供电源、时钟和资源管理。它存在于某些 i.MX8 处理器中，例如 i.MX8QM (QM, QP)，以及 i.MX8QX (QXP, DX)。
应用处理器 (AP) 通过位于 LSIO 子系统中的多端口 MU 模块与 SC 进行通信。当前定义的这个 MU 模块提供了 5 个远程 AP 连接到 SC，以支持最多 5 个执行环境（可信区，虚拟机监视器，标准 Linux 等）。这个 MU 模块的 SC 一侧接口与 LSIO DSC IP 总线相连。SC 固件将使用 MSI 总线与该 MU 模块进行通信。
properties:
  compatible:
    const: fsl,imx-scu

  clock-controller:
    description:
      提供由 SCU 控制的时钟的时钟控制器节点
    $ref: /schemas/clock/fsl,scu-clk.yaml

  gpio:
    description:
      通过固件 API 控制 SCU 域上的 GPIO 引脚
    $ref: /schemas/gpio/fsl,imx8qxp-sc-gpio.yaml

  ocotp:
    description:
      由 SCU 提供的 OCOTP 控制器节点
    $ref: /schemas/nvmem/fsl,scu-ocotp.yaml

  keys:
    description:
      由 SCU 提供的按键
    $ref: /schemas/input/fsl,scu-key.yaml

  mboxes:
    description:
      一个 TX MU 通道的 phandle 列表后跟一个 RX MU 通道的 phandle 列表。列表末尾可以包含一个可选的 MU 通道用于通用中断。如果 MU 实例与 "fsl,imx8-mu-scu" 兼容，则预期的 TX 和 RX 通道数量为 1 TX 和 1 RX 通道；否则为 4 TX 和 4 RX 通道。所有 MU 通道必须在同一 MU 实例内。不允许跨实例。MU 实例只能是 imx8qxp 和 imx8qm 中的 LSIO MU0～M4 之一。用户需要确保所用的一个不与其它执行环境（如 ATF）冲突。
oneOf:
      - items:
          - description: TX0 MU 通道
          - description: RX0 MU 通道
      - items:
          - description: TX0 MU 通道
          - description: RX0 MU 通道
          - description: 可选 MU 通道用于通用中断
      - items:
          - description: TX0 MU 通道
          - description: TX1 MU 通道
          - description: TX2 MU 通道
          - description: TX3 MU 通道
          - description: RX0 MU 通道
          - description: RX1 MU 通道
          - description: RX2 MU 通道
          - description: RX3 MU 通道
      - items:
          - description: TX0 MU 通道
          - description: TX1 MU 通道
          - description: TX2 MU 通道
          - description: TX3 MU 通道
          - description: RX0 MU 通道
          - description: RX1 MU 通道
          - description: RX2 MU 通道
          - description: RX3 MU 通道
          - description: 可选 MU 通道用于通用中断

  mbox-names:
    oneOf:
      - items:
          - const: tx0
          - const: rx0
      - items:
          - const: tx0
          - const: rx0
          - const: gip3
      - items:
          - const: tx0
          - const: tx1
          - const: tx2
          - const: tx3
          - const: rx0
          - const: rx1
          - const: rx2
          - const: rx3
      - items:
          - const: tx0
          - const: tx1
          - const: tx2
          - const: tx3
          - const: rx0
          - const: rx1
          - const: rx2
          - const: rx3
          - const: gip3

  pinctrl:
    description:
      由 SCU 提供的引脚控制器
    $ref: /schemas/pinctrl/fsl,scu-pinctrl.yaml

  power-controller:
    description:
      提供由 SCU 控制的电源域的电源域控制器节点
    $ref: /schemas/power/fsl,scu-pd.yaml

  rtc:
    description:
      由 SCU 提供的 RTC 控制器
    $ref: /schemas/rtc/fsl,scu-rtc.yaml

  thermal-sensor:
    description:
      由 SCU 提供的温度传感器
    $ref: /schemas/thermal/fsl,scu-thermal.yaml

  watchdog:
    description:
      由 SCU 提供的看门狗控制器
    $ref: /schemas/watchdog/fsl,scu-wdt.yaml

required:
  - compatible
  - mbox-names
  - mboxes

additionalProperties: false

examples:
  - |
    #include <dt-bindings/firmware/imx/rsrc.h>
    #include <dt-bindings/input/input.h>
    #include <dt-bindings/pinctrl/pads-imx8qxp.h>

    firmware {
        system-controller {
            compatible = "fsl,imx-scu";
            mbox-names = "tx0", "tx1", "tx2", "tx3",
                         "rx0", "rx1", "rx2", "rx3",
                         "gip3";
            mboxes = <&lsio_mu1 0 0 &lsio_mu1 0 1 &lsio_mu1 0 2 &lsio_mu1 0 3
                      &lsio_mu1 1 0 &lsio_mu1 1 1 &lsio_mu1 1 2 &lsio_mu1 1 3
                      &lsio_mu1 3 3>;

            clock-controller {
                compatible = "fsl,imx8qxp-clk", "fsl,scu-clk";
                #clock-cells = <2>;
            };

            pinctrl {
                compatible = "fsl,imx8qxp-iomuxc";

                pinctrl_lpuart0: lpuart0grp {
                    fsl,pins = <
                        IMX8QXP_UART0_RX_ADMA_UART0_RX   0x06000020
                        IMX8QXP_UART0_TX_ADMA_UART0_TX   0x06000020
                    >;
                };
            };

            ocotp {
                compatible = "fsl,imx8qxp-scu-ocotp";
                #address-cells = <1>;
                #size-cells = <1>;

                fec_mac0: mac@2c4 {
                    reg = <0x2c4 6>;
                };
            };

            power-controller {
                compatible = "fsl,imx8qxp-scu-pd", "fsl,scu-pd";
                #power-domain-cells = <1>;
            };

            rtc {
                compatible = "fsl,imx8qxp-sc-rtc";
            };

            keys {
                compatible = "fsl,imx8qxp-sc-key", "fsl,imx-sc-key";
                linux,keycodes = <KEY_POWER>;
            };

            watchdog {
                compatible = "fsl,imx8qxp-sc-wdt", "fsl,imx-sc-wdt";
                timeout-sec = <60>;
            };

            thermal-sensor {
                compatible = "fsl,imx8qxp-sc-thermal", "fsl,imx-sc-thermal";
                #thermal-sensor-cells = <1>;
            };
        };
    };
```
