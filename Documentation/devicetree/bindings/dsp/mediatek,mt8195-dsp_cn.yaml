## Documentation/devicetree/bindings/firmware/intel,ixp4xx-network-processing-engine_cn.yaml
~~~~yaml
```yaml
# SPDX-许可证标识符: (GPL-2.0 或 BSD-2-Clause)
# 版权所有 2019 Linaro 有限公司
%YAML 1.2
---
$id: http://devicetree.org/schemas/firmware/intel,ixp4xx-network-processing-engine.yaml#
$schema: http://devicetree.org/meta-schemas/core.yaml#

标题: Intel IXP4xx 网络处理引擎

维护者:
  - Linus Walleij <linus.walleij@linaro.org>

描述: |
  在 IXP4xx 系统级芯片上，网络处理引擎（NPE）是一个小型处理器，
  可以加载固件来执行网络和加密任务的卸载。它还管理 IXP4xx 平台上的 MDIO 总线到以太网 PHY。
  所有的 IXP4xx 平台都有三个位于连续内存位置的 NPE。由于它们彼此并不独立，因此都包含在同一个设备节点中。
属性:
  compatible:
    oneOf:
      - items:
          - 常量: intel,ixp4xx-network-processing-engine

  reg:
    items:
      - 描述: NPE0 (NPE-A) 寄存器范围
      - 描述: NPE1 (NPE-B) 寄存器范围
      - 描述: NPE2 (NPE-C) 寄存器范围

  crypto:
    $ref: /schemas/crypto/intel,ixp4xx-crypto.yaml#
    类型: 对象
    描述: 内置加密引擎的可选节点，该节点应使用用于加密引擎的 NPE 引擎实例编号进行命名

"#address-cells":
    常量: 1

  "#size-cells":
    常量: 0

模式属性:
  hss@[0-9]+$:
    $ref: /schemas/net/intel,ixp4xx-hss.yaml#
    类型: 对象
    描述: 高速串行链路 (HSS) 的可选节点，该节点应使用用于 HSS 的 NPE 引擎实例编号进行命名
所需:
  - compatible
  - reg

附加属性: false

示例:
  - |
    #include <dt-bindings/gpio/gpio.h>

    npe: npe@c8006000 {
         compatible = "intel,ixp4xx-network-processing-engine";
         reg = <0xc8006000 0x1000>, <0xc8007000 0x1000>, <0xc8008000 0x1000>;
         #address-cells = <1>;
         #size-cells = <0>;

         hss@0 {
             compatible = "intel,ixp4xx-hss";
             reg = <0>;
             intel,npe-handle = <&npe 0>;
             intel,queue-chl-rxtrig = <&qmgr 12>;
             intel,queue-chl-txready = <&qmgr 34>;
             intel,queue-pkt-rx = <&qmgr 13>;
             intel,queue-pkt-tx = <&qmgr 14>, <&qmgr 15>, <&qmgr 16>, <&qmgr 17>;
             intel,queue-pkt-rxfree = <&qmgr 18>, <&qmgr 19>, <&qmgr 20>, <&qmgr 21>;
             intel,queue-pkt-txdone = <&qmgr 22>;
             cts-gpios = <&gpio0 10 GPIO_ACTIVE_LOW>;
             rts-gpios = <&gpio0 14 GPIO_ACTIVE_LOW>;
             dcd-gpios = <&gpio0 6 GPIO_ACTIVE_LOW>;
             dtr-gpios = <&gpio_74 2 GPIO_ACTIVE_LOW>;
             clk-internal-gpios = <&gpio_74 0 GPIO_ACTIVE_HIGH>;
         };

         crypto {
             compatible = "intel,ixp4xx-crypto";
             intel,npe-handle = <&npe 2>;
             queue-rx = <&qmgr 30>;
             queue-txready = <&qmgr 29>;
         };
    };
..
```
```markdown
注意: YAML 文件中的注释以及特殊格式（如 `|` 和 `-`）可能需要根据 Markdown 或其他文本格式的要求进行适当调整。
```
~~~~

## Documentation/devicetree/bindings/firmware/intel,stratix10-svc_cn.txt
~~~~
Intel Stratix10 SoC 服务层驱动程序
============================================

Intel Stratix10 SoC 系统由一个 64 位四核 ARM Cortex A53 硬件处理器系统 (HPS) 和安全设备管理器 (SDM) 组成。当从 HPS 配置 FPGA 时，需要一种方法让 HPS 通知 SDM 配置数据的位置和大小。然后 SDM 将从该位置获取配置数据并执行 FPGA 配置。

为了满足整个系统的安全需求并支持虚拟机请求与 SDM 的通信，只有运行在安全世界（EL3，异常层 3）的软件才能与 SDM 接口。所有在其他异常层上运行的软件实体在需要 SDM 提供服务时都必须通过 EL3 软件进行。

Intel Stratix10 服务层驱动程序运行在特权异常层（EL1，异常层 1），与服务提供者接口，并为 FPGA 配置、QSPI、加密和热重置等提供服务。服务层驱动程序还管理安全监视调用 (SMC)，以便与在 EL3 中运行的安全监视代码进行通信。

所需属性：
-------------------

svc 节点具有以下必需属性，必须位于 firmware 节点下：

- compatible: "intel,stratix10-svc" 或 "intel,agilex-svc"
- method: smc 或 hvc
        smc - 安全监视调用
        hvc - 虚拟机调用
- memory-region:
	指向保留内存节点的 phandle。详情请参阅 Documentation/devicetree/bindings/reserved-memory/reserved-memory.txt

示例：
-------

```devicetree
reserved-memory {
        #address-cells = <2>;
        #size-cells = <2>;
        ranges;

        service_reserved: svcbuffer@0 {
                compatible = "shared-dma-pool";
                reg = <0x0 0x0 0x0 0x1000000>;
                alignment = <0x1000>;
                no-map;
        };
};

firmware {
	svc {
		compatible = "intel,stratix10-svc";
		method = "smc";
		memory-region = <&service_reserved>;
	};
};
```
~~~~

## Documentation/devicetree/bindings/firmware/nvidia,tegra186-bpmp_cn.yaml
~~~~yaml
# SPDX-许可证标识符: (GPL-2.0-only 或 BSD-2-Clause)
%YAML 1.2
---
$id: http://devicetree.org/schemas/firmware/nvidia,tegra186-bpmp.yaml#
$schema: http://devicetree.org/meta-schemas/core.yaml#

标题: NVIDIA Tegra 启动与电源管理处理器 (BPMP)

维护者:
  - Thierry Reding <thierry.reding@gmail.com>
  - Jon Hunter <jonathanh@nvidia.com>

描述: |
  BPMP 是 Tegra 芯片中的一个特定处理器，用于处理启动过程，并从 CPU 卸载电源管理、时钟管理和复位控制等任务。此绑定文档定义了 BPMP 固件驱动程序将使用的资源，该驱动程序可以创建 CPU 和 BPMP 之间的处理器间通信 (IPC)。
此节点是邮箱消费者。有关邮箱子系统的详细信息及由相关提供者实现的规范，请参阅以下文件：

    - .../mailbox/mailbox.txt
    - .../mailbox/nvidia,tegra186-hsp.yaml

  此节点是时钟、电源域和复位提供者。有关这些特性的通用文档及其由本节点实现的规范，请参阅以下文件：

    - .../clock/clock-bindings.txt
    - <dt-bindings/clock/tegra186-clock.h>
    - ../power/power-domain.yaml
    - <dt-bindings/power/tegra186-powergate.h>
    - .../reset/reset.txt
    - <dt-bindings/reset/tegra186-reset.h>

  BPMP 实现了一些服务，这些服务必须通过单独的节点表示。例如，它能够提供对某些 I2C 控制器的访问，而 I2C 绑定则将每个 I2C 控制器表示为设备树中的一个节点。此类节点应直接嵌套在主 BPMP 节点内。
软件可以通过检查 BPMP 节点的子节点是否存在兼容性属性来确定其是否代表一个设备。任何具有兼容性属性的节点都表示一个可实例化的设备。没有兼容性属性的节点可用于提供有关 BPMP 本身的配置信息，尽管目前此绑定尚未定义这样的配置节点。
BPMP 固件并未为这些服务定义单一的全局命名/编号空间。换句话说，I2C 总线的编号方案与 BPMP 可能提供的任何其他服务（如未来可能的 SPI 总线服务）的编号方案是不同的。因此，子设备节点将不包含 reg 属性，且 BPMP 节点也不会包含 "#address-cells" 或 "#size-cells" 属性。
CPU 和 BPMP 之间的 IPC TX 和 RX 的共享内存区域是预先定义好的，并基于芯片内部的 sysram（静态 RAM）或正常的 SDRAM 运行。
请参阅 ".../sram/sram.yaml" 以了解 SRAM 情况下的绑定。
请参阅 "../reserved-memory/nvidia,tegra264-bpmp-shmem.yaml" 以了解 SDRAM 情况下的绑定。

属性:
  compatible:
    oneOf:
      - items:
          - enum:
              - nvidia,tegra194-bpmp
              - nvidia,tegra234-bpmp
          - const: nvidia,tegra186-bpmp
      - const: nvidia,tegra186-bpmp

  mboxes:
    描述: 用于与 BPMP 通信的邮箱的句柄和通道标识符
maxItems: 1

  shmem:
    描述: 基于 CPU 和 BPMP 之间 IPC 的 TX 和 RX 共享内存区域的句柄列表
minItems: 2
    maxItems: 2

  memory-region:
    描述: 用于 CPU-NS 和 BPMP 之间 IPC 的预留内存区域的句柄
The provided text describes a Device Tree Blob (DTB) configuration for an NVIDIA Tegra186 platform, specifically focusing on the Bridge Processor Mailbox (BPMP) component and its interactions with other hardware elements. Below is a translation of the key parts into Chinese:

- `maxItems`: 1

  `#clock-cells`:
    `const`: 1

  `#power-domain-cells`:
    `const`: 1

  `#reset-cells`:
    `const`: 1

  `interconnects`:
    `items`:
      - 描述: 内存读取客户端
      - 描述: 内存写入客户端
      - 描述: DMA读取客户端
      - 描述: DMA写入客户端

  `interconnect-names`:
    `items`:
      - `const`: 读取
      - `const`: 写入
      - `const`: dma-mem # dma-读取
      - `const`: dma-写入

  `iommus`:
    `maxItems`: 1

  `i2c`:
    类型: 对象

  `thermal`:
    类型: 对象

  `additionalProperties`: false

  `oneOf`:
    - `required`:
        - `memory-region`
    - `required`:
        - `shmem`

  `required`:
    - `compatible`
    - `mboxes`
    - `#clock-cells`
    - `#power-domain-cells`
    - `#reset-cells`

### 示例

#### 第一个示例
```yaml
#include <dt-bindings/interrupt-controller/arm-gic.h>
#include <dt-bindings/mailbox/tegra186-hsp.h>
#include <dt-bindings/memory/tegra186-mc.h>

hsp_top0: hsp@3c00000 {
    compatible = "nvidia,tegra186-hsp";
    reg = <0x03c00000 0xa0000>;
    interrupts = <GIC_SPI 176 IRQ_TYPE_LEVEL_HIGH>;
    interrupt-names = "doorbell";
    #mbox-cells = <2>;
};

sram@30000000 {
    compatible = "nvidia,tegra186-sysram", "mmio-sram";
    reg = <0x30000000 0x50000>;
    #address-cells = <1>;
    #size-cells = <1>;
    ranges = <0x0 0x30000000 0x50000>;

    cpu_bpmp_tx: sram@4e000 {
        reg = <0x4e000 0x1000>;
        label = "cpu-bpmp-tx";
        pool;
    };

    cpu_bpmp_rx: sram@4f000 {
        reg = <0x4f000 0x1000>;
        label = "cpu-bpmp-rx";
        pool;
    };
};

bpmp {
    compatible = "nvidia,tegra186-bpmp";
    interconnects = <&mc TEGRA186_MEMORY_CLIENT_BPMPR &emc>,
                    <&mc TEGRA186_MEMORY_CLIENT_BPMPW &emc>,
                    <&mc TEGRA186_MEMORY_CLIENT_BPMPDMAR &emc>,
                    <&mc TEGRA186_MEMORY_CLIENT_BPMPDMAW &emc>;
    interconnect-names = "read", "write", "dma-mem", "dma-write";
    iommus = <&smmu TEGRA186_SID_BPMP>;
    mboxes = <&hsp_top0 TEGRA_HSP_MBOX_TYPE_DB TEGRA_HSP_DB_MASTER_BPMP>;
    shmem = <&cpu_bpmp_tx>, <&cpu_bpmp_rx>;
    #clock-cells = <1>;
    #power-domain-cells = <1>;
    #reset-cells = <1>;

    i2c {
        compatible = "nvidia,tegra186-bpmp-i2c";
        nvidia,bpmp-bus-id = <5>;
        #address-cells = <1>;
        #size-cells = <0>;
    };

    thermal {
        compatible = "nvidia,tegra186-bpmp-thermal";
        #thermal-sensor-cells = <1>;
    };
};
```

#### 第二个示例
```yaml
#include <dt-bindings/mailbox/tegra186-hsp.h>

bpmp {
    compatible = "nvidia,tegra186-bpmp";
    interconnects = <&mc TEGRA186_MEMORY_CLIENT_BPMPR &emc>,
                    <&mc TEGRA186_MEMORY_CLIENT_BPMPW &emc>,
                    <&mc TEGRA186_MEMORY_CLIENT_BPMPDMAR &emc>,
                    <&mc TEGRA186_MEMORY_CLIENT_BPMPDMAW &emc>;
    interconnect-names = "read", "write", "dma-mem", "dma-write";
    mboxes = <&hsp_top1 TEGRA_HSP_MBOX_TYPE_DB TEGRA_HSP_DB_MASTER_BPMP>;
    memory-region = <&dram_cpu_bpmp_mail>;
    #clock-cells = <1>;
    #power-domain-cells = <1>;
    #reset-cells = <1>;
};
```

这段配置描述了BPMP组件与其他硬件的交互，包括内存区域、中断控制器、I²C总线和热管理等。
~~~~

## Documentation/devicetree/bindings/firmware/nvidia,tegra210-bpmp_cn.txt
~~~~
NVIDIA Tegra210 启动和电源管理处理器 (BPMP)

启动和电源管理处理器 (BPMP) 是在 Tegra210 系统级芯片 (SoC) 中发现的协处理器。它被设计用于处理启动过程的早期阶段，以及帮助进入深度低功耗状态（挂起到内存），还在某些平台上卸载 DRAM 内存时钟缩放功能。绑定文档定义了 BPMP T210 固件驱动程序将使用的资源，这些资源可以创建 CPU 和 BPMP 之间的处理器间通信 (IPC)。
所需属性：
- compatible
    字符串数组
    可以是：
    - "nvidia,tegra210-bpmp"
- reg: 为硬件同步原语指定物理基地址和长度
       1) Tegra “原子”硬件的基地址和长度
       2) Tegra “信号量”硬件的基地址和长度
- interrupts: 指定接收消息 ("rx") 和触发消息 ("tx") 的中断编号

可选属性：
- #clock-cells : 对于将 DRAM 时钟控制卸载到 BPMP 的平台，其值应为 1

示例：

```
bpmp@70016000 {
	compatible = "nvidia,tegra210-bpmp";
	reg = <0x0 0x70016000 0x0 0x2000
	       0x0 0x60001000 0x0 0x1000>;
	interrupts = <GIC_SPI 6 IRQ_TYPE_EDGE_RISING>,
		     <GIC_SPI 4 IRQ_TYPE_EDGE_RISING>;
	interrupt-names = "tx", "rx";
};
```
~~~~

## Documentation/devicetree/bindings/firmware/qcom,scm_cn.yaml
```yaml
# SPDX-许可证标识符: (GPL-2.0-only 或 BSD-2-Clause)
%YAML 1.2
---
$id: http://devicetree.org/schemas/firmware/qcom,scm.yaml#
$schema: http://devicetree.org/meta-schemas/core.yaml#

title: 高通安全通道管理器 (SCM)

description: |
  高通处理器包含一个与安全固件通信的接口。
  此接口允许客户端请求不同类型的操作，
  这些操作可以包括CPU上下电、HDCP请求、固件加载和其他各种操作。
maintainers:
  - Bjorn Andersson <bjorn.andersson@linaro.org>
  - Robert Marko <robimarko@gmail.com>
  - Guru Das Srinagesh <quic_gurus@quicinc.com>

properties:
  compatible:
    items:
      - enum:
          - qcom,scm-apq8064
          - qcom,scm-apq8084
          - qcom,scm-ipq4019
          - qcom,scm-ipq5018
          - qcom,scm-ipq5332
          - qcom,scm-ipq6018
          - qcom,scm-ipq806x
          - qcom,scm-ipq8074
          - qcom,scm-ipq9574
          - qcom,scm-mdm9607
          - qcom,scm-msm8226
          - qcom,scm-msm8660
          - qcom,scm-msm8916
          - qcom,scm-msm8953
          - qcom,scm-msm8960
          - qcom,scm-msm8974
          - qcom,scm-msm8976
          - qcom,scm-msm8994
          - qcom,scm-msm8996
          - qcom,scm-msm8998
          - qcom,scm-qcm2290
          - qcom,scm-qdu1000
          - qcom,scm-sa8775p
          - qcom,scm-sc7180
          - qcom,scm-sc7280
          - qcom,scm-sc8180x
          - qcom,scm-sc8280xp
          - qcom,scm-sdm670
          - qcom,scm-sdm845
          - qcom,scm-sdx55
          - qcom,scm-sdx65
          - qcom,scm-sdx75
          - qcom,scm-sm6115
          - qcom,scm-sm6125
          - qcom,scm-sm6350
          - qcom,scm-sm6375
          - qcom,scm-sm7150
          - qcom,scm-sm8150
          - qcom,scm-sm8250
          - qcom,scm-sm8350
          - qcom,scm-sm8450
          - qcom,scm-sm8550
          - qcom,scm-sm8650
          - qcom,scm-qcs404
          - qcom,scm-x1e80100
      - const: qcom,scm

  clocks:
    minItems: 1
    maxItems: 3

  clock-names:
    minItems: 1
    maxItems: 3

  dma-coherent: true

  interconnects:
    maxItems: 1

  interconnect-names:
    maxItems: 1

  '#reset-cells':
    const: 1

  interrupts:
    description:
      固件作为握手协议的一部分引发的等待队列中断，用于处理睡眠中的SCM调用
maxItems: 1

  memory-region:
    description:
      预留给共享内存桥到TZ的内存区域的句柄
maxItems: 1

  qcom,sdi-enabled:
    description:
      指示由TZ默认启用的SDI（安全调试映像）需要被禁用
      如果不被禁用，WDT断言或重启会导致系统挂起在调试模式中
type: boolean

  qcom,dload-mode:
    $ref: /schemas/types.yaml#/definitions/phandle-array
    items:
      - items:
          - description: 指向TCSR硬件块的句柄
          - description: 下载模式控制寄存器的偏移量
    description: TCSR硬件块

allOf:
  # 时钟
  - if:
      properties:
        compatible:
          contains:
            enum:
              - qcom,scm-apq8064
              - qcom,scm-apq8084
              - qcom,scm-mdm9607
              - qcom,scm-msm8226
              - qcom,scm-msm8660
              - qcom,scm-msm8916
              - qcom,scm-msm8953
              - qcom,scm-msm8960
              - qcom,scm-msm8974
              - qcom,scm-msm8976
              - qcom,scm-qcm2290
              - qcom,scm-sm6375
    then:
      required:
        - clocks
        - clock-names
    else:
      properties:
        clock-names: false
        clocks: false

  - if:
      properties:
        compatible:
          contains:
            enum:
              - qcom,scm-apq8064
              - qcom,scm-msm8660
              - qcom,scm-msm8960
              - qcom,scm-qcm2290
              - qcom,scm-sm6375
    then:
      properties:
        clock-names:
          items:
            - const: core

        clocks:
          maxItems: 1

  - if:
      properties:
        compatible:
          contains:
            enum:
              - qcom,scm-apq8084
              - qcom,scm-mdm9607
              - qcom,scm-msm8226
              - qcom,scm-msm8916
              - qcom,scm-msm8953
              - qcom,scm-msm8974
              - qcom,scm-msm8976
    then:
      properties:
        clock-names:
          items:
            - const: core
            - const: bus
            - const: iface

        clocks:
          minItems: 3
          maxItems: 3

  # 中断
  - if:
      not:
        properties:
          compatible:
            contains:
              enum:
                - qcom,scm-sm8450
                - qcom,scm-sm8550
                - qcom,scm-sm8650
    then:
      properties:
        interrupts: false
  - if:
      not:
        properties:
          compatible:
            contains:
              enum:
                - qcom,scm-sa8775p
    then:
      properties:
        memory-region: false

required:
  - compatible

additionalProperties: false

examples:
  - |
    #include <dt-bindings/clock/qcom,gcc-msm8916.h>

    firmware {
        scm {
            compatible = "qcom,scm-msm8916", "qcom,scm";
            clocks = <&gcc GCC_CRYPTO_CLK>,
                     <&gcc GCC_CRYPTO_AXI_CLK>,
                     <&gcc GCC_CRYPTO_AHB_CLK>;
            clock-names = "core", "bus", "iface";
        };
    };
```

## Documentation/devicetree/bindings/firmware/qemu,fw-cfg-mmio_cn.yaml
```yaml
# SPDX-许可证标识符: GPL-2.0
%YAML 1.2
---
$id: http://devicetree.org/schemas/firmware/qemu,fw-cfg-mmio.yaml#
$schema: http://devicetree.org/meta-schemas/core.yaml#

标题: QEMU 固件配置

维护者:
  - Rob Herring <robh@kernel.org>

描述: |
  多种 QEMU 模拟/虚拟化目标在 "virt" 机器类型上提供了以下
  固件配置接口：

  - 一个只写、16位宽的选择器（或控制）寄存器，
  - 一个读写、64位宽的数据寄存器
QEMU 将控制和数据寄存器以内存映射寄存器的形式暴露给客户机；它们的位置通过 QEMU 放置在客户机 DRAM 底部的设备树二进制文件（DTB）传递给客户机的 UEFI 固件。
权威的客户机侧硬件接口文档可以在 QEMU 源代码树中的 "docs/specs/fw_cfg.txt" 文件中找到。
属性:
  compatible:
    常量: qemu,fw-cfg-mmio

  reg:
    最大项数: 1
    描述: |
      * 字节 0x0 到 0x7 覆盖数据寄存器
* 字节 0x8 到 0x9 覆盖选择器寄存器
* 如果将来有接口修订/功能位，可能会在此区域追加更多的寄存器
dma-coherent: true

必需:
  - compatible
  - reg

附加属性: false

示例:
  - |

    fw-cfg@9020000 {
        compatible = "qemu,fw-cfg-mmio";
        reg = <0x9020000 0xa>;
    };
..
```
