## Documentation/devicetree/bindings/firmware/arm,scmi_cn.yaml
~~~~yaml
# SPDX-许可证标识符: (GPL-2.0 或 BSD-2-Clause)
# 版权所有 2021 ARM 有限公司
%YAML 1.2
---
$id: http://devicetree.org/schemas/firmware/arm,scmi.yaml#
$schema: http://devicetree.org/meta-schemas/core.yaml#

标题: 系统控制和管理接口 (SCMI) 消息协议

维护者:
  - Sudeep Holla <sudeep.holla@arm.com>

描述: |
  SCMI 的设计目的是允许诸如 OSPM 之类的代理管理各种由其所运行的硬件平台提供的功能，包括电源和性能功能。
本绑定旨在定义实现 SCMI 的固件（如 ARM 文件编号 ARM DEN 0056 "ARM 系统控制与管理接口平台设计文档"[0]中所述）在设备树中为 OSPM 提供的接口。
[0] https://developer.arm.com/documentation/den0056/latest

属性:
  $nodename:
    常量: scmi

  compatible:
    oneOf:
      - 描述: 符合 SCMI 规范的固件，使用邮箱传输
        items:
          - 常量: arm,scmi
      - 描述: 符合 SCMI 规范的固件，使用 ARM SMC/HVC 传输
        items:
          - 常量: arm,scmi-smc
      - 描述: 符合 SCMI 规范的固件，使用 ARM SMC/HVC 传输
                     其参数为共享内存地址（4KB-页面，偏移）
        items:
          - 常量: arm,scmi-smc-param
      - 描述: 符合 SCMI 规范的固件，使用 Qualcomm SMC/HVC 传输
        items:
          - 常量: qcom,scmi-smc
      - 描述: 符合 SCMI 规范的固件，使用 SCMI Virtio 传输
The virtio 传输仅支持单个设备
        items:
          - 常量: arm,scmi-virtio
      - 描述: 符合 SCMI 规范的固件，使用 OP-TEE 传输
        items:
          - 常量: linaro,scmi-optee

  interrupts:
    描述:
      表示平台完成消息而非通过 smc 调用返回的中断。这不应该被使用，
      除非平台需要此类行为
    maxItems: 1

  interrupt-names:
    常量: a2p

  mbox-names:
    描述:
      指定用于与符合 SCMI 规范的固件通信的邮箱
    oneOf:
      - items:
          - 常量: tx
          - 常量: rx
        minItems: 1
      - items:
          - 常量: tx
          - 常量: tx_reply
          - 常量: rx
          - 常量: rx_reply
        minItems: 2

  mboxes:
    描述:
      包含 phandle 和邮箱通道标识符的列表。它应该正好包含一个、两个、三个或四个邮箱；
      第一个或前两个用于发送消息 ("tx")，另一个可选的 ("rx") 用于接收通知和延迟响应（如果平台支持的话）。
      可选的 ("rx_reply") 用于通知完成中断（如果平台支持的话）。
      发送消息所需邮箱的数量取决于底层邮箱控制器暴露的通道类型；
      如果这样的通道是双向的，则一个单通道描述符就足够了；而如果底层邮箱通道是单向类型的，则需要两个通道描述符来表示 SCMI ("tx") 通道。
有效的mbox和shmem描述符数量的组合让SCMI子系统能够明确地判断出底层邮箱控制器提供的SCMI通道类型以及如何使用这些通道：

- 1 mbox / 1 shmem => SCMI发送通过一个双向邮箱通道
- 2 mbox / 2 shmem => SCMI发送和接收通过两个双向邮箱通道
- 2 mbox / 1 shmem => SCMI发送通过两个单向邮箱通道
- 3 mbox / 2 shmem => SCMI发送和接收通过三个单向邮箱通道
- 4 mbox / 2 shmem => SCMI发送和接收通过四个单向邮箱通道
- 任何其他mbox和shmem的组合都是无效的

mbox最小数量：1
    mbox最大数量：4

shmem：
    描述：
      每个指定传输通道指向共享内存（SHM）区域的phandle列表
shmem最小数量：1
    shmem最大数量：2

'#address-cells'：
    常量：1

'#size-cells'：
    常量：0

atomic-threshold-us：
    描述：
      可选的时间值，以微秒为单位，在此平台上表示阈值，当任何SCMI命令声明其执行延迟高于该阈值时，则不应将其视为原子模式操作的一部分，即使被请求
默认值：0

arm,smc-id：
    引用：/schemas/types.yaml#/definitions/uint32
    描述：
      使用smc或hvc传输时所需的SMC ID

linaro,optee-channel-id：
    引用：/schemas/types.yaml#/definitions/uint32
    描述：
      使用OP-TEE传输时所需的通道标识符

protocol@11：
    引用：#/$defs/protocol-node
    不评估未定义属性

    属性：
      reg：
        常量：0x11

      '#power-domain-cells'：
        常量：1

    必需属性：
      - '#power-domain-cells'

protocol@13：
    引用：#/$defs/protocol-node
    不评估未定义属性

    属性：
      reg：
        常量：0x13

      '#clock-cells'：
        常量：1

      '#power-domain-cells'：
        常量：1

    任一条件：
      - 必需属性：
          - '#clock-cells'

      - 必需属性：
          - '#power-domain-cells'

protocol@14：
    引用：#/$defs/protocol-node
    不评估未定义属性

    属性：
      reg：
        常量：0x14

      '#clock-cells'：
        常量：1

    必需属性：
      - '#clock-cells'

protocol@15：
    引用：#/$defs/protocol-node
    不评估未定义属性

    属性：
      reg：
        常量：0x15

      '#thermal-sensor-cells'：
        常量：1

    必需属性：
      - '#thermal-sensor-cells'

protocol@16：
    引用：#/$defs/protocol-node
    不评估未定义属性

    属性：
      reg：
        常量：0x16

      '#reset-cells'：
        常量：1

    必需属性：
      - '#reset-cells'

protocol@17：
    引用：#/$defs/protocol-node
    不评估未定义属性

    属性：
      reg：
        常量：0x17

      regulators：
        类型：对象
        额外属性：不允许
        描述：
          此SCMI控制器提供的所有稳压器列表

属性：
          '#address-cells'：
            常量：1

          '#size-cells'：
            常量：0

        匹配属性：
          '^regulator@[0-9a-f]+$'：
            类型：对象
            引用：/schemas/regulator/regulator.yaml#
            不评估未定义属性

            属性：
              reg：
                最大数量：1
                描述：电压稳压器的标识符

必需属性：
              - reg

protocol@18：
    引用：#/$defs/protocol-node
    不评估未定义属性

    属性：
      reg：
        常量：0x18

protocol@19：
    类型：对象
    全部包含：
      - 引用：#/$defs/protocol-node
      - 引用：/schemas/pinctrl/pinctrl.yaml

    不评估未定义属性

    属性：
      reg：
        常量：0x19

    匹配属性：
      '-pins$'：
        类型：对象
        全部包含：
          - 引用：/schemas/pinctrl/pincfg-node.yaml#
          - 引用：/schemas/pinctrl/pinmux-node.yaml#
        不评估未定义属性

        描述：
          一个引脚复用子节点描述了如何将一组引脚配置为所需的某种功能。
一个子节点可能定义多个引脚配置。
此子节点使用默认的pinctrl绑定来配置引脚复用，并使用SCMI协议来应用特定的配置。
下面是您提供的 YAML 格式的文档翻译为中文：

```yaml
# 必须字段:
#   - reg

# 不允许额外的属性
additionalProperties: false

$defs:
  protocol-node:
    type: object
    description: 
      每个子节点代表一个支持的协议。如果平台
      支持特定协议的专用通信通道，
      则相应的传输属性必须存在。
      Virtio传输不支持专用通信通道。
properties:
  reg:
    maxItems: 1

  mbox-names:
    oneOf:
      - items:
          - const: tx
          - const: rx
        minItems: 1
      - items:
          - const: tx
          - const: tx_reply
          - const: rx
        minItems: 2

  mboxes:
    minItems: 1
    maxItems: 3

  shmem:
    minItems: 1
    maxItems: 2

  linaro,optee-channel-id:
    $ref: /schemas/types.yaml#/definitions/uint32
    description: 
      当使用OP-TEE传输且
      协议有专用通信通道时所需的通道标识符。

# 必须字段:
#   - reg

# 必须字段:
#   - compatible

if:
  properties:
    compatible:
      contains:
        const: arm,scmi
then:
  properties:
    interrupts: false
    interrupt-names: false

  required:
    - mboxes
    - shmem

else:
  if:
    properties:
      compatible:
        contains:
          enum:
            - arm,scmi-smc
            - arm,scmi-smc-param
            - qcom,scmi-smc
  then:
    required:
      - arm,smc-id
      - shmem

  else:
    if:
      properties:
        compatible:
          contains:
            const: linaro,scmi-optee
    then:
      required:
        - linaro,optee-channel-id

examples:
  - |
    firmware {
        scmi {
            compatible = "arm,scmi";
            mboxes = <&mhuB 0 0>,
                     <&mhuB 0 1>;
            mbox-names = "tx", "rx";
            shmem = <&cpu_scp_lpri0>,
                    <&cpu_scp_lpri1>;

            #address-cells = <1>;
            #size-cells = <0>;

            atomic-threshold-us = <10000>;

            scmi_devpd: protocol@11 {
                reg = <0x11>;
                #power-domain-cells = <1>;
            };

            scmi_dvfs: protocol@13 {
                reg = <0x13>;
                #power-domain-cells = <1>;

                mboxes = <&mhuB 1 0>,
                         <&mhuB 1 1>;
                mbox-names = "tx", "rx";
                shmem = <&cpu_scp_hpri0>,
                        <&cpu_scp_hpri1>;
            };

            scmi_clk: protocol@14 {
                reg = <0x14>;
                #clock-cells = <1>;
            };

            scmi_sensors: protocol@15 {
                reg = <0x15>;
                #thermal-sensor-cells = <1>;
            };

            scmi_reset: protocol@16 {
                reg = <0x16>;
                #reset-cells = <1>;
            };

            scmi_voltage: protocol@17 {
                reg = <0x17>;
                regulators {
                    #address-cells = <1>;
                    #size-cells = <0>;

                    regulator_devX: regulator@0 {
                        reg = <0x0>;
                        regulator-max-microvolt = <3300000>;
                    };

                    regulator_devY: regulator@9 {
                        reg = <0x9>;
                        regulator-min-microvolt = <500000>;
                        regulator-max-microvolt = <4200000>;
                    };
                };
            };

            scmi_powercap: protocol@18 {
                reg = <0x18>;
            };

            scmi_pinctrl: protocol@19 {
                reg = <0x19>;

                i2c2-pins {
                    groups = "g_i2c2_a", "g_i2c2_b";
                    function = "f_i2c2";
                };

                mdio-pins {
                    groups = "g_avb_mdio";
                    drive-strength = <24>;
                };

                keys_pins: keys-pins {
                    pins = "gpio_5_17", "gpio_5_20", "gpio_5_22", "gpio_2_1";
                    bias-pull-up;
                };
            };
        };
    };

    soc {
        #address-cells = <2>;
        #size-cells = <2>;

        sram@50000000 {
            compatible = "mmio-sram";
            reg = <0x0 0x50000000 0x0 0x10000>;

            #address-cells = <1>;
            #size-cells = <1>;
            ranges = <0 0x0 0x50000000 0x10000>;

            cpu_scp_lpri0: scp-sram-section@0 {
                compatible = "arm,scmi-shmem";
                reg = <0x0 0x80>;
            };

            cpu_scp_lpri1: scp-sram-section@80 {
                compatible = "arm,scmi-shmem";
                reg = <0x80 0x80>;
            };

            cpu_scp_hpri0: scp-sram-section@100 {
                compatible = "arm,scmi-shmem";
                reg = <0x100 0x80>;
            };

            cpu_scp_hpri2: scp-sram-section@180 {
                compatible = "arm,scmi-shmem";
                reg = <0x180 0x80>;
            };
        };
    };

  - |
    firmware {
        scmi {
            compatible = "arm,scmi-smc";
            shmem = <&cpu_scp_lpri0>, <&cpu_scp_lpri1>;
            arm,smc-id = <0xc3000001>;

            #address-cells = <1>;
            #size-cells = <0>;

            scmi_devpd1: protocol@11 {
                reg = <0x11>;
                #power-domain-cells = <1>;
            };
        };
    };

  - |
    firmware {
        scmi {
            compatible = "linaro,scmi-optee";
            linaro,optee-channel-id = <0>;

            #address-cells = <1>;
            #size-cells = <0>;

            scmi_dvfs1: protocol@13 {
                reg = <0x13>;
                linaro,optee-channel-id = <1>;
                shmem = <&cpu_optee_lpri0>;
                #power-domain-cells = <1>;
            };

            scmi_clk0: protocol@14 {
                reg = <0x14>;
                #clock-cells = <1>;
            };
        };
    };

    soc {
        #address-cells = <2>;
        #size-cells = <2>;

        sram@51000000 {
            compatible = "mmio-sram";
            reg = <0x0 0x51000000 0x0 0x10000>;

            #address-cells = <1>;
            #size-cells = <1>;
            ranges = <0 0x0 0x51000000 0x10000>;

            cpu_optee_lpri0: optee-sram-section@0 {
                compatible = "arm,scmi-shmem";
                reg = <0x0 0x80>;
            };
        };
    };
```

请注意，上述翻译尽可能保留了原有格式和结构，但某些 YAML 结构（如 `oneOf`、`if`/`then`/`else`）在中文语境中没有直接对应的说法，因此在翻译时采用了描述性表达方式。
~~~~
