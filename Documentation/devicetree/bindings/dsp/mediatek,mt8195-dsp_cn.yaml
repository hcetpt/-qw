## Documentation/devicetree/bindings/firmware/xilinx/xlnx,zynqmp-firmware_cn.yaml
```yaml
# SPDX-许可证标识符: (GPL-2.0-only 或 BSD-2-Clause)
%YAML 1.2
---
$id: http://devicetree.org/schemas/firmware/xilinx/xlnx,zynqmp-firmware.yaml#
$schema: http://devicetree.org/meta-schemas/core.yaml#

标题: Xilinx 固件驱动程序

维护者:
  - Nava Kishore Manne <nava.kishore.manne@amd.com>

描述: 节点 zynqmp-firmware 描述了与平台固件的接口。ZynqMP 拥有一个用于与安全固件通信的接口。
固件驱动程序提供了对固件 API 的接口。这些接口 API 可以被任何驱动程序用来与 PMUFW（平台管理单元）通信。
这些请求包括时钟管理、引脚控制、设备控制、电源管理服务、FPGA 服务以及其他平台管理服务。
属性:
  compatible:
    oneOf:
      - 描述: 遵循 Zynq Ultrascale+ MPSoC 实现
const: xlnx,zynqmp-firmware

      - 描述: 遵循 Versal 实现
const: xlnx,versal-firmware

      - 描述: 遵循 Versal NET 实现
items:
          - 枚举:
              - xlnx,versal-net-firmware
          - const: xlnx,versal-firmware

  method:
    描述: |
                 调用 PM-API 固件层的方法
允许的值为
- "smc" : SMC #0，遵循 SMCCC
                 - "hvc" : HVC #0，遵循 SMCCC

    $ref: /schemas/types.yaml#/definitions/string-array
    枚举:
      - smc
      - hvc

  "#power-domain-cells":
    const: 1

  clock-controller:
    $ref: /schemas/clock/xlnx,versal-clk.yaml#
    描述: 时钟控制器是 Xilinx Versal 时钟树的一个硬件块。它从设备树中读取所需的输入时钟频率，并为所有 PS 时钟的消费者提供时钟。列出提供给给定时钟控制器的外部输入时钟的时钟指定符列表
类型: 对象

  gpio:
    $ref: /schemas/gpio/xlnx,zynqmp-gpio-modepin.yaml#
    描述: gpio 节点通过固件接口描述连接到 PS_MODE 引脚的方式
```

## Documentation/devicetree/bindings/fpga/altera-passive-serial_cn.txt
~~~~
Altera 的被动串行 SPI FPGA 管理器

Altera 的 FPGA 支持一种被称为“被动串行”的方法来加载位流。
被动串行链接从技术上讲并不是 SPI，并且可能需要额外的电路才能与其他在同一总线上的 SPI 从设备兼容。
详情请参阅 https://www.altera.com/literature/hb/cyc/cyc_c51013.pdf

必需属性：
- compatible: 必须是以下之一：
    - "altr,fpga-passive-serial",
    - "altr,fpga-arria10-passive-serial"
- reg: FPGA 的 SPI 芯片选择
- nconfig-gpios: 配置引脚（在手册中称为 nCONFIG）
- nstat-gpios: 状态引脚（在手册中称为 nSTATUS）

可选属性：
- confd-gpios: confd 引脚（在手册中称为 CONF_DONE）

示例：
```
fpga: fpga@0 {
	compatible = "altr,fpga-passive-serial";
	spi-max-frequency = <20000000>;
	reg = <0>;
	nconfig-gpios = <&gpio4 9 GPIO_ACTIVE_LOW>;
	nstat-gpios = <&gpio4 11 GPIO_ACTIVE_LOW>;
	confd-gpios = <&gpio4 12 GPIO_ACTIVE_LOW>;
};
```
~~~~

## Documentation/devicetree/bindings/fpga/altera-pr-ip_cn.txt
~~~~
这段文本是用设备树语法（Device Tree syntax）描述的一个硬件组件。它定义了一个名为 `fpga_mgr` 的节点，该节点表示一个与 Altera Arria 10 部分重构（Partial Reconfiguration）IP 相关的管理器。下面是翻译和解释：

```plaintext
// 定义了一个名为 fpga_mgr 的节点，其地址为 ff20c000
fpga_mgr: fpga-mgr@ff20c000 {
	// 兼容属性，指明了这个节点兼容 "altr,a10-pr-ip"，即与 Altera Arria 10 部分重构 IP 相关
	compatible = "altr,a10-pr-ip";
	
	// 内存映射 I/O 的基地址和大小
	// 基地址为 0xff20c000，大小为 0x10 (16 bytes)
	reg = <0xff20c000 0x10>;
};
```

**中文翻译：**

```plaintext
// 定义了一个名为 fpga_mgr 的节点，其地址为 ff20c000
fpga_mgr: fpga-mgr@ff20c000 {
	// 兼容性属性，指明此节点与 "altr,a10-pr-ip" 兼容，即与 Altera Arria 10 部分重构 IP 相关
	compatible = "altr,a10-pr-ip";

	// 内存映射 I/O 的基地址和大小
	// 基地址为 0xff20c000，大小为 0x10 (16 字节)
	reg = <0xff20c000 0x10>;
};
```

这里的关键点包括：
- `compatible` 属性指定了这个节点与 Altera Arria 10 部分重构 IP 相关。
- `reg` 属性定义了内存映射 I/O 的基地址和大小。
~~~~

## Documentation/devicetree/bindings/fpga/altera-socfpga-a10-fpga-mgr_cn.txt
~~~~
这段文本描述了一个设备树节点，用于配置Altera SOCFPGA Arria 10的FPGA管理器。下面是根据提供的英文内容翻译成的中文版本：

所需属性：
- `compatible`：应包含`altr,socfpga-a10-fpga-mgr`
- `reg`：内存映射I/O的基本地址和大小
  - 第一个索引是用于FPGA管理器寄存器访问
  - 第二个索引是用于写入FPGA配置数据
- `resets`：该设备复位的Phandle和复位指定符
- `clocks`：设备使用的时钟

示例：

```plaintext
fpga_mgr: fpga-mgr@ffd03000 { 
    compatible = "altr,socfpga-a10-fpga-mgr"; 
    reg = <0xffd03000 0x100 
           0xffcfe400 0x20>; 
    clocks = <&l4_mp_clk>; 
    resets = <&rst FPGAMGR_RESET>; 
};
```

这里，“fpga-mgr@ffd03000”定义了FPGA管理器的内存映射基地址（0xffd03000），以及两个不同的区域：一个用于FPGA管理器寄存器访问，另一个用于写入FPGA配置数据。同时指定了时钟源和复位信号的配置。
~~~~

## Documentation/devicetree/bindings/fpga/altera-socfpga-fpga-mgr_cn.txt
```
所需属性：
- compatible（兼容性）：应当包含"altr,socfpga-fpga-mgr"
- reg（寄存器）       ：内存映射IO的基本地址和大小
   - 第一个索引用于FPGA管理器寄存器访问
   - 第二个索引用于写入FPGA配置数据
- interrupts（中断）  ：FPGA管理器设备的中断

示例：

	hps_0_fpgamgr: fpgamgr@ff706000 { 
		compatible = "altr,socfpga-fpga-mgr"; 
		reg = <0xFF706000 0x1000 
		       0xFFB90000 0x1000>; 
		interrupts = <0 175 4>; 
	}; 

此段代码描述了一个名为`hps_0_fpgamgr`的FPGA管理器设备，它位于内存地址`0xFF706000`处，并且具有`0x1000`字节的内存映射I/O区域。此外，还指定了另一个内存区域`0xFFB90000`，同样具有`0x1000`字节的大小，用于写入FPGA配置数据。该设备与中断号为175的IRQ线相连，并通过IRQ控制器0接收中断信号。
```

## Documentation/devicetree/bindings/fpga/altr,freeze-bridge-controller_cn.yaml
~~~~yaml
```yaml
# SPDX-许可证标识符: (GPL-2.0-only 或 BSD-2-Clause)
%YAML 1.2
---
$id: http://devicetree.org/schemas/fpga/altr,freeze-bridge-controller.yaml#
$schema: http://devicetree.org/meta-schemas/core.yaml#

title: Altera 冻结桥控制器

description:
  Altera 冻结桥控制器管理一个或多个冻结桥。
  控制器可以冻结/禁用这些桥，这会阻止信号变化通过桥传递。
  控制器也可以解冻/启用这些桥，从而允许流量正常通过桥。
maintainers:
  - Xu Yilun <yilun.xu@intel.com>

allOf:
  - $ref: fpga-bridge.yaml#

properties:
  compatible:
    const: altr,freeze-bridge-controller

  reg:
    maxItems: 1

required:
  - compatible
  - reg

unevaluatedProperties: false

examples:
  - |
    fpga-bridge@100000450 {
        compatible = "altr,freeze-bridge-controller";
        reg = <0x1000 0x10>;
        bridge-enable = <0>;
    };
```

此代码段定义了一个设备树规范文件，用于描述Altera冻结桥控制器的配置。它指定了如何在设备树中表示这种类型的控制器，并给出了一个示例。
~~~~

## Documentation/devicetree/bindings/fpga/altr,socfpga-fpga2sdram-bridge_cn.yaml
~~~~yaml
```yaml
# SPDX-文件许可人: (GPL-2.0-only 或 BSD-2-Clause)
%YAML 1.2
---
$id: http://devicetree.org/schemas/fpga/altr,socfpga-fpga2sdram-bridge.yaml#
$schema: http://devicetree.org/meta-schemas/core.yaml#

title: Altera FPGA 至 SDRAM 桥接器

maintainers:
  - Xu Yilun <yilun.xu@intel.com>

allOf:
  - $ref: fpga-bridge.yaml#

properties:
  compatible:
    const: altr,socfpga-fpga2sdram-bridge

  reg:
    maxItems: 1

required:
  - compatible

unevaluatedProperties: false

examples:
  - |
    fpga-bridge@ffc25080 {
        compatible = "altr,socfpga-fpga2sdram-bridge";
        reg = <0xffc25080 0x4>;
        bridge-enable = <0>;
    };
```

请注意，`SPDX-文件许可人:` 标签的翻译可能需要根据具体上下文调整以符合中文习惯，这里的翻译为“SPDX-文件许可人:”是一种直接的中文翻译。在实际使用中，你可能会看到类似“SPDX-许可证标识符:”这样的表达。此外，“Altera FPGA 至 SDRAM 桥接器”是对标题的一种较为常见的中文翻译方式。
~~~~

## Documentation/devicetree/bindings/fpga/altr,socfpga-hps2fpga-bridge_cn.yaml
~~~~yaml
此文档定义了在 Device Tree 中描述 Altera SoCFPGA 的 HPS (Hard Processor System) 到 FPGA 布桥的规范。

相关信息：
- 许可证：GPL-2.0-only 或 BSD-2-Clause
- YAML 版本：1.2
- URI：http://devicetree.org/schemas/fpga/altr,socfpga-hps2fpga-bridge.yaml
- 核心模式的 URI：http://devicetree.org/meta-schemas/core.yaml

### 标题
Altera FPGA/HPS 桥接器

### 维护者
- Xu Yilun <yilun.xu@intel.com>

### 所有内容
- 引用 `fpga-bridge.yaml`

### 属性
- `compatible`:
  - 枚举值:
    - `altr,socfpga-lwhps2fpga-bridge`
    - `altr,socfpga-hps2fpga-bridge`
    - `altr,socfpga-fpga2hps-bridge`

- `reg`:
  - 最大项数：1

- `resets`:
  - 最大项数：1

- `clocks`:
  - 最大项数：1

### 必须包含的属性
- `compatible`
- `reg`
- `clocks`
- `resets`

### 未评估的属性
不允许存在未评估的属性。

### 示例
```yaml
# 包含 <dt-bindings/reset/altr,rst-mgr.h>

fpga-bridge@ff400000 {
  compatible = "altr,socfpga-lwhps2fpga-bridge";
  reg = <0xff400000 0x100000>;
  bridge-enable = <0>;
  clocks = <&l4_main_clk>;
  resets = <&rst LWHPS2FPGA_RESET>;
};
```

这个示例展示了如何在 Device Tree 中描述一个 Altera SoCFPGA 的 HPS 到 FPGA 的桥接器。其中，`fpga-bridge@ff400000` 表示该桥接器的基地址为 `0xff400000`，长度为 `0x100000`。`bridge-enable` 设置为 `0` 表明桥接器默认是禁用状态。此外，它还指定了时钟和复位信号的来源。
~~~~
