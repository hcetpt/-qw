## Documentation/devicetree/bindings/interconnect/mediatek,cci_cn.yaml
```yaml
# SPDX-许可证标识符: (GPL-2.0-only 或 BSD-2-Clause)
%YAML 1.2
---
$id: http://devicetree.org/schemas/interconnect/mediatek,cci.yaml#
$schema: http://devicetree.org/meta-schemas/core.yaml#

title: MediaTek 高速缓存一致性互连 (CCI) 频率和电压缩放

maintainers:
  - Jia-Wei Chang <jia-wei.chang@mediatek.com>
  - Johnson Wang <johnson.wang@mediatek.com>

description: |
  MediaTek 高速缓存一致性互连 (CCI) 是一个硬件引擎，用于 MT8183 和 MT8186 系统级芯片 (SoC)，以在硬件中调整频率并调整电压。它还可以优化电压以降低功耗。
properties:
  compatible:
    enum:
      - mediatek,mt8183-cci
      - mediatek,mt8186-cci

  clocks:
    items:
      - description:
          总线的时钟输入多路复用器
- description:
          "总线"时钟的一个父级，当原始时钟源（PLL）处于转换过程中且不稳定时，用作中间时钟源
clock-names:
    items:
      - const: cci
      - const: intermediate

  operating-points-v2: true
  opp-table:
    type: object

  proc-supply:
    description:
      提供电压供给 CCI 的调节器的 Phandle
sram-supply:
    description:
      提供电压供给 CCI 的 SRAM 的调节器的 Phandle。当存在时，实现需要进行“电压跟踪”，逐步缩放 Vproc 和 Vsram 来满足 SoC 特定的需求。如果不存在，则电压缩放流程由硬件处理，因此不需要软件“电压跟踪”
required:
  - compatible
  - clocks
  - clock-names
  - operating-points-v2
  - proc-supply

additionalProperties: false

examples:
  - |
    #include <dt-bindings/clock/mt8183-clk.h>
    cci: cci {
        compatible = "mediatek,mt8183-cci";
        clocks = <&mcucfg CLK_MCU_BUS_SEL>,
                 <&topckgen CLK_TOP_ARMPLL_DIV_PLL1>;
        clock-names = "cci", "intermediate";
        operating-points-v2 = <&cci_opp>;
        proc-supply = <&mt6358_vproc12_reg>;
    };

    cci_opp: opp-table-cci {
        compatible = "operating-points-v2";
        opp-shared;
        opp2_00: opp-273000000 {
            opp-hz = /bits/ 64 <273000000>;
            opp-microvolt = <650000>;
        };
        opp2_01: opp-338000000 {
            opp-hz = /bits/ 64 <338000000>;
            opp-microvolt = <687500>;
        };
        opp2_02: opp-403000000 {
            opp-hz = /bits/ 64 <403000000>;
            opp-microvolt = <718750>;
        };
        opp2_03: opp-463000000 {
            opp-hz = /bits/ 64 <463000000>;
            opp-microvolt = <756250>;
        };
        opp2_04: opp-546000000 {
            opp-hz = /bits/ 64 <546000000>;
            opp-microvolt = <800000>;
        };
        opp2_05: opp-624000000 {
            opp-hz = /bits/ 64 <624000000>;
            opp-microvolt = <818750>;
        };
        opp2_06: opp-689000000 {
            opp-hz = /bits/ 64 <689000000>;
            opp-microvolt = <850000>;
        };
        opp2_07: opp-767000000 {
            opp-hz = /bits/ 64 <767000000>;
            opp-microvolt = <868750>;
        };
        opp2_08: opp-845000000 {
            opp-hz = /bits/ 64 <845000000>;
            opp-microvolt = <893750>;
        };
        opp2_09: opp-871000000 {
            opp-hz = /bits/ 64 <871000000>;
            opp-microvolt = <906250>;
        };
        opp2_10: opp-923000000 {
            opp-hz = /bits/ 64 <923000000>;
            opp-microvolt = <931250>;
        };
        opp2_11: opp-962000000 {
            opp-hz = /bits/ 64 <962000000>;
            opp-microvolt = <943750>;
        };
        opp2_12: opp-1027000000 {
            opp-hz = /bits/ 64 <1027000000>;
            opp-microvolt = <975000>;
        };
        opp2_13: opp-1092000000 {
            opp-hz = /bits/ 64 <1092000000>;
            opp-microvolt = <1000000>;
        };
        opp2_14: opp-1144000000 {
            opp-hz = /bits/ 64 <1144000000>;
            opp-microvolt = <1025000>;
        };
        opp2_15: opp-1196000000 {
            opp-hz = /bits/ 64 <1196000000>;
            opp-microvolt = <1050000>;
        };
    };
```

## Documentation/devicetree/bindings/interconnect/qcom,bcm-voter_cn.yaml
```yaml
# SPDX-许可证标识符: (GPL-2.0 或 BSD-2-Clause)
%YAML 1.2
---
$id: http://devicetree.org/schemas/interconnect/qcom,bcm-voter.yaml#
$schema: http://devicetree.org/meta-schemas/core.yaml#

标题: 高通 BCM-Voter 互连

维护者:
  - Georgi Djakov <georgi.djakov@linaro.org>

描述: |
  总线时钟管理器（BCM）是一个专用的硬件加速器，通过聚合来自多个资源状态协调器（RSC）的请求来管理共享系统资源。互连提供者能够通过它们各自的 RSC 通信来投票选择消费者汇总的阈值。
属性:
  compatible:
    枚举:
      - qcom,bcm-voter

  qcom,tcs-wait:
    描述: |
      可选的触发命令集（TCS）掩码，在触发时等待完成。如果未指定，则默认AMC和WAKE集合等待完成。掩码位在 QCOM_ICC_TAG_* 定义中可用。
      当调用 icc_set_bw() 时，AMC TCS 立即被触发。当 RSC 在活动模式和睡眠模式之间转换时触发 WAKE/SLEEP TCS。
      在大多数情况下，需要在 AMC 和 WAKE 集合中等待以确保使用前资源可用。如果特定的 RSC 及其使用案例可以通过其他方式确保足够的延迟，则可以覆盖此设置以减少延迟。
$ref: /schemas/types.yaml#/definitions/uint32

必需:
  - compatible

附加属性: false

示例:
  # 示例 1: 在 SDM845 SoC 上的应用程序 bcm_voter 应该定义在 &apps_rsc 节点内，
  # 如 Documentation/devicetree/bindings/soc/qcom/qcom,rpmh-rsc.yaml 中所定义
  - |

    apps_bcm_voter: bcm-voter {
        compatible = "qcom,bcm-voter";
    };

  # 示例 2: 在 SDM845 上的显示 bcm_voter 应该定义在 &disp_rsc 节点内，
  # 如 Documentation/devicetree/bindings/soc/qcom/qcom,rpmh-rsc.yaml 中所定义
  - |

    #include <dt-bindings/interconnect/qcom,icc.h>

    disp_bcm_voter: bcm-voter {
        compatible = "qcom,bcm-voter";
        qcom,tcs-wait = <QCOM_ICC_TAG_AMC>;
    };
..
```

## Documentation/devicetree/bindings/interconnect/qcom,msm8939_cn.yaml
~~~~yaml
```yaml
# SPDX-文件许可标识: (GPL-2.0 或 BSD-2-Clause)
%YAML 1.2
---
$id: http://devicetree.org/schemas/interconnect/qcom,msm8939.yaml#
$schema: http://devicetree.org/meta-schemas/core.yaml#

title: 高通MSM8939网络芯片间互联

maintainers:
  - Konrad Dybcio <konradybcio@kernel.org>

description: |
  高通MSM8939互联提供商支持调整各种NoC结构之间的带宽需求。
allOf:
  - $ref: qcom,rpm-common.yaml#

properties:
  compatible:
    enum:
      - qcom,msm8939-bimc
      - qcom,msm8939-pcnoc
      - qcom,msm8939-snoc

  reg:
    maxItems: 1

patternProperties:
  '^interconnect-[a-z0-9\-]+$':
    type: object
    $ref: qcom,rpm-common.yaml#
    description:
      互联提供商没有独立的QoS寄存器空间，而是共享父级的空间
allOf:
      - $ref: qcom,rpm-common.yaml#

    properties:
      compatible:
        const: qcom,msm8939-snoc-mm

    required:
      - compatible

    unevaluatedProperties: false

required:
  - compatible
  - reg

unevaluatedProperties: false

examples:
  - |
    #include <dt-bindings/clock/qcom,rpmcc.h>

    snoc: interconnect@580000 {
        compatible = "qcom,msm8939-snoc";
        reg = <0x00580000 0x14000>;
        #interconnect-cells = <1>;
    };

    bimc: interconnect@400000 {
        compatible = "qcom,msm8939-bimc";
        reg = <0x00400000 0x62000>;
        #interconnect-cells = <1>;

          snoc_mm: interconnect-snoc {
              compatible = "qcom,msm8939-snoc-mm";
              #interconnect-cells = <1>;
          };
    };
```

以上是将原始英文内容翻译为中文。请注意，一些专有名词和缩写（如 `SPDX`、`YAML`、`NoC`、`QoS` 等）保持了原文形式，以保持其专业性与准确性。
~~~~

## Documentation/devicetree/bindings/interconnect/qcom,msm8974_cn.yaml
~~~~yaml
```yaml
# SPDX-许可证标识符: (GPL-2.0 或 BSD-2-Clause)
%YAML 1.2
---
$id: http://devicetree.org/schemas/interconnect/qcom,msm8974.yaml#
$schema: http://devicetree.org/meta-schemas/core.yaml#

title: 高通MSM8974 网络芯片内互联

maintainers:
  - Brian Masney <masneyb@onstation.org>

description: |
  高通MSM8974互联提供者支持在不同的网络芯片之间设置系统带宽需求
properties:
  reg:
    maxItems: 1

  compatible:
    enum:
      - qcom,msm8974-bimc
      - qcom,msm8974-cnoc
      - qcom,msm8974-mmssnoc
      - qcom,msm8974-ocmemnoc
      - qcom,msm8974-pnoc
      - qcom,msm8974-snoc

  '#interconnect-cells':
    const: 1

  clock-names:
    items:
      - const: bus
      - const: bus_a

  clocks:
    items:
      - description: 总线时钟
      - description: 总线A时钟

required:
  - compatible
  - reg
  - '#interconnect-cells'
  - clock-names
  - clocks

additionalProperties: false

examples:
  - |
      #include <dt-bindings/clock/qcom,rpmcc.h>

      bimc: interconnect@fc380000 {
              reg = <0xfc380000 0x6a000>;
              compatible = "qcom,msm8974-bimc";
              #interconnect-cells = <1>;
              clock-names = "bus", "bus_a";
              clocks = <&rpmcc RPM_SMD_BIMC_CLK>,
                       <&rpmcc RPM_SMD_BIMC_A_CLK>;
      };
```

此文档描述了高通MSM8974平台上的网络芯片内互联配置。它定义了如何通过Device Tree（设备树）来指定这些互联模块的属性和配置，包括它们的兼容性、寄存器地址、时钟等信息。
~~~~

## Documentation/devicetree/bindings/interconnect/qcom,msm8996_cn.yaml
~~~~yaml
下面是给定 YAML 文档的中文翻译：

```yaml
# SPDX-文件许可标识符: (GPL-2.0 或 BSD-2-Clause)
%YAML 1.2
---
$id: http://devicetree.org/schemas/interconnect/qcom,msm8996.yaml#
$schema: http://devicetree.org/meta-schemas/core.yaml#

标题: Qualcomm MSM8996 网络芯片间互连

维护者:
  - Konrad Dybcio <konradybcio@kernel.org>

描述: |
  Qualcomm MSM8996 互连提供者支持调整不同网络芯片（NoC）结构之间的带宽需求。

属性:
  compatible:
    枚举:
      - qcom,msm8996-a0noc
      - qcom,msm8996-a1noc
      - qcom,msm8996-a2noc
      - qcom,msm8996-bimc
      - qcom,msm8996-cnoc
      - qcom,msm8996-mnoc
      - qcom,msm8996-pnoc
      - qcom,msm8996-snoc

  reg:
    最大项数: 1

  clock-names:
    最小项数: 1
    最大项数: 3

  clocks:
    最小项数: 1
    最大项数: 3

  power-domains:
    最大项数: 1

必需:
  - compatible
  - reg

未评估属性: false

allOf:
  - $ref: qcom,rpm-common.yaml#
  - 如果:
      属性:
        compatible:
          常量: qcom,msm8996-a0noc

    则:
      属性:
        clocks:
          项:
            - 描述: Aggregate0 系统 NoC AXI 时钟
            - 描述: Aggregate0 配置 NoC AHB 时钟
            - 描述: Aggregate0 NoC MPU 时钟
        clock-names:
          项:
            - 常量: aggre0_snoc_axi
            - 常量: aggre0_cnoc_ahb
            - 常量: aggre0_noc_mpu_cfg

      必需:
        - power-domains

  - 如果:
      属性:
        compatible:
          常量: qcom,msm8996-mnoc

    则:
      属性:
        clocks:
          项:
            - 描述: CPU-NoC 高性能总线时钟
        clock-names:
          常量: iface

  - 如果:
      属性:
        compatible:
          常量: qcom,msm8996-a2noc

    则:
      属性:
        clocks:
          项:
            - 描述: Aggregate2 NoC UFS AXI 时钟
            - 描述: UFS AXI 时钟

        clock-names:
          项:
            - 常量: aggre2_ufs_axi
            - 常量: ufs_axi

示例:
  - |
    #include <dt-bindings/clock/qcom,gcc-msm8996.h>
    #include <dt-bindings/clock/qcom,mmcc-msm8996.h>
    #include <dt-bindings/clock/qcom,rpmcc.h>

    bimc: interconnect@408000 {
        compatible = "qcom,msm8996-bimc";
        reg = <0x00408000 0x5a000>;
        #interconnect-cells = <1>;
    };

    a0noc: interconnect@543000 {
        compatible = "qcom,msm8996-a0noc";
        reg = <0x00543000 0x6000>;
        #interconnect-cells = <1>;
        clocks = <&gcc GCC_AGGRE0_SNOC_AXI_CLK>,
                 <&gcc GCC_AGGRE0_CNOC_AHB_CLK>,
                 <&gcc GCC_AGGRE0_NOC_MPU_CFG_AHB_CLK>;
        clock-names = "aggre0_snoc_axi",
                      "aggre0_cnoc_ahb",
                      "aggre0_noc_mpu_cfg";
        power-domains = <&gcc AGGRE0_NOC_GDSC>;
    };
```

请注意，由于 YAML 的语法特点，缩进和换行在 YAML 文件中很重要。在翻译过程中，尽量保持了原文的格式和结构。
~~~~

## Documentation/devicetree/bindings/interconnect/qcom,qcm2290_cn.yaml
~~~~yaml
```yaml
# SPDX-许可证标识符: (GPL-2.0 或 BSD-2-Clause)
%YAML 1.2
---
$id: http://devicetree.org/schemas/interconnect/qcom,qcm2290.yaml#
$schema: http://devicetree.org/meta-schemas/core.yaml#

title: Qualcomm QCM2290 网络-on-芯片互连

maintainers:
  - Shawn Guo <shawn.guo@linaro.org>

description: |
  Qualcomm QCM2290 互连提供商支持调整各种 NoC 织物之间的带宽需求。
allOf:
  - $ref: qcom,rpm-common.yaml#

properties:
  reg:
    maxItems: 1

  compatible:
    enum:
      - qcom,qcm2290-bimc
      - qcom,qcm2290-cnoc
      - qcom,qcm2290-snoc

# 子节点的属性
patternProperties:
  '^interconnect-[a-z0-9]+$':
    type: object
    description:
      互连提供商没有单独的 QoS 寄存器空间，而是共享父级的空间
allOf:
      - $ref: qcom,rpm-common.yaml#

    properties:
      compatible:
        enum:
          - qcom,qcm2290-qup-virt
          - qcom,qcm2290-mmrt-virt
          - qcom,qcm2290-mmnrt-virt

    required:
      - compatible

    unevaluatedProperties: false

required:
  - compatible
  - reg

unevaluatedProperties: false

examples:
  - |
    #include <dt-bindings/clock/qcom,rpmcc.h>

    snoc: interconnect@1880000 {
        compatible = "qcom,qcm2290-snoc";
        reg = <0x01880000 0x60200>;
        #interconnect-cells = <1>;

        qup_virt: interconnect-qup {
            compatible = "qcom,qcm2290-qup-virt";
            #interconnect-cells = <1>;
        };

        mmnrt_virt: interconnect-mmnrt {
            compatible = "qcom,qcm2290-mmnrt-virt";
            #interconnect-cells = <1>;
        };

        mmrt_virt: interconnect-mmrt {
            compatible = "qcom,qcm2290-mmrt-virt";
            #interconnect-cells = <1>;
        };
    };

    cnoc: interconnect@1900000 {
        compatible = "qcom,qcm2290-cnoc";
        reg = <0x01900000 0x8200>;
        #interconnect-cells = <1>;
    };

    bimc: interconnect@4480000 {
        compatible = "qcom,qcm2290-bimc";
        reg = <0x04480000 0x80000>;
        #interconnect-cells = <1>;
    };
```
请注意，这个文档描述了一个设备树配置文件的结构，用于定义Qualcomm QCM2290 SoC中的网络-on-芯片（NoC）互连。
~~~~

## Documentation/devicetree/bindings/interconnect/qcom,qdu1000-rpmh_cn.yaml
```yaml
# SPDX-许可证标识符: (GPL-2.0 或 BSD-2-Clause)
%YAML 1.2
---
$id: http://devicetree.org/schemas/interconnect/qcom,qdu1000-rpmh.yaml#
$schema: http://devicetree.org/meta-schemas/core.yaml#

标题: Qualcomm RPMh 网络-on-芯片互连在 QDU1000 上

维护者:
  - Georgi Djakov <djakov@kernel.org>
  - Odelu Kukatla <quic_okukatla@quicinc.com>

描述: |
   RPMh 互连提供者通过 RPMh 硬件加速器（称为总线时钟管理器 (BCM)）支持系统带宽需求。提供者能够通过与其每个执行环境相关的资源状态协调器 (RSC) 与 BCM 进行通信。提供者节点必须指向至少一个与其 RSC 相关的 RPMh 设备子节点，且每个提供者可以映射到多个 RPMh 资源。
属性:
  compatible:
    枚举:
      - qcom,qdu1000-clk-virt
      - qcom,qdu1000-gem-noc
      - qcom,qdu1000-mc-virt
      - qcom,qdu1000-system-noc

  '#interconnect-cells': 真

  reg:
    最大项数: 1

allOf:
  - $ref: qcom,rpmh-common.yaml#
  - 如果:
      属性:
        compatible:
          包含:
            枚举:
              - qcom,qdu1000-clk-virt
              - qcom,qdu1000-mc-virt
    那么:
      属性:
        reg: 假
    否则:
      必需:
        - reg

必需:
  - compatible

未评估属性: 假

示例:
  - |
    #include <dt-bindings/interconnect/qcom,qdu1000-rpmh.h>

    system_noc: interconnect@1640000 {
        compatible = "qcom,qdu1000-system-noc";
        reg = <0x1640000 0x45080>;
        #interconnect-cells = <2>;
        qcom,bcm-voters = <&apps_bcm_voter>;
    };

    clk_virt: interconnect-0 {
        compatible = "qcom,qdu1000-clk-virt";
        #interconnect-cells = <2>;
        qcom,bcm-voters = <&apps_bcm_voter>;
    };
```

## Documentation/devicetree/bindings/interconnect/qcom,rpm_cn.yaml
~~~~yaml
```yaml
# SPDX-许可证标识符: (GPL-2.0 或 BSD-2-Clause)
%YAML 1.2
---
$id: http://devicetree.org/schemas/interconnect/qcom,rpm.yaml#
$schema: http://devicetree.org/meta-schemas/core.yaml#

title: 高通RPM网络芯片间互连

maintainers:
  - Georgi Djakov <djakov@kernel.org>

description: |
  RPM互连提供者通过RPM处理器支持系统带宽需求。该提供者能够通过RPM共享内存设备与RPM进行通信。
allOf:
  - $ref: qcom,rpm-common.yaml#

properties:
  reg:
    maxItems: 1

  compatible:
    enum:
      - qcom,msm8909-bimc
      - qcom,msm8909-pcnoc
      - qcom,msm8909-snoc
      - qcom,msm8916-bimc
      - qcom,msm8916-pcnoc
      - qcom,msm8916-snoc
      - qcom,qcs404-bimc
      - qcom,qcs404-pcnoc
      - qcom,qcs404-snoc

required:
  - compatible
  - reg

unevaluatedProperties: false

examples:
  - |
      #include <dt-bindings/clock/qcom,rpmcc.h>

      bimc: interconnect@400000 {
          compatible = "qcom,msm8916-bimc";
          reg = <0x00400000 0x62000>;
          #interconnect-cells = <1>;
      };
```
请注意，上述翻译将英文原文尽可能地转换为中文，但为了保持语义的准确性和技术文档的规范性，一些专业术语和格式被保留了下来。
~~~~
