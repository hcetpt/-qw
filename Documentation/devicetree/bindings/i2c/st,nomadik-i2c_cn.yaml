## Documentation/devicetree/bindings/i3c/aspeed,ast2600-i3c_cn.yaml
~~~~yaml
```yaml
# SPDX-License-Identifier: GPL-2.0 OR BSD-2-Clause
%YAML 1.2
---
$id: http://devicetree.org/schemas/i3c/aspeed,ast2600-i3c.yaml#
$schema: http://devicetree.org/meta-schemas/core.yaml#

title: ASPEED AST2600 i3c 控制器

maintainers:
  - Jeremy Kerr <jk@codeconstruct.com.au>

allOf:
  - $ref: i3c.yaml#

properties:
  compatible:
    const: aspeed,ast2600-i3c

  reg:
    maxItems: 1

  clocks:
    maxItems: 1

  resets:
    maxItems: 1

  interrupts:
    maxItems: 1

  sda-pullup-ohms:
    enum: [545, 750, 2000]
    default: 2000
    description: |
      配置SDA上拉电阻的值，单位为欧姆

  aspeed,global-regs:
    $ref: /schemas/types.yaml#/definitions/phandle-array
    items:
      - items:
          - description: 指向i3c全局寄存器syscon节点的phandle
          - description: 在全局寄存器集中的此i3c控制器索引
    description: |
      指向用于此设备的i3c全局寄存器集的(phandle, 控制器索引)引用

required:
  - compatible
  - reg
  - clocks
  - interrupts
  - aspeed,global-regs

unevaluatedProperties: false

examples:
  - |
    #include <dt-bindings/interrupt-controller/arm-gic.h>

    i3c@2000 {
        compatible = "aspeed,ast2600-i3c";
        reg = <0x2000 0x1000>;
        #address-cells = <3>;
        #size-cells = <0>;
        clocks = <&syscon 0>;
        resets = <&syscon 0>;
        aspeed,global-regs = <&i3c_global 0>;
        pinctrl-names = "default";
        pinctrl-0 = <&pinctrl_i3c1_default>;
        interrupts = <GIC_SPI 102 IRQ_TYPE_LEVEL_HIGH>;
    };
```

以上是将提供的英文Device Tree文档翻译成中文版本。注意，其中的注释、变量和属性名保持了英文原样以避免混淆，并且保持了原有的语法结构以便于理解。
~~~~

## Documentation/devicetree/bindings/i3c/cdns,i3c-master_cn.yaml
```yaml
# SPDX-许可证标识符: GPL-2.0
%YAML 1.2
---
$id: http://devicetree.org/schemas/i3c/cdns,i3c-master.yaml#
$schema: http://devicetree.org/meta-schemas/core.yaml#

标题: Cadence I3C 主控模块

维护者:
  - Boris Brezillon <bbrezillon@kernel.org>

allOf:
  - $ref: i3c.yaml#

属性:
  compatible:
    常量: cdns,i3c-master

  reg:
    最大项数: 1

  clocks:
    最大项数: 2

  clock-names:
    项:
      - 常量: pclk
      - 常量: sysclk

  interrupts:
    最大项数: 1

必需:
  - compatible
  - reg
  - clocks
  - clock-names
  - interrupts

未评估属性: false

示例:
  - |
    i3c@d040000 {
        compatible = "cdns,i3c-master";
        clocks = <&coreclock>, <&i3csysclock>;
        clock-names = "pclk", "sysclk";
        interrupts = <3 0>;
        reg = <0x0d040000 0x1000>;
        #address-cells = <3>;
        #size-cells = <0>;
        i2c-scl-hz = <100000>;

        eeprom@57{
            compatible = "atmel,24c01";
            reg = <0x57 0x0 0x10>;
            pagesize = <0x8>;
        };
    };
```

## Documentation/devicetree/bindings/i3c/i3c_cn.yaml
~~~~yaml
# SPDX-许可证标识符: (GPL-2.0-only 或 BSD-2-Clause)
%YAML 1.2
---
$id: http://devicetree.org/schemas/i3c/i3c.yaml#
$schema: http://devicetree.org/meta-schemas/core.yaml#

标题: I3C 总线

维护者:
  - Alexandre Belloni <alexandre.belloni@bootlin.com>
  - Miquel Raynal <miquel.raynal@bootlin.com>

描述: |
  I3C 总线可以通过一个节点来描述主 I3C 控制器设备，并为总线上的每个 I2C 或 I3C 从设备设置一系列子节点。在总线生命周期中，它们中的每一个都可能请求成为主设备。
属性:
  $nodename:
    模式: "^i3c@[0-9a-f]+$"

  "#address-cells":
    常量: 3
    描述: |
      连接到总线的每个 I2C 设备应在子节点中描述。
      所有 I3C 设备都应支持 DAA（动态地址分配），因此它们是可发现的。所以，默认情况下，I3C 设备不需要在设备树中描述。然而，我们可能想要为这些设备附加额外的资源，而这些资源可能需要在设备树中描述，这意味着我们必须描述 I3C 设备。
      在设备树中描述 I3C 设备的另一个使用场景是：当此 I3C 设备具有静态 I2C 地址，并且我们希望在 DAA 发生之前为其分配一个特定的 I3C 动态地址（以便总线上的其他设备不能占用这个动态地址）。
"#size-cells":
    常量: 0

  i3c-scl-hz:
    描述: |
      用于 I3C 传输的 SCL 信号频率。如果未定义，则默认值应为 12.5 MHz。
      并非所有控制器都支持该属性。
i2c-scl-hz:
    描述: |
      用于 I2C 传输的 SCL 信号频率。如果未定义，则默认应该是查看设备树中描述的 I2C 设备的 LVR（遗留虚拟寄存器）值以确定最大 I2C 频率。
      并非所有控制器都支持该属性。
mctp-controller:
    类型: 布尔
    描述: |
      表明系统可通过此总线作为 MCTP over I3C 传输的端点访问。
必需:
  - "#address-cells"
  - "#size-cells"

模式属性:
  "@[0-9a-f]+$":
    类型: 对象
    描述: |
      I2C 子设备，应命名为：<device-type>@<i2c-address>

      dtschema schemas/i2c/i2c-controller.yaml 中描述的所有属性在此处均有效，但 reg 属性的内容已更改。
以下是给定内容的中文翻译：

### 属性：
- `compatible`:
  - **描述**：I2C 设备的兼容性。
- `reg`:
  - **项**：
    - **项**：
      - **描述**：I2C 地址。不支持 10 位寻址。具有 10 位地址的设备无法通过 DEFSLVS 命令正确传递。
        - 最小值：0
        - 最大值：0x7f
      - **常量**：0
      - **描述**：应编码 I3C LVR（Legacy Virtual Register）：
        - 位 [31:8]：未使用/被忽略
        - 位 [7:5]：I2C 设备索引。可能的值：
          * 0：I2C 设备具有 50 纳秒脉冲滤波器
          * 1：I2C 设备没有 50 纳秒脉冲滤波器，但支持 SCL 上的高频
          * 2：I2C 设备没有 50 纳秒脉冲滤波器，并且不耐受高频
          * 3-7：保留
        - 位 [4]：指示设备是否以 FM（快速模式）或 FM+ 模式运行：
          * 0：FM+ 模式
          * 1：FM 模式
        - 位 [3:0]：设备类型
          * 0-15：保留

### 必需项：
- `compatible`
- `reg`

### “@ [0-9a-f]+, [0-9a-f]+$”：
- **类型**：对象
- **描述**：I3C 子设备，应命名为：<device-type>@<static-i2c-address>,<i3c-pid>
  
  - **属性**：
    - `reg`:
      - **项**：
        - **项**：
          - **描述**：编码静态 I2C 地址。如果设备没有，则应为 0（0 不是有效的 I2C 地址）
            - 最小值：0
            - 最大值：0x7f
          - **描述**：Provisioned ID 的前半部分（遵循 I3C 规范提供的 PID 定义）
            包含制造商 ID 左移一位
          - **描述**：Provisioned ID 的后半部分（遵循 I3C 规范提供的 PID 定义）
            包含将部件 ID 左移 16 位、实例 ID 左移 12 位以及额外信息
    - `assigned-address`:
      - **引用**：/schemas/types.yaml#definitions/uint32
      - **最小值**：0x1
      - **最大值**：0xff
      - **描述**：要分配给此设备的动态地址。如果存在静态地址（reg 属性的第一单元格 != 0），则通过 SETDASA 分配此地址；如果不存在静态地址，则通过 SETNEWDA 分配此地址，在此之前需要通过 ENTDAA 分配一个临时地址。

### 必需项：
- `reg`

### 其他属性：
- **true**

### 示例：
```yaml
i3c@d040000 {
    compatible = "cdns,i3c-master";
    clocks = <&coreclock>, <&i3csysclock>;
    clock-names = "pclk", "sysclk";
    interrupts = <3 0>;
    reg = <0x0d040000 0x1000>;
    #address-cells = <3>;
    #size-cells = <0>;
    i2c-scl-hz = <100000>;

    /* I2C 设备。 */
    eeprom@57 {
        compatible = "atmel,24c01";
        reg = <0x57 0x0 0x10>;
        pagesize = <0x8>;
    };

    /* I3C 设备，有静态 I2C 地址和分配地址。 */
    thermal_sensor: sensor@68,39200144004 {
        reg = <0x68 0x392 0x144004>;
        assigned-address = <0xa>;
    };

    /* I3C 设备，只有分配地址。 */
    pressure_sensor: sensor@0,39200124004 {
        reg = <0x0 0x392 0x124000>;
        assigned-address = <0xc>;
    };

    /*
     * I3C 设备，没有静态 I2C 地址，但在 DT 中需要资源描述
    */
    sensor@0,39200154004 {
        reg = <0x0 0x392 0x154004>;
        clocks = <&clock_provider 0>;
    };
};
```
~~~~

## Documentation/devicetree/bindings/i3c/mipi-i3c-hci_cn.yaml
~~~~yaml
```yaml
# SPDX-License-Identifier: (GPL-2.0 OR BSD-2-Clause)
%YAML 1.2
---
$id: http://devicetree.org/schemas/i3c/mipi-i3c-hci.yaml#
$schema: http://devicetree.org/meta-schemas/core.yaml#

title: MIPI I3C 主控制器接口

maintainers:
  - Nicolas Pitre <npitre@baylibre.com>

allOf:
  - $ref: /schemas/i3c/i3c.yaml#

description: |
  MIPI I3C 主控制器接口（MIPI I3C HCI）

  MIPI I3C HCI（主控制器接口）规范定义了一个通用的软件驱动程序接口，以支持多个供应商提供的符合MIPI I3C标准的主控制器硬件实现。
  硬件会自行声明其实施差异的能力，包括它基于的规范版本等，因此这里不需要过多描述（至少目前如此）。
  更多详情，请参见：
  https://www.mipi.org/specifications/i3c-hci

properties:
  compatible:
    const: mipi-i3c-hci
  reg:
    maxItems: 1
  interrupts:
    maxItems: 1

required:
  - compatible
  - reg
  - interrupts

unevaluatedProperties: false

examples:
  - |
    i3c@a0000000 {
      compatible = "mipi-i3c-hci";
      reg = <0xa0000000 0x2000>;
      interrupts = <89>;
      #address-cells = <3>;
      #size-cells = <0>;
    };
```
请注意，上述内容将原文翻译成了中文，并保持了YAML格式的结构。
~~~~

## Documentation/devicetree/bindings/i3c/silvaco,i3c-master_cn.yaml
~~~~yaml
```yaml
# SPDX-许可证标识符: GPL-2.0-only 或 BSD-2-Clause
%YAML 1.2
---
$id: http://devicetree.org/schemas/i3c/silvaco,i3c-master.yaml#
$schema: http://devicetree.org/meta-schemas/core.yaml#

title: Silvaco I3C 主控制器

maintainers:
  - Conor Culhane <conor.culhane@silvaco.com>

allOf:
  - $ref: i3c.yaml#

properties:
  compatible:
    const: silvaco,i3c-master-v1

  reg:
    maxItems: 1

  interrupts:
    maxItems: 1

  clocks:
    items:
      - description: 系统时钟
      - description: 总线时钟
      - description: 其他（较慢）事件时钟

  clock-names:
    items:
      - const: pclk
      - const: fast_clk
      - const: slow_clk

  resets:
    maxItems: 1

required:
  - compatible
  - reg
  - interrupts
  - clock-names
  - clocks

unevaluatedProperties: false

examples:
  - |
    i3c@a0000000 {
        compatible = "silvaco,i3c-master-v1";
        clocks = <&zynqmp_clk 71>, <&fclk>, <&sclk>;
        clock-names = "pclk", "fast_clk", "slow_clk";
        interrupt-parent = <&gic>;
        interrupts = <0 89 4>;
        reg = <0xa0000000 0x1000>;
        #address-cells = <3>;
        #size-cells = <0>;
    };
```

此文档描述了Silvaco I3C主控制器在设备树中的配置要求。包括兼容性声明、时钟需求、中断信息以及寄存器配置等必要属性，并提供了一个示例配置。
~~~~

## Documentation/devicetree/bindings/i3c/snps,dw-i3c-master_cn.yaml
```yaml
# SPDX-许可证标识符: GPL-2.0
%YAML 1.2
---
$id: http://devicetree.org/schemas/i3c/snps,dw-i3c-master.yaml#
$schema: http://devicetree.org/meta-schemas/core.yaml#

title: Synopsys DesignWare I3C 主控制器模块

维护者:
  - Alexandre Belloni <alexandre.belloni@bootlin.com>

allOf:
  - $ref: i3c.yaml#

属性:
  compatible:
    常量: snps,dw-i3c-master-1.00a

  reg:
    最大项数: 1

  clocks:
    最大项数: 1

  interrupts:
    最大项数: 1

必需:
  - compatible
  - reg
  - clocks
  - interrupts

未评估的属性: false

示例:
  - |
    i3c@2000 {
        compatible = "snps,dw-i3c-master-1.00a";
        #address-cells = <3>;
        #size-cells = <0>;
        reg = <0x02000 0x1000>;
        interrupts = <0>;
        clocks = <&i3cclk>;

        eeprom@57{
            compatible = "atmel,24c01";
            reg = <0x57 0x0 0x10>;
            pagesize = <0x8>;
        };
    };
```

## Documentation/devicetree/bindings/infiniband/hisilicon-hns-roce_cn.txt
~~~~
Hisilicon RoCE引擎是网络子系统的一部分。
其工作依赖于网络子系统的其他部分，例如GMAC（Gigabit Media Access Controller）和DSA Fabric（Distributed Switch Architecture Fabric）。
以下描述了额外的属性：

必需属性：
- compatible：应包含"hisilicon,hns-roce-v1"
- reg：RoCE驱动的物理基地址及内存映射区域的长度
- eth-handle：phandle，指定一个节点的引用，代表以太网设备
- dsaf-handle：phandle，指定一个节点的引用，代表DSAf设备
- node_guid：一个唯一标识设备或组件的数字
- #address-cells：必须为2
- #size-cells：必须为2
可选属性：
- dma-coherent：如果DMA操作是一致性的，则存在此属性
- interrupts：应包含32个完成事件中断、1个异步事件中断以及1个事件溢出中断
- interrupt-names：对于RoCE设备，应有34个中断名
  - hns-roce-comp-0 ~ hns-roce-comp-31：32个完成事件中断
  - hns-roce-async：1个异步事件中断
  - hns-roce-common：名为common的异常警告中断

示例：
```
infiniband@c4000000 {
	compatible = "hisilicon,hns-roce-v1";
	reg = <0x0 0xc4000000 0x0 0x100000>;
	dma-coherent;
	eth-handle = <&eth2 &eth3 &eth4 &eth5 &eth6 &eth7>;
	dsaf-handle = <&soc0_dsa>;
	node-guid = [00 9A CD 00 00 01 02 03];
	#address-cells = <2>;
	#size-cells = <2>;
	interrupt-parent = <&mbigen_dsa>;
	interrupts = <722 1>, <723 1>, <724 1>, <725 1>, <726 1>, <727 1>, <728 1>, <729 1>, <730 1>, <731 1>, <732 1>, <733 1>, <734 1>, <735 1>, <736 1>, <737 1>, <738 1>, <739 1>, <740 1>, <741 1>, <742 1>, <743 1>, <744 1>, <745 1>, <746 1>, <747 1>, <748 1>, <749 1>, <750 1>, <751 1>, <752 1>, <753 1>, <785 1>, <754 4>;
	interrupt-names = "hns-roce-comp-0", "hns-roce-comp-1", "hns-roce-comp-2", "hns-roce-comp-3", "hns-roce-comp-4", "hns-roce-comp-5", "hns-roce-comp-6", "hns-roce-comp-7", "hns-roce-comp-8", "hns-roce-comp-9", "hns-roce-comp-10", "hns-roce-comp-11", "hns-roce-comp-12", "hns-roce-comp-13", "hns-roce-comp-14", "hns-roce-comp-15", "hns-roce-comp-16", "hns-roce-comp-17", "hns-roce-comp-18", "hns-roce-comp-19", "hns-roce-comp-20", "hns-roce-comp-21", "hns-roce-comp-22", "hns-roce-comp-23", "hns-roce-comp-24", "hns-roce-comp-25", "hns-roce-comp-26", "hns-roce-comp-27", "hns-roce-comp-28", "hns-roce-comp-29", "hns-roce-comp-30", "hns-roce-comp-31", "hns-roce-async", "hns-roce-common";
};
```
```
~~~~

## Documentation/devicetree/bindings/interconnect/fsl,imx8m-noc_cn.yaml
```yaml
# SPDX-许可证标识符: GPL-2.0
%YAML 1.2
---
$id: http://devicetree.org/schemas/interconnect/fsl,imx8m-noc.yaml#
$schema: http://devicetree.org/meta-schemas/core.yaml#

标题: 通用的 i.MX 总线频率设备

维护者:
  - Peng Fan <peng.fan@nxp.com>

描述: |
  i.MX 系列 SoC 拥有多个总线，其时钟频率（有时还包括电压）可以进行调整。
  这些总线中的一些暴露了在内存映射中提到的寄存器区域作为 GPV（"全局编程视图"），但并非所有都如此。对于普通（非安全）环境，可能无法访问这些区域。
  这些总线基于外部授权的 IP，如 ARM NIC-301 和 Arteris FlexNOC，但设备树绑定是针对这些总线互连 IP 在 i.MX SoC 中集成的具体情况。

属性:
  compatible:
    oneOf:
      - items:
          - enum:
              - fsl,imx8mm-nic
              - fsl,imx8mn-nic
              - fsl,imx8mp-nic
              - fsl,imx8mq-nic
          - const: fsl,imx8m-nic
      - items:
          - enum:
              - fsl,imx8mm-noc
              - fsl,imx8mn-noc
              - fsl,imx8mp-noc
              - fsl,imx8mq-noc
          - const: fsl,imx8m-noc
      - const: fsl,imx8m-nic

  reg:
    maxItems: 1

  clocks:
    maxItems: 1

  operating-points-v2: true
  opp-table:
    type: object

  fsl,ddrc:
    $ref: /schemas/types.yaml#/definitions/phandle
    description:
      DDR 控制器的 phandle
'#interconnect-cells':
    description:
      如果指定，则也充当互连提供者。每个 SoC 上应该只设置一次主 NoC（Network on Chip）。
const: 1

必需:
  - compatible
  - clocks

额外属性: false

示例:
  - |
    #include <dt-bindings/clock/imx8mm-clock.h>
    #include <dt-bindings/interconnect/imx8mm.h>
    #include <dt-bindings/interrupt-controller/arm-gic.h>

    noc: interconnect@32700000 {
        compatible = "fsl,imx8mm-noc", "fsl,imx8m-noc";
        reg = <0x32700000 0x100000>;
        clocks = <&clk IMX8MM_CLK_NOC>;
        #interconnect-cells = <1>;
        fsl,ddrc = <&ddrc>;

        operating-points-v2 = <&noc_opp_table>;
        noc_opp_table: opp-table {
            compatible = "operating-points-v2";

            opp-133333333 {
                opp-hz = /bits/ 64 <133333333>;
            };
            opp-800000000 {
                opp-hz = /bits/ 64 <800000000>;
            };
        };
    };

    ddrc: memory-controller@3d400000 {
        compatible = "fsl,imx8mm-ddrc", "fsl,imx8m-ddrc";
        reg = <0x3d400000 0x400000>;
        clock-names = "core", "pll", "alt", "apb";
        clocks = <&clk IMX8MM_CLK_DRAM_CORE>,
                 <&clk IMX8MM_DRAM_PLL>,
                 <&clk IMX8MM_CLK_DRAM_ALT>,
                 <&clk IMX8MM_CLK_DRAM_APB>;
    };
```

## Documentation/devicetree/bindings/interconnect/interconnect_cn.txt
~~~~
### 互连提供者设备树绑定

#### 概述

本文档旨在定义一套通用的互连提供者/消费者属性。

##### 互连提供者

互连提供者绑定旨在表示系统中的互连控制器。每个提供者注册一组互连节点，这些节点公开了与互连相关的功能给消费者驱动程序。这些功能可能包括带宽、延迟、优先级等。根据使用场景，消费者驱动程序会对互连路径（或端点）设置约束。互连提供者本身也可以是互连消费者，例如当两个片上网络直接接口时的情况。
**必需属性**：
- `compatible`：包含互连提供者的兼容字符串。
- `#interconnect-cells`：互连指定符中单元的数量，用于编码互连节点ID，并可选地添加一个路径标签。

**示例**：

```plaintext
snoc: interconnect@580000 {
    compatible = "qcom,msm8916-snoc";
    #interconnect-cells = <1>;
    reg = <0x580000 0x14000>;
    clock-names = "bus_clk", "bus_a_clk";
    clocks = <&rpmcc RPM_SMD_SNOC_CLK>,
             <&rpmcc RPM_SMD_SNOC_A_CLK>;
};
```

##### 互连消费者

互连消费者是设备节点，它们可以动态地表达通过它们所连接的互连路径的带宽需求。在一个SoC上可能有多个互连提供者，而消费者可能会从不同的提供者消费多条路径，这取决于使用场景和它需要交互的组件。
**必需属性**：
- `interconnects`：互连提供者句柄对和互连提供者指定符的配对，用来表示互连路径的源端口和目标端口。可以为两端点指定一个可选的路径标签值，这种情况下，该信息将被传递给互连框架，以根据附加的标签进行聚合。
**可选属性**：
- `interconnect-names`：按照与`interconnects`属性相同的顺序排列的互连路径名称字符串列表。消费者驱动程序将使用`interconnect-names`来匹配互连路径与互连指定符对。
**保留的互连名称**：
- `dma-mem`：从设备到系统主内存的路径。

**示例**：

```plaintext
sdhci@7864000 {
    ..
    interconnects = <&pnoc MASTER_SDCC_1 &bimc SLAVE_EBI_CH0>;
    interconnect-names = "sdhc-mem";
};
```

**具有路径标签的示例**：

```plaintext
gnoc: interconnect@17900000 {
    ..
    interconnect-cells = <2>;
};

mnoc: interconnect@1380000 {
    ..
    interconnect-cells = <2>;
};

cpu@0 {
    ..
};
```
请注意，在包含路径标签的示例中，`interconnect-cells`的值为2，这意味着除了互连节点ID之外，还包含了路径标签的信息。
这段文本似乎是某种编程语言或配置文件中的语句，包含了自定义的符号和语法，并不适合直接翻译成中文。但如果尝试理解其结构和含义，可以这样解释：

`interconnects = <&gnoc MASTER_APPSS_PROC 3 &mnoc SLAVE_EBI1 3>;`

这里可能是定义了一个互联（interconnect），在某些硬件描述语言或系统配置中，这可能意味着指定了一个从 `MASTER_APPSS_PROC` 到 `SLAVE_EBI1` 的连接，其中数字3可能代表端口编号或其他参数。

如果需要更具体的中文表述，可以是：
```plaintext
互联 = <&gnoc 主应用进程3 &mnoc 从属EBI1_3>;
```
这里的“&gnoc”和“&mnoc”可能是某种特定的操作符或者指示符，具体含义需要根据上下文或相关文档来确定。
~~~~
