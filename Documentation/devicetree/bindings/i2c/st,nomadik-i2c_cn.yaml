## Documentation/devicetree/bindings/interconnect/qcom,sa8775p-rpmh_cn.yaml
```yaml
# SPDX-许可证标识符: (GPL-2.0-only 或 BSD-2-Clause)
%YAML 1.2
---
$id: http://devicetree.org/schemas/interconnect/qcom,sa8775p-rpmh.yaml#
$schema: http://devicetree.org/meta-schemas/core.yaml#

标题: Qualcomm RPMh 网络-on-芯片互连在 SA8775P 上

维护者:
  - Bartosz Golaszewski <bartosz.golaszewski@linaro.org>

描述: |
  RPMh 互连提供者通过 RPMh 硬件加速器（称为总线时钟管理器 (BCM)）支持系统带宽需求。
另见:: include/dt-bindings/interconnect/qcom,sa8775p.h

属性:
  compatible:
    枚举:
      - qcom,sa8775p-aggre1-noc
      - qcom,sa8775p-aggre2-noc
      - qcom,sa8775p-clk-virt
      - qcom,sa8775p-config-noc
      - qcom,sa8775p-dc-noc
      - qcom,sa8775p-gem-noc
      - qcom,sa8775p-gpdsp-anoc
      - qcom,sa8775p-lpass-ag-noc
      - qcom,sa8775p-mc-virt
      - qcom,sa8775p-mmss-noc
      - qcom,sa8775p-nspa-noc
      - qcom,sa8775p-nspb-noc
      - qcom,sa8775p-pcie-anoc
      - qcom,sa8775p-system-noc

必需:
  - compatible

allOf:
  - $ref: qcom,rpmh-common.yaml#

未评估的属性: false

示例:
  - |
    aggre1_noc: interconnect-aggre1-noc {
        compatible = "qcom,sa8775p-aggre1-noc";
        #interconnect-cells = <2>;
        qcom,bcm-voters = <&apps_bcm_voter>;
    };
```

## Documentation/devicetree/bindings/interconnect/qcom,sc7280-rpmh_cn.yaml
```yaml
# SPDX-许可证标识符: GPL-2.0-only 或 BSD-2-Clause
%YAML 1.2
---
$id: http://devicetree.org/schemas/interconnect/qcom,sc7280-rpmh.yaml#
$schema: http://devicetree.org/meta-schemas/core.yaml#

title: Qualcomm RPMh 网络-on-芯片互连在 SC7280 上

maintainers:
  - Bjorn Andersson <andersson@kernel.org>
  - Konrad Dybcio <konrad.dybcio@linaro.org>

description: |
  RPMh 互连提供者通过 RPMh 硬件加速器（称为总线时钟管理器 (BCM)）支持系统带宽需求。
更多信息参见: include/dt-bindings/interconnect/qcom,sc7280.h

properties:
  compatible:
    enum:
      - qcom,sc7280-aggre1-noc
      - qcom,sc7280-aggre2-noc
      - qcom,sc7280-clk-virt
      - qcom,sc7280-cnoc2
      - qcom,sc7280-cnoc3
      - qcom,sc7280-dc-noc
      - qcom,sc7280-gem-noc
      - qcom,sc7280-lpass-ag-noc
      - qcom,sc7280-mc-virt
      - qcom,sc7280-mmss-noc
      - qcom,sc7280-nsp-noc
      - qcom,sc7280-system-noc

  reg:
    maxItems: 1

required:
  - compatible

allOf:
  - $ref: qcom,rpmh-common.yaml#
  - if:
      properties:
        compatible:
          contains:
            enum:
              - qcom,sc7280-clk-virt
    then:
      properties:
        reg: false
    else:
      required:
        - reg

unevaluatedProperties: false

examples:
  - |
    interconnect {
        compatible = "qcom,sc7280-clk-virt";
        #interconnect-cells = <2>;
        qcom,bcm-voters = <&apps_bcm_voter>;
    };

    interconnect@9100000 {
        reg = <0x9100000 0xe2200>;
        compatible = "qcom,sc7280-gem-noc";
        #interconnect-cells = <2>;
        qcom,bcm-voters = <&apps_bcm_voter>;
    };
```

## Documentation/devicetree/bindings/interconnect/qcom,sc8280xp-rpmh_cn.yaml
~~~~yaml
```yaml
# SPDX-文件许可标识符: GPL-2.0-only 或 BSD-2-Clause
%YAML 1.2
---
$id: http://devicetree.org/schemas/interconnect/qcom,sc8280xp-rpmh.yaml#
$schema: http://devicetree.org/meta-schemas/core.yaml#

title: Qualcomm RPMh 网络-on-芯片互连在 SC8280XP 上

maintainers:
  - Bjorn Andersson <andersson@kernel.org>
  - Konrad Dybcio <konrad.dybcio@linaro.org>

description: |
  RPMh 互连提供者通过称为总线时钟管理器（BCM）的 RPMh 硬件加速器支持系统带宽需求。
参见也:: include/dt-bindings/interconnect/qcom,sc8280xp.h

properties:
  compatible:
    enum:
      - qcom,sc8280xp-aggre1-noc
      - qcom,sc8280xp-aggre2-noc
      - qcom,sc8280xp-clk-virt
      - qcom,sc8280xp-config-noc
      - qcom,sc8280xp-dc-noc
      - qcom,sc8280xp-gem-noc
      - qcom,sc8280xp-lpass-ag-noc
      - qcom,sc8280xp-mc-virt
      - qcom,sc8280xp-mmss-noc
      - qcom,sc8280xp-nspa-noc
      - qcom,sc8280xp-nspb-noc
      - qcom,sc8280xp-system-noc

required:
  - compatible

allOf:
  - $ref: qcom,rpmh-common.yaml#

unevaluatedProperties: false

examples:
  - |
    interconnect-0 {
        compatible = "qcom,sc8280xp-aggre1-noc";
        #interconnect-cells = <2>;
        qcom,bcm-voters = <&apps_bcm_voter>;
    };
```

请注意，上面的文本是将提供的 YAML 文件翻译成中文。某些专业术语和专有名词未被翻译以保持其原始含义。
~~~~

## Documentation/devicetree/bindings/interconnect/qcom,sdm660_cn.yaml
~~~~yaml
```yaml
# SPDX-许可证标识符: (GPL-2.0 或 BSD-2-Clause)
%YAML 1.2
---
$id: http://devicetree.org/schemas/interconnect/qcom,sdm660.yaml#
$schema: http://devicetree.org/meta-schemas/core.yaml#

title: 高通 SDM660 网络-on-芯片互连

maintainers:
  - Konrad Dybcio <konradybcio@kernel.org>

description: |
  高通 SDM660 互连提供者支持调整各种 NoC 织物之间的带宽需求。

properties:
  compatible:
    enum:
      - qcom,sdm660-a2noc
      - qcom,sdm660-bimc
      - qcom,sdm660-cnoc
      - qcom,sdm660-gnoc
      - qcom,sdm660-mnoc
      - qcom,sdm660-snoc

  reg:
    maxItems: 1

  clock-names:
    minItems: 1
    maxItems: 5

  clocks:
    minItems: 1
    maxItems: 5

required:
  - compatible
  - reg

unevaluatedProperties: false

allOf:
  - $ref: qcom,rpm-common.yaml#
  - if:
      properties:
        compatible:
          const: qcom,sdm660-mnoc

    then:
      properties:
        clocks:
          items:
            - description: CPU-NoC 高性能总线时钟
clock-names:
          const: iface

  - if:
      properties:
        compatible:
          const: qcom,sdm660-a2noc

    then:
      properties:
        clocks:
          items:
            - description: IPA 时钟
- description: UFS AXI 时钟
- description: Aggregate2 UFS AXI 时钟
- description: Aggregate2 USB3 AXI 时钟
- description: 配置 NoC USB2 AXI 时钟
clock-names:
          items:
            - const: ipa
            - const: ufs_axi
            - const: aggre2_ufs_axi
            - const: aggre2_usb3_axi
            - const: cfg_noc_usb2_axi

examples:
  - |
    #include <dt-bindings/clock/qcom,gcc-sdm660.h>
    #include <dt-bindings/clock/qcom,mmcc-sdm660.h>
    #include <dt-bindings/clock/qcom,rpmcc.h>

    bimc: interconnect@1008000 {
        compatible = "qcom,sdm660-bimc";
        reg = <0x01008000 0x78000>;
        #interconnect-cells = <1>;
    };

    a2noc: interconnect@1704000 {
        compatible = "qcom,sdm660-a2noc";
        reg = <0x01704000 0xc100>;
        #interconnect-cells = <1>;
        clocks = <&rpmcc RPM_SMD_IPA_CLK>,
                 <&gcc GCC_UFS_AXI_CLK>,
                 <&gcc GCC_AGGRE2_UFS_AXI_CLK>,
                 <&gcc GCC_AGGRE2_USB3_AXI_CLK>,
                 <&gcc GCC_CFG_NOC_USB2_AXI_CLK>;
        clock-names = "ipa",
                      "ufs_axi",
                      "aggre2_ufs_axi",
                      "aggre2_usb3_axi",
                      "cfg_noc_usb2_axi";
    };
```

请注意，代码示例部分的注释和内容未被翻译，因为它们包含特定于系统的指令和设备树绑定。
~~~~

## Documentation/devicetree/bindings/interconnect/qcom,sdx75-rpmh_cn.yaml
~~~~yaml
```yaml
# SPDX-License-Identifier: (GPL-2.0 OR BSD-2-Clause)
%YAML 1.2
---
$id: 'http://devicetree.org/schemas/interconnect/qcom,sdx75-rpmh.yaml#'
$schema: 'http://devicetree.org/meta-schemas/core.yaml#'

title: 高通 SDX75 上的 RPMh 网络芯片间互连

maintainers:
  - Rohit Agarwal <quic_rohiagar@quicinc.com>

description:
  RPMh 互连提供者通过 RPMh 硬件加速器（称为总线时钟管理器 (BCM)）支持系统带宽需求。提供者能够通过与每个执行环境相关的资源状态协调器 (RSC) 与 BCM 进行通信。提供节点必须指向至少一个与其 RSC 相关的 RPMh 设备子节点，且每个提供者可以映射到多个 RPMh 资源。
properties:
  compatible:
    enum:
      - qcom,sdx75-clk-virt
      - qcom,sdx75-dc-noc
      - qcom,sdx75-gem-noc
      - qcom,sdx75-mc-virt
      - qcom,sdx75-pcie-anoc
      - qcom,sdx75-system-noc

  '#interconnect-cells': true

  reg:
    maxItems: 1

  clocks:
    maxItems: 1

required:
  - compatible

allOf:
  - $ref: 'qcom,rpmh-common.yaml#'
  - if:
      properties:
        compatible:
          contains:
            enum:
              - qcom,sdx75-clk-virt
              - qcom,sdx75-mc-virt
    then:
      properties:
        reg: false
    else:
      required:
        - reg

  - if:
      properties:
        compatible:
          contains:
            enum:
              - qcom,sdx75-clk-virt
    then:
      properties:
        clocks:
          items:
            - description: RPMH CC QPIC 时钟
      required:
        - clocks
    else:
      properties:
        clocks: false

unevaluatedProperties: false

examples:
  - |
    #include <dt-bindings/clock/qcom,rpmh.h>

    clk_virt: interconnect-0 {
            compatible = "qcom,sdx75-clk-virt";
            #interconnect-cells = <2>;
            qcom,bcm-voters = <&apps_bcm_voter>;
            clocks = <&rpmhcc RPMH_QPIC_CLK>;
    };

    system_noc: interconnect@1640000 {
            compatible = "qcom,sdx75-system-noc";
            reg = <0x1640000 0x4b400>;
            #interconnect-cells = <2>;
            qcom,bcm-voters = <&apps_bcm_voter>;
    };
```
~~~~
