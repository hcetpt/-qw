## Documentation/devicetree/bindings/w1/maxim,ds2482_cn.yaml
~~~~yaml
```yaml
# SPDX-许可证标识符: (GPL-2.0-only 或 BSD-2-Clause)
%YAML 1.2
---
$id: http://devicetree.org/schemas/w1/maxim,ds2482.yaml#
$schema: http://devicetree.org/meta-schemas/core.yaml#

title: Maxim 一线总线主控制器

maintainers:
  - Stefan Wahren <stefan.wahren@chargebyte.com>

description: |
  I2C 到 1-Wire 桥接器

  https://www.analog.com/media/en/technical-documentation/data-sheets/ds2482-100.pdf
  https://www.analog.com/media/en/technical-documentation/data-sheets/DS2482-800.pdf
  https://www.analog.com/media/en/technical-documentation/data-sheets/DS2484.pdf

properties:
  compatible:
    enum:
      - maxim,ds2482
      - maxim,ds2484

  reg:
    maxItems: 1

required:
  - compatible
  - reg

additionalProperties:
  type: object

examples:
  - |
    i2c {
      #address-cells = <1>;
      #size-cells = <0>;
      onewire@18 {
        compatible = "maxim,ds2484";
        reg = <0x18>;
      };
    };
```

这段 YAML 文档定义了 Maxim 的 1-Wire 主控制器设备树的模式。它指定了该设备可以是 `maxim,ds2482` 或 `maxim,ds2484` 类型，并且需要指定寄存器地址。此外，还给出了一个示例，展示了如何在设备树中描述这种类型的设备。
~~~~

## Documentation/devicetree/bindings/w1/omap-hdq_cn.txt
~~~~
* OMAP HDQ单线总线主控制器

必需属性：
- compatible（兼容性）: 应为 "ti,omap3-1w" 或 "ti,am4372-hdq"
- reg（寄存器区域）: 设备的寄存器集的地址和长度
- interrupts（中断）: 中断线路
- ti,hwmods: "hdq1w"

可选属性：
- ti,mode（模式）: 应为 "hdq": HDQ 模式  "1w": 单线模式
如果未指定，则默认为 HDQ 模式

示例：

- 来自 omap3.dtsi
``` 
hdqw1w: 1w@480b2000 { 
	compatible = "ti,omap3-1w"; 
	reg = <0x480b2000 0x1000>; 
	interrupts = <58>; 
	ti,hwmods = "hdq1w"; 
	ti,mode = "hdq"; 
};
```
这段代码描述了一个使用HDQ单线总线主控制器的设备实例，它与 "ti,omap3-1w" 兼容，并且其寄存器区域位于地址 0x480b2000 处，长度为 0x1000。此外，该设备通过第 58 号中断线连接，并且被标记为使用 "hdq1w" 硬件模块。这里还指定了 "ti,mode" 属性为 "hdq"，表明设备工作在 HDQ 模式下。
~~~~

## Documentation/devicetree/bindings/w1/w1-gpio_cn.yaml
```yaml
# SPDX-文件许可人: GPL-2.0
%YAML 1.2
---
$id: http://devicetree.org/schemas/w1/w1-gpio.yaml#
$schema: http://devicetree.org/meta-schemas/core.yaml#

标题: 位操作的GPIO 1-Wire总线

维护者:
  - Daniel Mack <zonque@gmail.com>

属性:
  compatible:
    常量: w1-gpio

  gpios:
    最少项目数: 1
    项目:
      - 描述: 数据I/O引脚
      - 描述: 用于外部上拉电阻的使能引脚

  linux,open-drain:
    类型: 布尔值
    描述: >
      如果指定，则认为数据引脚处于开漏模式

必需:
  - compatible
  - gpios

附加属性:
  类型: 对象

示例:
  - |
    #include <dt-bindings/gpio/gpio.h>

    onewire {
        compatible = "w1-gpio";
        gpios = <&gpio 0 GPIO_ACTIVE_HIGH>;
    };
```

## Documentation/devicetree/bindings/w1/w1-uart_cn.yaml
```yaml
# SPDX-文件许可人: GPL-2.0-only 或 BSD-2-Clause
%YAML 1.2
---
$id: http://devicetree.org/schemas/w1/w1-uart.yaml#
$schema: http://devicetree.org/meta-schemas/core.yaml#

title: UART 1-Wire 总线

maintainers:
  - Christoph Winklhofer <cj.winklhofer@gmail.com>

description: |
  UART 1-Wire 总线。通过串行设备总线利用 UART 接口创建 1-Wire 定时模式。
  UART 外设必须支持全双工并以开漏模式运行。定时模式由特定组合的波特率和发送字节生成，这对应于 1-Wire 读取位、写入位或重置脉冲。
  重置和存在检测的默认波特率为 9600，而 1-Wire 读取或写入操作的默认波特率为 115200。如果实际波特率与请求的不同，则调整发送字节以生成 1-Wire 定时模式。
  https://www.analog.com/en/technical-articles/using-a-uart-to-implement-a-1wire-bus-master.html

properties:
  compatible:
    const: w1-uart

  reset-bps:
    default: 9600
    description:
      1-Wire 重置和存在检测的波特率

  write-0-bps:
    default: 115200
    description:
      1-Wire 写 0 周期的波特率

  write-1-bps:
    default: 115200
    description:
      1-Wire 写 1 和读周期的波特率

required:
  - compatible

additionalProperties:
  type: object

examples:
  - |
    serial {
        onewire {
            compatible = "w1-uart";
        };
    };
```

## Documentation/devicetree/bindings/w1/w1_cn.txt
```
通用的 OneWire (w1) 总线设备树绑定
=================================

OneWire 总线通过其主控制器总线节点来描述。
从属设备被列为这些主设备的子节点。目前，每个总线主设备只允许有一个从属设备。
示例：

	charger: charger {  // 充电器节点
		compatible = "gpio-charger";  // 兼容性为 gpio-charger
		charger-type = "mains";  // 充电类型为主电源
		gpios = <&gpio 1 GPIO_ACTIVE_LOW>;  // GPIO 设置为 1 号引脚，且为低电平有效
	};

	onewire {  // OneWire 总线节点
		compatible = "w1-gpio";  // 兼容性为 w1-gpio
		gpios = <&gpio 100 0>, <&gpio 101 0>;  // GPIO 设置为 100 和 101 号引脚

		battery {  // 电池节点
			compatible = "maxim,ds2760";  // 兼容性为 maxim 的 ds2760
			power-supplies = <&charger>;  // 供电由 charger 提供
		};
	};
```

## Documentation/devicetree/bindings/xilinx_cn.txt
~~~~
d) Xilinx IP 核心

Xilinx EDK 工具链随附了一套 IP 核心（设备），用于在 Xilinx Spartan 和 Virtex 现场可编程门阵列 (FPGA) 中使用。这些设备覆盖了整个标准设备类型范围（如网络、串行等）以及各种其他设备（如 GPIO、LCD、SPI 等）。此外，由于这些设备是在 FPGA 布局内实现的，因此每个设备实例都可以用不同的选项进行综合，以改变其行为。
每个 IP 核心都有一组参数，FPGA 设计人员可以使用这些参数来控制核心如何被综合。传统上，EDK 工具会提取与设备驱动程序相关的设备参数，并将它们以 `#define` 符号的形式复制到 `xparameters.h` 文件中。这告诉设备驱动程序 IP 核心是如何配置的，但它要求每当 FPGA 位流重新综合时都要重新编译内核。
新的方法是将这些参数导出到设备树中，并且每次 FPGA 位流发生变化时生成一个新的设备树。以前作为 `#define` 符号导出的参数现在将成为设备节点的属性。一般来说，IP 核心的设备节点将采取以下形式：

	(name): (generic-name)@(base-address) {
		compatible = "xlnx,(ip-core-name)-(HW_VER)"
			     [, (list of compatible devices), ...];
		reg = <(baseaddr) (size)>;
		interrupt-parent = <&interrupt-controller-phandle>;
		interrupts = < ... >;
		xlnx,(parameter1) = "(string-value)";
		xlnx,(parameter2) = <(int-value)>;
	};

	(generic-name):   一个开放固件风格的名称，描述设备的一般类别。最好是一个单词，比如“serial”或“ethernet”
(ip-core-name):	IP 块的名称（在 system.mhs 中 BEGIN 指令后给出）。应为小写，所有下划线 '_' 应转换为破折号 '-'
(name):	来源于 "PARAMETER INSTANCE" 的值
(parameter#):	system.mhs 中的 C_* 参数。从参数名称中去掉 C_ 前缀，将名称转换为小写，并将所有下划线 '_' 字符转换为破折号 '-'
(baseaddr):	baseaddr 参数值（通常命名为 C_BASEADDR）
(HW_VER):	HW_VER 参数
(size):	地址范围大小（通常是 C_HIGHADDR - C_BASEADDR + 1）
通常，兼容列表将包括确切的 IP 核心版本，后面跟着较旧的 IP 核心版本，该版本实现了相同的接口，或者任何具有相同接口的其他设备。
'reg' 和 'interrupts' 都是可选属性。
例如，system.mhs 中的以下块：

```
BEGIN opb_uartlite
	PARAMETER INSTANCE = opb_uartlite_0
	PARAMETER HW_VER = 1.00.b
	PARAMETER C_BAUDRATE = 115200
	PARAMETER C_DATA_BITS = 8
	PARAMETER C_ODD_PARITY = 0
	PARAMETER C_USE_PARITY = 0
	PARAMETER C_CLK_FREQ = 50000000
	PARAMETER C_BASEADDR = 0xEC100000
	PARAMETER C_HIGHADDR = 0xEC10FFFF
	BUS_INTERFACE SOPB = opb_7
	PORT OPB_Clk = CLK_50MHz
	PORT Interrupt = opb_uartlite_0_Interrupt
	PORT RX = opb_uartlite_0_RX
	PORT TX = opb_uartlite_0_TX
	PORT OPB_Rst = sys_bus_reset_0
END
```

转换为以下设备树节点：

```
opb_uartlite_0: serial@ec100000 {
	device_type = "serial";
	compatible = "xlnx,opb-uartlite-1.00.b";
	reg = <ec100000 10000>;
	interrupt-parent = <&opb_intc_0>;
	interrupts = <1 0>; // 这是从 opb_intc 参数中得到的
	current-speed = <d#115200>;	// 标准串行设备属性
	clock-frequency = <d#50000000>;	// 标准串行设备属性
	xlnx,data-bits = <8>;
	xlnx,odd-parity = <0>;
	xlnx,use-parity = <0>;
};
```

这涵盖了将Xilinx IP内核绑定到设备树的一般方法。以下是针对特定设备的绑定：

1) Xilinx ML300 帧缓冲器

这是来自 ML300 参考设计（同样也在 ML403 参考设计以及其他设计中）的简单帧缓冲器设备。
可选属性：
   - resolution = <xres yres>：帧缓冲器的像素分辨率。某些实现使用不同的分辨率，默认值为 <d#640 d#480>。
   - virt-resolution = <xvirt yvirt>：内存中的帧缓冲器大小，默认值为 <d#1024 d#480>。
   - rotate-display（空）：旋转显示 180 度。

2) Xilinx SystemACE

Xilinx SystemACE 设备用于从 CF 卡上存储的 FPGA 位流编程 FPGA。它还可以用作通用 CF 接口设备。
可选属性：
   - 8-bit（空）：对于处于 8 位模式下的 SystemACE 设置此属性。

3) Xilinx EMAC 和 Xilinx TEMAC

Xilinx 以太网设备。除了上述一般的 Xilinx 属性外，这些设备的节点还应包含一个 phy-handle 属性，并且可能还包括其他常见的网络设备属性，如 local-mac-address。

4) Xilinx Uartlite

Xilinx Uartlite 设备是简单的固定速度串行端口。
必需属性：
   - current-speed：Uartlite 的波特率。

5) Xilinx hwicap

Xilinx hwicap 设备提供了通过内部配置访问端口 (ICAP) 访问 FPGA 配置逻辑的功能。ICAP 支持 FPGA 的部分重构、配置信息的读回以及对 FPGA 织构“热启动”的一些控制。
所需属性：
    - xlnx,family：FPGA 的系列，这是必需的，因为底层 ICAP 硬件的功能在不同的系列之间有所不同。可以是 'virtex2p'、'virtex4' 或 'virtex5'。
- compatible：应当包含 "xlnx,xps-hwicap-1.00.a" 或 "xlnx,opb-hwicap-1.00.b"

vi) Xilinx UART 16550

      Xilinx UART 16550 设备与 NS16550 非常相似，但具有不同的寄存器间隔和相对于基地址的偏移量。
所需属性：
       - clock-frequency：时钟输入的频率
       - reg-offset：需要一个值为 3
       - reg-shift：需要一个值为 2

      vii) Xilinx USB 主控制器

      Xilinx USB 主控制器与 EHCI 兼容，但 EHCI 寄存器的基本地址不同，并且它始终是一个大端模式的 USB 主控制器。硬件可以配置为仅支持高速模式，或同时支持高速/全速混合模式。
所需属性：
      - xlnx,support-usb-fs：值为 0 表示核心仅构建为高速模式。值为 1 表示核心还支持全速设备。
~~~~
