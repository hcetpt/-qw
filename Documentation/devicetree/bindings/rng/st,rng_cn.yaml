## Documentation/devicetree/bindings/rng/st,rng_cn.yaml
~~~~yaml
```yaml
# SPDX-许可证标识符: GPL-2.0-only 或 BSD-2-Clause
%YAML 1.2
---
$id: http://devicetree.org/schemas/rng/st,rng.yaml#
$schema: http://devicetree.org/meta-schemas/core.yaml#

title: STMicroelectronics 硬件随机数生成器

maintainers:
  - Patrice Chotard <patrice.chotard@foss.st.com>

properties:
  compatible:
    const: st,rng

  clocks:
    maxItems: 1

  reg:
    maxItems: 1

required:
  - compatible
  - clocks
  - reg

additionalProperties: false

examples:
  - |
    rng@fee80000 {
        compatible = "st,rng";
        reg = <0xfee80000 0x1000>;
        clocks = <&clk_sysin>;
    };
```

这段 YAML 文件描述了一个用于 STMicroelectronics 硬件随机数生成器的 Device Tree 配置文件。它定义了必要的属性和兼容性要求，并提供了一个示例配置。
~~~~

## Documentation/devicetree/bindings/rng/st,stm32-rng_cn.yaml
```yaml
# SPDX-许可证标识符: (GPL-2.0-only 或 BSD-2-Clause)
%YAML 1.2
---
$id: http://devicetree.org/schemas/rng/st,stm32-rng.yaml#
$schema: http://devicetree.org/meta-schemas/core.yaml#

title: STMicroelectronics STM32 随机数生成器

description: |
  STM32 硬件随机数生成器是一个简单的专用 IP，并且完全与其它加密功能分离。
maintainers:
  - Lionel Debieve <lionel.debieve@foss.st.com>

properties:
  compatible:
    enum:
      - st,stm32-rng
      - st,stm32mp13-rng

  reg:
    maxItems: 1

  clocks:
    maxItems: 1

  resets:
    maxItems: 1

  clock-error-detect:
    type: boolean
    description: 如果设置，将启用时钟检测管理

  st,rng-lock-conf:
    type: boolean
    description: 如果设置，RNG_CR、RNG_HTCR 和 RNG_NSCR 中的 RNG 配置将被锁定
access-controllers:
    minItems: 1
    maxItems: 2

required:
  - compatible
  - reg
  - clocks

allOf:
  - if:
      properties:
        compatible:
          contains:
            enum:
              - st,stm32-rng
    then:
      properties:
        st,rng-lock-conf: false

additionalProperties: false

examples:
  - |
    #include <dt-bindings/clock/stm32mp1-clks.h>
    rng@54003000 {
      compatible = "st,stm32-rng";
      reg = <0x54003000 0x400>;
      clocks = <&rcc RNG1_K>;
    };
```

## Documentation/devicetree/bindings/rng/starfive,jh7110-trng_cn.yaml
```yaml
# SPDX-文件许可人: (GPL-2.0-only 或 BSD-2-Clause)
%YAML 1.2
---
$id: http://devicetree.org/schemas/rng/starfive,jh7110-trng.yaml#
$schema: http://devicetree.org/meta-schemas/core.yaml#

title: StarFive 系统级芯片 TRNG 模块

maintainers:
  - Jia Jie Ho <jiajie.ho@starfivetech.com>

properties:
  compatible:
    oneOf:
      - items:
          - const: starfive,jh8100-trng
          - const: starfive,jh7110-trng
      - const: starfive,jh7110-trng

  reg:
    maxItems: 1

  clocks:
    items:
      - description: 硬件参考时钟
      - description: AHB 参考时钟

  clock-names:
    items:
      - const: hclk
      - const: ahb

  resets:
    maxItems: 1

  interrupts:
    maxItems: 1

required:
  - compatible
  - reg
  - clocks
  - clock-names
  - resets
  - interrupts

additionalProperties: false

examples:
  - |
    rng: rng@1600C000 {
        compatible = "starfive,jh7110-trng";
        reg = <0x1600C000 0x4000>;
        clocks = <&clk 15>, <&clk 16>;
        clock-names = "hclk", "ahb";
        resets = <&reset 3>;
        interrupts = <30>;
    };
..
```

## Documentation/devicetree/bindings/rng/ti,keystone-rng_cn.yaml
~~~~yaml
```yaml
# SPDX-许可证标识符: GPL-2.0-only 或 BSD-2-Clause
%YAML 1.2
---
$id: http://devicetree.org/schemas/rng/ti,keystone-rng.yaml#
$schema: http://devicetree.org/meta-schemas/core.yaml#

title: Keystone 系统级芯片硬件随机数生成器

maintainers:
  - Nishanth Menon <nm@ti.com>
  - Santosh Shilimkar <ssantosh@kernel.org>

properties:
  compatible:
    const: ti,keystone-rng

  clocks:
    maxItems: 1

  clock-names:
    items:
      - const: fck

  reg:
    maxItems: 1

  ti,syscon-sa-cfg:
    $ref: /schemas/types.yaml#/definitions/phandle
    description: |
      指向 SA 配置寄存器的 syscon 节点的句柄。这些
      寄存器由 HWRNG 和加密驱动程序共享。
required:
  - compatible
  - clocks
  - clock-names
  - reg
  - ti,syscon-sa-cfg

additionalProperties: false

examples:
  - |
    rng@24000 {
        compatible = "ti,keystone-rng";
        ti,syscon-sa-cfg = <&sa_config>;
        clocks = <&clksa>;
        clock-names = "fck";
        reg = <0x24000 0x1000>;
    };
```
请注意，上述 YAML 文档的注释和描述部分已被翻译成中文，而 YAML 结构本身保持不变以保持其格式的有效性。
~~~~

## Documentation/devicetree/bindings/rng/ti,omap-rom-rng_cn.yaml
```yaml
# SPDX-许可证标识符: GPL-2.0-only 或 BSD-2-Clause
%YAML 1.2
---
$id: http://devicetree.org/schemas/rng/ti,omap-rom-rng.yaml#
$schema: http://devicetree.org/meta-schemas/core.yaml#

标题: OMAP ROM 随机数生成器

维护者:
  - Pali Rohár <pali@kernel.org>
  - Tony Lindgren <tony@atomide.com>

描述:
  安全的系统芯片(SoC)可以通过安全ROM调用提供随机数生成器(RNG)，例如诺基亚N900的做法。
  实现可能会依赖于所使用的SoC安全ROM。

属性:
  compatible:
    常量: nokia,n900-rom-rng

  clocks:
    最大项数: 1

  clock-names:
    项:
      - 常量: ick

必需:
  - compatible
  - clocks
  - clock-names

额外属性: false

示例:
  - |
    rng {
        compatible = "nokia,n900-rom-rng";
        clocks = <&rng_ick>;
        clock-names = "ick";
    };
```

## Documentation/devicetree/bindings/rng/timeriomem_rng_cn.yaml
```yaml
# SPDX-许可证标识符: GPL-2.0-only
%YAML 1.2
---
$id: http://devicetree.org/schemas/rng/timeriomem_rng.yaml#
$schema: http://devicetree.org/meta-schemas/core.yaml#

标题: TimerIO 随机数生成器

维护者:
  - Krzysztof Kozlowski <krzk@kernel.org>

属性:
  compatible:
    常量: timeriomem_rng

  period:
    $ref: /schemas/types.yaml#/definitions/uint32
    描述: 在样本之间等待的微秒时间

  quality:
    $ref: /schemas/types.yaml#/definitions/uint32
    默认: 0
    描述:
      从 rng 每读取 1024 位数据中估计的真实熵比特数。
      默认值为零，这会导致使用内核的默认质量替代。注意，默认质量通常是零，这会禁用使用此 rng 自动填充内核的熵池。
reg:
    maxItems: 1
    描述:
      采样的基地址。目前 'reg' 必须至少为四个字节宽且 32 位对齐。
所需:
  - compatible
  - period
  - reg

额外属性: false

示例:
  - |
    rng@44 {
        compatible = "timeriomem_rng";
        reg = <0x44 0x04>;
        period = <1000000>;
    };
```

## Documentation/devicetree/bindings/rng/xiphera,xip8001b-trng_cn.yaml
~~~~yaml
```yaml
# SPDX-许可证标识符: (GPL-2.0-only 或 BSD-2-Clause)
%YAML 1.2
---
$id: http://devicetree.org/schemas/rng/xiphera,xip8001b-trng.yaml#
$schema: http://devicetree.org/meta-schemas/core.yaml#

title: Xiphera XIP8001B-trng

maintainers:
  - Atte Tommiska <atte.tommiska@xiphera.com>

description: |
  Xiphera 基于 FPGA 的真随机数生成器知识产权核心

properties:
  compatible:
    const: xiphera,xip8001b-trng

  reg:
    maxItems: 1

required:
  - compatible
  - reg

additionalProperties: false

examples:
  - |
    rng@43c00000 {
        compatible = "xiphera,xip8001b-trng";
        reg = <0x43c00000 0x10000>;
    };
```

请注意，这里使用了 YAML 格式来定义设备树规范。上述代码描述了一个基于 Xiphera XIP8001B-trng 的真随机数生成器的设备树条目，并规定了其兼容性和注册地址范围。
~~~~

## Documentation/devicetree/bindings/rtc/abracon,abx80x_cn.yaml
~~~~yaml
以下是提供的 YAML 文件的中文翻译：

```yaml
# SPDX 许可证标识符: (GPL-2.0-only 或 BSD-2-Clause)
%YAML 1.2
---
$id: http://devicetree.org/schemas/rtc/abracon,abx80x.yaml#
$schema: http://devicetree.org/meta-schemas/core.yaml#

title: Abracon ABX80X I2C 超低功耗 RTC/报警芯片

maintainers:
  - linux-rtc@vger.kernel.org

properties:
  compatible:
    description:
      通配符 'abracon,abx80x' 可用于支持不同 Abracon RTC 的组合。在这种情况下，驱动程序必须从 ID 寄存器执行自动检测。
    enum:
      - abracon,abx80x
      - abracon,ab0801
      - abracon,ab0803
      - abracon,ab0804
      - abracon,ab0805
      - abracon,ab1801
      - abracon,ab1803
      - abracon,ab1804
      - abracon,ab1805
      - microcrystal,rv1805

  reg:
    maxItems: 1

  interrupts:
    maxItems: 1

  abracon,tc-diode:
    description:
      渗漏充电二极管类型
      需要启用以给备用电池充电
      支持的有标准二极管（0.6V 电压降）和肖特基二极管（0.3V 电压降）
    $ref: /schemas/types.yaml#/definitions/string
    enum:
      - standard
      - schottky

  abracon,tc-resistor:
    description:
      渗漏充电电阻值（千欧姆）
      需要启用以给备用电池充电
    $ref: /schemas/types.yaml#/definitions/uint32
    enum: [0, 3, 6, 11]

dependentRequired:
  abracon,tc-diode: ["abracon,tc-resistor"]
  abracon,tc-resistor: ["abracon,tc-diode"]

required:
  - compatible
  - reg

allOf:
  - $ref: rtc.yaml#
  - if:
      properties:
        compatible:
          not:
            contains:
              enum:
                - abracon,abx80x
                - abracon,ab0804
                - abracon,ab1804
                - abracon,ab0805
                - abracon,ab1805
    then:
      properties:
        abracon,tc-diode: false
        abracon,tc-resistor: false

unevaluatedProperties: false

examples:
  - |
    #include <dt-bindings/interrupt-controller/irq.h>

    i2c {
        #address-cells = <1>;
        #size-cells = <0>;

        rtc@69 {
            compatible = "abracon,abx80x";
            reg = <0x69>;
            abracon,tc-diode = "schottky";
            abracon,tc-resistor = <3>;
            interrupts = <44 IRQ_TYPE_EDGE_FALLING>;
        };
    };
```

请注意，上述翻译尽量保持了 YAML 结构的原貌，仅对文本描述部分进行了翻译。
~~~~

## Documentation/devicetree/bindings/rtc/adi,max31335_cn.yaml
~~~~yaml
```yaml
# SPDX-文件许可标识: GPL-2.0-only 或 BSD-2-Clause
%YAML 1.2
---
$id: http://devicetree.org/schemas/rtc/adi,max31335.yaml#
$schema: http://devicetree.org/meta-schemas/core.yaml#

title: Analog Devices MAX31335 实时时钟

maintainers:
  - Antoniu Miclaus <antoniu.miclaus@analog.com>

description:
  Analog Devices MAX31335 I2C 实时时钟 ±2ppm 汽车级实时时钟，内置 MEMS 谐振器
allOf:
  - $ref: rtc.yaml#

properties:
  compatible:
    const: adi,max31335

  reg:
    maxItems: 1

  interrupts:
    maxItems: 1

  "#clock-cells":
    description:
      实时时钟可以通过其时钟输出引脚用作时钟源
    const: 0

  adi,tc-diode:
    description:
      选择涓流充电器的二极管配置
    schottky - 串联的肖特基二极管
    standard+schottky - 标准二极管 + 串联的肖特基二极管
    enum: [schottky, standard+schottky]

  trickle-resistor-ohms:
    description:
      选择用于涓流充电器的电阻。如果要启用涓流充电器，则应指定该值
    enum: [3000, 6000, 11000]

required:
  - compatible
  - reg

unevaluatedProperties: false

examples:
  - |
    #include <dt-bindings/interrupt-controller/irq.h>
    i2c {
        #address-cells = <1>;
        #size-cells = <0>;

        rtc@68 {
            compatible = "adi,max31335";
            reg = <0x68>;
            pinctrl-0 = <&rtc_nint_pins>;
            interrupts-extended = <&gpio1 16 IRQ_TYPE_LEVEL_HIGH>;
            aux-voltage-chargeable = <1>;
            trickle-resistor-ohms = <6000>;
            adi,tc-diode = "schottky";
        };
    };
```

请注意，上述翻译中的 `aux-voltage-chargeable` 在原始 YAML 示例中未定义描述，因此在翻译中保留了英文原词，并且在实际使用中可能需要根据上下文或具体文档来确定其含义。此外，某些术语如 `pinctrl-0` 和 `interrupts-extended` 等保持了英文原词，这是因为这些术语在特定技术文档和代码中通常使用英文表示。
~~~~

## Documentation/devicetree/bindings/rtc/allwinner,sun4i-a10-rtc_cn.yaml
```yaml
# SPDX-许可证标识符: GPL-2.0
%YAML 1.2
---
$id: http://devicetree.org/schemas/rtc/allwinner,sun4i-a10-rtc.yaml#
$schema: http://devicetree.org/meta-schemas/core.yaml#

标题: Allwinner A10 实时时钟 (RTC)

全部满足以下条件:
  - $ref: rtc.yaml#

维护者:
  - 陈宇 蔡 <wens@csie.org>
  - 马克西姆·里帕德 <mripard@kernel.org>

属性:
  compatible:
    枚举:
      - allwinner,sun4i-a10-rtc
      - allwinner,sun7i-a20-rtc

  reg:
    最大项目数: 1

  interrupts:
    最大项目数: 1

必需的:
  - compatible
  - reg
  - interrupts

额外属性: false

示例:
  - |
    rtc: rtc@1c20d00 {
        compatible = "allwinner,sun4i-a10-rtc";
        reg = <0x01c20d00 0x20>;
        interrupts = <24>;
    };
```

## Documentation/devicetree/bindings/rtc/allwinner,sun6i-a31-rtc_cn.yaml
```yaml
以下是提供的 YAML 文件的中文翻译：

# SPDX 许可证标识符: GPL-2.0
%YAML 1.2
---
$id: http://devicetree.org/schemas/rtc/allwinner,sun6i-a31-rtc.yaml#
$schema: http://devicetree.org/meta-schemas/core.yaml#

title: Allwinner A31 实时时钟 (RTC)

maintainers:
  - 陈宇 蔡 <wens@csie.org>
  - 马西姆·里帕德 <mripard@kernel.org>

properties:
  "#clock-cells":
    const: 1

  compatible:
    oneOf:
      - enum:
          - allwinner,sun6i-a31-rtc
          - allwinner,sun8i-a23-rtc
          - allwinner,sun8i-h3-rtc
          - allwinner,sun8i-r40-rtc
          - allwinner,sun8i-v3-rtc
          - allwinner,sun50i-h5-rtc
          - allwinner,sun50i-h6-rtc
          - allwinner,sun50i-h616-rtc
          - allwinner,sun50i-r329-rtc
      - items:
          - const: allwinner,sun50i-a64-rtc
          - const: allwinner,sun8i-h3-rtc
      - items:
          - const: allwinner,sun20i-d1-rtc
          - const: allwinner,sun50i-r329-rtc

  reg:
    maxItems: 1

  interrupts:
    minItems: 1
    items:
      - description: RTC 报警 0
      - description: RTC 报警 1

  clocks:
    minItems: 1
    maxItems: 4

  clock-names:
    minItems: 1
    maxItems: 4

  clock-output-names:
    minItems: 1
    maxItems: 3
    description:
      RTC 提供多达三个时钟输出：
        - 低频振荡器（LOSC），索引为 0，
        - 低频振荡器外部输出（X32KFOUT 在数据手册中），索引为 1，
        - 内部振荡器，索引为 2
allOf:
  - $ref: rtc.yaml#
  - if:
      properties:
        compatible:
          contains:
            const: allwinner,sun6i-a31-rtc

    then:
      properties:
        clock-output-names:
          maxItems: 1

  - if:
      properties:
        compatible:
          contains:
            enum:
              - allwinner,sun8i-a23-rtc
              - allwinner,sun8i-r40-rtc
              - allwinner,sun8i-v3-rtc

    then:
      properties:
        clock-output-names:
          minItems: 2
          maxItems: 2

  - if:
      properties:
        compatible:
          contains:
            enum:
              - allwinner,sun8i-h3-rtc
              - allwinner,sun50i-h5-rtc
              - allwinner,sun50i-h6-rtc

    then:
      properties:
        clock-output-names:
          minItems: 3

  - if:
      properties:
        compatible:
          contains:
            const: allwinner,sun50i-h616-rtc

    then:
      properties:
        clocks:
          items:
            - description: 寄存器访问的总线时钟
            - description: 24 MHz 振荡器
            - description: 来自 CCU 的 32 kHz 时钟

        clock-names:
          items:
            - const: bus
            - const: hosc
            - const: pll-32k

      required:
        - clocks
        - clock-names

  - if:
      properties:
        compatible:
          contains:
            const: allwinner,sun50i-r329-rtc

    then:
      properties:
        clocks:
          minItems: 3
          items:
            - description: 寄存器访问的总线时钟
            - description: 24 MHz 振荡器
            - description: 用于内部 SPI 时钟的 AHB 父时钟
            - description: 外部 32768 Hz 振荡器

        clock-names:
          minItems: 3
          items:
            - const: bus
            - const: hosc
            - const: ahb
            - const: ext-osc32k

      required:
        - clocks
        - clock-names

  - if:
      properties:
        compatible:
          contains:
            enum:
              - allwinner,sun8i-r40-rtc
              - allwinner,sun50i-h616-rtc
              - allwinner,sun50i-r329-rtc

    then:
      properties:
        interrupts:
          maxItems: 1

    else:
      properties:
        interrupts:
          minItems: 2

required:
  - "#clock-cells"
  - compatible
  - reg
  - interrupts

additionalProperties: false

examples:
  - |
    rtc: rtc@1f00000 {
        compatible = "allwinner,sun6i-a31-rtc";
        reg = <0x01f00000 0x400>;
        interrupts = <0 40 4>, <0 41 4>;
        clock-output-names = "osc32k";
        clocks = <&ext_osc32k>;
        #clock-cells = <1>;
    };

..
```
