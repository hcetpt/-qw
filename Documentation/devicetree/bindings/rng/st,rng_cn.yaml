## Documentation/devicetree/bindings/rtc/alphascale,asm9260-rtc_cn.yaml
~~~~yaml
```yaml
# SPDX-许可证标识符: (GPL-2.0 或 BSD-2-Clause)
%YAML 1.2
---
$id: http://devicetree.org/schemas/rtc/alphascale,asm9260-rtc.yaml#
$schema: http://devicetree.org/meta-schemas/core.yaml#

title: Alphascale asm9260 系统实时钟

maintainers:
  - Javier Carrasco <javier.carrasco.cruz@gmail.com>

allOf:
  - $ref: rtc.yaml#

properties:
  compatible:
    const: alphascale,asm9260-rtc

  reg:
    maxItems: 1

  clocks:
    maxItems: 1

  clock-names:
    const: ahb

  interrupts:
    maxItems: 1

required:
  - compatible
  - reg
  - clocks
  - clock-names
  - interrupts

unevaluatedProperties: false

examples:
  - |
    #include <dt-bindings/clock/alphascale,asm9260.h>

    rtc@800a0000 {
        compatible = "alphascale,asm9260-rtc";
        reg = <0x800a0000 0x100>;
        clocks = <&acc CLKID_AHB_RTC>;
        clock-names = "ahb";
        interrupts = <2>;
    };
```

这段 YAML 文件定义了一个设备树的模式，用于描述 Alphascale asm9260 系统芯片中的实时钟（RTC）。此文件指定了 RTC 节点的兼容性、寄存器地址、时钟源、时钟名称和中断等属性，并提供了一个使用示例。
~~~~

## Documentation/devicetree/bindings/rtc/amlogic,meson-vrtc_cn.yaml
```yaml
# SPDX-许可证标识符: (GPL-2.0-only 或 BSD-2-Clause)
%YAML 1.2
---
$id: http://devicetree.org/schemas/rtc/amlogic,meson-vrtc.yaml#
$schema: http://devicetree.org/meta-schemas/core.yaml#

标题: Amlogic 虚拟实时时钟 (VRTC)

维护者:
  - Neil Armstrong <neil.armstrong@linaro.org>

描述: |
  这是一个Linux接口，用于与由固件管理的实时时钟（RTC）进行交互，因此从Linux的角度来看它是虚拟的。该接口包含一个寄存器，在该寄存器中写入闹钟时间（以秒为单位）。
闹钟寄存器是一个简单的共享暂存寄存器，用于应用程序处理器（AP）和安全协处理器（SCP）之间。当AP挂起时，SCP将使用此寄存器的值来配置一个始终开启的计时器，然后进入睡眠状态。当计时器到期时，SCP会唤醒，并随后唤醒AP。
allOf:
  - $ref: rtc.yaml#

属性:
  compatible:
    枚举:
      - amlogic,meson-vrtc

  reg:
    最大项数: 1

必需:
  - compatible
  - reg

额外属性: false

示例:
  - |
    rtc@a8 {
      compatible = "amlogic,meson-vrtc";
      reg = <0x000a8 0x4>;
    };
```

## Documentation/devicetree/bindings/rtc/amlogic,meson6-rtc_cn.yaml
```yaml
# SPDX-许可证标识符: (GPL-2.0-only 或 BSD-2-Clause)
%YAML 1.2
---
$id: http://devicetree.org/schemas/rtc/amlogic,meson6-rtc.yaml#
$schema: http://devicetree.org/meta-schemas/core.yaml#

标题: Amlogic Meson6、Meson8、Meson8b 和 Meson8m2 实时时钟 (RTC)

维护者:
  - Neil Armstrong <neil.armstrong@linaro.org>
  - Martin Blumenstingl <martin.blumenstingl@googlemail.com>

allOf:
  - $ref: rtc.yaml#
  - $ref: /schemas/nvmem/nvmem.yaml#
  - $ref: /schemas/nvmem/nvmem-deprecated-cells.yaml#

属性:
  compatible:
    枚举:
      - amlogic,meson6-rtc
      - amlogic,meson8-rtc
      - amlogic,meson8b-rtc
      - amlogic,meson8m2-rtc

  reg:
    最大项数: 1

  clocks:
    最大项数: 1

  interrupts:
    最大项数: 1

  resets:
    最大项数: 1

  vdd-supply: 真

必需:
  - compatible
  - reg

未评估的属性: 假

示例:
  - |
    #include <dt-bindings/interrupt-controller/irq.h>
    #include <dt-bindings/interrupt-controller/arm-gic.h>
    rtc: rtc@740 {
        compatible = "amlogic,meson6-rtc";
        reg = <0x740 0x14>;
        interrupts = <GIC_SPI 72 IRQ_TYPE_EDGE_RISING>;
        clocks = <&rtc32k_xtal>;
        vdd-supply = <&rtc_vdd>;
        resets = <&reset_rtc>;
        #address-cells = <1>;
        #size-cells = <1>;

        mac@0 {
            reg = <0 6>;
        };
    };
```

## Documentation/devicetree/bindings/rtc/arm,pl031_cn.yaml
~~~~yaml
```yaml
# SPDX-许可证标识符: (GPL-2.0-only 或 BSD-2-Clause)
%YAML 1.2
---
$id: http://devicetree.org/schemas/rtc/arm,pl031.yaml#
$schema: http://devicetree.org/meta-schemas/core.yaml#

title: Arm Primecell PL031 实时时钟

select:
  properties:
    compatible:
      contains:
        const: arm,pl031
  required:
    - compatible

allOf:
  - $ref: rtc.yaml#

maintainers:
  - Rob Herring <robh@kernel.org>

properties:
  compatible:
    items:
      - const: arm,pl031
      - const: arm,primecell

  reg:
    maxItems: 1

  interrupts:
    maxItems: 1

  clocks:
    maxItems: 1

  clock-names:
    maxItems: 1

  start-year: true

required:
  - compatible
  - reg
  - clocks
  - clock-names

additionalProperties: false

examples:
  - |
    rtc@10017000 {
        compatible = "arm,pl031", "arm,primecell";
        reg = <0x10017000 0x1000>;
        clocks = <&pclk>;
        clock-names = "apb_pclk";
    };
```

请注意，`start-year` 属性在上述 YAML 文件中未被详细定义，如果需要使用它，需要根据实际的设备树规范来添加其描述。此外，“maxItems: 1”意味着这些属性（如 `reg`, `interrupts`, `clocks`, `clock-names`）最多只能出现一次。
~~~~

## Documentation/devicetree/bindings/rtc/atmel,at91sam9260-rtt_cn.yaml
```yaml
下面是给定内容的中文翻译：

# SPDX-文件许可标识符: (GPL-2.0-only 或 BSD-2-Clause)
# 版权所有 (C) 2022 Microchip Technology Inc. 及其子公司
%YAML 1.2
---
$id: http://devicetree.org/schemas/rtc/atmel,at91sam9260-rtt.yaml#
$schema: http://devicetree.org/meta-schemas/core.yaml#

标题: Atmel AT91 RTT

allOf:
  - $ref: rtc.yaml#

维护者:
  - Alexandre Belloni <alexandre.belloni@bootlin.com>

属性:
  compatible:
    oneOf:
      - items:
          - const: atmel,at91sam9260-rtt
      - items:
          - enum:
              - microchip,sam9x60-rtt
              - microchip,sam9x7-rtt
          - const: atmel,at91sam9260-rtt
      - items:
          - const: microchip,sama7g5-rtt
          - const: microchip,sam9x60-rtt
          - const: atmel,at91sam9260-rtt

  reg:
    maxItems: 1

  interrupts:
    maxItems: 1

  clocks:
    maxItems: 1

  atmel,rtt-rtc-time-reg:
    $ref: /schemas/types.yaml#/definitions/phandle-array
    items:
      - items:
          - 描述: 指向 GPBR 节点的 phandle
          - 描述: 在 GPBR 块内的偏移量
描述:
      应当编码用于存储 RTT 作为 RTC 使用时的时间基准的 GPBR 寄存器。第一个单元应当指向 GPBR 节点，第二个单元编码了在 GPBR 块内的偏移量（或者说，用于存储时间基准的 GPBR 寄存器）
所需:
  - compatible
  - reg
  - interrupts
  - clocks
  - atmel,rtt-rtc-time-reg

未评估属性: false

示例:
  - |
    #include <dt-bindings/interrupt-controller/irq.h>

    rtc@fffffd20 {
        compatible = "atmel,at91sam9260-rtt";
        reg = <0xfffffd20 0x10>;
        interrupts = <1 IRQ_TYPE_LEVEL_HIGH 7>;
        clocks = <&clk32k>;
        atmel,rtt-rtc-time-reg = <&gpbr 0x0>;
    };
```

## Documentation/devicetree/bindings/rtc/brcm,brcmstb-waketimer_cn.yaml
```yaml
# SPDX-许可证标识符: (GPL-2.0-only 或 BSD-2-Clause)
%YAML 1.2
---
$id: http://devicetree.org/schemas/rtc/brcm,brcmstb-waketimer.yaml#
$schema: http://devicetree.org/meta-schemas/core.yaml#

title: Broadcom STB 唤醒计时器

maintainers:
  - Florian Fainelli <f.fainelli@gmail.com>

description:
  Broadcom STB 唤醒计时器提供了一个具有 27MHz 分辨率的计时器，具备从低功耗挂起/待机模式唤醒系统的能力，并可选地生成 RTC 报警中断。
allOf:
  - $ref: rtc.yaml#

properties:
  compatible:
    const: brcm,brcmstb-waketimer

  reg:
    maxItems: 1

  interrupts:
    minItems: 1
    items:
      - description: TIMER 中断
      - description: ALARM 中断
    description:
      TIMER 中断会从低功耗挂起/待机模式唤醒系统。可指定 ALARM 中断，在 RTC 报警被启用时中断 CPU。
clocks:
    description: 在 27MHz 域中的时钟参考
    maxItems: 1

additionalProperties: false

examples:
  - |
    rtc@f041a080 {
        compatible = "brcm,brcmstb-waketimer";
        reg = <0xf041a080 0x14>;
        interrupts-extended = <&aon_pm_l2_intc 0x04>,
                              <&upg_aux_aon_intr2_intc 0x08>;
        clocks = <&upg_fixed>;
    };
```

## Documentation/devicetree/bindings/rtc/cdns,rtc_cn.txt
~~~~
### Cadence 实时钟

带有日期、时间和报警功能的 Cadence RTC 控制器  
报警可以将系统从低功耗状态唤醒  
**必需的属性：**
- compatible（兼容性）: 应为 "cdns,rtc-r109v3"
- reg（寄存器）: 指定寄存器区域的基本物理地址和大小
- interrupts（中断）: 单个中断指定符
- clocks（时钟）: 必须包含两个条目：
    - pclk: APB 寄存器时钟
    - ref_clk: 参考 1Hz 或 100Hz 时钟，具体取决于 IP 配置
   更多详情请参阅 ../clocks/clock-bindings.txt

**示例：**
```plaintext
rtc0: rtc@fd080000 { 
	compatible = "cdns,rtc-r109v3"; 
	reg = <0xfd080000 0x1000>; 

	clock-names = "pclk", "ref_clk"; 
	clocks = <&sysclock>, <&refclock>; 

	interrupt-parent = <&gic>; 
	interrupts = <0 6 IRQ_TYPE_LEVEL_HIGH>; 
};
```
以上是 Cadence RTC 控制器配置的一个示例。
~~~~

## Documentation/devicetree/bindings/rtc/cirrus,ep9301-rtc_cn.yaml
~~~~yaml
```yaml
# SPDX-许可证标识符: (GPL-2.0-only 或 BSD-2-Clause)
%YAML 1.2
---
$id: http://devicetree.org/schemas/rtc/cirrus,ep9301-rtc.yaml#
$schema: http://devicetree.org/meta-schemas/core.yaml#

title: Cirrus EP93xx 实时时钟控制器

maintainers:
  - Hartley Sweeten <hsweeten@visionengravers.com>
  - Alexander Sverdlin <alexander.sverdlin@gmail.com>

allOf:
  - $ref: rtc.yaml#

properties:
  compatible:
    oneOf:
      - const: cirrus,ep9301-rtc
      - items:
          - enum:
              - cirrus,ep9302-rtc
              - cirrus,ep9307-rtc
              - cirrus,ep9312-rtc
              - cirrus,ep9315-rtc
          - const: cirrus,ep9301-rtc

  reg:
    maxItems: 1

required:
  - compatible
  - reg

unevaluatedProperties: false

examples:
  - |
    rtc@80920000 {
        compatible = "cirrus,ep9301-rtc";
        reg = <0x80920000 0x100>;
    };
```

请注意，某些关键字如 `const`, `oneOf`, `items`, `enum`, `maxItems`, `required`, 和 `unevaluatedProperties` 保持英文状态，因为这些是 YAML 和 JSON Schema 的规范术语。
~~~~

## Documentation/devicetree/bindings/rtc/cpcap-rtc_cn.txt
~~~~
这是CPCAP模块的一部分。关于整个芯片的更多详细信息，请参阅 `Documentation/devicetree/bindings/mfd/motorola-cpcap.txt`。
所需节点属性：
- compatible（兼容性）：应当包含"motorola,cpcap-rtc"
- interrupts（中断）：为报警和1 Hz中断提供中断指定

示例：

```dt
&cpcap { // 这里的"&"表示该节点在设备树中的标识符
	cpcap_rtc: rtc { // rtc是这个RTC模块的标签
		compatible = "motorola,cpcap-rtc"; // 兼容性字符串
		interrupts = <39 IRQ_TYPE_NONE>, <26 IRQ_TYPE_NONE>; // 中断配置，39号和26号中断，类型为无
	};
};
```
此示例展示了如何在设备树中定义一个与Motorola CPCAP PMIC RTC模块相关的节点。
~~~~

## Documentation/devicetree/bindings/rtc/dallas,ds1390_cn.txt
~~~~
* Dallas DS1390    SPI 串行实时钟

必需属性：
- compatible: 应包含 "dallas,ds1390"
- reg: 芯片的 SPI 地址

可选属性：
- trickle-resistor-ohms : 为涓流充电器选择的电阻值
    对于 ds1390 可用的值为 250、2000、4000
    如果要启用涓流充电器，则应给出该值
- trickle-diode-disable : 不使用内部的涓流充电二极管
    如果需要禁用内部的涓流充电二极管，则应给出此选项

示例：
```
ds1390: rtc@0 {
    compatible = "dallas,ds1390";
    trickle-resistor-ohms = <250>;
    reg = <0>;
};
```
~~~~

## Documentation/devicetree/bindings/rtc/epson,rtc7301_cn.yaml
~~~~yaml
```yaml
# SPDX-许可证标识符: (GPL-2.0-only 或 BSD-2-Clause)
%YAML 1.2
---
$id: http://devicetree.org/schemas/rtc/epson,rtc7301.yaml#
$schema: http://devicetree.org/meta-schemas/core.yaml#

title: Epson Toyocom RTC-7301SF/DG

description:
  这两种变体之间的唯一区别在于封装形式。
  DG变体采用DIL封装，而SF变体采用扁平封装。
maintainers:
  - Akinobu Mita <akinobu.mita@gmail.com>

properties:
  compatible:
    enum:
      - epson,rtc7301dg
      - epson,rtc7301sf

  reg:
    maxItems: 1

  reg-io-width:
    description:
      应对设备执行的IO访问的大小（以字节为单位）
    enum: [1, 4]
    default: 4

  interrupts:
    maxItems: 1

required:
  - compatible
  - reg

additionalProperties: false

examples:
  - |
    #include <dt-bindings/interrupt-controller/irq.h>
    rtc: rtc@44a00000 {
        compatible = "epson,rtc7301dg";
        reg = <0x44a00000 0x10000>;
        reg-io-width = <4>;
        interrupt-parent = <&axi_intc_0>;
        interrupts = <3 2>;
    };
```

以上是将给定的 YAML 文件翻译成中文。请注意，某些专有名词和技术术语保持原样，以避免翻译误差。
~~~~

## Documentation/devicetree/bindings/rtc/epson,rx6110_cn.txt
```
Epson RX6110 实时时钟
============================

Epson RX6110 可以使用 SPI 或 I2C 总线。所使用的总线类型取决于 SPISEL 引脚，并且不能通过软件进行配置。

I2C 模式
--------

必需属性：
  - compatible: 应为 "epson,rx6110"
  - reg : 设备的 I2C 地址

示例：

    rtc: rtc@32 {
        compatible = "epson,rx6110";
        reg = <0x32>;
    };

SPI 模式
--------

必需属性：
  - compatible: 应为 "epson,rx6110"
  - reg: 芯片选择编号
  - spi-cs-high: RX6110 需要高电平的芯片选择信号
  - spi-cpha: RX6110 使用 SPI 时钟相位偏移
  - spi-cpol: RX6110 使用 SPI 逆向时钟极性

示例：

    rtc: rtc@3 {
        compatible = "epson,rx6110";
        reg = <3>;
        spi-cs-high;
        spi-cpha;
        spi-cpol;
    };
```

## Documentation/devicetree/bindings/rtc/epson,rx8900_cn.yaml
~~~~yaml
```yaml
# SPDX-许可证标识符: (GPL-2.0-only 或 BSD-2-Clause)
%YAML 1.2
---
$id: http://devicetree.org/schemas/rtc/epson,rx8900.yaml#
$schema: http://devicetree.org/meta-schemas/core.yaml#

title: EPSON RX8900 / Microcrystal RV8803 实时时钟

maintainers:
  - Marek Vasut <marex@denx.de>

allOf:
  - $ref: rtc.yaml#

properties:
  compatible:
    enum:
      - epson,rx8804
      - epson,rx8900
      - microcrystal,rv8803

  reg:
    maxItems: 1

  epson,vdet-disable:
    type: 布尔
    description: |
      禁用电压检测器。如果没有使用备用电池，则应设置此属性。

  wakeup-source: true

required:
  - compatible
  - reg

additionalProperties: false

examples:
  - |
    i2c {
        #address-cells = <1>;
        #size-cells = <0>;

        rtc@32 {
            compatible = "epson,rx8900";
            reg = <0x32>;
            epson,vdet-disable;
            trickle-diode-disable;
        };
    };
```

请注意，`trickle-diode-disable: true` 在原始 YAML 中并未定义为一个属性，所以我未将其直接翻译到中文版本中。如果需要包含这个属性，请确保在描述部分添加相应的中文说明。另外，“布尔”类型在这里直接被翻译为“布尔”，但实际上更常见的中文表述可能是“布尔值”或“逻辑值”。
~~~~

## Documentation/devicetree/bindings/rtc/faraday,ftrtc010_cn.yaml
~~~~yaml
```yaml
# SPDX-许可证标识符: (GPL-2.0-only 或 BSD-2-Clause)
%YAML 1.2
---
$id: http://devicetree.org/schemas/rtc/faraday,ftrtc010.yaml#
$schema: http://devicetree.org/meta-schemas/core.yaml#

title: Faraday Technology FTRTC010 实时时钟

maintainers:
  - Linus Walleij <linus.walleij@linaro.org>

description: |
  这种实时时钟出现在例如 Storlink Gemini 系列系统级芯片中。
properties:
  compatible:
    oneOf:
      - const: faraday,ftrtc010
      - items:
          - const: cortina,gemini-rtc
          - const: faraday,ftrtc010

  resets:
    maxItems: 1

  reg:
    maxItems: 1

  interrupts:
    maxItems: 1

  clocks:
    items:
      - description: PCLK 时钟
      - description: EXTCLK 时钟。Faraday 称之为 CLK1HZ 并说时钟应为 1 Hz，但实际实施者似乎在这里选择了不同的时钟，例如 Cortina 选择了 32768 Hz（一种典型的低功耗时钟）
clock-names:
    items:
      - const: PCLK
      - const: EXTCLK

required:
  - compatible

additionalProperties: false

examples:
  - |
    #include <dt-bindings/interrupt-controller/irq.h>
    rtc@45000000 {
      compatible = "cortina,gemini-rtc", "faraday,ftrtc010";
      reg = <0x45000000 0x100>;
      interrupts = <17 IRQ_TYPE_LEVEL_HIGH>;
      clocks = <&foo 0>, <&foo 1>;
      clock-names = "PCLK", "EXTCLK";
    };
```
以上是您提供的 YAML 文件的中文翻译。注意，由于 YAML 是一种数据格式，并且通常与代码一起使用，因此在进行翻译时保持了其原有的结构和语法。
~~~~
